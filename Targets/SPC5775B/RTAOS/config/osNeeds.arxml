AUTOSAR XML (schema 4-0-3)
package /ETAS_Project/EcucModuleConfigurationValuess
  module config Os
    RTE_RESOURCE (OsResource): OsResourceProperty=STANDARD
    9 x OsTask, all with OsTaskSchedule=FULL, OsTaskActivation=1, OsTaskResourceRef=RTE_RESOURCE:
      ASW_OsTask_10ms: OsTaskPriority=23
      ASW_OsTask_5ms: OsTaskPriority=25
      ASW_OsTask_2ms: OsTaskPriority=27
      ASW_OsTask_1ms: OsTaskPriority=29
      BSW_OsTask_50ms: OsTaskPriority=22
      BSW_OsTask_10ms: OsTaskPriority=24
      BSW_OsTask_5ms: OsTaskPriority=26
      BSW_OsTask_2ms: OsTaskPriority=28
      BSW_OsTask_1ms: OsTaskPriority=30
    Rte_TickCounter (OsCounter): OsCounterMaxAllowedValue=65535, OsCounterMinCycle=1, OsCounterTicksPerBase=1, OsCounterType=SOFTWARE
    Rte_ScheduleTable (OsScheduleTable): OsScheduleTableRepeating=true, OsScheduleTableDuration=50, OsScheduleTableCounterRef=Rte_TickCounter
      50 x OsScheduleTableExpiryPoint:
        rte_Stimulus_1: OsScheduleTblExpPointOffset=0
          9 x OsScheduleTableTaskActivation:
            TaskActivation1: OsScheduleTableActivateTaskRef=ASW_OsTask_10ms
            TaskActivation2: OsScheduleTableActivateTaskRef=ASW_OsTask_1ms
            TaskActivation3: OsScheduleTableActivateTaskRef=ASW_OsTask_2ms
            TaskActivation4: OsScheduleTableActivateTaskRef=ASW_OsTask_5ms
            TaskActivation5: OsScheduleTableActivateTaskRef=BSW_OsTask_10ms
            TaskActivation6: OsScheduleTableActivateTaskRef=BSW_OsTask_1ms
            TaskActivation7: OsScheduleTableActivateTaskRef=BSW_OsTask_2ms
            TaskActivation8: OsScheduleTableActivateTaskRef=BSW_OsTask_50ms
            TaskActivation9: OsScheduleTableActivateTaskRef=BSW_OsTask_5ms
        rte_Stimulus_2: OsScheduleTblExpPointOffset=1
          TaskActivation1 (OsScheduleTableTaskActivation): OsScheduleTableActivateTaskRef=ASW_OsTask_1ms
          TaskActivation2 (OsScheduleTableTaskActivation): OsScheduleTableActivateTaskRef=BSW_OsTask_1ms
        rte_Stimulus_3: OsScheduleTblExpPointOffset=2
          4 x OsScheduleTableTaskActivation:
            TaskActivation1: OsScheduleTableActivateTaskRef=ASW_OsTask_1ms
            TaskActivation2: OsScheduleTableActivateTaskRef=ASW_OsTask_2ms
            TaskActivation3: OsScheduleTableActivateTaskRef=BSW_OsTask_1ms
            TaskActivation4: OsScheduleTableActivateTaskRef=BSW_OsTask_2ms
        rte_Stimulus_4: OsScheduleTblExpPointOffset=3
          TaskActivation1 (OsScheduleTableTaskActivation): OsScheduleTableActivateTaskRef=ASW_OsTask_1ms
          TaskActivation2 (OsScheduleTableTaskActivation): OsScheduleTableActivateTaskRef=BSW_OsTask_1ms
        rte_Stimulus_5: OsScheduleTblExpPointOffset=4
          4 x OsScheduleTableTaskActivation:
            TaskActivation1: OsScheduleTableActivateTaskRef=ASW_OsTask_1ms
            TaskActivation2: OsScheduleTableActivateTaskRef=ASW_OsTask_2ms
            TaskActivation3: OsScheduleTableActivateTaskRef=BSW_OsTask_1ms
            TaskActivation4: OsScheduleTableActivateTaskRef=BSW_OsTask_2ms
        rte_Stimulus_6: OsScheduleTblExpPointOffset=5
          4 x OsScheduleTableTaskActivation:
            TaskActivation1: OsScheduleTableActivateTaskRef=ASW_OsTask_1ms
            TaskActivation2: OsScheduleTableActivateTaskRef=ASW_OsTask_5ms
            TaskActivation3: OsScheduleTableActivateTaskRef=BSW_OsTask_1ms
            TaskActivation4: OsScheduleTableActivateTaskRef=BSW_OsTask_5ms
        rte_Stimulus_7: OsScheduleTblExpPointOffset=6
          4 x OsScheduleTableTaskActivation:
            TaskActivation1: OsScheduleTableActivateTaskRef=ASW_OsTask_1ms
            TaskActivation2: OsScheduleTableActivateTaskRef=ASW_OsTask_2ms
            TaskActivation3: OsScheduleTableActivateTaskRef=BSW_OsTask_1ms
            TaskActivation4: OsScheduleTableActivateTaskRef=BSW_OsTask_2ms
        rte_Stimulus_8: OsScheduleTblExpPointOffset=7
          TaskActivation1 (OsScheduleTableTaskActivation): OsScheduleTableActivateTaskRef=ASW_OsTask_1ms
          TaskActivation2 (OsScheduleTableTaskActivation): OsScheduleTableActivateTaskRef=BSW_OsTask_1ms
        rte_Stimulus_9: OsScheduleTblExpPointOffset=8
          4 x OsScheduleTableTaskActivation:
            TaskActivation1: OsScheduleTableActivateTaskRef=ASW_OsTask_1ms
            TaskActivation2: OsScheduleTableActivateTaskRef=ASW_OsTask_2ms
            TaskActivation3: OsScheduleTableActivateTaskRef=BSW_OsTask_1ms
            TaskActivation4: OsScheduleTableActivateTaskRef=BSW_OsTask_2ms
        rte_Stimulus_10: OsScheduleTblExpPointOffset=9
          TaskActivation1 (OsScheduleTableTaskActivation): OsScheduleTableActivateTaskRef=ASW_OsTask_1ms
          TaskActivation2 (OsScheduleTableTaskActivation): OsScheduleTableActivateTaskRef=BSW_OsTask_1ms
        rte_Stimulus_11: OsScheduleTblExpPointOffset=10
          8 x OsScheduleTableTaskActivation:
            TaskActivation1: OsScheduleTableActivateTaskRef=ASW_OsTask_10ms
            TaskActivation2: OsScheduleTableActivateTaskRef=ASW_OsTask_1ms
            TaskActivation3: OsScheduleTableActivateTaskRef=ASW_OsTask_2ms
            TaskActivation4: OsScheduleTableActivateTaskRef=ASW_OsTask_5ms
            TaskActivation5: OsScheduleTableActivateTaskRef=BSW_OsTask_10ms
            TaskActivation6: OsScheduleTableActivateTaskRef=BSW_OsTask_1ms
            TaskActivation7: OsScheduleTableActivateTaskRef=BSW_OsTask_2ms
            TaskActivation8: OsScheduleTableActivateTaskRef=BSW_OsTask_5ms
        rte_Stimulus_12: OsScheduleTblExpPointOffset=11
          TaskActivation1 (OsScheduleTableTaskActivation): OsScheduleTableActivateTaskRef=ASW_OsTask_1ms
          TaskActivation2 (OsScheduleTableTaskActivation): OsScheduleTableActivateTaskRef=BSW_OsTask_1ms
        rte_Stimulus_13: OsScheduleTblExpPointOffset=12
          4 x OsScheduleTableTaskActivation:
            TaskActivation1: OsScheduleTableActivateTaskRef=ASW_OsTask_1ms
            TaskActivation2: OsScheduleTableActivateTaskRef=ASW_OsTask_2ms
            TaskActivation3: OsScheduleTableActivateTaskRef=BSW_OsTask_1ms
            TaskActivation4: OsScheduleTableActivateTaskRef=BSW_OsTask_2ms
        rte_Stimulus_14: OsScheduleTblExpPointOffset=13
          TaskActivation1 (OsScheduleTableTaskActivation): OsScheduleTableActivateTaskRef=ASW_OsTask_1ms
          TaskActivation2 (OsScheduleTableTaskActivation): OsScheduleTableActivateTaskRef=BSW_OsTask_1ms
        rte_Stimulus_15: OsScheduleTblExpPointOffset=14
          4 x OsScheduleTableTaskActivation:
            TaskActivation1: OsScheduleTableActivateTaskRef=ASW_OsTask_1ms
            TaskActivation2: OsScheduleTableActivateTaskRef=ASW_OsTask_2ms
            TaskActivation3: OsScheduleTableActivateTaskRef=BSW_OsTask_1ms
            TaskActivation4: OsScheduleTableActivateTaskRef=BSW_OsTask_2ms
        rte_Stimulus_16: OsScheduleTblExpPointOffset=15
          4 x OsScheduleTableTaskActivation:
            TaskActivation1: OsScheduleTableActivateTaskRef=ASW_OsTask_1ms
            TaskActivation2: OsScheduleTableActivateTaskRef=ASW_OsTask_5ms
            TaskActivation3: OsScheduleTableActivateTaskRef=BSW_OsTask_1ms
            TaskActivation4: OsScheduleTableActivateTaskRef=BSW_OsTask_5ms
        rte_Stimulus_17: OsScheduleTblExpPointOffset=16
          4 x OsScheduleTableTaskActivation:
            TaskActivation1: OsScheduleTableActivateTaskRef=ASW_OsTask_1ms
            TaskActivation2: OsScheduleTableActivateTaskRef=ASW_OsTask_2ms
            TaskActivation3: OsScheduleTableActivateTaskRef=BSW_OsTask_1ms
            TaskActivation4: OsScheduleTableActivateTaskRef=BSW_OsTask_2ms
        rte_Stimulus_18: OsScheduleTblExpPointOffset=17
          TaskActivation1 (OsScheduleTableTaskActivation): OsScheduleTableActivateTaskRef=ASW_OsTask_1ms
          TaskActivation2 (OsScheduleTableTaskActivation): OsScheduleTableActivateTaskRef=BSW_OsTask_1ms
        rte_Stimulus_19: OsScheduleTblExpPointOffset=18
          4 x OsScheduleTableTaskActivation:
            TaskActivation1: OsScheduleTableActivateTaskRef=ASW_OsTask_1ms
            TaskActivation2: OsScheduleTableActivateTaskRef=ASW_OsTask_2ms
            TaskActivation3: OsScheduleTableActivateTaskRef=BSW_OsTask_1ms
            TaskActivation4: OsScheduleTableActivateTaskRef=BSW_OsTask_2ms
        rte_Stimulus_20: OsScheduleTblExpPointOffset=19
          TaskActivation1 (OsScheduleTableTaskActivation): OsScheduleTableActivateTaskRef=ASW_OsTask_1ms
          TaskActivation2 (OsScheduleTableTaskActivation): OsScheduleTableActivateTaskRef=BSW_OsTask_1ms
        rte_Stimulus_21: OsScheduleTblExpPointOffset=20
          8 x OsScheduleTableTaskActivation:
            TaskActivation1: OsScheduleTableActivateTaskRef=ASW_OsTask_10ms
            TaskActivation2: OsScheduleTableActivateTaskRef=ASW_OsTask_1ms
            TaskActivation3: OsScheduleTableActivateTaskRef=ASW_OsTask_2ms
            TaskActivation4: OsScheduleTableActivateTaskRef=ASW_OsTask_5ms
            TaskActivation5: OsScheduleTableActivateTaskRef=BSW_OsTask_10ms
            TaskActivation6: OsScheduleTableActivateTaskRef=BSW_OsTask_1ms
            TaskActivation7: OsScheduleTableActivateTaskRef=BSW_OsTask_2ms
            TaskActivation8: OsScheduleTableActivateTaskRef=BSW_OsTask_5ms
        rte_Stimulus_22: OsScheduleTblExpPointOffset=21
          TaskActivation1 (OsScheduleTableTaskActivation): OsScheduleTableActivateTaskRef=ASW_OsTask_1ms
          TaskActivation2 (OsScheduleTableTaskActivation): OsScheduleTableActivateTaskRef=BSW_OsTask_1ms
        rte_Stimulus_23: OsScheduleTblExpPointOffset=22
          4 x OsScheduleTableTaskActivation:
            TaskActivation1: OsScheduleTableActivateTaskRef=ASW_OsTask_1ms
            TaskActivation2: OsScheduleTableActivateTaskRef=ASW_OsTask_2ms
            TaskActivation3: OsScheduleTableActivateTaskRef=BSW_OsTask_1ms
            TaskActivation4: OsScheduleTableActivateTaskRef=BSW_OsTask_2ms
        rte_Stimulus_24: OsScheduleTblExpPointOffset=23
          TaskActivation1 (OsScheduleTableTaskActivation): OsScheduleTableActivateTaskRef=ASW_OsTask_1ms
          TaskActivation2 (OsScheduleTableTaskActivation): OsScheduleTableActivateTaskRef=BSW_OsTask_1ms
        rte_Stimulus_25: OsScheduleTblExpPointOffset=24
          4 x OsScheduleTableTaskActivation:
            TaskActivation1: OsScheduleTableActivateTaskRef=ASW_OsTask_1ms
            TaskActivation2: OsScheduleTableActivateTaskRef=ASW_OsTask_2ms
            TaskActivation3: OsScheduleTableActivateTaskRef=BSW_OsTask_1ms
            TaskActivation4: OsScheduleTableActivateTaskRef=BSW_OsTask_2ms
        rte_Stimulus_26: OsScheduleTblExpPointOffset=25
          4 x OsScheduleTableTaskActivation:
            TaskActivation1: OsScheduleTableActivateTaskRef=ASW_OsTask_1ms
            TaskActivation2: OsScheduleTableActivateTaskRef=ASW_OsTask_5ms
            TaskActivation3: OsScheduleTableActivateTaskRef=BSW_OsTask_1ms
            TaskActivation4: OsScheduleTableActivateTaskRef=BSW_OsTask_5ms
        rte_Stimulus_27: OsScheduleTblExpPointOffset=26
          4 x OsScheduleTableTaskActivation:
            TaskActivation1: OsScheduleTableActivateTaskRef=ASW_OsTask_1ms
            TaskActivation2: OsScheduleTableActivateTaskRef=ASW_OsTask_2ms
            TaskActivation3: OsScheduleTableActivateTaskRef=BSW_OsTask_1ms
            TaskActivation4: OsScheduleTableActivateTaskRef=BSW_OsTask_2ms
        rte_Stimulus_28: OsScheduleTblExpPointOffset=27
          TaskActivation1 (OsScheduleTableTaskActivation): OsScheduleTableActivateTaskRef=ASW_OsTask_1ms
          TaskActivation2 (OsScheduleTableTaskActivation): OsScheduleTableActivateTaskRef=BSW_OsTask_1ms
        rte_Stimulus_29: OsScheduleTblExpPointOffset=28
          4 x OsScheduleTableTaskActivation:
            TaskActivation1: OsScheduleTableActivateTaskRef=ASW_OsTask_1ms
            TaskActivation2: OsScheduleTableActivateTaskRef=ASW_OsTask_2ms
            TaskActivation3: OsScheduleTableActivateTaskRef=BSW_OsTask_1ms
            TaskActivation4: OsScheduleTableActivateTaskRef=BSW_OsTask_2ms
        rte_Stimulus_30: OsScheduleTblExpPointOffset=29
          TaskActivation1 (OsScheduleTableTaskActivation): OsScheduleTableActivateTaskRef=ASW_OsTask_1ms
          TaskActivation2 (OsScheduleTableTaskActivation): OsScheduleTableActivateTaskRef=BSW_OsTask_1ms
        rte_Stimulus_31: OsScheduleTblExpPointOffset=30
          8 x OsScheduleTableTaskActivation:
            TaskActivation1: OsScheduleTableActivateTaskRef=ASW_OsTask_10ms
            TaskActivation2: OsScheduleTableActivateTaskRef=ASW_OsTask_1ms
            TaskActivation3: OsScheduleTableActivateTaskRef=ASW_OsTask_2ms
            TaskActivation4: OsScheduleTableActivateTaskRef=ASW_OsTask_5ms
            TaskActivation5: OsScheduleTableActivateTaskRef=BSW_OsTask_10ms
            TaskActivation6: OsScheduleTableActivateTaskRef=BSW_OsTask_1ms
            TaskActivation7: OsScheduleTableActivateTaskRef=BSW_OsTask_2ms
            TaskActivation8: OsScheduleTableActivateTaskRef=BSW_OsTask_5ms
        rte_Stimulus_32: OsScheduleTblExpPointOffset=31
          TaskActivation1 (OsScheduleTableTaskActivation): OsScheduleTableActivateTaskRef=ASW_OsTask_1ms
          TaskActivation2 (OsScheduleTableTaskActivation): OsScheduleTableActivateTaskRef=BSW_OsTask_1ms
        rte_Stimulus_33: OsScheduleTblExpPointOffset=32
          4 x OsScheduleTableTaskActivation:
            TaskActivation1: OsScheduleTableActivateTaskRef=ASW_OsTask_1ms
            TaskActivation2: OsScheduleTableActivateTaskRef=ASW_OsTask_2ms
            TaskActivation3: OsScheduleTableActivateTaskRef=BSW_OsTask_1ms
            TaskActivation4: OsScheduleTableActivateTaskRef=BSW_OsTask_2ms
        rte_Stimulus_34: OsScheduleTblExpPointOffset=33
          TaskActivation1 (OsScheduleTableTaskActivation): OsScheduleTableActivateTaskRef=ASW_OsTask_1ms
          TaskActivation2 (OsScheduleTableTaskActivation): OsScheduleTableActivateTaskRef=BSW_OsTask_1ms
        rte_Stimulus_35: OsScheduleTblExpPointOffset=34
          4 x OsScheduleTableTaskActivation:
            TaskActivation1: OsScheduleTableActivateTaskRef=ASW_OsTask_1ms
            TaskActivation2: OsScheduleTableActivateTaskRef=ASW_OsTask_2ms
            TaskActivation3: OsScheduleTableActivateTaskRef=BSW_OsTask_1ms
            TaskActivation4: OsScheduleTableActivateTaskRef=BSW_OsTask_2ms
        rte_Stimulus_36: OsScheduleTblExpPointOffset=35
          4 x OsScheduleTableTaskActivation:
            TaskActivation1: OsScheduleTableActivateTaskRef=ASW_OsTask_1ms
            TaskActivation2: OsScheduleTableActivateTaskRef=ASW_OsTask_5ms
            TaskActivation3: OsScheduleTableActivateTaskRef=BSW_OsTask_1ms
            TaskActivation4: OsScheduleTableActivateTaskRef=BSW_OsTask_5ms
        rte_Stimulus_37: OsScheduleTblExpPointOffset=36
          4 x OsScheduleTableTaskActivation:
            TaskActivation1: OsScheduleTableActivateTaskRef=ASW_OsTask_1ms
            TaskActivation2: OsScheduleTableActivateTaskRef=ASW_OsTask_2ms
            TaskActivation3: OsScheduleTableActivateTaskRef=BSW_OsTask_1ms
            TaskActivation4: OsScheduleTableActivateTaskRef=BSW_OsTask_2ms
        rte_Stimulus_38: OsScheduleTblExpPointOffset=37
          TaskActivation1 (OsScheduleTableTaskActivation): OsScheduleTableActivateTaskRef=ASW_OsTask_1ms
          TaskActivation2 (OsScheduleTableTaskActivation): OsScheduleTableActivateTaskRef=BSW_OsTask_1ms
        rte_Stimulus_39: OsScheduleTblExpPointOffset=38
          4 x OsScheduleTableTaskActivation:
            TaskActivation1: OsScheduleTableActivateTaskRef=ASW_OsTask_1ms
            TaskActivation2: OsScheduleTableActivateTaskRef=ASW_OsTask_2ms
            TaskActivation3: OsScheduleTableActivateTaskRef=BSW_OsTask_1ms
            TaskActivation4: OsScheduleTableActivateTaskRef=BSW_OsTask_2ms
        rte_Stimulus_40: OsScheduleTblExpPointOffset=39
          TaskActivation1 (OsScheduleTableTaskActivation): OsScheduleTableActivateTaskRef=ASW_OsTask_1ms
          TaskActivation2 (OsScheduleTableTaskActivation): OsScheduleTableActivateTaskRef=BSW_OsTask_1ms
        rte_Stimulus_41: OsScheduleTblExpPointOffset=40
          8 x OsScheduleTableTaskActivation:
            TaskActivation1: OsScheduleTableActivateTaskRef=ASW_OsTask_10ms
            TaskActivation2: OsScheduleTableActivateTaskRef=ASW_OsTask_1ms
            TaskActivation3: OsScheduleTableActivateTaskRef=ASW_OsTask_2ms
            TaskActivation4: OsScheduleTableActivateTaskRef=ASW_OsTask_5ms
            TaskActivation5: OsScheduleTableActivateTaskRef=BSW_OsTask_10ms
            TaskActivation6: OsScheduleTableActivateTaskRef=BSW_OsTask_1ms
            TaskActivation7: OsScheduleTableActivateTaskRef=BSW_OsTask_2ms
            TaskActivation8: OsScheduleTableActivateTaskRef=BSW_OsTask_5ms
        rte_Stimulus_42: OsScheduleTblExpPointOffset=41
          TaskActivation1 (OsScheduleTableTaskActivation): OsScheduleTableActivateTaskRef=ASW_OsTask_1ms
          TaskActivation2 (OsScheduleTableTaskActivation): OsScheduleTableActivateTaskRef=BSW_OsTask_1ms
        rte_Stimulus_43: OsScheduleTblExpPointOffset=42
          4 x OsScheduleTableTaskActivation:
            TaskActivation1: OsScheduleTableActivateTaskRef=ASW_OsTask_1ms
            TaskActivation2: OsScheduleTableActivateTaskRef=ASW_OsTask_2ms
            TaskActivation3: OsScheduleTableActivateTaskRef=BSW_OsTask_1ms
            TaskActivation4: OsScheduleTableActivateTaskRef=BSW_OsTask_2ms
        rte_Stimulus_44: OsScheduleTblExpPointOffset=43
          TaskActivation1 (OsScheduleTableTaskActivation): OsScheduleTableActivateTaskRef=ASW_OsTask_1ms
          TaskActivation2 (OsScheduleTableTaskActivation): OsScheduleTableActivateTaskRef=BSW_OsTask_1ms
        rte_Stimulus_45: OsScheduleTblExpPointOffset=44
          4 x OsScheduleTableTaskActivation:
            TaskActivation1: OsScheduleTableActivateTaskRef=ASW_OsTask_1ms
            TaskActivation2: OsScheduleTableActivateTaskRef=ASW_OsTask_2ms
            TaskActivation3: OsScheduleTableActivateTaskRef=BSW_OsTask_1ms
            TaskActivation4: OsScheduleTableActivateTaskRef=BSW_OsTask_2ms
        rte_Stimulus_46: OsScheduleTblExpPointOffset=45
          4 x OsScheduleTableTaskActivation:
            TaskActivation1: OsScheduleTableActivateTaskRef=ASW_OsTask_1ms
            TaskActivation2: OsScheduleTableActivateTaskRef=ASW_OsTask_5ms
            TaskActivation3: OsScheduleTableActivateTaskRef=BSW_OsTask_1ms
            TaskActivation4: OsScheduleTableActivateTaskRef=BSW_OsTask_5ms
        rte_Stimulus_47: OsScheduleTblExpPointOffset=46
          4 x OsScheduleTableTaskActivation:
            TaskActivation1: OsScheduleTableActivateTaskRef=ASW_OsTask_1ms
            TaskActivation2: OsScheduleTableActivateTaskRef=ASW_OsTask_2ms
            TaskActivation3: OsScheduleTableActivateTaskRef=BSW_OsTask_1ms
            TaskActivation4: OsScheduleTableActivateTaskRef=BSW_OsTask_2ms
        rte_Stimulus_48: OsScheduleTblExpPointOffset=47
          TaskActivation1 (OsScheduleTableTaskActivation): OsScheduleTableActivateTaskRef=ASW_OsTask_1ms
          TaskActivation2 (OsScheduleTableTaskActivation): OsScheduleTableActivateTaskRef=BSW_OsTask_1ms
        rte_Stimulus_49: OsScheduleTblExpPointOffset=48
          4 x OsScheduleTableTaskActivation:
            TaskActivation1: OsScheduleTableActivateTaskRef=ASW_OsTask_1ms
            TaskActivation2: OsScheduleTableActivateTaskRef=ASW_OsTask_2ms
            TaskActivation3: OsScheduleTableActivateTaskRef=BSW_OsTask_1ms
            TaskActivation4: OsScheduleTableActivateTaskRef=BSW_OsTask_2ms
        rte_Stimulus_50: OsScheduleTblExpPointOffset=49
          TaskActivation1 (OsScheduleTableTaskActivation): OsScheduleTableActivateTaskRef=ASW_OsTask_1ms
          TaskActivation2 (OsScheduleTableTaskActivation): OsScheduleTableActivateTaskRef=BSW_OsTask_1ms
