AUTOSAR XML (schema 4-2-2)
package /ETAS_Project
  ecuc value collection Configuration: ecuc-values=Os
  module config Os
    OsOS:
      OsNumberOfCores = 1
      OsScalabilityClass = SC1
      OsStatus = STANDARD
      OsStackMonitoring = false
      OsUseParameterAccess = false
      OsUseGetServiceId = false
      OsUseResScheduler = false
      OsCyclesPerSecond = 200000000
      OsTicksPerSecond = 100000000
      OsHooks: OsProtectionHook=false, OsShutdownHook=true, OsStartupHook=true, OsPreTaskHook=false, OsPostTaskHook=false, OsStackFaultHook=false, OsErrorHook=true
    Rte_TickCounter (OsCounter): OsSecondsPerTick=0.001
    OsRTATarget: OsRTATargetName=PPCe200WR, OsRTATargetVersion=5.1.14, OsRTATargetVariant=MPC5744P
    OSDEFAULTAPPMODE (OsAppMode)
    Rte_ScheduleTable (OsScheduleTable)
    ECU_StartupTask (OsTask): OsTaskPriority=40, OsTaskActivation=1, OsTaskSchedule=NON
      OsTaskAutostart: OsTaskAppModeRef=OSDEFAULTAPPMODE
    ASW_OsTask_10ms (OsTask)
    37 x OsIsr, all with OsIsrCategory=CATEGORY_2:
      Can_IsrFCA_ERR: OsIsrPriority=3, OsIsrAddress=INTC_520
      Can_IsrFCA_BO: OsIsrAddress=INTC_521, OsIsrPriority=3
      Can_IsrFCA_MB_00_03: OsIsrAddress=INTC_522, OsIsrPriority=3
      Can_IsrFCA_MB_04_07: OsIsrAddress=INTC_523, OsIsrPriority=3
      Gpt_PIT_0_TIMER_0_ISR: OsIsrAddress=INTC_226, OsIsrPriority=6
      Adc_Adcdig_EndGroupConvUnit0: OsIsrAddress=INTC_496, OsIsrPriority=1
      Adc_Adcdig_EndGroupConvUnit1: OsIsrAddress=INTC_500, OsIsrPriority=1
      ETIMER_1_CH_0_ISR: OsIsrAddress=INTC_622, OsIsrPriority=3
      ETIMER_1_CH_2_ISR: OsIsrAddress=INTC_624, OsIsrPriority=3
      ETIMER_1_CH_3_ISR: OsIsrAddress=INTC_625, OsIsrPriority=3
      Gpt_PIT_0_TIMER_1_ISR: OsIsrAddress=INTC_227, OsIsrPriority=6
      MCL_DMA_CH_16_ISR: OsIsrAddress=INTC_69, OsIsrPriority=4
      MCL_DMA_CH_17_ISR: OsIsrAddress=INTC_70, OsIsrPriority=4
      MCL_DMA_CH_18_ISR: OsIsrAddress=INTC_71, OsIsrPriority=4
      MCL_DMA_ERROR_ISR: OsIsrAddress=INTC_52, OsIsrPriority=4
      Can_IsrFCA_MB_08_11: OsIsrAddress=INTC_524, OsIsrPriority=3
      Can_IsrFCA_MB_12_15: OsIsrAddress=INTC_525, OsIsrPriority=3
      Can_IsrFCA_MB_16_31: OsIsrAddress=INTC_526, OsIsrPriority=3
      Can_IsrFCA_MB_32_39: OsIsrAddress=INTC_527, OsIsrPriority=3
      Can_IsrFCA_MB_40_47: OsIsrAddress=INTC_528, OsIsrPriority=3
      Can_IsrFCA_MB_48_55: OsIsrAddress=INTC_529, OsIsrPriority=3
      Can_IsrFCA_MB_56_63: OsIsrAddress=INTC_530, OsIsrPriority=3
      ETIMER_1_CH_4_ISR: OsIsrAddress=INTC_626, OsIsrPriority=3
      ETIMER_0_CH_3_ISR: OsIsrAddress=INTC_614, OsIsrPriority=3
      ETIMER_2_CH_2_ISR: OsIsrAddress=INTC_635, OsIsrPriority=3
      Spi_Dspi_IsrTCF_DSPI_1: OsIsrAddress=INTC_272, OsIsrPriority=5
      Can_IsrFCB_ERR: OsIsrAddress=INTC_533, OsIsrPriority=7
      Can_IsrFCB_BO: OsIsrAddress=INTC_534, OsIsrPriority=7
      Can_IsrFCB_MB_00_03: OsIsrAddress=INTC_535, OsIsrPriority=7
      Can_IsrFCB_MB_04_07: OsIsrAddress=INTC_536, OsIsrPriority=7
      Can_IsrFCB_MB_08_11: OsIsrAddress=INTC_537, OsIsrPriority=7
      Can_IsrFCB_MB_12_15: OsIsrAddress=INTC_538, OsIsrPriority=7
      Can_IsrFCB_MB_16_31: OsIsrAddress=INTC_539, OsIsrPriority=7
      Can_IsrFCB_MB_32_39: OsIsrAddress=INTC_540, OsIsrPriority=7
      Can_IsrFCB_MB_40_47: OsIsrAddress=INTC_541, OsIsrPriority=7
      Can_IsrFCB_MB_48_55: OsIsrAddress=INTC_542, OsIsrPriority=7
      Can_IsrFCB_MB_56_63: OsIsrAddress=INTC_543, OsIsrPriority=7
