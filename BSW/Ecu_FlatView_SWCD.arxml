AUTOSAR XML (schema 4-2-2)
package /Ecu_FlatView/SwComponentTypes
  composition sw component type Ecu_FlatView
    component CPT_Os_SWC: type=Os_SWC
