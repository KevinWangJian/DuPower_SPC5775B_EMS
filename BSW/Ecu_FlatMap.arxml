AUTOSAR XML (schema 4-2-2)
package /Ecu_FlatView
  flat map Ecu_FlatMap
    flat instance descriptor CPT_Os_SWC: upstream-reference=RootSwCompositionPrototype_0.CPT_Os_SWC, ecu-extract-reference=CPT_Ecu_FlatView.CPT_Os_SWC
