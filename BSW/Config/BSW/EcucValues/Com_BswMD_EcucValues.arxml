AUTOSAR XML (schema 4-2-2)
package /RB/UBK/Project/EcucModuleConfigurationValuess
  module config rba_ArxmlGen
    Com (rba_ArxmlGen_Comp):
      rba_ArxmlGen_CompCategory = BswModule
      rba_ArxmlGen_CompId = 50
      rba_ArxmlGen_CompIsConfigurable = true
      rba_ArxmlGen_CompIsStandalone = false
      rba_ArxmlGen_CompIsStandardized = true
      rba_ArxmlGen_CompLongName = Communication
      rba_ArxmlGen_CompVersionAr = 4.2.2
      rba_ArxmlGen_CompVersionSw = 8.0.0
      9 x rba_ArxmlGen_ApplDataType:
        Com_IPduStatus_type: rba_ArxmlGen_ApplDataTypeCategory=Simple, rba_ArxmlGen_ApplDataTypeDispFormat=%5.0f, rba_ArxmlGen_ApplDataTypeLongName=unsigned char, rba_ArxmlGen_ApplDataTypeCompuMethodOwnRef=Com_IPduStatus_enum_type, rba_ArxmlGen_ApplDataTypeDataConstrOwnRef=Com_DataConstraint_b, rba_ArxmlGen_ApplDataTypeImplOwnRef=Com_impl_b
        Com_uint8: rba_ArxmlGen_ApplDataTypeCategory=Simple, rba_ArxmlGen_ApplDataTypeDispFormat=%5.0f, rba_ArxmlGen_ApplDataTypeLongName=unsigned char, rba_ArxmlGen_ApplDataTypeCompuMethodRef=Identical, rba_ArxmlGen_ApplDataTypeDataConstrOwnRef=Com_DataConstraint_u8, rba_ArxmlGen_ApplDataTypeImplOwnRef=Com_impl_u8
        Com_uint16: rba_ArxmlGen_ApplDataTypeCategory=Simple, rba_ArxmlGen_ApplDataTypeDispFormat=%5.0f, rba_ArxmlGen_ApplDataTypeLongName=unsigned short, rba_ArxmlGen_ApplDataTypeCompuMethodRef=Identical, rba_ArxmlGen_ApplDataTypeDataConstrOwnRef=Com_DataConstraint_u16, rba_ArxmlGen_ApplDataTypeImplOwnRef=Com_impl_u16
        Com_uint32: rba_ArxmlGen_ApplDataTypeCategory=Simple, rba_ArxmlGen_ApplDataTypeDispFormat=%5.0f, rba_ArxmlGen_ApplDataTypeLongName=unsigned int, rba_ArxmlGen_ApplDataTypeCompuMethodRef=Identical, rba_ArxmlGen_ApplDataTypeDataConstrOwnRef=Com_DataConstraint_u32, rba_ArxmlGen_ApplDataTypeImplOwnRef=Com_impl_u32
        Com_uint64: rba_ArxmlGen_ApplDataTypeCategory=Simple, rba_ArxmlGen_ApplDataTypeDispFormat=%5.0f, rba_ArxmlGen_ApplDataTypeLongName=unsigned long long, rba_ArxmlGen_ApplDataTypeCompuMethodRef=Identical, rba_ArxmlGen_ApplDataTypeDataConstrOwnRef=Com_DataConstraint_u64, rba_ArxmlGen_ApplDataTypeImplOwnRef=Com_impl_u64
        Com_SigBuf_au8: rba_ArxmlGen_ApplDataTypeCategory=Array, rba_ArxmlGen_ApplDataTypeLongName=Application data type for Signals of type - uint8,sint8,boolean., rba_ArxmlGen_ApplDataTypeImplOwnRef=Com_SigBuf_au8_impl
          Com_Subapp_u8 (rba_ArxmlGen_ApplDataTypeSub): rba_ArxmlGen_ApplDataTypeSubOwnRef=Com_uint8
        Com_SigBuf_au16: rba_ArxmlGen_ApplDataTypeCategory=Array, rba_ArxmlGen_ApplDataTypeLongName=Application data type for Signals of type - uint16,sint16., rba_ArxmlGen_ApplDataTypeImplOwnRef=Com_SigBuf_au16_impl
          Com_Subapp_u16 (rba_ArxmlGen_ApplDataTypeSub): rba_ArxmlGen_ApplDataTypeSubOwnRef=Com_uint16
        Com_SigBuf_au32: rba_ArxmlGen_ApplDataTypeCategory=Array, rba_ArxmlGen_ApplDataTypeLongName=Application data type for Signals of type - uint32,sint32., rba_ArxmlGen_ApplDataTypeImplOwnRef=Com_SigBuf_au32_impl
          Com_Subapp_u32 (rba_ArxmlGen_ApplDataTypeSub): rba_ArxmlGen_ApplDataTypeSubOwnRef=Com_uint32
        Com_SigBuf_au64: rba_ArxmlGen_ApplDataTypeCategory=Array, rba_ArxmlGen_ApplDataTypeLongName=Application data type for Signals of type - uint64,sint64., rba_ArxmlGen_ApplDataTypeImplOwnRef=Com_SigBuf_au64_impl
          Com_Subapp_u64 (rba_ArxmlGen_ApplDataTypeSub): rba_ArxmlGen_ApplDataTypeSubOwnRef=Com_uint64
      Com_IPduStatus_enum_type (rba_ArxmlGen_CompuMethod): rba_ArxmlGen_CompuMethodCategory=TextTable, rba_ArxmlGen_CompuMethodLongName=Computation Method for ComIPdu Calibration Status
        IPDU_INACTIVE (rba_ArxmlGen_CompuMethodTextEntry): rba_ArxmlGen_CompuMethodTEIntVal=0, rba_ArxmlGen_CompuMethodTENumVals=1, rba_ArxmlGen_CompuMethodTEText=INACTIVE
        IPDU_ACTIVE (rba_ArxmlGen_CompuMethodTextEntry): rba_ArxmlGen_CompuMethodTEIntVal=1, rba_ArxmlGen_CompuMethodTENumVals=1, rba_ArxmlGen_CompuMethodTEText=ACTIVE
      5 x rba_ArxmlGen_DataConstraint, all with rba_ArxmlGen_DataConstraintCategory=Physical, rba_ArxmlGen_DataConstraintLower=0, rba_ArxmlGen_DataConstraintUnitRef=NoUnit:
        Com_DataConstraint_b: rba_ArxmlGen_DataConstraintUpper=1
        Com_DataConstraint_u8: rba_ArxmlGen_DataConstraintUpper=255
        Com_DataConstraint_u16: rba_ArxmlGen_DataConstraintUpper=65535
        Com_DataConstraint_u32: rba_ArxmlGen_DataConstraintUpper=4294967295
        Com_DataConstraint_u64: rba_ArxmlGen_DataConstraintUpper=9223372036854775807
      BSWSE_MainFunctionRx (rba_ArxmlGen_ExecEntity): rba_ArxmlGen_ExecEntityCategory=Schedulable, rba_ArxmlGen_ExecEntityImplEntryRef=Com_MainFunctionRx
      BSWSE_MainFunctionTx (rba_ArxmlGen_ExecEntity): rba_ArxmlGen_ExecEntityCategory=Schedulable, rba_ArxmlGen_ExecEntityImplEntryRef=Com_MainFunctionTx
      9 x rba_ArxmlGen_ImplDataType:
        Com_impl_b: rba_ArxmlGen_ImplDataTypeCategory=Simple, rba_ArxmlGen_ImplDataTypeLongName=unsigned char, rba_ArxmlGen_ImplDataTypeBaseRef=boolean
        Com_impl_u8: rba_ArxmlGen_ImplDataTypeCategory=Simple, rba_ArxmlGen_ImplDataTypeLongName=unsigned char, rba_ArxmlGen_ImplDataTypeBaseRef=uint8
        Com_impl_u16: rba_ArxmlGen_ImplDataTypeCategory=Simple, rba_ArxmlGen_ImplDataTypeLongName=unsigned short, rba_ArxmlGen_ImplDataTypeBaseRef=uint16
        Com_impl_u32: rba_ArxmlGen_ImplDataTypeCategory=Simple, rba_ArxmlGen_ImplDataTypeLongName=unsigned long, rba_ArxmlGen_ImplDataTypeBaseRef=uint32
        Com_impl_u64: rba_ArxmlGen_ImplDataTypeCategory=Simple, rba_ArxmlGen_ImplDataTypeLongName=unsigned long long, rba_ArxmlGen_ImplDataTypeBaseRef=uint64
        Com_SigBuf_au8_impl: rba_ArxmlGen_ImplDataTypeCategory=Array, rba_ArxmlGen_ImplDataTypeLongName=Implementation data type for Signals of type - uint8,sint8,boolean.
          Com_Subimpl_u8 (rba_ArxmlGen_ImplDataTypeSub): rba_ArxmlGen_ImplDataTypeSubOwnRef=Com_impl_u8
        Com_SigBuf_au16_impl: rba_ArxmlGen_ImplDataTypeCategory=Array, rba_ArxmlGen_ImplDataTypeLongName=Implementation data type for Signals of type - uint16,sint16.
          Com_Subimpl_u16 (rba_ArxmlGen_ImplDataTypeSub): rba_ArxmlGen_ImplDataTypeSubOwnRef=Com_impl_u16
        Com_SigBuf_au32_impl: rba_ArxmlGen_ImplDataTypeCategory=Array, rba_ArxmlGen_ImplDataTypeLongName=Implementation data type for Signals of type - uint32,sint32.
          Com_Subimpl_u32 (rba_ArxmlGen_ImplDataTypeSub): rba_ArxmlGen_ImplDataTypeSubOwnRef=Com_impl_u32
        Com_SigBuf_au64_impl: rba_ArxmlGen_ImplDataTypeCategory=Array, rba_ArxmlGen_ImplDataTypeLongName=Implementation data type for Signals of type - uint64,sint64.
          Com_Subimpl_u64 (rba_ArxmlGen_ImplDataTypeSub): rba_ArxmlGen_ImplDataTypeSubOwnRef=Com_impl_u64
