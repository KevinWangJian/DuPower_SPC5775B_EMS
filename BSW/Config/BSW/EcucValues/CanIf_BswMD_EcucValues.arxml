AUTOSAR XML (schema 4-2-2)
package /RB/UBK/Project/EcucModuleConfigurationValuess
  module config rba_ArxmlGen
    CanIf (rba_ArxmlGen_Comp):
      rba_ArxmlGen_CompCategory = BswModule
      rba_ArxmlGen_CompId = 60
      rba_ArxmlGen_CompIsConfigurable = true
      rba_ArxmlGen_CompIsStandalone = true
      rba_ArxmlGen_CompIsStandardized = true
      rba_ArxmlGen_CompLongName = CANInterface
      rba_ArxmlGen_CompVersionAr = 4.2.2
      rba_ArxmlGen_CompVersionSw = 3.4.0
      6 x rba_ArxmlGen_ApplDataType:
        CanIf_boolean_app: rba_ArxmlGen_ApplDataTypeCategory=Simple, rba_ArxmlGen_ApplDataTypeDispFormat=%5.0f, rba_ArxmlGen_ApplDataTypeLongName=boolean application datatype in CanIf, rba_ArxmlGen_ApplDataTypeCompuMethodRef=Identical, rba_ArxmlGen_ApplDataTypeDataConstrOwnRef=CanIf_DataConstraint_bool, rba_ArxmlGen_ApplDataTypeImplOwnRef=CanIf_boolean_impl
        CanIf_ControllerStateType_struct_app: rba_ArxmlGen_ApplDataTypeCategory=Struct, rba_ArxmlGen_ApplDataTypeLongName=structure in CanIf, rba_ArxmlGen_ApplDataTypeImplOwnRef=CanIf_ControllerStateType_struct_impl
          DeviceMode (rba_ArxmlGen_ApplDataTypeSub): rba_ArxmlGen_ApplDataTypeSubOwnRef=CanIf_ControllerModeType_Enum_app
          ChannelMode (rba_ArxmlGen_ApplDataTypeSub): rba_ArxmlGen_ApplDataTypeSubOwnRef=CanIf_PduGetModeType_Enum_app
        CanIf_NotifStatusType_Enum_app: rba_ArxmlGen_ApplDataTypeCategory=Simple, rba_ArxmlGen_ApplDataTypeDispFormat=%5.0f, rba_ArxmlGen_ApplDataTypeLongName=enumeration data type, rba_ArxmlGen_ApplDataTypeCompuMethodOwnRef=CanIf_NotifStatusType_Enum_comp, rba_ArxmlGen_ApplDataTypeDataConstrOwnRef=CanIf_DataConstraint_enum, rba_ArxmlGen_ApplDataTypeImplRef=uint8
        CanIf_ControllerModeType_Enum_app: rba_ArxmlGen_ApplDataTypeCategory=Simple, rba_ArxmlGen_ApplDataTypeDispFormat=%5.0f, rba_ArxmlGen_ApplDataTypeLongName=enumeration data type, rba_ArxmlGen_ApplDataTypeCompuMethodOwnRef=CanIf_ControllerModeType_Enum_comp, rba_ArxmlGen_ApplDataTypeDataConstrOwnRef=CanIf_DataConstraint_enum, rba_ArxmlGen_ApplDataTypeImplRef=uint8
        CanIf_PduGetModeType_Enum_app: rba_ArxmlGen_ApplDataTypeCategory=Simple, rba_ArxmlGen_ApplDataTypeDispFormat=%5.0f, rba_ArxmlGen_ApplDataTypeLongName=enumeration data type, rba_ArxmlGen_ApplDataTypeCompuMethodOwnRef=CanIf_PduGetModeType_Enum_comp, rba_ArxmlGen_ApplDataTypeDataConstrOwnRef=CanIf_DataConstraint_enum, rba_ArxmlGen_ApplDataTypeImplRef=uint8
        CanIf_u8_app: rba_ArxmlGen_ApplDataTypeCategory=Simple, rba_ArxmlGen_ApplDataTypeDispFormat=%5.0f, rba_ArxmlGen_ApplDataTypeLongName=unsigned char application datatype in CanIf, rba_ArxmlGen_ApplDataTypeCompuMethodRef=Identical, rba_ArxmlGen_ApplDataTypeDataConstrOwnRef=CanIf_DataConstraint_u8, rba_ArxmlGen_ApplDataTypeImplOwnRef=CanIf_u8_impl
      3 x rba_ArxmlGen_CompuMethod, all with rba_ArxmlGen_CompuMethodCategory=TextTable:
        CanIf_NotifStatusType_Enum_comp: rba_ArxmlGen_CompuMethodLongName=Computation method for enum type CanIf_NotifStatusType
          CANIF_NO_NOTIFICATION (rba_ArxmlGen_CompuMethodTextEntry): rba_ArxmlGen_CompuMethodTEIntVal=0, rba_ArxmlGen_CompuMethodTENumVals=1, rba_ArxmlGen_CompuMethodTEText=CANIF_NO_NOTIFICATION
          CANIF_TX_RX_NOTIFICATION (rba_ArxmlGen_CompuMethodTextEntry): rba_ArxmlGen_CompuMethodTEIntVal=1, rba_ArxmlGen_CompuMethodTENumVals=1, rba_ArxmlGen_CompuMethodTEText=CANIF_TX_RX_NOTIFICATION
        CanIf_ControllerModeType_Enum_comp: rba_ArxmlGen_CompuMethodLongName=Computation method for enum type CanIf_ControllerModeType
          5 x rba_ArxmlGen_CompuMethodTextEntry, all with rba_ArxmlGen_CompuMethodTENumVals=1:
            CANIF_CS_UNINIT: rba_ArxmlGen_CompuMethodTEIntVal=0, rba_ArxmlGen_CompuMethodTEText=CANIF_CS_UNINIT
            CANIF_CS_STOPPED: rba_ArxmlGen_CompuMethodTEIntVal=1, rba_ArxmlGen_CompuMethodTEText=CANIF_CS_STOPPED
            CANIF_CS_STARTED: rba_ArxmlGen_CompuMethodTEIntVal=2, rba_ArxmlGen_CompuMethodTEText=CANIF_CS_STARTED
            CANIF_CS_SLEEP: rba_ArxmlGen_CompuMethodTEIntVal=3, rba_ArxmlGen_CompuMethodTEText=CANIF_CS_SLEEP
            CANIF_CS_MAXMODE: rba_ArxmlGen_CompuMethodTEIntVal=4, rba_ArxmlGen_CompuMethodTEText=CANIF_CS_MAXMODE
        CanIf_PduGetModeType_Enum_comp: rba_ArxmlGen_CompuMethodLongName=Computation method for enum type CanIf_PduGetModeType
          6 x rba_ArxmlGen_CompuMethodTextEntry, all with rba_ArxmlGen_CompuMethodTENumVals=1:
            CANIF_GET_OFFLINE: rba_ArxmlGen_CompuMethodTEIntVal=0, rba_ArxmlGen_CompuMethodTEText=CANIF_GET_OFFLINE
            CANIF_GET_RX_ONLINE: rba_ArxmlGen_CompuMethodTEIntVal=1, rba_ArxmlGen_CompuMethodTEText=CANIF_GET_RX_ONLINE
            CANIF_GET_TX_ONLINE: rba_ArxmlGen_CompuMethodTEIntVal=2, rba_ArxmlGen_CompuMethodTEText=CANIF_GET_TX_ONLINE
            CANIF_GET_ONLINE: rba_ArxmlGen_CompuMethodTEIntVal=3, rba_ArxmlGen_CompuMethodTEText=CANIF_GET_ONLINE
            CANIF_GET_OFFLINE_ACTIVE: rba_ArxmlGen_CompuMethodTEText=CANIF_GET_OFFLINE_ACTIVE
            CANIF_GET_OFFLINE_ACTIVE_RX_ONLINE: rba_ArxmlGen_CompuMethodTEText=CANIF_GET_OFFLINE_ACTIVE_RX_ONLINE
      3 x rba_ArxmlGen_DataConstraint, all with rba_ArxmlGen_DataConstraintCategory=Physical, rba_ArxmlGen_DataConstraintLower=0, rba_ArxmlGen_DataConstraintUnitRef=NoUnit:
        CanIf_DataConstraint_enum: rba_ArxmlGen_DataConstraintUpper=255
        CanIf_DataConstraint_bool: rba_ArxmlGen_DataConstraintUpper=1
        CanIf_DataConstraint_u8: rba_ArxmlGen_DataConstraintUpper=255
      6 x rba_ArxmlGen_ImplDataType:
        CanIf_boolean_impl: rba_ArxmlGen_ImplDataTypeCategory=Simple, rba_ArxmlGen_ImplDataTypeLongName=implementation data type for application data type boolean, rba_ArxmlGen_ImplDataTypeBaseRef=uint8
        CanIf_u8_impl: rba_ArxmlGen_ImplDataTypeCategory=Simple, rba_ArxmlGen_ImplDataTypeLongName=implementation data type for application data type uint8, rba_ArxmlGen_ImplDataTypeBaseRef=uint8
        CanIf_NotifStatusType_Enum_impl: rba_ArxmlGen_ImplDataTypeCategory=Simple, rba_ArxmlGen_ImplDataTypeLongName=implementation data type for application data type enum, rba_ArxmlGen_ImplDataTypeBaseRef=uint8
        CanIf_ControllerModeType_Enum_impl: rba_ArxmlGen_ImplDataTypeCategory=Simple, rba_ArxmlGen_ImplDataTypeLongName=implementation data type for application data type enum, rba_ArxmlGen_ImplDataTypeBaseRef=uint8
        CanIf_PduGetModeType_Enum_impl: rba_ArxmlGen_ImplDataTypeCategory=Simple, rba_ArxmlGen_ImplDataTypeLongName=implementation data type for application data type enum, rba_ArxmlGen_ImplDataTypeBaseRef=uint8
        CanIf_ControllerStateType_struct_impl: rba_ArxmlGen_ImplDataTypeCategory=Struct, rba_ArxmlGen_ImplDataTypeLongName=implementation data type for structure
          DeviceMode (rba_ArxmlGen_ImplDataTypeSub): rba_ArxmlGen_ImplDataTypeSubOwnRef=CanIf_ControllerModeType_Enum_impl
          ChannelMode (rba_ArxmlGen_ImplDataTypeSub): rba_ArxmlGen_ImplDataTypeSubOwnRef=CanIf_PduGetModeType_Enum_impl
      CanIf_Init_Flag (rba_ArxmlGen_Measurement):
        rba_ArxmlGen_MeasCategory = Simple
        rba_ArxmlGen_MeasDispFormat = %5.0f
        rba_ArxmlGen_MeasLongName = Flag to check if CANIF is Initialized(TRUE) or Not Initialized (FALSE)
        rba_ArxmlGen_MeasAddrMethodRef = INTERNAL_VAR_CLEARED
        rba_ArxmlGen_MeasApplDataTypeOwnRef = CanIf_boolean_app
