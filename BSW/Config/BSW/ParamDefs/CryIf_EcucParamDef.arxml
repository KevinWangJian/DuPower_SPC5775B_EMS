AUTOSAR XML (schema 4-2-2)
package /AUTOSAR_CryIf/EcucModuleDefs
  module definition CryIf [0..1]: refined-module-def=CryIf, variants pre-compile  # Configuration of the Crypto Interface.
    container CryIfChannel [0..*]: multiplicity set at pre-compile  # Container for incorporation of CryIfChannel.
      integer CryIfChannelId [0..1]: 0..4294967295, multiplicity set at pre-compile, set at pre-compile, symbolic-name-value=true  # Identifier of the crypto channel.
      symbolic name reference CryIfDriverObjectRef: multiplicity set at , set at pre-compile, destination=CryptoDriverObject  # This parameter refers to a Crypto Driver Object.
    container CryIfGeneral: multiplicity set at   # Container for incorporation of CryIfGeneral.
      boolean CryIfDevErrorDetect: multiplicity set at , set at pre-compile  # Switches the development error detection and notification on or off.
      boolean CryIfVersionInfoApi: multiplicity set at , set at pre-compile  # Pre-processor switch to enable and disable availability of the API CryIf_GetVersionInfo().
    container CryIfKey [0..*]: multiplicity set at pre-compile  # Container for incorporation of CryIfKey.
      integer CryIfKeyId [0..1]: 0..4294967295, multiplicity set at pre-compile, set at pre-compile, symbolic-name-value=true  # Identifier of the CryIf key.
      symbolic name reference CryIfKeyRef: multiplicity set at , set at pre-compile, destination=CryptoKey  # This parameter refers to the crypto driver key.
