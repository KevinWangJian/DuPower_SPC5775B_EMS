AUTOSAR XML (schema 4-2-2)
package /AUTOSAR_CanSM/EcucModuleDefs
  ecuc definition collection AUTOSARParameterDefinition: module=CanSM
  module definition CanSM [0..1]: post-build-variant-support=true, refined-module-def=CanSM, variants pre-compile  # CanSM Module | Configuration of the CanSM module
    container CanSMConfiguration  # This container contains the global parameters of the CanSM and sub containers, which are for the CAN network specific configuration.
      integer CanSMModeRequestRepetitionMax: 0..255, post-build-variant-value=true, set at link in variant link-time / post-build in variant post-build / pre-compile in variant pre-compile  # Specifies the maximal amount of mode request repetitions without a respective mode indication from the CanIf module until the CanSM module reports a Default Error to the Det and tries to go back to no communication.
      float CanSMModeRequestRepetitionTime: 0..65.535, post-build-variant-value=true, set at link in variant link-time / post-build in variant post-build / pre-compile in variant pre-compile  # Specifies in which time duration the CanSM module shall repeat mode change requests by using the API of the CanIf module.
      container CanSMManagerNetwork [1..*]: post-build-variant-multiplicity=true  # This container contains the CAN network specific parameters of each CAN network
        integer CanSMBorCounterL1ToL2: 0..255, post-build-variant-value=true, set at link in variant link-time / post-build in variant post-build / pre-compile in variant pre-compile  # This threshold defines the count of bus-offs until the bus-off recovery switches from level 1 (short recovery time) to level 2 (long recovery time).
        float CanSMBorTimeL1: 0..65.535, post-build-variant-value=true, set at link in variant link-time / post-build in variant post-build / pre-compile in variant pre-compile  # This time parameter defines in seconds the duration of the bus-off recovery time in level 1 (short recovery time).
        float CanSMBorTimeL2: 0..65.535, post-build-variant-value=true, set at link in variant link-time / post-build in variant post-build / pre-compile in variant pre-compile  # This time parameter defines in seconds the duration of the bus-off recovery time in level 2 (long recovery time).
        float CanSMBorTimeTxEnsured: 0..65.535, post-build-variant-value=true, set at link in variant link-time / post-build in variant post-build / pre-compile in variant pre-compile  # This parameter defines in seconds the duration of the bus-off event check. This check assesses, if the recovery has been successful after the recovery reenables the transmit path. If a new bus-off occurs during this time period, the CanSM assesses this bus-off as sequential bus-off without successful recovery. Because a bus-off only can be detected, when PDUs are transmitted, the time has to be great enough to ensure that PDUs are transmitted again (e. g. time period of the fastest cyclic transmitted PDU of the COM module / ComTxModeTimePeriodFactor).
        boolean CanSMBorTxConfirmationPolling: set at pre-compile  # This parameter shall configure, if the CanSM polls the CanIf_GetTxConfirmationState API to decide the bus-off state to be recovered instead of using the CanSMBorTimeTxEnsured parameter for this decision.
        boolean CanSMEnableBusOffDelay [0..1]: multiplicity set at pre-compile, set at pre-compile, default-value=false  # This parameter defines if the <User_GetBusOffDelay> shall be called for this network.
        integer CanSMNetworkIndex: 0..255, origin=RB:22.0.0:2016-08-31, post-build-variant-value=true, set at link in variant link-time / post-build in variant post-build / pre-compile in variant pre-compile, with-auto=true  # This parameter holds the unique channel index value. The value shall be the same as the ComMChannelId of the ComMChannel referenced by CanSMComMNetworkHandleRef. Implementation Type: NetworkHandleType
        symbolic name reference CanSMComMNetworkHandleRef: post-build-variant-value=true, set at link in variant link-time / post-build in variant post-build / pre-compile in variant pre-compile, destination=ComMChannel  # Unique handle to identify one certain CAN network. Reference to one of the network handles configured for the ComM.
        symbolic name reference CanSMTransceiverId [0..1]: multiplicity set at link in variant link-time / post-build in variant post-build / pre-compile in variant pre-compile, post-build-variant-multiplicity=true, post-build-variant-value=true, set at link in variant link-time / post-build in variant post-build / pre-compile in variant pre-compile, destination=CanIfTrcvCfg  # ID of the CAN transceiver assigned to the configured network handle. Reference to one of the transceivers managed by the CanIf module.
        container CanSMController [1..*]  # This container contains the controller IDs assigned to a CAN network.
          symbolic name reference CanSMControllerId: post-build-variant-value=true, set at link in variant link-time / post-build in variant post-build / pre-compile in variant pre-compile, destination=CanIfCtrlCfg  # Unique handle to identify one certain CAN controller. Reference to one of the CAN controllers managed by the CanIf module.
        container CanSMDemEventParameterRefs  # Container for the references to DemEventParameter elements which shall be invoked using the API Dem_ReportErrorStatus API in case the corresponding error occurs. The EventId is taken from the referenced DemEventParameter's DemEventId value. The standardized errors are provided in the container and can be extended by vendor specific error references.
          enumeration CanSMRbDynCreate_CANSM_E_BUS_OFF [0..1]: {Disabled, Standard}, origin=RB:16.0.1:2015-02-18, set at pre-compile, default-value=Disabled  # Selects the way how the CanSM DemEvents are created. If not set or set to "Disabled", no such DemEvent is automatically created. If the dynamic creation of this DemEvent is enabled, the reference to this DemEvent (in parameter CANSM_E_BUS_OFF) is also automatically created and shall therefore not be set manually. | ImplementationType: Disabled, Standard
          symbolic name reference CANSM_E_BUS_OFF [0..1]: multiplicity set at link in variant link-time / post-build in variant post-build / pre-compile in variant pre-compile, post-build-variant-multiplicity=true, post-build-variant-value=true, set at link in variant link-time / post-build in variant post-build / pre-compile in variant pre-compile, destination=DemEventParameter  # Reference to configured DEM event to report bus off errors for this CAN network.
    container CanSMGeneral  # Container for general pre-compile parameters of the CanSM module
      boolean CanSMDevErrorDetect: set at pre-compile  # Switches the Default Error Tracer (Det) detection and notification ON or OFF. | * true: enabled (ON). * false: disabled (OFF).
      function name CanSMGetBusOffDelayFunction [0..1]: multiplicity set at pre-compile, set at pre-compile  # This parameter configures the name of the <User_GetBusOffDelay> callout function, which is used by CanSM to acquire an additional L1/L2 delay time. This function is only called for channels where CanSMEnableBusOffDelay is enabled.
      string CanSMGetBusOffDelayHeader [0..1]: multiplicity set at pre-compile, set at pre-compile  # This parameter configures the header file containing the prototype of the <User_GetBusOffDelay> callout function.
      boolean CanSMIcomSupport [0..0]: scope=ECU, set at pre-compile, default-value=false  # Selects support of Pretended Network features in CanSM.Currently Unused Parameter.Do not configure it. | True: Enabled False: Disabled
      float CanSMMainFunctionTimePeriod: 0.001..65.535, set at pre-compile  # This parameter defines the cycle time of the function CanSM_MainFunction in seconds
      boolean CanSMPncSupport [0..1]: multiplicity set at pre-compile, set at pre-compile, default-value=false  # Enables or disables support of partial networking. | False: Partial Networking is disabled True: Partial Networking is enabled
      boolean CanSMSetBaudrateApi [0..1]: scope=ECU, multiplicity set at pre-compile, set at pre-compile, default-value=false  # The support of the Can_SetBaudrate API is optional. If this parameter is set to true the Can_SetBaudrate API shall be supported. Otherwise the API is not supported.
      boolean CanSMTxOfflineActiveSupport [0..1]: multiplicity set at pre-compile, set at pre-compile  # Determines whether the ECU passive feature is supported by CanSM. | True: Enabled False: Disabled
      boolean CanSMVersionInfoApi: set at pre-compile  # Activate/Deactivate the version information API (CanSM_GetVersionInfo). | true: version information API activated false: version information API deactivated
      boolean CanSMChangeBaudrateApi [0..1]: scope=ECU, multiplicity set at pre-compile, origin=RB:22.0.0:2016-08-31, set at pre-compile, default-value=false  # The support of the CanSM_ChangeBaudrate API is optional. If this parameter is set to true the CanSM_ChangeBaudrate API shall be supported. Otherwise the API is not supported.This parameter has been retained in AR 4.2.2 to maintain the backward compatibility. For more info, check details of Can_ChangeBaudrate [SWS_Can_00449] in Specification of CAN Driver AUTOSAR Release 4.2.2
      boolean CanSMNoPreNoCom [0..0]: set at pre-compile, origin=RB:16.0.1:2014-10-18, default-value=false  # This parameter is used to enable/disable the CANSM_BSM_S_PRE_NOCOM substate during startup. It is not recommended to set this value to True.
      boolean CanSMDSMReInitEnabled [0..1]: scope=ECU, origin=RB:2.0.0:2017-02-20, set at pre-compile, default-value=false  # Enables or disables the reporting of DEM events to DEM after the Re-initialisation of DEM has occured.The status of latest DEM event is reported in the next MainFunction cycle
      container CanSMCalibrationSupport [0..1]  # This container contains the switch which has to be enabled/disabled for Calibration support
        boolean CanSMCalibration: origin=RB:22.0.0:2016-08-31, set at pre-compile, default-value=false  # This parameter defines whether CanSM supports calibration(of CanSMBorRTimeL1 and CanSMBorRTimeL2) or not. | true: Enabled false: Disabled
        string CalibrationNamePrefixCanSMBorTimeL1 [0..1]: origin=RB:22.0.0:2016-08-31, set at pre-compile  # This container provides an option of giving the desired prefix to the calibratable CanSMBorTimeL1 parameter.
        string CalibrationNameSuffixCanSMBorTimeL1 [0..1]: origin=RB:22.0.0:2016-08-31, set at pre-compile  # This container provides an option of giving the desired suffix to the calibratable CanSMBorTimeL1 parameter.
        string CalibrationNamePrefixCanSMBorTimeL2 [0..1]: origin=RB:22.0.0:2016-08-31, set at pre-compile  # This container provides an option of giving the desired prefix to the calibratable CanSMBorTimeL2 parameter.
        string CalibrationNameSuffixCanSMBorTimeL2 [0..1]: origin=RB:22.0.0:2016-08-31, set at pre-compile  # This container provides an option of giving the desired suffix to the calibratable CanSMBorTimeL2 parameter.
