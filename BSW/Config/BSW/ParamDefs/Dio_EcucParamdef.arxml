AUTOSAR XML (schema 4-2-2)
package /AUTOSAR_Dio/EcucModuleDefs
  module definition Dio [0..1]: category=VENDOR_SPECIFIC_MODULE_DEFINITION, refined-module-def=Dio, variants pre-compile  # MCAL Digital I/O | Configuration of the MCAL module for digital inputs and outputs.
    container DioConfig [0..1]: multiplicity set at pre-compile  # Configuration data set | Defines one data set of post-build configuration. Which of these data sets is actually active is controlled by EcuM. Data sets can only be switched at initialization time.
      container DioPort [1..*]: multiplicity set at pre-compile  # Port | Configuration of a single digital input/output port, consisting of channels and possible channel groups. This shortname is only needed for Dio_WritePort and Dio_ReadPort API Signal name is configured as the short name here.
        integer DioPortId [0..1]: 0..4294967295, multiplicity set at pre-compile, set at pre-compile, symbolic-name-value=true  # Port ID | Numeric identifier of the Dio port. Not all MCU ports may be used for Dio, thus there may be "gaps" in the list of all IDs. This value will be assigned to the Dio port symbolic name (i.e. the short name of the DioPort container indirectly).
        string DioPortRbConnectedTo: origin=RB:0.1.0:2013-10-30, set at pre-compile, symbolic-name-value=true  # ConnectedTo | Customer specific name of Hardware port.
        container DioChannel [0..*]: multiplicity set at pre-compile  # Channel | Configuration of an individual Dio channel. Besides a HW specific channel name which is typically fixed for a specific micro controller, additional symbolic names can be defined per channel.
          integer DioChannelId [0..1]: 0..4294967295, multiplicity set at pre-compile, set at pre-compile  # Channel ID | Numeric identifier of the Dio channel.
          string DioChannelRbConnectedTo: origin=RB:0.1.0:2013-10-30, set at pre-compile, symbolic-name-value=true  # Connected to | Physical ID of Logical channel . Create the Mapping with below format
        container DioChannelGroup [0..*]: multiplicity set at pre-compile  # Channel Group | Configuration of a group of Dio channels. A channel group represents several adjoining Dio channels represented by a logical group.
          string DioChannelGroupIdentification: set at pre-compile, symbolic-name-value=true  # Identification | The Dio channel group is identified in Dio API by a pointer to a data structure (of type Dio_ChannelGroupType). That data structure contains the channel group information. This parameter contains the code fragment that has to be inserted in the API call of the calling module to get the address of the variable in memory which holds the channel group information.
          integer DioPortMask: 0..4294967295, set at pre-compile  # Port mask | This shall be the mask which defines the positions of the channel group. The channels shall consist of adjoining bits in the same port. The data type depends on the port width.
          integer DioPortOffset: 0..31, set at pre-compile  # Port offset | The position of the channel group on the port, counted from the LSB. This value can be derived from DioPortMask: calculationFormula = position of the first bit of DioPortMask which is set to '1'; counted from LSB.
    container DioGeneral  # General settings | Configuration of general aspects of the Dio module.
      enumeration Dio0RbMachineType [0..1]: multiplicity set at pre-compile, origin=RB:0.1.0:2014-09-22, set at pre-compile  # Dio device Type | Select the families for which Dio shall be compiled. If Mcu module is available in the project, this is parameter can be left without configuring. When Mcu is integrated , the device type will be extracted from Mcu modfule itself. If Mcu module is not available . this parameter is mandatory. If device type is configured in both Mcu and Dio, the one configured in Mcu module will be assumed as device type
        Type1  # RH850 F1L devices
        Type2  # RH850 R1L devices
        Type3  # RH850 P1X-C devices
      boolean Dio1RbReadChannelApi: origin=RB:0.1.0:2014-09-22, set at pre-compile  # Read channel API | Enables/disables the ReadChannel() API.
      boolean Dio2RbWriteChannelApi: origin=RB:0.1.0:2014-09-22, set at pre-compile  # Write channel API | Enables/disables the WriteChannel() API.
      boolean Dio3RbReadPortApi: origin=RB:0.1.0:2014-09-22, set at pre-compile  # Read Port API | Enables/disables the ReadPort() API.
      boolean Dio4RbWritePortApi: origin=RB:0.1.0:2014-09-22, set at pre-compile  # Write Port API | Enables/disables the WritePort() API.
      boolean Dio5RbReadChannelGroupApi: origin=RB:0.1.0:2014-09-22, set at pre-compile  # Read Channel Group API | Enables/disables the ReadChannelGroup() API.
      boolean Dio6RbWriteChannelGroupApi: origin=RB:0.1.0:2014-09-22, set at pre-compile  # Write Channel Group API | Enables/disables the WriteChannelGroup() API.
      boolean DioDevErrorDetect: set at pre-compile  # Development error detection | Enables/disables the detection and notification of development errors. If this parameter is enabled, then extended error checking is performed during runtime; any errors detected by these checks are reported to the Dem module. This feature should be switched off in series software.
      boolean DioFlipChannelApi: set at pre-compile  # Flip channel API | Enables/disables the FlipChannel() API.
      boolean DioVersionInfoApi: set at pre-compile  # Version information API | Enables/disables the GetVersionInfo() API. This functionality can be used e.g. for providing version information to test equipment.
