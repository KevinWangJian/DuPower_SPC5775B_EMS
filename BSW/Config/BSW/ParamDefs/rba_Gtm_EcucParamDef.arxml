AUTOSAR XML (schema 4-2-2)
package /RB/RBA/rba_Gtm/EcucModuleDefs
  module definition rba_Gtm: category=VENDOR_SPECIFIC_MODULE_DEFINITION, variants pre-compile  # MCAL rba_Gtm Driver | Configuration of the rba_Gtm module.
    container rba_GtmConfigSet  # Configuration Data Sets | This container contains the configuration parameters and sub containers of the AUTOSAR rba_Gtm module.
      container rba_Gtm_AtomSubModule [0..1]: multiplicity set at pre-compile  # ATOM Submodule | This container has the configuration of ATOM channels.
        container rba_Gtm_GptAtomChannels [0..*]: multiplicity set at pre-compile  # Gpt Channel | Container to collect all the ATOM channels that support Gpt.
          integer rba_Gtm_0_GptAtomHwInst: 0..2, origin=RB:42.1.0.0:2016-12-05, set at pre-compile  # Atom Hardware Instance | The Hardware instance where the channel is located. | The ATOM hardware instance where the Gpt channel is located. RH850 controller has 3 Hardware instances 0..3.
          integer rba_Gtm_1_GptAtomHwCh: 0..7, origin=RB:42.1.0.0:2016-12-05, set at pre-compile  # Atom Hardware Channel | The used Hardware channel in ATOM for Gpt. | The Hardware channel of ATOM submodule used for Gpt.
          enumeration rba_Gtm_2_GptAtomClk: origin=RB:42.1.0.0:2016-12-05, set at pre-compile  # CMU clock Divider selection | Selection of Configurable clock divider for the ATOM channel(configured for Gpt). | For each channel, select the clock source divider to drive the channel. Please note that the selected clock source must also be present in "Clock Management Unit" container and configured with required clock divider value.
            CMU_CLK_{0..7}  # Clock Source Divider {0..7}
          integer rba_Gtm_3_GptChannelIndex: 0..255, origin=RB:42.1.0.0:2016-12-05, set at pre-compile  # Channel Index | The index that specifies the location\placement of this channel configuration in an array containing the configurations of all the channels. Note : Do not fill this parameter. This parameter will be updated in the BCT action rba_Gtm_Prepare | Do not fill this parameter. It will be filled automatically during BCT build.
        container rba_Gtm_PwmAtomChannels [0..*]: multiplicity set at pre-compile  # Pwm Channel | Container to collect all the ATOM channels that support Pwm generation
          integer rba_Gtm_0_PwmAtomHwInst: 0..2, origin=RB:42.1.0.0:2016-09-28, set at pre-compile  # Atom Hardware Instance | The Hardware instance where the channel is located. | The ATOM hardware instance where the Pwm channel is located. RH850 controller has 3 Hardware instances 0..3.
          integer rba_Gtm_1_PwmAtomHwCh: 0..7, origin=RB:42.1.0.0:2016-09-28, set at pre-compile  # Atom Hardware Channel | The used Hardware channel in ATOM for Pwm generation. | The Hardware channel of ATOM submodule used for Pwm generation.
          enumeration rba_Gtm_2_PwmAtomClk: origin=RB:42.1.0.0:2016-09-28, set at pre-compile  # CMU clock Divider selection | Selection of Configurable clock divider for the ATOM channel(configured for PWM). | For each channel, select the clock source divider to drive the channel. Please note that the selected clock source must also be present in "Clock Management Unit" container and configured with required clock divider value.
            CMU_CLK_{0..7}  # Clock Source Divider {0..7}
          integer rba_Gtm_3_PwmChannelIndex: 0..255, origin=RB:42.1.0.0:2016-09-28, set at pre-compile  # Channel Index | The index that specifies the location\placement of this channel configuration in an array containing the configurations of all the channels. Note : Do not fill this parameter. This parameter will be updated in the BCT action rba_Gtm_Prepare | Do not fill this parameter. It will be filled automatically during BCT build.
      container rba_Gtm_TimSubModule [0..1]: multiplicity set at pre-compile  # TIM Submodule | This container has the configuration of TIM channels(currently for Icu).
        container rba_Gtm_TimIcuChannels [0..*]: multiplicity set at pre-compile  # Icu Channel | Container to collect all the TIM channels that support Icu generation
          integer rba_Gtm_0_TimHwInst: 0..1, origin=RB:42.1.0.0:2016-09-28, set at pre-compile  # Tim Hardware Instance | The Hardware instance where the channel is located. | The TIM hardware instance where the channel is located.
          integer rba_Gtm_1_TimHwCh: 0..7, origin=RB:42.1.0.0:2016-09-28, set at pre-compile  # Tim Hardware Channel | The used Hardware channel in TIM for Icu | The Hardware channel of TIM submodule used for Pwm generation.
          enumeration rba_Gtm_2_TimIcuClk: origin=RB:42.1.0.0:2016-09-28, set at pre-compile  # CMU clock Divider selection | Selection of Configurable clock divider for the TIM channel(configured for Icu). | For each channel, select the clock source divider to drive the channel. Please note that the selected clock source must also be present in "Clock Management Unit" container and configured with required clock divider value.
            CMU_CLK_{0..7}  # Clock Source Divider {0..7}
          integer rba_Gtm_3_IcuChannelIndex: 0..255, origin=RB:42.1.0.0:2016-09-28, set at pre-compile  # Channel Index | The index that specifies the location\placement of this channel configuration in an array containing the configurations of all the channels. Note : Do not fill this parameter. This parameter will be updated in the BCT action rba_Gtm_Prepare | Do not fill this parameter. It will be filled automatically during BCT build.
    container rba_GtmGeneral  # General Settings | Configuration of general rba_Gtm parameters.
      enumeration rba_Gtm_G0_Controller: origin=RB:42.1.0.0:2016-09-28, set at pre-compile  # MicroController Selection | Selection of MicroController variant | Configure the used MicroController. Currently, rba_Gtm component supports only RH850P1X variant.
        MCAL_RH850_P1X  # RH850P1X
      integer rba_Gtm_G1_BaseAddress: 0..4294967295, origin=RB:42.1.0.0:2016-09-28, set at pre-compile  # GTM Base Address | Configure the Base Address of GTM module as mentioned in the data sheet. | The base address where the registers of GTM module begin will be vary for different micro controllers. Configure this parameter by refering the DataSheet. Example : 0xFFE00000
      boolean rba_Gtm_G2_ARVersionCheck: origin=RB:42.1.0.0:2016-09-28, set at pre-compile  # AUTOSAR Version check | Switch to ON\OFF intra module AUTOSAR version check | True : Enables intra module AUTOSAR version checks. rba_Gtm comp works with Pwm and Icu comp in AR4.2 False : Disable intra module AUTOSAR version checks.
      boolean rba_Gtm_G3_DevErrorDetect: origin=RB:42.1.0.0:2016-09-28, set at pre-compile  # Default Error Detection | Switches the Default Error Tracer (Det) detection ON or OFF. Currently not supported. | True: enable Default error tracer detection and notification to DET comp. False: Disable Default error tracer and notification.
      integer rba_Gtm_G4_Index [0..0]: 0..255, origin=RB:42.1.0.0:2016-09-28, set at pre-compile  # rba_Gtm module instance ID | Specifies the InstanceId of this module instance. If only one instance is present it shall have the Id 0.
      enumeration rba_Gtm_G5_Pwm_Gtm_Usage: origin=RB:42.1.0.0:2016-09-28, set at pre-compile  # Usage of GTM by Pwm | Selection of GTM submodule that will be used by Pwm. If Pwm comp does not exist and\or does not use GTM, set this parameter to OFF. | If Pwm comp exist and uses rba_Gtm comp, select the used GTM submodule for Pwm generation(currently only ATOM is supported for Pwm). If Pwm does not need rba_Gtm or if Pwm comp does not exist, set this to OFF.
        PWM_USE_GTM_ATOM  # GTM_ATOM
        PWM_GTM_OFF  # OFF
      enumeration rba_Gtm_G6_Icu_Gtm_Usage: origin=RB:42.1.0.0:2016-09-28, set at pre-compile  # Usage of GTM by Icu | Selection of GTM submodule that will be used by Icu. If Icu comp does not exist and\or does not use GTM, set this parameter to OFF. | If Icu comp exist and uses rba_Gtm comp, select the used GTM submodule for Icu functionality (currently TIM is supported for Icu). If Icu does not need rba_Gtm or if Icu comp does not exist, set this to OFF.
        ICU_USE_GTM_TIM  # GTM_TIM
        ICU_GTM_OFF  # OFF
      enumeration rba_Gtm_G7_Gpt_Gtm_Usage: origin=RB:42.1.0.0:2016-12-05, set at pre-compile  # Usage of GTM by Gpt | Selection of GTM submodule that will be used by Gpt. If Gpt comp does not exist and\or does not use GTM, set this parameter to OFF. | If Gpt comp exist and uses rba_Gtm comp, select the used GTM submodule for Gpt(currently only ATOM is supported for Gpt). If Gpt does not need rba_Gtm or if Gpt comp does not exist, set this to OFF.
        GPT_USE_GTM_ATOM  # GTM_ATOM
        GPT_GTM_OFF  # OFF
      container rba_Gtm_CmuClk  # Clock Management Unit | This Sub-Container has the configuration for CMU clock sources and its division factors.
        integer rba_Gtm_G7_Gclock_Num: 1..16777215, origin=RB:42.1.0.0:2016-09-28, set at pre-compile  # GTM Global clock Numerator | selection of numerator(Z) for fractional divider for GTM global input clock. | Numerator for global clock divider. Defines numerator of the fractional divider(Z/N).
        integer rba_Gtm_G8_Gclock_Den: 1..16777215, origin=RB:42.1.0.0:2016-09-28, set at pre-compile  # GTM Global clock Denominator | selection of Denominator(N) for fractional divider for GTM global input clock. | Denominator for global clock divider. Defines denominator of the fractional divider.
        container rba_Gtm_CmuClk_Dividers [1..8]: multiplicity set at pre-compile  # Clock Source Divider | configurable Clock Generation sub-units
          enumeration rba_Gtm_CmuClkDivider: origin=RB:42.1.0.0:2016-09-28, set at pre-compile  # Clock Source Divider | Configure the clock source divider ( CMU_CLK_# ) Example : for CMU clock source divider 1, write <CMU_CLK_1>
            CMU_CLK_{0..7}  # Clock Source Divider {0..7}
          integer rba_Gtm_CmuClkx_CLK_CNT: 0..16777215, origin=RB:42.1.0.0:2016-09-28, set at pre-compile  # Global Clock Division value | Define the count value for the clock divider of clock source CMU_CLK[x] | This is the value that will be used to divide the global clock signal. The resulting clock will correspond to CMU_CLK_x [x= 0…7]
    container rba_GtmOptionalApis  # Optional APIs | This container contains all configuration switches for configuring optional API services of the rba_Gtm driver.
      boolean rba_GtmGetVersionInfoApi: origin=RB:42.1.0.0:2016-09-28, set at pre-compile  # rba_Gtm Get VersionInfo API | Adds / removes the service rba_Gtm_GetVersionInfo() from the code. | True: rba_Gtm_GetVersionInfo() can be used. False: rba_Gtm_GetVersionInfo() can not be used.
