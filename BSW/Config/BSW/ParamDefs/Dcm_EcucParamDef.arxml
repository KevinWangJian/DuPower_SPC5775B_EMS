[part 1 of 2: package /AUTOSAR_Dcm/EcucModuleDefs]
AUTOSAR XML (schema 4-2-2)
package /AUTOSAR_Dcm/EcucModuleDefs
  module definition Dcm [0..1]: category=VENDOR_SPECIFIC_MODULE_DEFINITION, refined-module-def=Dcm, variants pre-compile  # Configuration of the Dcm (Diagnostic Communications Manager) module.
    container DcmConfigSet  # This container contains the configuration parameters and sub containers of the DCM module supporting multiple configuration sets. | This container is a MultipleConfigurationContainer, i.e. this container and its sub-containers exist once per configuration set.
      container DcmDsd  # These parameters apply to Diagnostic Service Dispatcher. All parameters for all service dispatchers are included in this one configuration container. | There must always be one service dispatcher in a DCM.
        boolean DcmDsdRequestManufacturerNotificationEnabled: scope=ECU, set at pre-compile  # Allows to enable or disable the requested notification mechanism for the Manufacturer.
        boolean DcmDsdRequestSupplierNotificationEnabled: scope=ECU, set at pre-compile  # Allows to enable or disable the requested notification mechanism for the Supplier.
        container DcmDsdServiceRequestManufacturerNotification [0..*]  # The name of this container is used to define the name of the R-Port through which the DCM accesses the interface ServiceRequestNotification. | The R-Port is named ServiceRequestManufacturerNotification_{Name} where {Name} is the name of the container DcmDsdServiceRequestManufacturerNotification. The lowerMultiplicity is 0: If DcmDsdRequestManufacturerNotificationEnabled = false the Indication API is not available.
        container DcmDsdServiceRequestSupplierNotification [0..*]  # The name of this container is used to define the name of the R-Port through which the DCM accesses the interface ServiceRequestNotification. | The R-Port is named ServiceRequestSupplierNotification_<SWC> where <SWC> is the name of the container DcmDsdServiceRequestSupplierNotification. The lowerMultiplicity is 0: If DcmDsdRequestSupplierNotification = false the Indication API is not available.
        container DcmDsdServiceTable [1..256]  # This container contains the configuration (DSD parameters) for Service Identifier Table. | Note: It is allowed to add OBD services to a DcmDsdServiceTable related to a UDS Protocol. But it is not allowed to add UDS services to a DcmDsdServiceTable related to a OBD Protocol.
          integer DcmDsdSidTabId: 0..255, scope=ECU, set at link in variant link-time / pre-compile in variant post-build+pre-compile, with-auto=true  # Due the fact of using one or more service tables the member of the Service Identifier Table includes a unique id for the Service Identifier Table.
          integer DcmRbNRCForService [0..1]: 1..254, multiplicity set at link in variant link-time+post-build / pre-compile in variant pre-compile, origin=RB:AR42.1.0.0:2017-01-31, set at link in variant link-time+post-build / pre-compile in variant pre-compile, default-value=127  # The NRC updated in this field shall be returned for any request in the protocol referring this service table if the service is not supported in active session. ISO recommends that the parameter should be set to 0x7F for UDS.Users may configure any NRC value for this parameter, according to project requirements, for other protocols.
          container DcmDsdService [1..*]  # This container contains the configuration (DSD parameters) for Service.
            boolean DcmDsdServiceUsed [0..0]: set at link in variant link-time / post-build in variant post-build / pre-compile in variant pre-compile, with-auto=true, default-value=true  # Allow to activate or deactivate the usage of a Service, for multi purpose ECUs | true = Service available false = Service not available
            function name DcmDsdSidTabFnc [0..1]: scope=ECU, multiplicity set at link in variant link-time / pre-compile in variant post-build+pre-compile, set at link in variant link-time / pre-compile in variant post-build+pre-compile  # Callback function of the DSP or ECU Supplier specific component for the particular DcmDsdSidTabServiceId.User may see the function name for Dcm specific services by pressing "Ctrl+Enter" | This parameter is related to the interface <Module>_<DiagnosticService>. If it is not configured the service is handled Dcm-internally.
            integer DcmDsdSidTabServiceId: 0..255, scope=ECU, set at link in variant link-time / pre-compile in variant post-build+pre-compile  # Id of the Service identifier.The possible Service identifier are predefined in the ISO 14229-1 and ISO 15031-5 | The possible Service identifier are predefined in the ISO 14229-1 and ISO 15031-5 and in Table 4 and Table 5.
            boolean DcmDsdSidTabSubfuncAvail: scope=ECU, set at link in variant link-time / pre-compile in variant post-build+pre-compile  # Information whether the DcmDsdSidTabServiceId includes Sub functions or not. Used for handling of "suppressPosRspMsgIndicationBit". ISO14229-1 can be referenced here, as this specification gives fix definition, if an SID includes subfunction or not. The parameter should configured as TRUE if subservices for the service in DSD are used. Minimum length check shall be performed in DSD if the parameter is configured as TRUE. Other subservice related checks (subservice session/subservice security/subservice mode rule check shall be performed in DSD only if subservices under the Service DcmDsdService->DcmDsdSubService are configured. | true = sub-function available false = sub-function not available
            enumeration DcmRbDsdSidTabScheduler [0..1]: {DcmMainScheduler, DcmCooperativeScheduler}, multiplicity set at link in variant link-time+post-build / pre-compile in variant pre-compile, origin=RB:AR42.1.0.0:2017-01-31, set at link in variant link-time+post-build / pre-compile in variant pre-compile, default-value=DcmMainScheduler  # Selection of scheduler for a given service. DcmMainScheduler : Service will be scheduled from Dcm_MainFunction() DcmCooperativeScheduler: Service is scheduled from Dcm_CoOpr_MainFunction()
            string DcmRbDsdSidTabSidInitFunction [0..1]: multiplicity set at link in variant link-time+post-build / pre-compile in variant pre-compile, origin=RB:AR42.1.0.0:2017-01-31, set at link in variant link-time+post-build / pre-compile in variant pre-compile  # Function pointer of the service initializing function.User may see the function name for Dcm specific services by pressing "Ctrl+Enter"
            function name DcmRbDsdSidTabUserModeRuleFnc [0..1]: multiplicity set at pre-compile, origin=RB:AR42.1.0.0:2017-01-31, set at pre-compile  # Function name used by the application to perform user specific checks on the SID.In case the checks fails, NRC value set by the application can be returned to the tester. In case the function is not configured for SID, the DcmAppl API Xxx_UserServiceModeRuleService shall be called.
            reference DcmDsdSidTabModeRuleRef [0..1]: scope=ECU, multiplicity set at link in variant link-time / pre-compile in variant post-build+pre-compile, set at link in variant link-time / pre-compile in variant post-build+pre-compile, destination=DcmModeRule  # Reference to DcmDspModeRule | Mode rule which controls the execution of the DcmDsdService. If there is no reference, no check of the mode rule shall be done.
            reference DcmDsdSidTabSecurityLevelRef [0..*]: scope=ECU, multiplicity set at link in variant link-time / pre-compile in variant post-build+pre-compile, set at link in variant link-time / pre-compile in variant post-build+pre-compile, destination=DcmDspSecurityRow  # Link to the Security Access Levels needed for execution of the DcmDsdService. Please refer to the ISO 14229-1, ISO 15031-5 and "Verification of the Security Access levels". User can configure multiple DcmDsdSidTabSecurityLevelRef per DcmDsdService. If reference is provided, then DcmDsdService shall be enabled only in the configured security levels. The service will be allowed in all security levels, if no reference is provided. The additional security levels configured for the subservice will also be considered as the security level of the service. | Please refer to the ISO 14229-1, ISO 15031-5 and "Verification of the Security Access levels". Please note, that it shall be provided to configure several DcmDsdSidTabSecurityLevelRef per DcmDsdService. If there is no reference, no check of security level shall be done.
            reference DcmDsdSidTabSessionLevelRef [0..*]: scope=ECU, multiplicity set at link in variant link-time / pre-compile in variant post-build+pre-compile, set at link in variant link-time / pre-compile in variant post-build+pre-compile, destination=DcmDspSessionRow  # Link to the Session Control needed for execution of the DcmDsdService. Please refer to the ISO 14229-1, ISO 15031-5 and "Verification of the Diagnostic Session". It is possible for user to configure multiple DcmDsdSidTabSessionLevelRef per DcmDsdService. If reference is provided,DcmDsdService to be enabled only in the configured session levels. If there is no reference, no check of session level shall be done. The additional session levels configured for the subservice will also be considered as the session level of the service.
            container DcmDsdSubService [0..*]  # This container contains the configuration (DSD parameters) for SubServices. This configuration is available only for services having Subfunction: this container exists only if parameter DcmDsdSidTabSubfuncAvail, of this service, is set to TRUE and the parameter DcmDsdSidTabFnc is not existing. It is not advisable to configure Sub-Functions for RoutineControl Service(0x31).Any DcmDsdSubService configuration for RoutineControl Service(0x31) service will be ignored.
              function name DcmDsdSubServiceFnc [0..0]: multiplicity set at link in variant link-time / pre-compile in variant post-build+pre-compile, set at link in variant link-time / pre-compile in variant post-build+pre-compile, with-auto=true  # Callback function of the ECU Supplier specific component. This parameter is related to the interface <Module>_<DiagnosticService>_<SubService>. | If it is not configured the sub-service is handled Dcm-internally.
              integer DcmDsdSubServiceId: 0..255, scope=ECU, set at link in variant link-time / pre-compile in variant post-build+pre-compile  # Id of the SubService identifier. The possible Subfunction parameter value are predefined in the ISO 14229-1 and ISO 15031-5.
              boolean DcmDsdSubServiceUsed [0..0]: set at link in variant link-time / post-build in variant post-build / pre-compile in variant pre-compile, with-auto=true, default-value=true  # Allow to activate or deactivate the usage of a Subfunction, for multi purpose ECUs. | true = Subfunction available true = Subfunction not available
              function name DcmRbDsdSubFuncServHandler [0..1]: multiplicity set at link in variant link-time / pre-compile in variant post-build+pre-compile, origin=RB:AR42.1.0.0:2017-01-31, set at link in variant link-time / pre-compile in variant post-build+pre-compile  # Service Handler for configured RDTC Sub Function (0x01, 0x2 , 0x3, 0x4, 0x5, 0x6,0x7, 0x8, 0x09, 0xA, 0x0B, 0x0C, 0x0D, 0x0E, 0xF, 0x10, 0x11, 0x12, 0x13, 0x14, 0x15) If the user has not configured SubFuncServHandler for Sub function level 0x01, 0x2 ,0x3, 0x4, 0x5, 0x6, 0x7, 0x8, 0x09, 0xA, 0x0B, 0x0C, 0x0D, 0x0E, 0xF, 0x10, 0x11, 0x12, 0x13, 0x14, 0x15 ; , Default ServHandler names are configured. If the user configures ServHandler Name for Sub function level other than 0x01, 0x2 ,0x3, 0x4, 0x5,0x6, 0x7, 0x8, 0x09, 0xA, 0x0B, 0x0C, 0x0D, 0x0E, 0xF, 0x10, 0x11, 0x12, 0x13, 0x14, 0x15 ; the entered function name is configured. For any Sub Function levels other than (0x01, 0x2 ,0x3, 0x4, 0x5, 0x6, 0x7, 0x8, 0x09, 0xA, 0x0B, 0x0C, 0x0D, 0x0E, 0xF, 0x10, 0x11, 0x12, 0x13, 0x14, 0x15 ); The user has to enter the Service Handler name Mandatory. | If it is not configured the sub-service is handled Dcm-internally.
              function name DcmRbDsdSubServiceUserModeRuleFnc [0..1]: multiplicity set at pre-compile, origin=RB:AR42.1.0.0:2017-01-31, set at pre-compile  # Function name used by the application to perform user specific checks on the subfunction.In case the checks fails, NRC value set by the application can be returned to the tester. In case the function is not configured for sub service , the DcmAppl API DcmAppl_UserSubServiceModeRuleService shall be called. | Function name used by the application to perform user specific checks on the subfunction.In case the checks fails, NRC value set by the application can be returned to the tester. In case the function is not configured for sub service, the DcmAppl API DcmAppl_UserSubServiceModeRuleService shall be called.
              reference DcmDsdSubServiceModeRuleRef [0..1]: scope=ECU, multiplicity set at link in variant link-time / pre-compile in variant post-build+pre-compile, set at link in variant link-time / pre-compile in variant post-build+pre-compile, destination=DcmModeRule  # Reference to DcmDspModeRule which controls execution of this DcmDsdSubService. If there is no reference, no check of the mode rule shall be done before executing the subservice. Refer DcmProcessingConditions->DcmModeRule for more details regarding mode rules. | Mode rule which controls execution of this the DcmDsdSubService. If there is no reference, no check of the mode rule shall be done.
              reference DcmDsdSubServiceSecurityLevelRef [0..*]: scope=ECU, multiplicity set at link in variant link-time / pre-compile in variant post-build+pre-compile, set at link in variant link-time / pre-compile in variant post-build+pre-compile, destination=DcmDspSecurityRow  # Link to the Security Level needed for execution of the DcmDsdSubService. User can configure multiple DcmDsdSubServiceSecurityLevelRef per DcmDsdSubService. Please refer to ISO 14229-1, ISO 15031-5 and "Verification of the Diagnostic Session". If reference is provided, then DcmDsdSubService shall be enabled only in the configured security levels. If no reference is provided, DcmDsdSubService shall be allowed in all security levels. | Please refer to the ISO 14229-1, ISO 15031-5 and "Verification of the Diagnostic Session". Please note, that it shall be provided to configure several DcmDsdSubServiceSecurityLevelRef per DcmDsdSubService. If there is no reference, no check of security level shall be done.
              reference DcmDsdSubServiceSessionLevelRef [0..*]: scope=ECU, multiplicity set at link in variant link-time / pre-compile in variant post-build+pre-compile, set at link in variant link-time / pre-compile in variant post-build+pre-compile, destination=DcmDspSessionRow  # Link to the Session Control needed for execution of the DcmDsdSubService. Please refer to ISO 14229-1, ISO 15031-5 and "Verification of the Diagnostic Session". User can configure multiple DcmDsdSubServiceSessionLevelRef per DcmDsdSubService. If reference is provided, then DcmDsdSubService shall be enabled only in the configured session levels. If no reference is provided, no check of session level shall be done, before processing the subservice. | Please refer to the ISO 14229-1, ISO 15031-5 and "Verification of the Diagnostic Session". Please note, that it shall be provided to configure several DcmDsdSubServiceSessionLevelRef per DcmDsdSubService. If there is no reference, no check of session level shall be done.
      container DcmDsl  # These parameters apply to a Diagnostic Session Layer. There may be a parameter set (DSL Configuration) per protocol. Each DCM configuration must have exactly one DSL configuration. | upperMultiplicity: Each DCM configuration must have exactly one DSL configuration. lowerMultiplicity: Each DCM configuration must have exactly one DSL configuration.
        container DcmDslBuffer [1..256]  # This container contains the configuration (parameters) for the diagnostic buffer.
          integer DcmDslBufferSize: 8..4294967294, scope=ECU, set at pre-compile  # Size of Diagnostic Buffer (in Bytes).For a linear buffer: size of the buffer shall be as large as the longest message (request or response) For a paged buffer (only Tx possible): size has impacts on the application performance | For a linear buffer: size of the buffer shall be as large as the longest message (request or response) For a paged buffer (only Tx possible): size has impacts on the application performance Please note: max. range is the valid range for a CAN network. We assume a FlexRay (or other networks) implementation will work with this range (and the page buffer mechanism) without any problems.
        container DcmDslCallbackDCMRequestService [0..*]  # The name of this container is used to define the name of the R-Port through which the DCM access the interface CallbackDCMRequestServices(with operations Xxx_StartProtocol and Xxx_StopProtocol). The R-Port is named CallbackDCMRequestServices _SWC where _SWC is the name of the container DcmDslCallbackDCMRequestService. | The R-Port is named CallbackDCMRequestServices_<SWC> where _<SWC> is the name of the container DcmDslCallbackDCMRequestService.
        container DcmDslDiagResp  # This container contains the configuration (parameters) for the ResponsePending handling
          integer DcmDslDiagRespMaxNumRespPend: 0..255, scope=ECU, set at link in variant link-time / pre-compile in variant post-build+pre-compile  # Maximum number of negative responses with response code 0x78 (requestCorrectlyReceived-ResponsePending) allowed per request. DCM will send a negative response with response code 0x10 (generalReject), in case the limit value is reached. Value 255 (0xFF) configured for this parameter means that there is no limit on the number of 0x78 (ResponsePending). | Value 0xFF means that no limit number of NRC 0x78 response apply.
          boolean DcmDslDiagRespOnSecondDeclinedRequest [0..0]: scope=ECU, set at link in variant link-time / pre-compile in variant post-build+pre-compile  # Defines the reaction upon a second request (ClientB) that can not be processed (e.g. due to priority assessment). | TRUE: when the second request (Client B) can not be processed, it shall be answered with NRC21 BusyRepeatRequest. FALSE: when the second request (Client B) can not be processed, it shall not be responded.
        container DcmDslProtocol  # This container contains the configuration (parameters) for the protocol configuration (for each protocol) The following parameters needs to be configured per protocol.
          container DcmDslProtocolRow [1..*]  # Definition of a single Row of configuration for the protocol configuration (for each protocol)
            enumeration DcmDslProtocolID: {DCM_OBD_ON_CAN, DCM_OBD_ON_FLEXRAY, DCM_OBD_ON_IP, DCM_OBD_ON_KLINE, DCM_PERIODICTRANS_ON_CAN, DCM_PERIODICTRANS_ON_FLEXRAY, DCM_PERIODICTRANS_ON_IP, DCM_ROE_ON_CAN, DCM_ROE_ON_FLEXRAY, DCM_ROE_ON_IP, DCM_SUPPLIER_1, DCM_SUPPLIER_10, DCM_SUPPLIER_11, DCM_SUPPLIER_12, DCM_SUPPLIER_13, DCM_SUPPLIER_14, DCM_SUPPLIER_15, DCM_SUPPLIER_2, DCM_SUPPLIER_3, DCM_SUPPLIER_4, DCM_SUPPLIER_5, DCM_SUPPLIER_6, DCM_SUPPLIER_7, DCM_SUPPLIER_8, DCM_SUPPLIER_9, DCM_UDS_ON_CAN, DCM_UDS_ON_FLEXRAY, DCM_UDS_ON_IP, DCM_ACEA_ON_CAN, DCM_ACEA_ON_FLEXRAY, DCM_KWP_ON_KLINE, DCM_KWP_ON_CAN, DCM_CARB_ON_KLINE}, scope=ECU, set at pre-compile, symbolic-name-value=true  # The diagnostic protocol type for the DCM DSL protocol that is being configured. | Implementation Type: Dcm_ProtocolType
            integer DcmDslProtocolMaximumResponseSize [0..1]: 1..65535, scope=ECU, multiplicity set at pre-compile, set at pre-compile, default-value=4095  # The value of this parameter is the maximum response length possible in case paged buffer is enabled for any service (For example 0x19,0x22). The parameter should be configured by the user.In case the user leaves the parameter unconfigured, Dcm shall fill the value during generate Id as 4095 for CAN(If CanTpFlexibleDataRateSupport is not configured/ configured as FALSE in CanTp) and as 65535 for other protocols (Flexray, IP,CAN (if CanTpFlexibleDataRateSupport ios configured as TRUE)). Values configured by the user wil be overwritten by Dcm in this case.If paged buffer is enabled and the generated Response for a Request is longer than DcmDslProtocolMaximumResponseSize configured for the active protocol, the Dcm service shall respond with NRC 0x14 (DCM_E_RESPONSETOOLONG).Vendor specific services using paged buffer should also do a check based on this parameter. If paged buffer is disabled and the generated Response for a Request is longer than Dcm_MsgContextType structure element resMaxDataLen, the Dcm shall respond with NRC 0x14 (DCM_E_RESPONSETOOLONG).
            float DcmDslProtocolPreemptTimeout [0..0]: 0..1, scope=ECU, set at link in variant link-time / pre-compile in variant post-build+pre-compile, with-auto=true  # This is the value for the timeout in seconds of preempting protocol until protocol needs to be started. | This is defined in the AUTOSAR SWS for DCM as a uint16. The AUTOSAR configuration standard is to use SI units, so this parameter is defined as a float value in seconds. DCM configuration tools must convert this float value to the appropriate value format for the use in the software implementation of DCM. min: A negative value is not allowed. upperMultiplicity: Exactly one DcmDslProtocolPreemptTimeout value per DSL protocol timing structure. lowerMultiplicity: Exactly one DcmDslProtocolPreemptTimeout value per DSL timing structure. origin: Standard AUTOSAR configuration parameter.
            integer DcmDslProtocolPriority: 0..255, scope=ECU, set at link in variant link-time / pre-compile in variant post-build+pre-compile  # The SWS for DCM defines this item as uint8. This is the protocol priority that is used during protocol preemption handling. 0 is the highest priority and it reduces with the increase in value. | 0 = Highest priority (protocol may not be preempted by other protocols) 1, 2, 3... = Reducing priority. Protocol may be preempted by other protocols with lower priority value. upperMultiplicity: Exactly one priority must be provided per Tx Protocol. lowerMultiplicity: Exactly one priority must be provided per Tx Protocol. origin: Standard AUTOSAR configuration parameter.
            boolean DcmDslProtocolRowUsed [0..0]: set at link in variant link-time / post-build in variant post-build / pre-compile in variant pre-compile, with-auto=true, default-value=true  # Allow to activate or deactivate the usage of a Protocol, for multi purpose ECUs. | true = Protocol used false = Protocol not used
            enumeration DcmDslProtocolTransType [0..1]: {TYPE1, TYPE2}, scope=ECU, multiplicity set at link in variant link-time / pre-compile in variant post-build+pre-compile, set at link in variant link-time / pre-compile in variant post-build+pre-compile  # This parameter is used only if the protocol is of type DCM_ROE_ON_xxx or DCM_PERIODICTRANS_ON_xxx. It selects the transmission type of the protocol. TYPE1: Messages for ROE or Periodic Transmission uses the DcmTxPduId used for normal diagnostic responses. The outgoing messages must be synchronized with normal outgoing messages, which have a higher priority. TYPE2: Messages for ROE or Periodic Transmission are sent on a separate DcmTxPduId. | If the configuration parameter DcmDslProtocolId is not configure to Response on event or PeriodicTransmission the parameter should not be used
            boolean DcmSendRespPendOnTransToBoot: set at link in variant link-time / pre-compile in variant post-build+pre-compile, default-value=true  # Parameter specifying if the ECU should send a NRC 0x78 (response pending) before transitioning to the bootloader (parameter set to TRUE) or if the transition shall be initiated without sending NRC 0x78 (parameter set to FALSE).
            float DcmTimStrP2ServerAdjust: 0..1, scope=ECU, set at link in variant link-time / pre-compile in variant post-build+pre-compile  # This parameter is used to guarantee that the DCM response is available on the bus before reaching P2.This parameter value in seconds has to be configured as a multiple of DcmTaskTime and is minimum in the timing handling of P2. The AUTOSAR configuration standard is to use SI units, so this parameter is defined as a float value in seconds. DCM configuration tools must convert this float value to the appropriate value format for the use in the software implementation of DCM. | The AUTOSAR configuration standard is to use SI units, so this parameter is defined as a float value in seconds. DCM configuration tools must convert this float value to the appropriate value format for the use in the software implementation of DCM.
            float DcmTimStrP2StarServerAdjust: 0..5, scope=ECU, set at link in variant link-time / pre-compile in variant post-build+pre-compile  # This parameter is used to guarantee that the DCM response is available on the bus before reaching P2*.This parameter value in seconds has to be configured as multiple of DcmTaskTime and is minimum in the timing handling of P2*. The AUTOSAR configuration standard is to use SI units, so this parameter is defined as a float value in seconds. DCM configuration tools must convert this float value to the appropriate value format for the use in the software implementation of DCM. | The AUTOSAR configuration standard is to use SI units, so this parameter is defined as a float value in seconds. DCM configuration tools must convert this float value to the appropriate value format for the use in the software implementation of DCM.
            boolean DcmRbDslProtocolNRC21OnPriorityAssessmentReject [0..1]: multiplicity set at link in variant link-time / post-build in variant post-build / pre-compile in variant pre-compile, origin=RB:AR42.1.0.0:2017-01-31, set at link in variant link-time / post-build in variant post-build / pre-compile in variant pre-compile, default-value=false  # This parameter defines the reaction when a new requests arrives on this protocol, when there is already a request with higher or same priority under processing. TRUE: answer with NRC21 BusyRepeatRequest FALSE: silently ignore the request In case the parameter is left unconfigured ,then the FALSE will be considered as the default value and the new request wth same priority will be ignored silently. | TRUE: answer with NRC21 BusyRepeatRequest. FALSE: silently ignore the request
            reference DcmDslProtocolRxBufferRef [0..1]: scope=ECU, multiplicity set at link in variant link-time / post-build in variant post-build / pre-compile in variant pre-compile, set at link in variant link-time / pre-compile in variant post-build+pre-compile, destination=DcmDslBuffer  # Link to buffer configuration (DcmDslBuffer) for configuration of protocol buffer used for Rx actions. | upperMultiplicity / lowerMultiplicity:: Exactly one Rx buffer is required for protocol reception
            reference DcmDslProtocolSIDTable [0..1]: scope=ECU, multiplicity set at link in variant link-time / post-build in variant post-build / pre-compile in variant pre-compile, set at link in variant link-time / pre-compile in variant post-build+pre-compile, destination=DcmDsdServiceTable  # Link to the used diagnostic service table for this protocol. | upperMultiplicity: Must have exactly one service table for the protocol. lowerMultiplicity: Must have exactly one service table for the protocol.
            reference DcmDslProtocolTxBufferRef [0..1]: scope=ECU, multiplicity set at link in variant link-time / post-build in variant post-build / pre-compile in variant pre-compile, set at link in variant link-time / pre-compile in variant post-build+pre-compile, destination=DcmDslBuffer  # Link to buffer configuration (DcmDslBuffer) for configuration of protocol buffer used for Tx actions. | upperMultiplicity / lowerMultiplicity:: Exactly one Tx buffer is required for protocol transmission.
            choice container DcmDslConnection [1..*]  # This container contains links between Diagnostic Protocol (=DcmDslProtocolRow) and the according Rx or Tx channel. And also contains links to the ROE connection (DcmDslROEConnectionRef) and the Periodic Transmission Connection (DcmDslPeriodicTransmissionConRef). Tto allow more then one diagnostic tester (using different CAN channels), configuration of multiple DcmDslConnections is possible. | Because of the usecase to allow more then one diagnostic tester (using different CAN channels) it is necessary to allow configuration of multiple DcmDslConnections.
              container DcmDslMainConnection [0..1]  # This container contains configuration for Diagnostic Main Connection (DcmDslProtocolTx, DcmDslProtocolRx).In addition it contains links to the ROE connection (DcmDslROEConnectionRef) and the Periodic Transmission Connection (DcmDslPeriodicTransmissionConRef) relevant for protocols with DcmDslProtocolTransType = TYPE2 or TYPE1. | (DcmDslProtocolTx, DcmDslProtocolRx). In addition it contains links to the ROE connection (DcmDslROEConnectionRef) and the Periodic Transmission Connection (DcmDslPeriodicTransmissionConRef) relevant for protocols with DcmDslProtocolTransType = TYPE2 or TYPE1.
                integer DcmDslProtocolRxTesterSourceAddr [0..1]: 0..65535, scope=ECU, multiplicity set at pre-compile, set at link in variant link-time / pre-compile in variant post-build+pre-compile  # Tester source address uniquely describes a client and will be used e.g within the jump to Bootloader interfaces. This parameter is not required for generic connections (DcmPdus with MetaDataLength >= 1).
                reference DcmDslPeriodicTransmissionConRef [0..1]: scope=ECU, multiplicity set at pre-compile, set at link in variant link-time / pre-compile in variant post-build+pre-compile, destination=DcmDslPeriodicTransmission  # Configures the link to the connection of PeriodicTransmission protocol for the processing of the PeriodicTransmission events.
                symbolic name reference DcmDslProtocolComMChannelRef: scope=ECU, set at link in variant link-time / pre-compile in variant post-build+pre-compile, destination=ComMChannel  # Reference to the ComMChannel on which the DcmDslProtocolRxPdu is received and the DcmDslProtocolTxPdu is transmitted.
                reference DcmDslROEConnectionRef [0..1]: scope=ECU, multiplicity set at pre-compile, origin=AUTOSAR_ECUC V1.0.0, set at link in variant link-time / pre-compile in variant post-build+pre-compile, destination=DcmDslResponseOnEvent  # Configures the link to the connection of ROE protocol for processing of the ROE events.
                container DcmDslProtocolRx [1..*]  # This container contains the configuration (parameters) for the protocol configuration of RX channel (for each protocol).The following parameters needs to be configured per protocol. Please keep in mind, that the parameter DcmDslProtocolRxPduId can be given several times per protocol and that the combination from DcmDslProtocolRxPduId and DcmDslProtocolRxAddrType is unique. | The following parameters needs to be configured per protocol. Please keep in mind, that the parameter DcmDslProtocolRxPduId can be given several times per protocol and that the combination from DcmDslProtocolRxPduId and DcmDslProtocolRxAddrType is unique. Only one physical protocol is allowed per connection. upperMultiplicity: More than one receive PDU ID may be configured for reception (e.g. one for func requests, one for phys requests). lowerMultiplicity: At least one receive PDU ID configuration must be provided per protocol.
                  enumeration DcmDslProtocolRxAddrType: {DCM_FUNCTIONAL_TYPE, DCM_PHYSICAL_TYPE}, scope=ECU, set at link in variant link-time / pre-compile in variant post-build+pre-compile  # Declares the communication type of this DCM_PROTOCOL_DCMRXPDUID. PHYSICAL is used for 1 to 1 communication and FUNCTIONAL is used for 1 to n communication. | PHYSICAL is used for 1 to 1 communication FUNCTIONAL is used for 1 to n communication
                  integer DcmDslProtocolRxPduId: 0..65535, scope=ECU, set at pre-compile, symbolic-name-value=true, with-auto=true  # DcmRxPduId value for reception of requests. The user need not update this field. Instead the user may invoke generateId for Dcm inorder to automatically configure the same.
                  reference DcmDslProtocolRxPduRef: scope=ECU, set at link in variant link-time / pre-compile in variant post-build+pre-compile, destination=Pdu  # DcmRxPduId reference for reception of requests / Multiple links shall be allowed. (e.g. one DcmRxPduId to receive func requests, one DcmRxPduId to receive phys requests)
                container DcmDslProtocolTx  # This container contains the configuration (parameters) for the protocol configuration of TX channel (for each protocol) | The included parameters needs to be configured per protocol.
                  integer DcmDslTxConfirmationPduId: 0..65535, scope=ECU, set at pre-compile, symbolic-name-value=true, with-auto=true  # Handle Id to be used by the Lower Layer to confirm the transmission of the DcmDsProtocolTxPdu to the LowerLayer.The user need not update this field. Instead, the user may invoke generateId for Dcm inorder to automatically configure the same.
                  reference DcmDslProtocolTxPduRef: scope=ECU, set at link in variant link-time / pre-compile in variant post-build+pre-compile, destination=Pdu  # DcmTxPduId reference for transmission of responses
              container DcmDslPeriodicTransmission [0..1]  # This container contains the configuration (parameters) for Periodic Transmission service. Hint:Periodic Transmission request comes via DcmDslMainConnection and PeriodicTransmission Event response is given via DcmDslPeriodicTransmission. | Hint: Periodic Transmission request comes via DcmDslMainConnection and PeriodicTransmission Event response is given via DcmDslPeriodicTransmission.
                container DcmDslPeriodicConnection [0..*]  # Holding the TxPduId configuration for PeriodicTransmission.
                  integer DcmDslPeriodicTxConfirmationPduId: 0..65535, scope=ECU, set at pre-compile, symbolic-name-value=true, with-auto=true  # Handle Id to be used by the Lower Layer to confirm the transmission of the DcmDslPeriodicTxPdu to the LowerLayer.The user need not update this field. Instead, the user may invoke generateId for Dcm inorder to automatically configure the same.
                  reference DcmDslPeriodicTxPduRef: scope=ECU, set at link in variant link-time / pre-compile in variant post-build+pre-compile, destination=Pdu  # This is the reference to the PDU ID to be used by this DCM when sending Periodic Transmissions. It is only needed for Type2 Periodic Transmissions configurations.One or several DcmDslPeriodicTxPduRef can be defined if Periodic Transmission is enabled and TYPE2 Periodic Transmissions is configured.DcmDslPeriodicTxPduRef does not need to be defined if Periodic Transmission is not enabled or TYPE1 Periodic Transmissions is configured. | upperMultiplicity: one or several DcmDslPeriodicTxPduRef can be defined if Periodic Transmission is enabled and TYPE2 Periodic Transmissions is configured. lowerMultiplicity: DcmDslPeriodicTxPduRef does not need to be defined if Periodic Transmission is not enabled or TYPE1 Periodic Transmissions is configured..
              container DcmDslResponseOnEvent [0..1]  # This container contains the configuration (parameters) for ResponseOnEvent service.Hint- ROE service request is received via DcmDslMainConnection and Event response is given via DcmDslResposeOnEvent. | Hint: ROE service request is recept via DcmDslMainConnection and that Event response is given via DcmDslResposeOnEvent
                integer DcmDslRoeTxConfirmationPduId [0..1]: 0..65535, scope=ECU, multiplicity set at pre-compile, set at pre-compile, symbolic-name-value=true, with-auto=true  # Handle Id to be used by the Lower Layer to confirm the transmission of the DcmDslRoeTxPdu to the LowerLayer.
                reference DcmDslRoeTxPduRef [0..1]: scope=ECU, multiplicity set at pre-compile, set at link in variant link-time / pre-compile in variant post-build+pre-compile, destination=Pdu  # Reference to the PDU for transmission of ROE response (only needed for ROE Transmission Type is TYPE2). One PDU required if ROE Transmission Type is TYPE2. No PDU required if ROE Transmission Type is TYPE1. | upperMultiplicity: One PDU required if ROE Transmission Type is TYPE2. lowerMultiplicity: No PDU required if ROE Transmission Type is TYPE1.
            container DcmRbDslKWPTimings [0..1]  # Timings set required for KWP protocol
              float DcmRbP2MaxDefaultTime: 0..4293, origin=RB:AR42.1.0.0:2017-01-31, set at link in variant link-time+post-build / pre-compile in variant pre-compile  # Default time of P2 max (This time activated during the start of communication) in seconds
              float DcmRbP2MaxLimitTime: 0..4293, origin=RB:AR42.1.0.0:2017-01-31, set at link in variant link-time+post-build / pre-compile in variant pre-compile  # Limit time of P2 max (Aceess timing parameter service while changing the ECU timngs cross check the limit by refering this configured value) in seconds
              float DcmRbP3MaxDefaultTime: 0..4293, origin=RB:AR42.1.0.0:2017-01-31, set at link in variant link-time+post-build / pre-compile in variant pre-compile  # Default time of P3 max (This time activated during the start of communication) in seconds
              float DcmRbP3MaxLimitTime: 0..4293, origin=RB:AR42.1.0.0:2017-01-31, set at link in variant link-time+post-build / pre-compile in variant pre-compile  # Limit time of P3 max (Aceess timing parameter service while changing the ECU timngs cross check the limit by refering this configured value) in seconds
        container DcmRbDslKWPSplitResponseFeature [0..1]  # The container to enable/disable the feature of splitting the responses for KWP services. If configured, the split of responses from any service shall be supported for KWP2000 services. If not configured, the split of responses by the services shall be disabled. Based on the configuration of the above container, the compiler switch DCM_CFG_SPLITRESPSUPPORTEDFORKWP shall be generated. This container shall be effective only if there is a KWP protocol configured.
          float DcmRbDslKWPTimeBetweenSplitResponses: 0..4293.0, origin=RB:AR42.1.0.0:2017-01-31, set at link in variant link-time / pre-compile in variant post-build+pre-compile  # The parameter to define the timing between any 2 split responses in seconds. The timing has to be in multiples of DcmTaskTime. This parameter is mandatory if the container DcmRbDslKWPSplitResponseFeature is configured. The value in the parameter shall be generated as DCM_CFG_SPLITRESPONSETIMEFORKWP.
      container DcmDsp [0..1]  # These parameters apply to Diagnostic Service Processing. There will always be one set of these parameters per DCM.
        boolean DcmDspDDDIDcheckPerSourceDID [0..1]: multiplicity set at link in variant link-time / pre-compile in variant post-build+pre-compile, set at link in variant link-time / pre-compile in variant post-build+pre-compile  # Defines the check the session, security and mode dependencies per source DIDs with a ReadDataByIdentifier (0x22) | TRUE: DCM module shall check the session, security and mode dependencies per source DIDs with a ReadDataByIdentifier (0x22) with DID in the range 0xF200 to 0xF3FF FALSE:DCM module shall not check the session, security and mode dependencies per source DIDs with a ReadDataByIdentifier (0x22) with DID in the range 0xF200 to 0xF3FF
        enumeration DcmDspDataDefaultEndianness: {BIG_ENDIAN, LITTLE_ENDIAN, OPAQUE}, set at link in variant link-time / pre-compile in variant post-build+pre-compile  # Defines the default endianness belonging to a DID, RID or PID if the corresponding data does not define an endianness.
        boolean DcmDspEnableObdMirror [0..0]: scope=ECU, set at link in variant link-time / pre-compile in variant post-build+pre-compile, default-value=false  # DcmDspEnableObdMirror defines whether a DID inside the OBD range (F400-F4FF) and the OBD InfoType range (F800-F8FF) shall get the DID value as defined for OBD on reception of the UDS Service ReadDataByIdentifier (0x22), or not.
        integer DcmDspMaxDidToRead [0..1]: 1..65535, scope=ECU, multiplicity set at link in variant link-time / pre-compile in variant post-build+pre-compile, set at link in variant link-time / pre-compile in variant post-build+pre-compile  # Indicates the maximum allowed DIDs in a single "ReadDataByIdentifier" request. If set to 0, then no limitation is applied,i.e,any number of DIDs in the request is supported. | If set to 0, then no limitation is applied.
        integer DcmDspMaxPeriodicDidToRead [0..1]: 1..65535, multiplicity set at link in variant link-time / pre-compile in variant post-build+pre-compile, set at link in variant link-time / pre-compile in variant post-build+pre-compile  # Indicates the maximum allowed periodicDIDs which can be read in a single "ReadDataByPeriodicIdentifier" request.
        integer DcmDspPowerDownTime [0..1]: 0..255, scope=ECU, multiplicity set at link in variant link-time / pre-compile in variant post-build+pre-compile, set at link in variant link-time / pre-compile in variant post-build+pre-compile  # This parameter indicates to the client the minimum time of the stand-by sequence the server will remain in the power-down sequence. The resolution of this parameter is one second per count.Values 0x00-0xFE are valid representing 0-254s.The resolution of this parameter is one second per count. The following values are valid: 00 - FE hex: 0 - 254 s powerDownTime; FF hex: indicates a failure or time not available. This value needs to be defined by the integrator according to the ECU capabilities. This parameter has to be available if the service EcuReset, sub-service enableRapidPowerShutDown is configured. | The resolution of this parameter is one second per count. The following values are valid: 00 - FE hex: 0 - 254 s powerDownTime; FF hex: indicates a failure or time not available. This value needs to be defined by the integrator according to the ECU capabilities. This parameter has to be available if the service EcuReset, sub-service enableRapidPowerShutDown is configured.
        boolean DcmRbDspLimitRDBIRespToBufSize [0..1]: multiplicity set at pre-compile, origin=RB:AR42.1.0.0:2017-01-31, set at pre-compile, default-value=false  # Preprocessor switch to enable or disable cut short positive response of RDBI in case if total response length of DID is greater than the available size of DCM response buffer. If set to false, the cutting positive response for RDBI service is disabled i.e., when ever the total response length of DIDs in a request is greater than the available DCM buffer size, the software will simply respond with NRC RESPONSE_TOO_LONG (NRC0x14) IF set to TRUE, the cutting positive response feature for RDBI service is enabled i.e., when the total response length of DIDs in a request is greater than the available DCM buffer size, the software will positively respond to the tester with DIDs which can be accommodated within the available DCM buffer. If the parameter is let unconfigured ,then the FALSE will be considered as the the default value and the if the response length is greater than the DCM buffer size NRC 0x14 will be triggered.
        boolean DcmRbDspRdbiPagedBufferEnabled [0..1]: multiplicity set at pre-compile, origin=RB:AR42.1.0.0:2017-01-31, set at pre-compile, default-value=false  # Vendor specific parameter to enable or disable the support of Paged Buffer for RDBI service. Inorder to support PagedBuffer for RDBI service in addition to this parameter, "DcmPagedBufferEnabled" should also be enabled. When this parameter is set to TRUE RDBI paged buffer support is enabled and the signal size of the DID can be greater than the page size (provided that the use port is configured as USE_RDBI_PAGED_FNC) or the DID should be fit within the page size,based on the configuration of use port of the signal(provided that the use port is configured to any value other than USE_RDBI_PAGED_FNC). When this parameter is set to false or not configured,RDBI paged buffer support is disabled
        boolean DcmRbDspRdtcPagedBufferEnabled [0..1]: multiplicity set at pre-compile, origin=RB:AR42.1.0.0:2017-01-31, set at pre-compile, default-value=false  # Vendor specific parameter to enable or disable the support of Paged Buffer for RDTC service. Inorder to support PagedBuffer for RDTC service in addition to this parameter, "DcmPagedBufferEnabled" should also be enabled. When this parameter is set to TRUE, RDTC paged buffer support is enabled and the total record size of the DTCs can be greater than the page size. When this parameter is set to FALSE or not configured, RDTC paged buffer support is disabled
        boolean DcmRbDspSequenceCheckRequestDownloadDisabled [0..1]: multiplicity set at pre-compile, origin=RB:AR42.1.0.0:2017-01-31, set at pre-compile, default-value=false  # Parameter which decides whether sequence check is enabled or disabled for RequestDownload.If the parameter is set to FALSE , a sequence check shall be done according to the ISO 14229-1 NRC sequence if an RequestDownload request is received if Upload/Download is already active (A previous RequestUpload which is not yet completed with a successful RequestTransferExit request. A negative response with NRC set to 0x22 (ConditionsNotCorrect) shall be send in this case. If the parameter is set to TRUE, no sequence check will be done if a RequestDownload request is received when upload/download is already active.If the parameter is left unconfigured ,then FALSE will be considered as the default value and therefore the sequence check will be enabled..
        boolean DcmRbDspSequenceCheckRequestUploadDisabled [0..1]: multiplicity set at pre-compile, origin=RB:AR42.1.0.0:2017-01-31, set at pre-compile, default-value=false  # Parameter whihc decides whether sequence check is enabled or disabled for RequestUpload.If the parameter is set to FALSE , a sequence check shall be done according to the ISO 14229-1 NRC sequence if an RequestUpload request is received if Upload is already active (A previous RequestUpload which is not yet completed with a successful RequestTransferExit request. A negative response with NRC set to 0x22 (ConditionsNotCorrect) shall be send in this case. If the parameter is set to TRUE, no sequence check will be done if a RequestUpload request is received when upload is already active.If the parameter is left unconfigured ,then FALSE will be considered as the default value and therefore the sequence check will be enabled.
        enumeration DcmRbDspSesSecUsedInProtocol [0..1]: multiplicity set at link in variant link-time+post-build / pre-compile in variant pre-compile, origin=RB:AR42.1.0.0:2017-01-31, set at link in variant link-time+post-build / pre-compile in variant pre-compile, default-value=UDS  # The DcmRbDspSesSecUsedInProtocol is a reference container to DcmDslProtocolRow which uses the Dsp Session and Security Configuration.Configure the protocol that will be using the DcmDspSession and DcmDspSecurity Services. If configured as UDS: UDS protocol shall use the DcmDsp session and security configuration. If configured as KWP: KWP protocol shall use the DcmDsp session and security configuration.
          UDS  # The UDS protocol is using the DcmDsp session and security configuration.
          KWP  # The KWP protocol is using the DcmDsp session and security configuration.
        boolean DcmRbDspTransferDataMaxLenChkRequired [0..1]: multiplicity set at pre-compile, origin=RB:AR42.1.0.0:2017-01-31, set at pre-compile, default-value=true  # Parameter which decides whether the length for TransferData requests/ response following a RequestDownload / RequestUpload needs to be checked against the maxNumberOfBlockLength passed in the RequestUpload/RequestDownload response.If the parameter is configured as TRUE or left unconfigured , Dcm will check if the length for TransferData requests/ response following a RequestDownload / RequestUpload is equal to the parameter maxNumberOfBlockLength passed in response of RequestDownload/RequestUpload service.If the parameter is configured as FALSE, Dcm will not check the length against maxNumberOfBlockLength passed in the RequestUpload/RequestDownload response
        enumeration DcmResponseToEcuReset [0..0]: {AFTER_RESET, BEFORE_RESET}, set at pre-compile, with-auto=true  # Defines the answer to EcuReset service should come: Before or after the reset
        container DcmDspClearDTC [0..1]  # This container contains the configuration (parameters) for ClearDTCInformation service.(0x14)
          function name DcmDspClearDTCCheckFnc [0..1]: multiplicity set at pre-compile, set at pre-compile  # Callback function for condition check, manufacturer / supplier specific checks on the groupOfDTC, which is requested to clear.
          reference DcmDspClearDTCModeRuleRef [0..1]: multiplicity set at pre-compile, set at pre-compile, destination=DcmModeRule  # Mode rule which controls to clear the DTCs. If there is no reference, no check of the mode rule shall be done.
        container DcmDspComControl [0..1]
          container DcmDspComControlAllChannel [0..*]  # Collection of ComM channels which shall be controlled if all networks are addressed.
            boolean DcmDspComControlAllChannelUsed [0..0]: set at link in variant link-time / post-build in variant post-build / pre-compile in variant pre-compile, with-auto=true, default-value=true  # Allow to activate or deactivate the usage of a ComM channel collection to be controlled, for multi purpose ECUs | true = ComM channel collection used false = ComM channel collection not used
            symbolic name reference DcmDspAllComMChannelRef: scope=ECU, set at link in variant link-time / post-build in variant post-build / pre-compile in variant pre-compile, destination=ComMChannel  # Reference to ComM channel.
          container DcmDspComControlSetting [0..1]  # Provide the configuration of the Communication control.
            function name DcmRbDspComControlReEnableUserModeRuleFnc [0..1]: multiplicity set at pre-compile, origin=RB:AR42.1.0.0:2017-01-31, set at pre-compile  # Function name used by the application to perform user specific check to verify if communication modes needs to be re-enabled for the channels.In case the checks fails, communication modes shall be re-enabled. In case the function is not configured , the DcmAppl API DcmAppl_UserCommCtrlReEnableModeRuleService shall be called. | Function name used by the application to perform user specific check to verify if communication modes needs to be re-enabled for the channels.In case the checks fails, communication modes shall be re-enabled. In case the function is not configured for sub service, the DcmAppl API DcmAppl_UserCommCtrlReEnableModeRuleService shall be called.
            reference DcmDspComControlCommunicationReEnableModeRuleRef [0..1]: scope=ECU, multiplicity set at link in variant link-time / pre-compile in variant post-build+pre-compile, set at link in variant link-time / pre-compile in variant post-build+pre-compile, destination=DcmModeRule  # Reference to DcmDspModeRule which controls re-enabling of communication by DCM. The DCM module shall call BswM_Dcm_CommunicationMode_CurrentState(DCM_ENABLE_RX_TX_NORM_NM)) in case that the referenced mode rule is not fulfilled anymore. | of communication by DCM. The DCM module shall call BswM_Dcm_CommunicationMode_CurrentState(DCM_ENABLE_RX_TX_NORM_NM)) in case that the referenced mode rule is not fulfilled anymore.
          container DcmDspComControlSpecificChannel [0..*]  # Assigns subnet number to ComM channel which will be controlled.
            boolean DcmDspComControlSpecificChannelUsed [0..0]: set at link in variant link-time / post-build in variant post-build / pre-compile in variant pre-compile, with-auto=true, default-value=true  # Allow to activate or deactivate the usage of a Subnet assigned to the ComM channel which will be controlled, for multi purpose ECUs. | true = Subnet used false = Subnet not used
            integer DcmDspSubnetNumber: 1..14, scope=ECU, set at pre-compile  # Subnet Number which controls the specific ComMChannel.
            symbolic name reference DcmDspSpecificComMChannelRef: scope=ECU, set at link in variant link-time / post-build in variant post-build / pre-compile in variant pre-compile, destination=ComMChannel  # Reference to ComM channel.
          container DcmDspComControlSubNode [0..0]  # This container gives information about the node identification number and the ComM channel used to address a sub-network.
            integer DcmDspComControlSubNodeId [0..0]: 1..65535, scope=ECU, set at link in variant link-time / pre-compile in variant post-build+pre-compile, with-auto=true  # The node identification number DcmDspComControlSubNodeId is adressed by the CommunicationControl (0x28) request.
            boolean DcmDspComControlSubNodeUsed [0..0]: set at link in variant link-time / post-build in variant post-build / pre-compile in variant pre-compile, with-auto=true, default-value=true  # This parameter determines if a node control function is available or not.
            symbolic name reference DcmDspComControlSubNodeComMChannelRef [0..0]: scope=ECU, set at link in variant link-time / post-build in variant post-build / pre-compile in variant pre-compile, destination=ComMChannel  # This parameter references a ComM channel where this node is connected to.
        container DcmDspCommonAuthorization [0..*]  # This container contains the configuration (parameters) for the common Authorization being equal for several services / sub-services.
          reference DcmDspCommonAuthorizationModeRuleRef [0..1]: scope=ECU, multiplicity set at link in variant link-time / pre-compile in variant post-build+pre-compile, set at link in variant link-time / pre-compile in variant post-build+pre-compile, destination=DcmModeRule  # Reference to DcmDspModeRule | Mode rule which controls this service/ sub-service. If there is no reference, no check of the mode rule shall be done.
          reference DcmDspCommonAuthorizationSecurityLevelRef [0..*]: scope=ECU, multiplicity set at link in variant link-time / pre-compile in variant post-build+pre-compile, set at link in variant link-time / pre-compile in variant post-build+pre-compile, destination=DcmDspSecurityRow  # Reference to DcmDspSecurityRow | Security levels allowed to control this service/ sub-service. If there is no reference, no check of security level shall be done.
          reference DcmDspCommonAuthorizationSessionRef [0..*]: scope=ECU, multiplicity set at link in variant link-time / pre-compile in variant post-build+pre-compile, set at link in variant link-time / pre-compile in variant post-build+pre-compile, destination=DcmDspSessionRow  # Reference to DcmDspSessionRow | Sessions allowed to control this service/ sub-service. If there is no reference, no check of session level shall be done.
        container DcmDspControlDTCSetting [0..1]  # Provide the configuration of the ControlDTCSetting mechanism.
          boolean DcmSupportDTCSettingControlOptionRecord [0..1]: scope=ECU, multiplicity set at pre-compile, set at pre-compile, default-value=false  # This configuration switch defines if the DTCSettingControlOptionRecord is in general supported in the request message or not.
          function name DcmRbDspControlDTCSettingReEnableUserModeRuleFnc [0..1]: multiplicity set at pre-compile, origin=RB:AR42.1.0.0:2017-01-31, set at pre-compile  # Function name used by the application to perform user specific check to verify if DTC setting needs to be re-enabled.In case the checks fails, DTC setting shall be re-enabled. In case the function is not configured , the DcmAppl API DcmAppl_UserDTCSettingEnableModeRuleService shall be called.
          reference DcmDspControlDTCSettingReEnableModeRuleRef [0..1]: scope=ECU, multiplicity set at link in variant link-time / pre-compile in variant post-build+pre-compile, set at link in variant link-time / pre-compile in variant post-build+pre-compile, destination=DcmModeRule  # Reference to DcmDspModeRule | Mode rule which controls re-enabling of controlDTCsetting by DCM. The DCM module shall execute a ControlDTCSetting.Off (call Dem_DcmEnableDTCSetting()) in case that the referenced mode rule is not fulfilled anymore.
        container DcmDspData [0..*]  # This container contains the configuration (parameters) of a Data belonging to a DID
          function name DcmDspDataConditionCheckReadFnc [0..1]: scope=ECU, multiplicity set at pre-compile, set at pre-compile  # Function name to demand application if the conditions (e.g. System state) to read the DID are correct. (ConditionCheckRead-function). | Multiplicity shall be equal to parameter DcmDspDataReadFnc. Only relevant if * DcmDspDataConditionCheckReadFncUsed is set to 'TRUE' and * DcmDspDataUsePort=="USE_DATA_SYNCH_FNC or * DcmDspDataUsePort==USE_DATA_ASYNCH_FNC" or * DcmDspDataUsePort==USE_DATA_ASYNCH_FNC_ERROR". This parameter is related to the interface Xxx_ConditionCheckRead.
          boolean DcmDspDataConditionCheckReadFncUsed [0..1]: multiplicity set at pre-compile, set at pre-compile  # This parameter determines if a condition check function is | available or not. If the parameter is set to 'TRUE' and DcmDspDataUsePort is set to * 'USE_DATA_ASYNCH_CLIENT_SERVER' or * 'USE_DATA_ASYNCH_CLIENT_SERVER_ERROR' or * 'USE_DATA_SYNCH_CLIENT_SERVER', the DCM shall generate the according function call. If the parameter is set to 'TRUE' and DcmDspDataUsePort is set to * 'USE_DATA_SYNCH_FNC' or * 'USE_DATA_ASYNCH_FNC_ERROR' * 'USE_DATA_ASYNCH_FNC', the parameter 'DcmDspDataConditionCheckReadFnc' shall contain a valid C-function.
          function name DcmDspDataEcuSignal [0..0]: scope=ECU, multiplicity set at pre-compile, set at pre-compile, with-auto=true  # Function name to control the access to a certain ECU Signal by the DCM. (IoHwAb_Dcm_<symbolic name of ECU signal>-function). | Only relevant if DcmDspDataUsePort==USE_ECU_SIGNAL.
          enumeration DcmDspDataEndianness [0..1]: {BIG_ENDIAN, LITTLE_ENDIAN, OPAQUE}, multiplicity set at link in variant link-time / pre-compile in variant post-build+pre-compile, set at link in variant link-time / pre-compile in variant post-build+pre-compile  # Defines the endianness of the data belonging to a DID.If projects configures OPAQUE no endianness conversion will be supported/applicable | If no DcmDspDataEndiness is defined the value of DcmDspDataDefaultEndianness is applicable.
          function name DcmDspDataFreezeCurrentStateFnc [0..1]: scope=ECU, multiplicity set at pre-compile, set at pre-compile  # Function name to request to application to freeze the current state of an IOControl. (FreezeCurrentState-function). | Only relevant if * DcmDspDataUsePort=="USE_DATA_SYNCH_FNC or * DcmDspDataUsePort==USE_DATA_ASYNCH_FNC" or * DcmDspDataUsePort==USE_DATA_ASYNCH_FNC_ERROR". This parameter is related to the interface Xxx_FreezeCurrentState.
          function name DcmDspDataGetScalingInfoFnc [0..0]: scope=ECU, multiplicity set at pre-compile, set at pre-compile, with-auto=true  # Function name to request to application the scaling information of the DID. (GetScalingInformation-function). | Only relevant if * DcmDspDataUsePort=="USE_DATA_SYNCH_FNC or * DcmDspDataUsePort==USE_DATA_ASYNCH_FNC" or * DcmDspDataUsePort==USE_DATA_ASYNCH_FNC_ERROR". This parameter is related to the interface Xxxx_GetScalingInformation.
          function name DcmDspDataReadDataLengthFnc [0..1]: scope=ECU, multiplicity set at pre-compile, set at pre-compile  # Function name to request from application the data length of a DID. (ReadDataLength-function). | Only relevant if * DcmDspDataUsePort=="USE_DATA_SYNCH_FNC or * DcmDspDataUsePort==USE_DATA_ASYNCH_FNC" or * DcmDspDataUsePort==USE_DATA_ASYNCH_FNC_ERROR". This parameter is related to the interface Xxx_ReadDataLength.
          function name DcmDspDataReadEcuSignal [0..0]: scope=ECU, multiplicity set at pre-compile, set at pre-compile, with-auto=true  # Function name for read access to a certain ECU Signal by the DCM. (IoHwAb_Dcm_Read<EcuSignalName>-function). | Only relevant if DcmDspDataUsePort==USE_ECU_SIGNAL.
          function name DcmDspDataReadFnc [0..1]: scope=ECU, multiplicity set at pre-compile, set at pre-compile  # Function name to request from application the data value of a DID. (ReadData-function). | Multiplicity shall be equal to parameter DcmDspDataConditionCheckReadFnc. Only relevant if * DcmDspDataConditionCheckReadFncUsed is set to 'TRUE' and * DcmDspDataUsePort=="USE_DATA_SYNCH_FNC or * DcmDspDataUsePort==USE_DATA_ASYNCH_FNC" or * DcmDspDataUsePort==USE_DATA_ASYNCH_FNC_ERROR". This parameter is related to the interface Xxx_ReadData.
          function name DcmDspDataResetToDefaultFnc [0..1]: scope=ECU, multiplicity set at pre-compile, set at pre-compile  # Function name to request to application to reset an IOControl to default value. (ResetToDefault-function). | Only relevant if * DcmDspDataUsePort=="USE_DATA_SYNCH_FNC or * DcmDspDataUsePort==USE_DATA_ASYNCH_FNC" or * DcmDspDataUsePort==USE_DATA_ASYNCH_FNC_ERROR". This parameter is related to the interface Xxx_ResetToDefault.
          function name DcmDspDataReturnControlToEcuFnc [0..1]: scope=ECU, multiplicity set at pre-compile, set at pre-compile  # Function name to request to application to return control to ECU of an IOControl. (ReturnControlToECU-function). | Only relevant if * DcmDspDataUsePort=="USE_DATA_SYNCH_FNC or * DcmDspDataUsePort==USE_DATA_ASYNCH_FNC" or * DcmDspDataUsePort==USE_DATA_ASYNCH_FNC_ERROR". This parameter is related to the interface Xxx_ReturnControlToECU.
          function name DcmDspDataShortTermAdjustmentFnc [0..1]: scope=ECU, multiplicity set at pre-compile, set at pre-compile  # Function name to request to application to adjuste the IO signal. (ShortTermAdjustment-function). | Only relevant if * DcmDspDataUsePort=="USE_DATA_SYNCH_FNC or * DcmDspDataUsePort==USE_DATA_ASYNCH_FNC" or * DcmDspDataUsePort==USE_DATA_ASYNCH_FNC_ERROR". This parameter is related to the interface Xxx_ShortTermAdjustment.
          integer DcmDspDataSize [0..1]: 0..65535, scope=ECU, multiplicity set at link in variant link-time / pre-compile in variant post-build+pre-compile, set at link in variant link-time / pre-compile in variant post-build+pre-compile  # Length of data in bits associated to the Data. If Data has variable datalength, that corresponds to the maximum datalength. If the the parameter DcmDspDataUsePort is configured as USE_DATA_SENDER_RECEIVER/USE_BLOCK_ID, the user need not update this field. Instead the user may invoke generateId for Dcm inorder to automatically configure the same depending on parameter DcmDspDataType/DcmDspDataBlockIdRef->NvMNvBlockLength.respectively
          enumeration DcmDspDataType: {BOOLEAN, SINT16, SINT16_N, SINT32, SINT32_N, SINT8, SINT8_N, UINT16, UINT16_N, UINT32, UINT32_N, UINT8, UINT8_DYN, UINT8_N}, scope=ECU, set at link in variant link-time / pre-compile in variant post-build+pre-compile  # Provide the implementation data type of data belonging to a DID.
          enumeration DcmDspDataUsePort: {USE_BLOCK_ID, USE_DATA_ASYNCH_CLIENT_SERVER, USE_DATA_ASYNCH_FNC, USE_DATA_SENDER_RECEIVER, USE_DATA_SENDER_RECEIVER_AS_SERVICE, USE_DATA_SYNCH_CLIENT_SERVER, USE_DATA_SYNCH_FNC, USE_DATA_RDBI_PAGED_FNC}, scope=ECU, set at pre-compile  # Defines which interface shall be used to access the data.
          boolean DcmRbDspDataUseAsynchronousServerCallPoint [0..1]: multiplicity set at link in variant link-time+post-build / pre-compile in variant pre-compile, origin=RB:AR42.1.0.0:2017-01-31, set at link in variant link-time+post-build / pre-compile in variant pre-compile, default-value=false  # Only relevant in case DcmDspDataUsePort is set to USE_DATA_ASYNCH_CLIENT_SERVER.This parameter is used to select the type of Server Handling required.Set the value to TRUE for Asynchronous server call point handling else Synchronous server call point handling is carried out
          string DcmRbDspDataArrayInfoSubElement [0..1]: multiplicity set at link in variant link-time / pre-compile in variant post-build+pre-compile, origin=AR42.2.0.0:2017-07-31, set at link in variant link-time / pre-compile in variant post-build+pre-compile  # String Input which contains the information Sub Array Index for DcmSubElementInImplDataElementInstance or structure type info for DcmSubElementInDataElementInstance. If DcmSubElementInDataElementInstance is configured then this parameter should the structure Type as well as the as the sub-structure type separated by commas: eg: struct Test { uint8 A, uint32 B }; If B is the SubElement required then this parameter must be filled with - Test,B If DcmSubElementInImplDataElementInstance is configured then this parameter should contain the sub array index to be accessed:
          function name DcmDspDataWriteFnc [0..1]: scope=ECU, multiplicity set at pre-compile, set at pre-compile  # Function name to request application to write the data value of a DID. (WriteData-function). | Only relevant if * DcmDspDataUsePort=="USE_DATA_SYNCH_FNC or * DcmDspDataUsePort==USE_DATA_ASYNCH_FNC" or * DcmDspDataUsePort==USE_DATA_ASYNCH_FNC_ERROR". This parameter is related to the interface Xxx_WriteData.
          add info DcmDspOdxDataDescription [0..0]: multiplicity set at pre-compile, set at pre-compile, with-auto=true  # Defines additional description for ODX documentation
          reference DcmDspDataInfoRef [0..0]: scope=ECU, set at pre-compile, destination=DcmDspDataInfo  # Reference to 1 DcmDspDataInfo
          symbolic name reference DcmDspDataBlockIdRef [0..1]: scope=ECU, multiplicity set at pre-compile, set at pre-compile, destination=NvMBlockDescriptor  # NVRAM blockId to access the data.Only relevant if DcmDspDataUsePort==USE_BLOCK_ID. | Only relevant if DcmDspDataUsePort==USE_BLOCK_ID.
          choice container DcmDspDiagnosisScaling [0..1]  # This container contains the configuration (parameters) of an alternative Diagnosis Representation. Out if this the scaling between Diagnosis and ECU internal representation and vice versa can be calculated.
            container DcmDspAlternativeDataInterface [0..0]  # This container contains the configuration (parameters) of an alternative Diagnosis Representation by the means of a VariableDataPrototoype in a DataInterface. | Additionally a reference to PortInterfaceMapping can be defined which provide already the mapping rules between the VariableDataPrototoype in a DataInterface used by the software component (DcmDspExternalSRDataElementClass) and the intended Diagnosis Representation defined by DcmDataElement.
              foreign reference DcmDataElement [0..0]: set at pre-compile, destination-type=VARIABLE-DATA-PROTOTYPE  # Alternative Diagnosis Representation for the data defined by the means of a VariableDataPrototoype in a DataInterface.
              foreign reference DcmPortInterfaceMapping [0..0]: multiplicity set at pre-compile, set at pre-compile, destination-type=PORT-INTERFACE-MAPPING  # Optional reference to PortInterfaceMapping which defines the mapping rules.
            container DcmDspAlternativeDataProps [0..1]  # This container contains the configuration (parameters) of an alternative Diagnosis Representation by the means of ECU configuration parameters. | The physical unit of the alternative data representation is defined by the DataPrototype referenced by DcmDspExternalSRDataElementClass. Additionally the definition of a text table mapping can be a defined for DcmDspDataTypeCategory TEXTTABLE and SCALE_LINEAR_AND_TEXTTABLE
              enumeration DcmDspDataTypeCategory [0..0]: {LINEAR, SCALE_LINEAR_AND_TEXTTABLE, TEXTTABLE}, scope=ECU, set at pre-compile, with-auto=true  # Data category of the alternative Diagnosis Representation.
              container DcmDspLinearScale [0..1]  # This container contains the configuration (parameters) of an linear scale of the alternative Diagnosis Representation.
                float DcmDspDiagnosisRepresentationDataLowerRange: -Inf..Inf, scope=ECU, set at pre-compile  # Lower Range for this scale of the data in the alternative Diagnosis Representation.
                float DcmDspDiagnosisRepresentationDataOffset: 0..Inf, scope=ECU, set at pre-compile, default-value=0  # Data offset of the alternative Diagnosis Representation for this scale.
                float DcmDspDiagnosisRepresentationDataResolution: 0..Inf, scope=ECU, set at pre-compile  # Data resolution of the alternative Diagnosis Representation for this scale.
                float DcmDspDiagnosisRepresentationDataUpperRange: -Inf..Inf, scope=ECU, set at pre-compile  # Upper Range for this scale of the data in the alternative Diagnosis Representation.
              container DcmDspTextTableMapping [0..0]  # This container contains the configuration (parameters) of the mapping a DataPrototype typed by AutosarDataType that refer to a CompuMethods of category TEXTTABLE or SCALE_LINEAR_AND_TEXTTABLE. | Each DcmDspTextTableMapping defines a value pair which is used to map the ECU internal value (DcmDspInternalDataValue) to the vale used in the diagnosis representation (DcmDspDiagnosisRepresentationDataValue) and vice versa. The set of all DcmDspTextTableMappings defines the whole mapping of an data.
                integer DcmDspDiagnosisRepresentationDataValue [0..0]: 0..18446744073709551615, scope=ECU, set at pre-compile  # The data value in the diagnosis representation.
                integer DcmDspInternalDataValue [0..0]: 0..18446744073709551615, scope=ECU, set at pre-compile, with-auto=true  # The ECU internal data value.
            container DcmDspAlternativeDataType [0..1]  # This container contains the configuration (parameters) of an alternative Diagnosis Representation by the means of an ApplicationDataType. | Additionally the definition of a text table mapping can be a defined for ApplicationDataTypes of category TEXTTABLE and SCALE_LINEAR_AND_TEXTTABLE.
              foreign reference DcmApplicationDataType: set at pre-compile, destination-type=APPLICATION-DATA-TYPE  # Alternative Diagnosis Representation for the data defined by the means of a ApplicationPrimitiveDataType of category VALUE or BOOLEAN.
              container DcmDspTextTableMapping [0..0]  # This container contains the configuration (parameters) of the mapping a DataPrototype typed by AutosarDataType that refer to a CompuMethods of category TEXTTABLE or SCALE_LINEAR_AND_TEXTTABLE. | Each DcmDspTextTableMapping defines a value pair which is used to map the ECU internal value (DcmDspInternalDataValue) to the vale used in the diagnosis representation (DcmDspDiagnosisRepresentationDataValue) and vice versa. The set of all DcmDspTextTableMappings defines the whole mapping of an data.
                integer DcmDspDiagnosisRepresentationDataValue [0..0]: 0..18446744073709551615, scope=ECU, set at pre-compile, with-auto=true  # The data value in the diagnosis representation.
                integer DcmDspInternalDataValue [0..0]: 0..18446744073709551615, scope=ECU, set at pre-compile, with-auto=true  # The ECU internal data value.
          choice container DcmDspExternalSRDataElementClass [0..1]  # This container defines the source of data in a provided port which shall be read respectively the target of data in a required port which shall be written. | This container shall contain either one DcmSubElementInDataElementInstance OR DcmDataElementInstance OR DcmSubElementInImplDataElementInstance reference.
            container DcmDataElementInstance [0..1]  # Instance Reference to the primitive data in a port where the data element is typed with an ApplicationPrimitveDataType or an ImplementationDataType.
              instance reference DcmDataElementInstanceRef: set at pre-compile, destination-context=ROOT-SW-COMPOSITION-PROTOTYPE SW-COMPONENT-PROTOTYPE PORT-PROTOTYPE, destination-type=AUTOSAR-DATA-PROTOTYPE  # Instance Reference to the primitive data which shall be read or written. | Supported are VariableDataPrototypes in SenderReceiverInterfaces and NvDataInterfaces and ParameterDataPrototypes in ParameterInterfaces (read only). This reference is applicable if the AutosarDataPrototype is typed with a ApplicationPrimitiveDataType of category VALUE or BOOLEAN or if the AutosarDataPrototype is typed with a ImplementationDataType of category VALUE or TYPE_REFERENCE that in turn boils down to VALUE
            container DcmSubElementInDataElementInstance [0..1]  # Instance Reference to the primitve sub-element (at any level) of composite data in a port where the data element is typed with an ApplicationCompositeDataType.
              instance reference DcmSubElementInDataElementInstanceRef: set at pre-compile, destination-context=ROOT-SW-COMPOSITION-PROTOTYPE SW-COMPONENT-PROTOTYPE PORT-PROTOTYPE AUTOSAR-DATA-PROTOTYPE APPLICATION-COMPOSITE-ELEMENT-DATA-PROTOTYPE*, destination-type=APPLICATION-COMPOSITE-ELEMENT-DATA-PROTOTYPE  # Instance Reference to the primitve sub-element (at any level) of composite data in a port which shall be read or written. | Supported are VariableDataPrototypes in SenderReceiverInterfaces and NvDataInterfaces and ParameterDataPrototypes in ParameterInterfaces (read only). This reference is applicable if the AutosarDataPrototype is typed with a ApplicationCompositeDataType.
            container DcmSubElementInImplDataElementInstance [0..1]  # Instance Reference to the primitve sub-element (at any level) of composite data in a port where the data element is typed with an ImplementationDataType.
              instance reference DcmSubElementInImplDataElementInstanceRef: set at pre-compile, destination-context=ROOT-SW-COMPOSITION-PROTOTYPE SW-COMPONENT-PROTOTYPE PORT-PROTOTYPE AUTOSAR-DATA-PROTOTYPE IMPLEMENTATION-DATA-TYPE-ELEMENT*, destination-type=IMPLEMENTATION-DATA-TYPE-ELEMENT  # Instance Reference to the primitve sub-element (at any level) of composite data in a port which shall be read or written. | Supported are VariableDataPrototypes in SenderReceiverInterfaces and NvDataInterfaces and ParameterDataPrototypes in ParameterInterfaces (read only). This reference is applicable if the AutosarDataPrototype is typed with a ImplementationDataType of category STRUCTURE or ARRAY. Please note that in case of ARRAY the index attribute in the target reference has to be set to select a single array element.
        container DcmDspDataInfo [0..0]  # This container contains the configuration (parameters) of a Data
          integer DcmDspDataScalingInfoSize [0..0]: 0..4294967295, scope=ECU, multiplicity set at link in variant link-time / pre-compile in variant post-build+pre-compile, set at link in variant link-time / pre-compile in variant post-build+pre-compile, with-auto=true  # If Scaling information service is available for this Data, it provides the size in bytes of the scaling information.
        container DcmDspDid [0..*]  # This container contains the configuration (parameters) of the DID.
          integer DcmDspDidIdentifier: 0..65535, scope=ECU, set at link in variant link-time / pre-compile in variant post-build+pre-compile  # 2 byte Identifier of the DID | Within each DcmConfigSet all DcmDspDidIdentifier values shall be unique.
          boolean DcmDspDidUsed [0..0]: scope=ECU, set at link in variant link-time / post-build in variant post-build / pre-compile in variant pre-compile, with-auto=true  # Allow to activate or deactivate the usage of a DID, for multi purpose ECUs | true = DID available false = DID not available
          function name DcmRbDspIsDIDAvailableFnc [0..1]: multiplicity set at pre-compile, origin=RB:AR42.1.0.0:2017-01-31, set at pre-compile  # Function name to request the application to check if the DID requested is supported in the variant.The user can leave the field empty if the check is not required for this DID
          reference DcmDspDidInfoRef: scope=ECU, set at link in variant link-time / pre-compile in variant post-build+pre-compile, destination=DcmDspDidInfo  # Reference to DcmDspDidInfo containing information on this DID.
          reference DcmDspDidInfotypeRef [0..0]: scope=ECU, multiplicity set at link in variant link-time / pre-compile in variant post-build+pre-compile, set at link in variant link-time / pre-compile in variant post-build+pre-compile, destination=DcmDspVehInfo  # Reference to DcmDspVehInfo | DcmDspVehInfo contains the configuration (parameters) of the "Request vehicle information service" (service $09).
          reference DcmDspDidPidRef [0..0]: scope=ECU, multiplicity set at link in variant link-time / pre-compile in variant post-build+pre-compile, set at link in variant link-time / pre-compile in variant post-build+pre-compile, destination=DcmDspPid  # Reference to DcmDspPid. | DcmDspPid defines the availability of a PID to the DCM
          reference DcmDspDidRef [0..0]: scope=ECU, multiplicity set at link in variant link-time / pre-compile in variant post-build+pre-compile, requires-index=true, set at link in variant link-time / pre-compile in variant post-build+pre-compile, destination=DcmDspDid  # Reference to DcmDspDid in case this DID refer to one or serveral other DID's
          container DcmDspDidSignal [0..*]  # This container defines the reference to 1 DcmDspData container and position relevant for this DID.
            integer DcmDspDidDataPos: 0..65535, scope=ECU, set at link in variant link-time / pre-compile in variant post-build+pre-compile  # Defines the position of the data defined by DcmDspDidDataRef reference to DcmDspData container in the DID. | The position is defined in bits.
            reference DcmDspDidDataRef: scope=ECU, set at link in variant link-time / pre-compile in variant post-build+pre-compile, destination=DcmDspData  # Reference to 1 DcmDspData container relevant for this DID.
          container DcmDspDidExtRoe [0..1]  # Provide information to manage a responseOnEvent request on this DID externally. If this container doesn't exist, an ROE event on this DID will be managed internally.In CUBAS DCM internally managed DIDs are not supported, if the projects want monitoring of DID as per Autosar 4.0.2, then it is mandatory to configure the DcmDspDidExtRoe | The R-Port for ROEServices interface is named ROEServices_<SWC> where <SWC> is the name of this container.
            function name DcmDspDidRoeActivateFnc [0..1]: multiplicity set at link in variant link-time / pre-compile in variant post-build+pre-compile, set at link in variant link-time / pre-compile in variant post-build+pre-compile  # Function name to activate/deactivate an ROE event managed externally.This parameter is related to the interface xxx_ActivateEvent.This parameter is to be configured mandatorily if atleast one of the signal of the DID is of the following DcmDspDataUsePort==USE_DATA_SYNCH_FNC/USE_DATA_ASYNCH_FNC/USE_BLOCK_ID. IF all the signals of the DID are set to ===USE_DATA_SENDER_RECEIVER/USE_DATA_ASYNCH_CLIENT_SERVER/USE_DATA_SYNCH_CLIENT_SERVER | Only relevant if DcmDspDataUsePort== USE_DATA_SYNCH_FNC/USE_DATA_ASYNCH_FNC. This parameter is related to the interface xxx_ActivateEvent.
            integer DcmDspDidRoeEventId: 0..255, set at link in variant link-time / pre-compile in variant post-build+pre-compile  # EventId to be used within Apis Dcm_TriggerOnEvent() and xxx_ActivateEvent()
        container DcmDspDidInfo [0..*]  # This container contains the configuration (parameters) of the DID's Info
          integer DcmDspDDDIDMaxElements [0..1]: 1..255, multiplicity set at link in variant link-time / pre-compile in variant post-build+pre-compile, set at link in variant link-time / pre-compile in variant post-build+pre-compile  # Maximum number of source elements of a DDDID.
          boolean DcmDspDidDynamicallyDefined: scope=ECU, set at link in variant link-time / pre-compile in variant post-build+pre-compile  # Indicates if this DID can be dynamically defined | true = DID can be dynamically defined false = DID can not be dynamically defined
          container DcmDspDidControl [0..1]  # This container contains the configuration (parameters) of the DID control.
            enumeration DcmDspDidControlMask: {DCM_CONTROLMASK_EXTERNAL, DCM_CONTROLMASK_INTERNAL, DCM_CONTROLMASK_NO}, set at link in variant link-time / pre-compile in variant post-build+pre-compile, default-value=DCM_CONTROLMASK_INTERNAL  # This indicates the presence of "controlEnableMask" in the AUTOSR interface.
            integer DcmDspDidControlMaskSize [0..1]: 0..4, multiplicity set at link in variant link-time / pre-compile in variant post-build+pre-compile, set at link in variant link-time / pre-compile in variant post-build+pre-compile  # The value defines the size of the controlEnableMaskRecord in bytes.
            boolean DcmDspDidFreezeCurrentState: scope=ECU, set at pre-compile  # This indicates the presence of "FreezeCurrentState".
            boolean DcmDspDidResetToDefault: scope=ECU, set at pre-compile  # This indicates the presence of "ResetToDefault".
            boolean DcmDspDidShortTermAdjustment: scope=ECU, set at pre-compile  # This indicates the presence of "ShortTermAdjustment".
            function name DcmRbDspDidControlUserModeRuleFnc [0..1]: multiplicity set at pre-compile, origin=RB:AR42.1.0.0:2017-01-31, set at pre-compile  # Function name used by the application to perform user specific checks before IO Control of a DID.In case the checks fails, NRC value set by the application can be returned to the tester. In case the function is not configured for DID Control, the DcmAppl API DcmAppl_UserDIDModeRuleService shall be called.
            boolean DcmRbDspIoCtrlResetOnSessSecurityChange [0..1]: multiplicity set at pre-compile, origin=RB:AR42.1.0.0:2017-01-31, set at pre-compile, default-value=true  # Indicates if resetting of IOControl on session / security change is enabled / disabled. | True = IOcontrol on session / security change is enabled False = IOcontrol on session / security change is disabled
            reference DcmDspDidControlModeRuleRef [0..1]: scope=ECU, multiplicity set at link in variant link-time / pre-compile in variant post-build+pre-compile, set at link in variant link-time / pre-compile in variant post-build+pre-compile, destination=DcmModeRule  # Reference to DcmDspModeRule | Mode rule which controls this DID. If there is no reference, no check of the mode rule shall be done.
            reference DcmDspDidControlSecurityLevelRef [0..*]: scope=ECU, multiplicity set at link in variant link-time / pre-compile in variant post-build+pre-compile, set at link in variant link-time / pre-compile in variant post-build+pre-compile, destination=DcmDspSecurityRow  # Reference to DcmDspSecurityRow | Security levels allowed to control this DID. If there is no reference, no check of security level shall be done.
            reference DcmDspDidControlSessionRef [0..*]: scope=ECU, multiplicity set at link in variant link-time / pre-compile in variant post-build+pre-compile, set at link in variant link-time / pre-compile in variant post-build+pre-compile, destination=DcmDspSessionRow  # Reference to DcmDspSessionRow | Sessions allowed to control this DID. If there is no reference, no check of session level shall be done.
            container DcmDspDidControlEnableMask [0..0]  # The shortname of the container value defines the symbol of the controlMask.
              integer DcmDspDidControlMaskBitPosition [0..0]: 0..31, scope=ECU, set at pre-compile  # Defines the position of the bit in the controlMask starting from most significant bit (MSB first) to least significant bit. | This Bit endianness is identical to the controlMask in UDS. The DcmDspDidControlMaskSize should be considered for most significant bit.
          container DcmDspDidRead [0..1]  # This container contains the configuration (parameters) of the DID read.
            function name DcmRbDspDidReadUserModeRuleFnc [0..1]: multiplicity set at pre-compile, origin=RB:AR42.1.0.0:2017-01-31, set at pre-compile  # Function name used by the application to perform user specific checks before Reading a DID.In case the checks fails, NRC value set by the application can be returned to the tester. In case the function is not configured for DID Read, the DcmAppl API DcmAppl_UserDIDModeRuleService shall be called.
            reference DcmDspDidReadModeRuleRef [0..1]: scope=ECU, multiplicity set at link in variant link-time / pre-compile in variant post-build+pre-compile, set at link in variant link-time / pre-compile in variant post-build+pre-compile, destination=DcmModeRule  # Reference to DcmDspModeRule | Mode rule which controls to read this DID. If there is no reference, no check of the mode rule shall be done.
            reference DcmDspDidReadSecurityLevelRef [0..*]: scope=ECU, multiplicity set at link in variant link-time / pre-compile in variant post-build+pre-compile, set at link in variant link-time / pre-compile in variant post-build+pre-compile, destination=DcmDspSecurityRow  # Reference to DcmDspSecurityRow | Security levels allowed to read this DID. If there is no reference, no check of security level shall be done.
            reference DcmDspDidReadSessionRef [0..*]: scope=ECU, multiplicity set at link in variant link-time / pre-compile in variant post-build+pre-compile, set at link in variant link-time / pre-compile in variant post-build+pre-compile, destination=DcmDspSessionRow  # Reference to DcmDspSessionRow | Sessions allowed to read this DID. If there is no reference, no check of session level shall be done.
          container DcmDspDidWrite [0..1]  # This container contains the configuration (parameters) of the DID write.
            function name DcmRbDspDidWriteUserModeRuleFnc [0..1]: multiplicity set at pre-compile, origin=RB:AR42.1.0.0:2017-01-31, set at pre-compile  # Function name used by the application to perform user specific checks before writing a DID.In case the checks fails, NRC value set by the application can be returned to the tester. In case the function is not configured for DID Write, the DcmAppl API DcmAppl_UserDIDModeRuleService shall be called.
            reference DcmDspDidWriteModeRuleRef [0..1]: scope=ECU, multiplicity set at link in variant link-time / pre-compile in variant post-build+pre-compile, set at link in variant link-time / pre-compile in variant post-build+pre-compile, destination=DcmModeRule  # Reference to DcmDspModeRule | Mode rule which controls to write this DID. If there is no reference, no check of the mode rule shall be done.
            reference DcmDspDidWriteSecurityLevelRef [0..*]: scope=ECU, multiplicity set at link in variant link-time / pre-compile in variant post-build+pre-compile, set at link in variant link-time / pre-compile in variant post-build+pre-compile, destination=DcmDspSecurityRow  # Reference to DcmDspSecurityRow | Security levels allowed to write this DID. If there is no reference, no check of security level shall be done.
            reference DcmDspDidWriteSessionRef [0..*]: scope=ECU, multiplicity set at link in variant link-time / pre-compile in variant post-build+pre-compile, set at link in variant link-time / pre-compile in variant post-build+pre-compile, destination=DcmDspSessionRow  # Reference to DcmDspSessionRow | Sessions allowed to write this DID. If there is no reference, no check of session level shall be done.
        container DcmDspDidRange [0..*]  # This container defines the DID Range
          boolean DcmDspDidRangeHasGaps: scope=ECU, set at link in variant link-time / pre-compile in variant post-build+pre-compile  # Parameter specifying if there are gaps in the DID range (parameter set to TRUE) or not (parameter set to FALSE)
          integer DcmDspDidRangeIdentifierLowerLimit: 0..65535, scope=ECU, set at link in variant link-time / pre-compile in variant post-build+pre-compile  # Lower limit of DID range.
          integer DcmDspDidRangeIdentifierUpperLimit: 0..65535, scope=ECU, set at link in variant link-time / pre-compile in variant post-build+pre-compile  # Upper limit of DID range.
          function name DcmDspDidRangeIsDidAvailableFnc [0..1]: scope=ECU, multiplicity set at pre-compile, set at pre-compile  # Function name to request from application if a specific DID is available within the range or not. | Only relevant if DcmDspDidRangeUsePort is set to false. This parameter is related to the interface Xxx_IsDidAvailable.
          integer DcmDspDidRangeMaxDataLength: 0..65535, scope=ECU, set at link in variant link-time / pre-compile in variant post-build+pre-compile  # Maximum data length in bytes
          function name DcmDspDidRangeReadDataLengthFnc [0..1]: multiplicity set at pre-compile, set at pre-compile  # Function name to request from application the data Length value for range of a DID.(ReadData-function).The parameter should be entered always,when DcmDspDidRangeUsePort is set to FALSE. | This parameter is related to the interface Xxx_ReadDidData. This parameter is related to the interface Xxx_ReadDidRangeDataLength.
          function name DcmDspDidRangeReadDidFnc [0..1]: scope=ECU, multiplicity set at pre-compile, set at pre-compile  # Function name to request from application the data range value of a DID.(ReadData-function). | Only relevant if DcmDspDidRangeUsePort is set to false. This parameter is related to the interface Xxx_ReadDidData.
          boolean DcmDspDidRangeUsePort: scope=ECU, set at pre-compile  # When the parameter DcmDspDidRangeUsePort is set to true the DCM will access the Data using an R-Port requiring a PortInteface DataServices_DIDRange. In that case, DcmDspDidRangeIsDidAvailableFnc, DcmDspDidRangeReadDidFnc and DcmDspDidRangeWriteDidFnc are ignored and the RTE APIs are used. When the parameter DcmDspDidRangeUsePort is false, the DCM calls the functions defined in DcmDspDidRangeIsDidAvailableFnc, DcmDspDidRangeReadDidFnc and DcmDspDidRangeWriteDidFnc.
          function name DcmDspDidRangeWriteDidFnc [0..1]: scope=ECU, multiplicity set at pre-compile, set at pre-compile  # Function name to request application to write the data range value of a DID.(WriteData-function). | Only relevant if DcmDspDidRangeUsePort is set to false. This parameter is related to the interface Xxx_WriteDidData.
          reference DcmDspDidRangeInfoRef: scope=ECU, set at link in variant link-time / pre-compile in variant post-build+pre-compile, destination=DcmDspDidInfo  # Reference to DcmDspDidInfo containing information on this DID Range.
        container DcmDspMemory [0..1]  # This container contains the configuration of the memory access.
          container DcmDspAddressAndLengthFormatIdentifier [0..0]  # This container contains the configuration of the supported AddressAndLengthFormatIdentifiers for memory access.
            integer DcmDspSupportedAddressAndLengthFormatIdentifier [0..0]: 0..255, scope=ECU, multiplicity set at link in variant link-time / pre-compile in variant post-build+pre-compile, set at link in variant link-time / pre-compile in variant post-build+pre-compile, with-auto=true  # This parameter defines the supported AddressAndLengthFormatIdentifier of the request message.
          container DcmDspMemoryIdInfo [1..*]  # Provides the value of memory identifier used to select the desired memory device | This container contains the configuration of the memory access requested through diagnostic services : ReadMemoryByAddress, WriteMemoryByAddress, RequestDownload, RequestUpload
            integer DcmDspMemoryIdValue [0..1]: 0..255, scope=ECU, multiplicity set at link in variant link-time / pre-compile in variant post-build+pre-compile, set at link in variant link-time / pre-compile in variant post-build+pre-compile  # Value of the memory device identifier used. | If this parameter is not configured, the DCM will not use MemoryIdentifier parameter. The Dcm_WriteMemory and Dcm_ReadMemory callouts shall be called without the MemoryIdentifier parameter. If this parameter is configured, the DCM will use MemoryIdentifier parameter to select the memory device to use. The Dcm_WriteMemory and Dcm_ReadMemory callouts shall be called with the MemoryIdentifier parameter. Every values configured in the configuration parameter DcmDspMemoryIdValue shall be unique. The MemoryIdValue is retrieved from the request messages (RMBA,WMBA,RD,RU,DDDI) according to ISO-14229-1.
            container DcmDspReadMemoryRangeInfo [0..*]  # Provides the range of memory address allowed for reading
              integer DcmDspReadMemoryRangeHigh: 0..4294967294, scope=ECU, set at link in variant link-time / pre-compile in variant post-build+pre-compile  # High memory address of a range allowed for reading
              integer DcmDspReadMemoryRangeLow: 0..4294967294, scope=ECU, set at link in variant link-time / pre-compile in variant post-build+pre-compile  # Low memory address of a range allowed for reading
              function name DcmRbDspReadMemoryRangeUserModeRuleFnc [0..1]: multiplicity set at pre-compile, origin=RB:AR42.1.0.0:2017-01-31, set at pre-compile  # Function name used by the application to perform user specific checks before reading a memory range.In case the checks fails, NRC value set by the application can be returned to the tester. In case the function is not configured for memory range, the DcmAppl API DcmAppl_UserMemoryRangeModeRuleService shall be called.
              reference DcmDspReadMemoryRangeModeRuleRef [0..1]: scope=ECU, multiplicity set at link in variant link-time / pre-compile in variant post-build+pre-compile, set at link in variant link-time / pre-compile in variant post-build+pre-compile, destination=DcmModeRule  # Reference to DcmDspModeRule | Mode rule which controls read access on this memory address. If there is no reference, no check of the mode rule shall be done.
              reference DcmDspReadMemoryRangeSecurityLevelRef [0..*]: scope=ECU, multiplicity set at link in variant link-time / pre-compile in variant post-build+pre-compile, set at link in variant link-time / pre-compile in variant post-build+pre-compile, destination=DcmDspSecurityRow  # Link to the Security Access Levels needed for read access on this memory address. If there is no reference, no check of security level shall be done.
              reference DcmDspReadMemoryRangeSessionLevelRef [0..*]: multiplicity set at link in variant link-time / pre-compile in variant post-build+pre-compile, set at link in variant link-time / pre-compile in variant post-build+pre-compile, destination=DcmDspSessionRow  # Link to the Session Levels needed for read access on this memory address. User can configure multiple DcmDspReadMemoryRangeSessionLevelRef for read access on this memory address. If reference is provided, then read access on this memory address shall be enabled only in the configured session levels. No session level check shall be done before read access on this memory address, if no reference is provided.
            container DcmDspWriteMemoryRangeInfo [0..*]  # Provides the range of memory address allowed for writting.
              integer DcmDspWriteMemoryRangeHigh: 0..4294967294, scope=ECU, set at link in variant link-time / pre-compile in variant post-build+pre-compile  # High memory address of a range allowed for writting.
              integer DcmDspWriteMemoryRangeLow: 0..4294967294, scope=ECU, set at link in variant link-time / pre-compile in variant post-build+pre-compile  # Low memory address of a range allowed for writting
              function name DcmRbDspWriteMemoryRangeUserModeRuleFnc [0..1]: multiplicity set at pre-compile, origin=RB:AR42.1.0.0:2017-01-31, set at pre-compile  # Function name used by the application to perform user specific checks before writing to a memory range.In case the checks fails, NRC value set by the application can be returned to the tester. In case the function is not configured for memory range, the DcmAppl API DcmAppl_UserMemoryRangeModeRuleService shall be called.
              reference DcmDspWriteMemoryRangeModeRuleRef [0..1]: scope=ECU, multiplicity set at link in variant link-time / pre-compile in variant post-build+pre-compile, set at link in variant link-time / pre-compile in variant post-build+pre-compile, destination=DcmModeRule  # Reference to DcmDspModeRule | Mode rule which controls write access on this memory address. If there is no reference, no check of the mode rule shall be done.
              reference DcmDspWriteMemoryRangeSecurityLevelRef [0..*]: scope=ECU, multiplicity set at link in variant link-time / pre-compile in variant post-build+pre-compile, set at link in variant link-time / pre-compile in variant post-build+pre-compile, destination=DcmDspSecurityRow  # Link to the Security Access Levels needed for write access on this memory address. If there is no reference, no check of security level shall be done.
              reference DcmDspWriteMemoryRangeSessionLevelRef [0..*]: multiplicity set at link in variant link-time / pre-compile in variant post-build+pre-compile, set at link in variant link-time / pre-compile in variant post-build+pre-compile, destination=DcmDspSessionRow  # Link to the Session Levels needed for write access on this memory address. User can configure multiple DcmDspWriteMemoryRangeSessionLevelRef for write access on this memory address. If reference is provided, then write access on this memory address shall be enabled only in the configured session levels. No session level check shall be done before write access on this memory address, if no reference is provided.
            container DcmDspReadMemoryRangeByLabelInfo [0..*]  # Provides a memory range allowed for reading via labels (lower and higher address configured as strings). | This container contains the configuration of the memory range allowed for reading
              string DcmDspReadMemoryRangeByLabelLow: origin=AR42.1.0.0:2017-01-31, set at link in variant link-time / pre-compile in variant post-build+pre-compile  # Lower memory address of a range allowed for reading. The address can be entered only in string format and the corresponding macro definition should be included in DcmAppl.h file
              string DcmDspReadMemoryRangeByLabelHigh: origin=AR42.1.0.0:2017-01-31, set at link in variant link-time / pre-compile in variant post-build+pre-compile  # Higher memory address of a range allowed for reading. The address can be entered only in string format and the corresponding macro definition should be included in DcmAppl.h file
              function name DcmRbDspReadMemoryRangeUserModeRuleFnc [0..1]: multiplicity set at link in variant link-time+post-build / pre-compile in variant pre-compile, origin=RB:AR42.1.0.0:2017-01-31, set at pre-compile  # Function name used by the application to perform user specific checks before reading a memory range.In case the checks fails, NRC value set by the application can be returned to the tester. In case the function is not configured for memory range, the DcmAppl API DcmAppl_UserMemoryRangeModeRuleService shall be called.
              reference DcmDspReadMemoryRangeModeRuleRef [0..1]: multiplicity set at link in variant link-time+post-build / pre-compile in variant pre-compile, origin=RB:AR42.1.0.0:2017-01-31, set at link in variant link-time / pre-compile in variant post-build+pre-compile, destination=DcmModeRule  # Reference to DcmDspModeRule which controls read access on this memory address. If there is no reference, no check of the mode rule shall be done. Refer container DcmProcessingConditions->DcmModeRule for more information regarding mode rules | Mode rule which controls read access on this memory address. If there is no reference, no check of the mode rule shall be done.
              reference DcmDspReadMemoryRangeSecurityLevelRef [0..*]: multiplicity set at link in variant link-time+post-build / pre-compile in variant pre-compile, origin=RB:AR42.1.0.0:2017-01-31, set at link in variant link-time / pre-compile in variant post-build+pre-compile, destination=DcmDspSecurityRow  # Link to the Security Access Levels needed for read access on this memory address. User can configure multiple DcmDspReadMemoryRangeSecurityLevelRef for read access on this memory range. If reference is provided, then read access on this memory address shall be allowed only in the configured security levels. Read access on this memory address will be allowed in all security levels, if no reference is provided.
              reference DcmDspReadMemoryRangeSessionLevelRef [0..*]: multiplicity set at link in variant link-time+post-build / pre-compile in variant pre-compile, origin=RB:AR42.1.0.0:2017-01-31, set at link in variant link-time / pre-compile in variant post-build+pre-compile, destination=DcmDspSessionRow  # Link to the Session Levels needed for Read access on this memory address. User can configure multiple DcmDspReadMemoryRangeSessionLevelRef for Read access on this memory address. If reference is provided, then Read access on this memory address shall be enabled only in the configured session levels. No session level check shall be done before Read access on this memory address, if no reference is provided.
            container DcmDspWriteMemoryRangeByLabelInfo [0..*]  # Provides a memory range allowed for Writing via labels (lower and higher address configured as strings). | This container contains the configuration of the memory range allowed for Writing
              string DcmDspWriteMemoryRangeByLabelLow: origin=AR42.1.0.0:2017-01-31, set at link in variant link-time / pre-compile in variant post-build+pre-compile  # Lower memory address of a range allowed for Writing. The address can be entered only in string format and the corresponding macro definition should be included in DcmAppl.h file
              string DcmDspWriteMemoryRangeByLabelHigh: origin=AR42.1.0.0:2017-01-31, set at link in variant link-time / pre-compile in variant post-build+pre-compile  # Higher memory address of a range allowed for Writing. The address can be entered only in string format and the corresponding macro definition should be included in DcmAppl.h file
              function name DcmRbDspWriteMemoryRangeUserModeRuleFnc [0..1]: multiplicity set at link in variant link-time+post-build / pre-compile in variant pre-compile, origin=RB:AR42.1.0.0:2017-01-31, set at pre-compile  # Function name used by the application to perform user specific checks before writing to a memory range.In case the checks fails, NRC value set by the application can be returned to the tester. In case the function is not configured for memory range, the DcmAppl API DcmAppl_UserMemoryRangeModeRuleService shall be called.
              reference DcmDspWriteMemoryRangeModeRuleRef [0..1]: multiplicity set at link in variant link-time+post-build / pre-compile in variant pre-compile, origin=AR42.1.0.0:2017-01-31, set at link in variant link-time / pre-compile in variant post-build+pre-compile, destination=DcmModeRule  # Reference to DcmDspModeRule which controls Write access on this memory address. If there is no reference, no check of the mode rule shall be done. Refer container DcmProcessingConditions->DcmModeRule for more information regarding mode rules | Mode rule which controls Write access on this memory address. If there is no reference, no check of the mode rule shall be done.
              reference DcmDspWriteMemoryRangeSecurityLevelRef [0..*]: multiplicity set at link in variant link-time+post-build / pre-compile in variant pre-compile, origin=AR42.1.0.0:2017-01-31, set at link in variant link-time / pre-compile in variant post-build+pre-compile, destination=DcmDspSecurityRow  # Link to the Security Access Levels needed for Write access on this memory address. User can configure multiple DcmDspWriteMemoryRangeSecurityLevelRef for Write access on this memory range. If reference is provided, then Write access on this memory address shall be allowed only in the configured security levels. Write access on this memory address will be allowed in all security levels, if no reference is provided.
              reference DcmDspWriteMemoryRangeSessionLevelRef [0..*]: multiplicity set at link in variant link-time+post-build / pre-compile in variant pre-compile, origin=RB:AR42.1.0.0:2017-01-31, set at link in variant link-time / pre-compile in variant post-build+pre-compile, destination=DcmDspSessionRow  # Link to the Session Levels needed for write access on this memory address. User can configure multiple DcmDspWriteMemoryRangeSessionLevelRef for write access on this memory address. If reference is provided, then write access on this memory address shall be enabled only in the configured session levels. No session level check shall be done before write access on this memory address, if no reference is provided.
            container DcmRbDspDownloadMemoryRangeInfo [0..*]  # Provides the range of memory address allowed for download
              integer DcmRbDspDownloadMemoryRangeHigh: 0..4294967294, origin=RB:AR42.1.0.0:2017-01-31, set at link in variant link-time / pre-compile in variant post-build+pre-compile  # High memory address of a range allowed for download
              integer DcmRbDspDownloadMemoryRangeLow: 0..4294967294, origin=RB:AR42.1.0.0:2017-01-31, set at link in variant link-time / pre-compile in variant post-build+pre-compile  # Low memory address of a range allowed for download.
              reference DcmRbDspDownloadMemoryRangeSecurityLevelRef [0..*]: multiplicity set at link in variant link-time / pre-compile in variant post-build+pre-compile, origin=RB:AR42.1.0.0:2017-01-31, set at link in variant link-time / pre-compile in variant post-build+pre-compile, destination=DcmDspSecurityRow  # Link to the Security Access Levels needed for download access on this memory address. If there is no reference, no check of security level shall be done.
            container DcmRbDspUploadMemoryRangeInfo [0..*]  # Provides the range of memory address allowed for upload
              integer DcmRbDspUploadMemoryRangeHigh: 0..4294967294, origin=RB:AR42.1.0.0:2017-01-31, set at link in variant link-time / pre-compile in variant post-build+pre-compile  # High memory address of a range allowed for upload.
              integer DcmRbDspUploadMemoryRangeLow: 0..4294967294, origin=RB:AR42.1.0.0:2017-01-31, set at link in variant link-time / pre-compile in variant post-build+pre-compile  # Low memory address of a range allowed for upload.
              reference DcmRbDspUploadMemoryRangeSecurityLevelRef [0..*]: scope=ECU, multiplicity set at link in variant link-time+post-build / pre-compile in variant pre-compile, origin=RB:AR42.1.0.0:2017-01-31, set at link in variant link-time / pre-compile in variant post-build+pre-compile, destination=DcmDspSecurityRow  # Link to the Security Access Levels needed for upload access on this memory address. If there is no reference, no check of security level shall be done.
        container DcmDspPeriodicDidTransmission [0..1]  # This container contains the configuration for the Periodic Did transmission. | This container exists only if the UDS Service ReadDataByPeriodicIdentifier(0x2A) is configured.
          integer DcmDspMaxPeriodicDidScheduler: 1..255, set at link in variant link-time / pre-compile in variant post-build+pre-compile  # Defines the maximum number of periodicDataIdentifiers that can be scheduled concurrently.
          enumeration DcmRbDspRDPIISOVersion [0..1]: {ISO14229_01_2013_03, ISO14229_01_2006_12}, multiplicity set at link in variant link-time / pre-compile in variant post-build+pre-compile, origin=RB:AR42.1.0.0:2017-01-31, set at link in variant link-time / pre-compile in variant post-build+pre-compile, default-value=ISO14229_01_2013_03  # This parameter indicates the version of ISO the project needs, the projects can choose between ISO version ISO14229-1 2013-03 edition and older edition ISO14229_01_2006_12. This parameter is only relevant to Rdpi and is used to choose the NRC sent when the no. of PDID in a request exceeds the configured DcmDspMaxPeriodicDidToRead. If ISO14229-1 2013-03 edition is chosen NRC 0x13 will be sent, else NRC 0x31 will be sent which is according to ISO14229_01_2006_12. ISO14229_01_2013_03 is the latest released ISO version. If the parameter is left unconfigured , ISO14229_01_2013_03 shall be considered as default | This parameter indicates the version of ISO the project needs, the projects can choose between ISO version ISO14229-1 2013-03 edition and older edition ISO14229_01_2006_12. This parameter is only relevant to Rdpi and is used to choose the NRC sent when the no. of PDID in a request exceeds the configured DcmDspMaxPeriodicDidToRead. If ISO14229-1 2013-03 edition is chosen NRC 0x13 will be sent, else NRC 0x31 will be sent which is according to ISO14229_01_2006_12. ISO14229_01_2013_03 is the latest released ISO version.
          integer DcmRbDspRdpiType2FreeTxPduCount [0..1]: 1..255, multiplicity set at pre-compile, origin=RB:AR42.1.0.0:2017-01-31, set at pre-compile, default-value=10  # This parameter indicates the number of main function calls available for Dcm before releasing the TxPdu in case of no confirmation from the lower layers. For example if this value is configured as 5 and say DcmTasktime is 10ms, 50 msecs of time is available for the confirmation to be received, if no confirmation is received the TxPduID is released for later transmission. This parameter has to be configured to a value greater than the timeout value for RDPI available in the Tp Modules
        container DcmDspPeriodicTransmission [0..1]  # This container contains the configuration (parameters) for Periodic Transmission Processing.
          float DcmDspPeriodicTransmissionFastRate [0..1]: 1E-4..0.255, multiplicity set at pre-compile, set at link in variant link-time / pre-compile in variant post-build+pre-compile  # This parameter give the transmission rate of the requested periodicDataIdentifiers to be used if the parameter transmissionMode given in the ReadDataByPeriodicID request is equal to 0x03 ("sendAtFastRate"). This parameter value in seconds have to be configured as a multiple of DcmTaskTime. | min: A negative value and zero is not allowed.
          float DcmDspPeriodicTransmissionMediumRate [0..1]: 1E-4..0.255, multiplicity set at pre-compile, set at link in variant link-time / pre-compile in variant post-build+pre-compile  # This parameter give the transmission rate of the requested periodicDataIdentifiers to be used if the parameter transmissionMode given in the ReadDataByPeriodicID request is equal to 0x02 ("sendAtMediumRate"). This parameter value in seconds have to be configured as a multiple of DcmTaskTime. | min: A negative value and zero is not allowed.
          float DcmDspPeriodicTransmissionSlowRate [0..1]: 1E-4..0.255, multiplicity set at pre-compile, set at link in variant link-time / pre-compile in variant post-build+pre-compile  # This parameter give the transmission rate of the requested periodicDataIdentifiers to be used if the parameter transmissionMode given in the ReadDataByPeriodicID request is equal to 0x01 ("sendAtSlowRate"). This parameter value in seconds have to be configured as a multiple of DcmTaskTime. | min: A negative value and zero is not allowed.
        container DcmDspPid [0..*]  # This container defines the availability of a PID to the DCM.
          integer DcmDspPidIdentifier: 0..255, scope=ECU, set at link in variant link-time / pre-compile in variant post-build+pre-compile  # 1 byte Identifier of the PID | Within each DcmConfigSet all DcmDspPidIdentifier values shall be unique.
          enumeration DcmDspPidService: {DCM_SERVICE_01, DCM_SERVICE_01_02, DCM_SERVICE_02}, scope=ECU, set at link in variant link-time / pre-compile in variant post-build+pre-compile  # Allow to indicate if this PID is used for service $01 or/and $02.
          integer DcmDspPidSize: 0..255, scope=ECU, set at link in variant link-time / pre-compile in variant post-build+pre-compile  # Length of the PID in byte.
          boolean DcmDspPidUsed [0..0]: scope=ECU, set at link in variant link-time / post-build in variant post-build / pre-compile in variant pre-compile, with-auto=true  # Allow to activate or deactivate the usage of a PID, for multi purpose ECUs | true = PID available false = PID not available
          container DcmDspPidData [1..*]  # This container defines the parameter for a Signal in the PID.
            integer DcmDspPidDataPos: 0..2040, scope=ECU, set at link in variant link-time / pre-compile in variant post-build+pre-compile  # This is the position in bit of the PID structure and will not start at position 0 in case a support information is availabe (for bit-mapped PIDs).
            integer DcmDspPidDataSize [0..1]: 0..2040, scope=ECU, multiplicity set at link in variant link-time / pre-compile in variant post-build+pre-compile, set at link in variant link-time / pre-compile in variant post-build+pre-compile  # Length of data associated to the PID in bit.
            container DcmDspPidDataSupportInfo [0..1]  # This container defines the supported information.
              integer DcmDspPidDataSupportInfoBit: 0..255, scope=ECU, set at link in variant link-time / pre-compile in variant post-build+pre-compile  # referenced Bit of the SupportInfo
              reference DcmDspPidDataSupportInfoRef: scope=ECU, set at link in variant link-time / pre-compile in variant post-build+pre-compile, destination=DcmDspPidSupportInfo  # Reference to DcmDspPidSupportInfo
            container DcmDspPidService01 [0..1]  # Contains specific configuration parameter of PID for service $01. This container exists only if DcmDspPidService is set to DCM_SERVICE_01 or DCM_SERVICE_01_02.
              enumeration DcmDspPidDataEndianness [0..1]: {BIG_ENDIAN, LITTLE_ENDIAN, OPAQUE}, scope=ECU, multiplicity set at pre-compile, set at pre-compile  # Defines the endianness of the data belonging to a PID. | If no DcmDspPidDataEndianness is defined the value of DcmDspDataDefaultEndianness is applicable.
              function name DcmDspPidDataReadFnc [0..1]: scope=ECU, multiplicity set at pre-compile, set at pre-compile  # Function name for reading PID data value. | This is only relevant if DcmDspPidDataUsePort==USE_DATA_SYNCH_FNC. This parameter is related to the interface Xxx_ReadData.
              enumeration DcmDspPidDataType [0..1]: {BOOLEAN, SINT16, SINT16_N, SINT32, SINT32_N, SINT8, SINT8_N, UINT16, UINT16_N, UINT32, UINT32_N, UINT8, UINT8_DYN, UINT8_N}, scope=ECU, multiplicity set at link in variant link-time / pre-compile in variant post-build+pre-compile, set at link in variant link-time / pre-compile in variant post-build+pre-compile  # Provide the implementation data type of data belonging to a PID.
              enumeration DcmDspPidDataUsePort: {USE_DATA_SENDER_RECEIVER, USE_DATA_SYNCH_CLIENT_SERVER, USE_DATA_SYNCH_FNC}, scope=ECU, set at pre-compile  # If this parameter is set to USE_DATA_SYNCH_FNC, the DCM will use the function defined in DcmDspPidDataReadFnc to get the PID data value. | If this parameter is set to USE_DATA_SYNCH_CLIENT_SERVER, the DCM will have an R-Port requiring the interface DataServices_{Data}. If this parameter is set to USE_DATA_SENDER_RECEIVER, the DCM will have an R-Port requiring a SenderReceiverInterface The R-Port is named DataServices_{Data} where {Data} is the name of the container DcmDspPidData.
            container DcmDspPidService02 [0..1]  # Contains specific configuration parameter of PID for service $02. This container exists only if DcmDspPidService is set to DCM_SERVICE_02 or DCM_SERVICE_01_02.
              reference DcmDspPidDataDemRef [0..1]: scope=ECU, multiplicity set at link in variant link-time / pre-compile in variant post-build+pre-compile, set at link in variant link-time / pre-compile in variant post-build+pre-compile, destination=DemPidDataElement  # Reference to DemPidDataElement in DEM configuration. Allows to link the DCM PID and DEM PID configuration for Mode $02.
              reference DcmRbDspPidDemDataElementClassRef [0..1]: multiplicity set at pre-compile, origin=RB:AR42.1.0.0:2017-01-31, set at pre-compile, destination=DemExternalCSDataElementClass  # Reference to DemDataElementClass in DEM configuration.Allows to link the DCM PID and DEM PID configuration for Mode $02.
          container DcmDspPidSupportInfo [0..*]  # This container defines the support information (typically byte A) to declare the usability of the data bytes within the so-called bit-mapped PIDs (e.g. PID$68).
            integer DcmDspPidSupportInfoLen: 0..255, scope=ECU, set at link in variant link-time / pre-compile in variant post-build+pre-compile  # Length of the supported information in bytes.
            integer DcmDspPidSupportInfoPos: 0..255, scope=ECU, set at link in variant link-time / pre-compile in variant post-build+pre-compile  # Position of the supported information in bytes.
        container DcmDspRequestControl [0..*]  # This container contains the configuration (parameters) of the "Request control of on-board system, test or component" service (Service $08). | The DCM will request the control using an R-Port requiring a PortInteface RequestControlServices_{Tid}. The R-Port is named RequestControlServices_{Tid} where {Tid} is the name of the container DcmDspRequestControl.
          integer DcmDspRequestControlInBufferSize: 0..255, scope=ECU, set at link in variant link-time / pre-compile in variant post-build+pre-compile  # Number of bytes to be provided in the input buffer of the interface RequestControlServices_{Tid} for OBD Service $08
          integer DcmDspRequestControlOutBufferSize: 0..255, scope=ECU, set at link in variant link-time / pre-compile in variant post-build+pre-compile  # Number of bytes to be provided in the output buffer of the interface RequestControlServices_{Tid} for OBD Service $08
          integer DcmDspRequestControlTestId: 0..255, scope=ECU, set at link in variant link-time / pre-compile in variant post-build+pre-compile  # Test Id for Service $08
          function name DcmRbDspRequestControlFnc [0..1]: multiplicity set at pre-compile, origin=RB:AR42.1.0.0:2017-01-31, set at pre-compile  # Function name for reading value by TID (DcmDspRequestControlFnc-function). This is only relevant if DcmDspRequestControlUsePort==FALSE.
          boolean DcmRbDspRequestControlUsePort: origin=RB:AR42.1.0.0:2017-01-31, set at pre-compile  # If this is false, the DCM will use the function defined in DcmDspRequestControlFnc. If this is true, R-Port requiring the interface. The name of this port is the name of the container.
        container DcmDspRequestFileTransfer [0..0]  # This container contains the configuration RequestFileTransfer. | This container only exists if RequestFileTransfer is configured.
          integer DcmRequestFileTransferFileSizeParameterLength [0..0]: 0..255, scope=ECU, set at pre-compile, with-auto=true  # Length of the fileSizeCompressed and fileSizeUncompressedOrDirInfoLength in the Dcm_ProcessRequestFileTransfer operation and response message.
          integer DcmRequestFileTransferLengthFormatIdentifier [0..0]: 0..255, scope=ECU, set at pre-compile, with-auto=true  # Defines the length (number of bytes) of the maxNumberOfBlockLength parameter.
        container DcmDspRoe [0..1]  # Provide the configuration of the ResponseOnEvent mechanism.
          float DcmDspRoeInterMessageTime: 0..5, set at link in variant link-time / pre-compile in variant post-build+pre-compile  # Provide the minimum time in seconds between two transmissions of ROE event. It is used for the delay between two different consecutive Roe transmissions.
          boolean DcmRbDspWindowTimeInReportEvents: origin=RB:AR42.1.0.0:2017-07-31  # If set to TRUE the Event Window Time will be the part of Roe request for event type ReportActiveEvents. If set to FALSE the Event Window Time will not be the part of Roe request for event type ReportActiveEvents;
          container DcmDspRoeEvent [1..255]  # This container contains a list of all supported Roe eventTypeRecords which are accepted by this ECU. | At most one DcmDspRoeEvent container is allowed to define a DcmDspRoeEventProperties container with the choice DcmDspRoeOnDTCStatusChange.
            integer DcmDspRoeEventId: 0..254, set at pre-compile, symbolic-name-value=true  # EventId for a global identification of this ROE event it is used within APIs Dcm_TriggerOnEvent() and the ModeDeclarationGroup. | The ratio Ids should be sequentially ordered beginning with 0 and no gaps in between.
            enumeration DcmDspRoeInitialEventStatus: {DCM_ROE_CLEARED, DCM_ROE_STOPPED}, set at link in variant link-time / pre-compile in variant post-build+pre-compile, default-value=DCM_ROE_CLEARED  # Initial Roe status of this RoeEvent
            choice container DcmDspRoeEventProperties  # This container contains the properties of Roe eventTypeRecords. | In one DcmDspRoeEventProperties container one DcmDspRoeOnDTCStatusChange or DcmDspRoeOnChangeOfDataIdentifier container shall be defined.
              container DcmDspRoeOnChangeOfDataIdentifier [0..1]  # This container contains configuration of a eventTypeRecord onChangeOfDataIdentifier accepted by this ECU.
                reference DcmDspRoeDidRef: set at link in variant link-time / pre-compile in variant post-build+pre-compile, destination=DcmDspDid  # Reference to a Did which is watched.
              container DcmDspRoeOnDTCStatusChange [0..1]  # This container contains configuration of a eventTypeRecord onDTCStatusChange accepted by this ECU. | Please note that currently are no additional parameters for DcmDspRoeOnDTCStatusChange are defined. Therefore the existence of the container denotes the choice.
          container DcmDspRoeEventWindowTime [1..*]  # This container configures the available EventWindowTime in this Ecu. | This container contains a sub-set of EventWindowTimes supported by the Dcm, to limit the Ecu resources.
            enumeration DcmDspRoeEventWindowTime: {DCM_ROE_EVENT_WINDOW_CURRENT_AND_FOLLOWING_CYCLE, DCM_ROE_EVENT_WINDOW_CURRENT_CYCLE, DCM_ROE_EVENT_WINDOW_INFINITE}, set at pre-compile  # Value of the EventWindowTime
            boolean DcmDspRoeStorageState: set at pre-compile  # If this parameter is set to TRUE the StorageStateBit will be evaluated if this EventWindowTime is requested.
        container DcmDspRoutine [0..*]  # This container contains the configuration (parameters) for Routines
          integer DcmDspRoutineIdentifier: 0..65535, scope=ECU, set at link in variant link-time / pre-compile in variant post-build+pre-compile  # 2 bytes Identifier of the RID | Within each DcmConfigSet all DcmDspRoutineIdentifier values shall be unique.
          integer DcmDspRoutineInfoByte [0..0]: 0..255, scope=ECU, set at link in variant link-time / pre-compile in variant post-build+pre-compile  # Manufacturer specific value reported to the tester for the record identifiers 0xE000 to OxE1FF. (OBD use cases)
          boolean DcmDspRoutineUsePort: scope=ECU, multiplicity set at pre-compile, set at pre-compile  # If this parameter is set to true, the DCM uses a port requiring a PortInterface RoutineServices_{RoutineName}. | The R-Port is named RoutineServices_{RoutineName} where {RoutineName} is the name of the container DcmDspRoutine In that case, the configuration must not provide function names in DcmDspStartRoutineFnc, DcmDspStopRoutineFnc or DcmDspRequestResultsRoutineFnc. If this is false, the DCM expects to find the names of the functions to be used in DcmDspStartRoutineFnc, DcmDspStopRoutineFnc or DcmDspRequestResultsRoutineFnc.
          boolean DcmRbDspRoutineUseAsynchronousServerCallPoint [0..1]: multiplicity set at link in variant link-time+post-build / pre-compile in variant pre-compile, origin=RB:AR42.13.0.0:2017-01-31, set at link in variant link-time+post-build / pre-compile in variant pre-compile, default-value=false  # Only relevant in case DcmDspRoutineUsePort is set to TRUE.This parameter is used to select the type of Server Handling required.Set the value to TRUE for Asynchronous server call point handling else Synchronous server call point handling is carried out
          boolean DcmDspRoutineUsed [0..0]: scope=ECU, set at link in variant link-time / post-build in variant post-build / pre-compile in variant pre-compile, with-auto=true  # Allow to activate or deactivate the usage of a Routine, for multi purpose ECUs | true = Routine available false = Routine not available
          function name DcmRbDspIsRIDAvailableFnc [0..1]: multiplicity set at pre-compile, origin=RB:AR42.1.0.0:2017-01-31, set at pre-compile  # Function name to request the application to check if the routine identifier (RID) requested is supported in the variant.The user can leave the field empty if the check is not required for this RID
          boolean DcmRbDspReqSequenceErrorEnabled [0..1]: multiplicity set at pre-compile, origin=RB:AR42.1.0.0:2017-01-31, set at pre-compile, default-value=true  # Indicates Request Sequence Error (NRC 0x24) shall be triggered for a RequestResults/Stop subfunction with/without a prior Start subfunction request for Routines which supports both RequestResults and Start subfunctions/ Stop and Start Subfunctions. True :For a Routine which supports both RequestResults/Stop and Start Subfunction,NRC 0x24 shall be triggered if Routine Control tester request with RequestResults subfunction(0x03)/Stop subfunction(0x02) comes for a Routine which is not started (without a prior Routine Control request with Start subfunction(0x01)) False:For a Routine which supports both RequestResults/Stop and Start Subfunction,positive response shall be triggered if valid Routine Control tester request with RequestResults subfunction(0x03)/Stop subfunction(0x02) comes without a prior Routine Control request with Start subfunction(0x01) Dependency: Applicable only if Start subfunction (DcmDspStartRoutineSupported configured as TRUE or left unconfigured) and RequestResults subfunction(DcmDspRequestResultsRoutineSupported configured as TRUE)/Stop subfunction(DcmDspStopRoutineSupported configured as TRUE) is supported for RID, otherwise not valid.If the parameter is left unconfigured , default value will be considered as TRUE and the request sequence error will be enabled. | True:For a Routine which supports both RequestResults/Stop and Start Subfunction,NRC 0x24 shall be triggered if Routine Control tester request with RequestResults subfunction(0x03/Stop subfunction(0x02) comes for a Routine which is not started (without a prior Routine Control request with Start subfunction(0x01)) False:For a Routine which supports both RequestResults/Stop and Start Subfunction,positive response shall be triggered if Routine Control tester request with RequestResults subfunction(0x03)/Stop subfunction(0x02) comes without a prior Routine Control request with Start subfunction(0x01)
          function name DcmRbDspRoutineUserRoutineModeRuleFnc [0..1]: multiplicity set at pre-compile, origin=RB:AR42.1.0.0:2017-01-31, set at pre-compile  # Function name used by the application to perform user specific checks before accessing a Routine.In case the checks fails, NRC value set by the application can be returned to the tester. In case the function is not configured for the Routine, the DcmAppl API DcmAppl_UserRIDModeRuleService shall be called.
          boolean DcmRbDspStopRoutineOnSessionChange [0..1]: multiplicity set at pre-compile, origin=RB:AR42.1.0.0:2017-01-31, set at pre-compile, default-value=false  # Indicates if the StopRoutine operation needs to be performed on any session change. True = Stop this Routine if it is active on transition to default session / Stop this routine if it is not supported in the new nondefault session. False = No action on session transitions Dependency: Applicable only if StopRoutine operation is supported for RID (DcmDspStopRoutineSupported = true), otherwise not valid.If the parameter is left unconfigured FALSE will be considered as the default value. | true = stopRoutine is supported on session change false = stopRoutine is not supported on session change
          reference DcmDspCommonAuthorizationRef [0..0]: scope=ECU, multiplicity set at link in variant link-time / pre-compile in variant post-build+pre-compile, set at link in variant link-time / pre-compile in variant post-build+pre-compile, destination=DcmDspCommonAuthorization  # Reference to DcmDspCommonAuthorization | Common authorization configuration taken from the referenced DcmDspCommonAuthorization. If there is no reference, no check on the commonly defined authorization conditions shall be done.
          reference DcmDspRoutineTidRef [0..0]: scope=ECU, multiplicity set at link in variant link-time / pre-compile in variant post-build+pre-compile, set at link in variant link-time / pre-compile in variant post-build+pre-compile, destination=DcmDspRequestControl  # Reference to DcmDspRequestControl | DcmDspRequestControl contains the configuration (parameters) of the "Request control of on-board system, test or component" service (Service $08).
          container DcmDspRequestRoutineResults [0..1]  # Provides the configuration of RequestResult subservice for RoutineControl service. | Existence indicates that the RequestRoutineResults in the RoutineControl is supported.
            function name DcmDspRequestRoutineResultsFnc [0..1]: scope=ECU, multiplicity set at pre-compile, set at pre-compile  # Function name for request to application the results of a routine. (Routine_RequestResults-function) | This parameter is related to the interface Xxx_RequestResults.
            reference DcmDspRequestRoutineResultsCommonAuthorizationRef [0..1]: scope=ECU, multiplicity set at link in variant link-time / pre-compile in variant post-build+pre-compile, set at link in variant link-time / pre-compile in variant post-build+pre-compile, destination=DcmDspCommonAuthorization  # Reference to DcmDspCommonAuthorization | Common authorization configuration taken from the referenced DcmDspRequestRoutineResultsCommonAuthorizationRef. If there is no reference, no check on the commonly defined authorization conditions shall be done to get the routine result.
            container DcmDspRequestRoutineResultsOut [0..1]  # Provide description of output parameter of RequestResult subservice for RoutineControl service.
              container DcmDspRequestRoutineResultsOutSignal [1..*]: requires-index=true  # Provide description of a routine signal used in RoutineControl service. | The ordering defined via the index attribute of the subcontainers in this list represents the order of the dataOutN elements in the XXX_RequestResult function call.
                enumeration DcmDspRoutineSignalEndianness [0..1]: {BIG_ENDIAN, LITTLE_ENDIAN, OPAQUE}, scope=ECU, multiplicity set at link in variant link-time / pre-compile in variant post-build+pre-compile, set at link in variant link-time / pre-compile in variant post-build+pre-compile  # Defines the endianness of the data belonging to a Request Routine Response Out Signal. | If no DcmDspRoutineSignalEndianness is defined the value of DcmDspDataDefaultEndianness is applicable.
                integer DcmDspRoutineSignalLength [0..1]: 0..65535, scope=ECU, multiplicity set at link in variant link-time / pre-compile in variant post-build+pre-compile, set at link in variant link-time / pre-compile in variant post-build+pre-compile  # Provide the length in bits of the signal in the RoutineControl request/response
                integer DcmDspRoutineSignalPos: 0..65535, scope=ECU, set at link in variant link-time / pre-compile in variant post-build+pre-compile  # Provide the position of the signal in the RoutineControl request/response. | The position is defined in bits.
                enumeration DcmDspRoutineSignalType: {BOOLEAN, SINT16, SINT16_N, SINT32, SINT32_N, SINT8, SINT8_N, UINT16, UINT16_N, UINT32, UINT32_N, UINT8, UINT8_N, VARIABLE_LENGTH}, scope=ECU, set at link in variant link-time / pre-compile in variant post-build+pre-compile  # Provide the type of the signal in the RoutineControl request/response.
                choice container DcmDspArgumentScaling [0..1]  # This container contains the configuration (parameters) of an alternative Diagnosis Representation. Out if this the scaling between Diagnosis and ECU internal representation and vice versa can be calculated.
                  container DcmDspAlternativeArgumentData [0..0]  # This container contains the configuration (parameters) of an alternative Diagnosis Representation by the means of a ArgumentDataPrototype.
                    foreign reference DcmDataElement [0..0]: set at pre-compile, destination-type=ARGUMENT-DATA-PROTOTYPE  # Alternative Diagnosis Representation for the data defined by the means of a ArgumentDataPrototype
                  container DcmDspAlternativeDataProps [0..1]  # This container contains the configuration (parameters) of an alternative Diagnosis Representation by the means of ECU configuration parameters.The physical unit of the alternative data representation is defined by the DataPrototype referenced by DcmDspExternalSRDataElementClass. Additionally the definition of a text table mapping can be a defined for DcmDspDataTypeCategory TEXTTABLE and SCALE_LINEAR_AND_TEXTTABLE | The physical unit of the alternative data representation is defined by the DataPrototype referenced by DcmDspExternalSRDataElementClass. Additionally the definition of a text table mapping can be a defined for DcmDspDataTypeCategory TEXTTABLE and SCALE_LINEAR_AND_TEXTTABLE
                    container DcmDspLinearScale  # This container contains the configuration (parameters) of an linear scale of the alternative Diagnosis Representation.
                      float DcmDspDiagnosisRepresentationDataLowerRange: -Inf..Inf, scope=ECU, set at pre-compile  # Lower Range for this scale of the data in the alternative Diagnosis Representation.
                      float DcmDspDiagnosisRepresentationDataOffset: 0..Inf, scope=ECU, set at pre-compile, default-value=0  # Data offset of the alternative Diagnosis Representation for this scale.
                      float DcmDspDiagnosisRepresentationDataResolution: 0..Inf, scope=ECU, set at pre-compile  # Data resolution of the alternative Diagnosis Representation for this scale.
                      float DcmDspDiagnosisRepresentationDataUpperRange: -Inf..Inf, set at pre-compile  # Upper Range for this scale of the data in the alternative Diagnosis Representation.
                  container DcmDspAlternativeDataType [0..1]  # This container contains the configuration (parameters) of an alternative Diagnosis Representation by the means of an ApplicationDataType. | Additionally the definition of a text table mapping can be a defined for ApplicationDataTypes of category TEXTTABLE and SCALE_LINEAR_AND_TEXTTABLE.
                    foreign reference DcmApplicationDataType: set at pre-compile, destination-type=APPLICATION-DATA-TYPE  # Alternative Diagnosis Representation for the data defined by the means of a ApplicationPrimitiveDataType of category VALUE or BOOLEAN.
                    container DcmDspTextTableMapping [0..0]  # This container contains the configuration (parameters) of the mapping a DataPrototype typed by AutosarDataType that refer to a CompuMethods of category TEXTTABLE or SCALE_LINEAR_AND_TEXTTABLE. | Each DcmDspTextTableMapping defines a value pair which is used to map the ECU internal value (DcmDspInternalDataValue) to the vale used in the diagnosis representation (DcmDspDiagnosisRepresentationDataValue) and vice versa. The set of all DcmDspTextTableMappings defines the whole mapping of an data.
                      integer DcmDspDiagnosisRepresentationDataValue [0..0]: 0..18446744073709551615, scope=ECU, set at pre-compile, with-auto=true  # The data value in the diagnosis representation.
                      integer DcmDspInternalDataValue [0..0]: 0..18446744073709551615, scope=ECU, set at pre-compile  # The ECU internal data value.
            container DcmRbDspRequestRoutineResultsIn [0..1]  # Provide description of input parameter of RequestResults subservice for RoutineControl service.
              container DcmRbDspRequestRoutineResultsInSignal [1..*]: requires-index=true  # Provide description of a routine signal used in RoutineControl service.
                enumeration DcmRbDspRoutineSignalEndianness [0..1]: {BIG_ENDIAN, LITTLE_ENDIAN, OPAQUE}, multiplicity set at link in variant link-time / pre-compile in variant post-build+pre-compile, set at link in variant link-time / pre-compile in variant post-build+pre-compile  # Defines the endianness of the data belonging to a Request Routine Response In Signal.If projects configures OPAQUE no endianness conversion will be supported/applicable | If no DcmDspRoutineSignalEndianness is defined the value of DcmDspDataDefaultEndianness is applicable.
                integer DcmRbDspRoutineSignalLength [0..1]: 0..65535, multiplicity set at link in variant link-time / pre-compile in variant post-build+pre-compile, origin=RB:AR42.1.0.0:2017-01-31, set at link in variant link-time / pre-compile in variant post-build+pre-compile  # Provide the length of the Routine signal in bits.If DcmDspRoutineRequestResINSignal is configured as VARIABLE_LENGTH, then Dcm shall update the currentDataLength parameter of the configured DcmAppl API (DcmDspRequestResultsRoutineFnc) in BYTES before calling the API .CurrentDataLength parameter signifies the actual length of the variable length signal positioned at the end in request.
                integer DcmRbDspRoutineSignalPos: 0..65535, origin=RB:AR42.1.0.0:2017-01-31, set at link in variant link-time / pre-compile in variant post-build+pre-compile  # Provide the position of the signal in the RoutineControl request/response.The position is defined in bits. | The position is defined in bits.
                enumeration DcmRbDspRoutineSignalType: {BOOLEAN, SINT16, SINT16_N, SINT32, SINT32_N, SINT8, SINT8_N, UINT16, UINT16_N, UINT32, UINT32_N, UINT8, UINT8_N, VARIABLE_LENGTH}, origin=RB:AR42.1.0.0:2017-01-31, set at link in variant link-time / pre-compile in variant post-build+pre-compile  # Provide the type of the signal in the RoutineControl request/response.
          container DcmDspStartRoutine [0..1]  # Provides the configuration of Start subservice for RoutineControl service.
            function name DcmDspStartRoutineFnc [0..1]: scope=ECU, multiplicity set at pre-compile, set at pre-compile  # Function name for request to application to start a routine. (Routine_Start-function) | This parameter is related to the interface Xxx_Start.
            reference DcmDspStartRoutineCommonAuthorizationRef [0..1]: scope=ECU, multiplicity set at link in variant link-time / pre-compile in variant post-build+pre-compile, set at link in variant link-time / pre-compile in variant post-build+pre-compile, destination=DcmDspCommonAuthorization  # Reference to DcmDspCommonAuthorization | Common authorization configuration taken from the referenced DcmDspStartRoutineCommonAuthorizationRef. If there is no reference, no check on the commonly defined authorization conditions shall be done to start the routine.
            container DcmDspStartRoutineIn [0..1]  # Provide description of input parameter of Start subservice for RoutineControl service
              container DcmDspStartRoutineInSignal [1..*]: requires-index=true  # Provide description of a routine signal used in RoutineControl service. | The ordering defined via the index attribute of the subcontainers in this list represents the order of the dataInN elements in the XXX_Start function call.
                enumeration DcmDspRoutineSignalEndianness [0..1]: {BIG_ENDIAN, LITTLE_ENDIAN, OPAQUE}, scope=ECU, multiplicity set at link in variant link-time / pre-compile in variant post-build+pre-compile, set at link in variant link-time / pre-compile in variant post-build+pre-compile  # Defines the endianness of the data belonging to a Start Routine In Signal. | If no DcmDspRoutineSignalEndianness is defined the value of DcmDspDataDefaultEndianness is applicable.
                integer DcmDspRoutineSignalLength [0..1]: 0..65535, scope=ECU, multiplicity set at link in variant link-time / pre-compile in variant post-build+pre-compile, set at link in variant link-time / pre-compile in variant post-build+pre-compile  # Provide the length in bits of the signal in the RoutineControl request/response
                integer DcmDspRoutineSignalPos: 0..65535, scope=ECU, set at link in variant link-time / pre-compile in variant post-build+pre-compile  # Provide the position of the signal in the RoutineControl request/response. | The position is defined in bits.
                enumeration DcmDspRoutineSignalType: {BOOLEAN, SINT16, SINT16_N, SINT32, SINT32_N, SINT8, SINT8_N, UINT16, UINT16_N, UINT32, UINT32_N, UINT8, UINT8_N, VARIABLE_LENGTH}, scope=ECU, set at link in variant link-time / pre-compile in variant post-build+pre-compile  # Provide the type of the signal in the RoutineControl request/response.
                choice container DcmDspArgumentScaling [0..1]  # This container contains the configuration (parameters) of an alternative Diagnosis Representation. Out if this the scaling between Diagnosis and ECU internal representation and vice versa can be calculated.
                  container DcmDspAlternativeDataProps [0..1]  # This container contains the configuration (parameters) of an alternative Diagnosis Representation by the means of ECU configuration parameters.The physical unit of the alternative data representation is defined by the DataPrototype referenced by DcmDspExternalSRDataElementClass. Additionally the definition of a text table mapping can be a defined for DcmDspDataTypeCategory TEXTTABLE and SCALE_LINEAR_AND_TEXTTABLE | The physical unit of the alternative data representation is defined by the DataPrototype referenced by DcmDspExternalSRDataElementClass. Additionally the definition of a text table mapping can be a defined for DcmDspDataTypeCategory TEXTTABLE and SCALE_LINEAR_AND_TEXTTABLE
                    container DcmDspLinearScale  # This container contains the configuration (parameters) of an linear scale of the alternative Diagnosis Representation.
                      float DcmDspDiagnosisRepresentationDataLowerRange: -Inf..Inf, scope=ECU, set at pre-compile  # Lower Range for this scale of the data in the alternative Diagnosis Representation.
                      float DcmDspDiagnosisRepresentationDataOffset: 0..Inf, scope=ECU, set at pre-compile, default-value=0  # Data offset of the alternative Diagnosis Representation for this scale.
                      float DcmDspDiagnosisRepresentationDataResolution: 0..Inf, scope=ECU, set at pre-compile  # Data resolution of the alternative Diagnosis Representation for this scale.
                      float DcmDspDiagnosisRepresentationDataUpperRange: -Inf..Inf, scope=ECU, set at pre-compile  # Upper Range for this scale of the data in the alternative Diagnosis Representation.
                  container DcmDspAlternativeDataType [0..1]  # This container contains the configuration (parameters) of an alternative Diagnosis Representation by the means of an ApplicationDataType. | Additionally the definition of a text table mapping can be a defined for ApplicationDataTypes of category TEXTTABLE and SCALE_LINEAR_AND_TEXTTABLE.
                    foreign reference DcmApplicationDataType: set at pre-compile, destination-type=APPLICATION-DATA-TYPE  # Alternative Diagnosis Representation for the data defined by the means of a ApplicationPrimitiveDataType of category VALUE or BOOLEAN.
                    container DcmDspTextTableMapping [0..0]  # This container contains the configuration (parameters) of the mapping a DataPrototype typed by AutosarDataType that refer to a CompuMethods of category TEXTTABLE or SCALE_LINEAR_AND_TEXTTABLE. | Each DcmDspTextTableMapping defines a value pair which is used to map the ECU internal value (DcmDspInternalDataValue) to the vale used in the diagnosis representation (DcmDspDiagnosisRepresentationDataValue) and vice versa. The set of all DcmDspTextTableMappings defines the whole mapping of an data.
                      integer DcmDspDiagnosisRepresentationDataValue [0..0]: 0..18446744073709551615, scope=ECU, set at pre-compile, with-auto=true  # The data value in the diagnosis representation.
                      integer DcmDspInternalDataValue [0..0]: 0..18446744073709551615, scope=ECU, set at pre-compile  # The ECU internal data value.
            container DcmDspStartRoutineOut [0..1]  # Provide description of output parameter of Start subservice for RoutineControl service.
              container DcmDspStartRoutineOutSignal [1..*]: requires-index=true  # Provide description of a routine signal used in RoutineControl service. | The ordering defined via the index attribute of the subcontainers in this list represents the order of the dataOutN elements in the XXX_Start function call.
                enumeration DcmDspRoutineSignalEndianness [0..1]: {BIG_ENDIAN, LITTLE_ENDIAN, OPAQUE}, scope=ECU, multiplicity set at link in variant link-time / pre-compile in variant post-build+pre-compile, set at link in variant link-time / pre-compile in variant post-build+pre-compile  # Defines the endianness of the data belonging to a Start Routine Out Signal. | If no DcmDspRoutineSignalEndianness is defined the value of DcmDspDataDefaultEndianness is applicable.
                integer DcmDspRoutineSignalLength [0..1]: 0..65535, scope=ECU, multiplicity set at link in variant link-time / pre-compile in variant post-build+pre-compile, set at link in variant link-time / pre-compile in variant post-build+pre-compile  # Provide the length in bits of the signal in the RoutineControl request/response.
                integer DcmDspRoutineSignalPos [0..1]: 0..65535, scope=ECU, multiplicity set at link in variant link-time / pre-compile in variant post-build+pre-compile, set at link in variant link-time / pre-compile in variant post-build+pre-compile  # Provide the position of the signal in the RoutineControl request/response. | The position is defined in bits.
                enumeration DcmDspRoutineSignalType: {BOOLEAN, SINT16, SINT16_N, SINT32, SINT32_N, SINT8, SINT8_N, UINT16, UINT16_N, UINT32, UINT32_N, UINT8, UINT8_N, VARIABLE_LENGTH}, scope=ECU, set at link in variant link-time / pre-compile in variant post-build+pre-compile  # Provide the type of the signal in the RoutineControl request/response.
                choice container DcmDspArgumentScaling [0..1]  # This container contains the configuration (parameters) of an alternative Diagnosis Representation. Out if this the scaling between Diagnosis and ECU internal representation and vice versa can be calculated.
                  container DcmDspAlternativeDataProps [0..1]  # This container contains the configuration (parameters) of an alternative Diagnosis Representation by the means of ECU configuration parameters.The physical unit of the alternative data representation is defined by the DataPrototype referenced by DcmDspExternalSRDataElementClass. Additionally the definition of a text table mapping can be a defined for DcmDspDataTypeCategory TEXTTABLE and SCALE_LINEAR_AND_TEXTTABLE | The physical unit of the alternative data representation is defined by the DataPrototype referenced by DcmDspExternalSRDataElementClass. Additionally the definition of a text table mapping can be a defined for DcmDspDataTypeCategory TEXTTABLE and SCALE_LINEAR_AND_TEXTTABLE
                    container DcmDspLinearScale  # This container contains the configuration (parameters) of an linear scale of the alternative Diagnosis Representation.
                      float DcmDspDiagnosisRepresentationDataLowerRange: -Inf..Inf, scope=ECU, set at pre-compile  # Lower Range for this scale of the data in the alternative Diagnosis Representation.
                      float DcmDspDiagnosisRepresentationDataOffset: 0..Inf, scope=ECU, set at pre-compile, default-value=0  # Data offset of the alternative Diagnosis Representation for this scale.
                      float DcmDspDiagnosisRepresentationDataResolution: 0..Inf, scope=ECU, set at pre-compile  # Data resolution of the alternative Diagnosis Representation for this scale.
                      float DcmDspDiagnosisRepresentationDataUpperRange: -Inf..Inf, scope=ECU, set at pre-compile  # Upper Range for this scale of the data in the alternative Diagnosis Representation.
                  container DcmDspAlternativeDataType [0..1]  # This container contains the configuration (parameters) of an alternative Diagnosis Representation by the means of an ApplicationDataType. | Additionally the definition of a text table mapping can be a defined for ApplicationDataTypes of category TEXTTABLE and SCALE_LINEAR_AND_TEXTTABLE.
                    foreign reference DcmApplicationDataType: set at pre-compile, destination-type=APPLICATION-DATA-TYPE  # Alternative Diagnosis Representation for the data defined by the means of a ApplicationPrimitiveDataType of category VALUE or BOOLEAN.
                    container DcmDspTextTableMapping [0..0]  # This container contains the configuration (parameters) of the mapping a DataPrototype typed by AutosarDataType that refer to a CompuMethods of category TEXTTABLE or SCALE_LINEAR_AND_TEXTTABLE. | Each DcmDspTextTableMapping defines a value pair which is used to map the ECU internal value (DcmDspInternalDataValue) to the vale used in the diagnosis representation (DcmDspDiagnosisRepresentationDataValue) and vice versa. The set of all DcmDspTextTableMappings defines the whole mapping of an data.
                      integer DcmDspDiagnosisRepresentationDataValue [0..0]: 0..18446744073709551615, scope=ECU, set at pre-compile, with-auto=true  # The data value in the diagnosis representation.
                      integer DcmDspInternalDataValue [0..0]: 0..18446744073709551615, scope=ECU, set at pre-compile  # The ECU internal data value.
          container DcmDspStopRoutine [0..1]  # Provides the configuration of Stop subservice for RoutineControl service. | Existence indicates that the StopRoutine in the RoutineControl is supported.
            function name DcmDspStopRoutineFnc [0..1]: scope=ECU, multiplicity set at pre-compile, set at pre-compile  # Function name for request to application to stop a routine. (Routine_Stop-function) | This parameter is related to the interface Xxx_Stop.
            reference DcmDspStopRoutineCommonAuthorizationRef [0..1]: scope=ECU, multiplicity set at link in variant link-time / pre-compile in variant post-build+pre-compile, set at link in variant link-time / pre-compile in variant post-build+pre-compile, destination=DcmDspCommonAuthorization  # Reference to DcmDspCommonAuthorization | Common authorization configuration taken from the referenced DcmDspStopRoutineCommonAuthorizationRef. If there is no reference, no check on the commonly defined authorization conditions shall be done to stop the routine.
            container DcmDspStopRoutineIn [0..1]  # Provide description of input parameter of Stop subservice for RoutineControl service.
              container DcmDspStopRoutineInSignal [1..*]: requires-index=true  # Provide description of a routine signal used in RoutineControl service. | The ordering defined via the index attribute of the subcontainers in this list represents the order of the dataInN elements in the XXX_Stop function call.
                enumeration DcmDspRoutineSignalEndianness [0..1]: {BIG_ENDIAN, LITTLE_ENDIAN, OPAQUE}, scope=ECU, multiplicity set at link in variant link-time / pre-compile in variant post-build+pre-compile, set at link in variant link-time / pre-compile in variant post-build+pre-compile  # Defines the endianness of the data belonging to a Stop Routine In Signal. | If no DcmDspRoutineSignalEndianness is defined the value of DcmDspDataDefaultEndianness is applicable.
                integer DcmDspRoutineSignalLength [0..1]: 0..65535, scope=ECU, multiplicity set at link in variant link-time / pre-compile in variant post-build+pre-compile, set at link in variant link-time / pre-compile in variant post-build+pre-compile  # Provide the length in bits of the signal in the RoutineControl request/response
                integer DcmDspRoutineSignalPos: 0..65535, scope=ECU, set at link in variant link-time / pre-compile in variant post-build+pre-compile  # Provide the position of the signal in the RoutineControl request/response. | The position is defined in bits.
                enumeration DcmDspRoutineSignalType: {BOOLEAN, SINT16, SINT16_N, SINT32, SINT32_N, SINT8, SINT8_N, UINT16, UINT16_N, UINT32, UINT32_N, UINT8, UINT8_N, VARIABLE_LENGTH}, scope=ECU, set at link in variant link-time / pre-compile in variant post-build+pre-compile  # Provide the type of the signal in the RoutineControl request/response.
                choice container DcmDspArgumentScaling [0..1]  # This container contains the configuration (parameters) of an alternative Diagnosis Representation. Out if this the scaling between Diagnosis and ECU internal representation and vice versa can be calculated.
                  container DcmDspAlternativeDataProps [0..1]  # This container contains the configuration (parameters) of an alternative Diagnosis Representation by the means of ECU configuration parameters.The physical unit of the alternative data representation is defined by the DataPrototype referenced by DcmDspExternalSRDataElementClass. Additionally the definition of a text table mapping can be a defined for DcmDspDataTypeCategory TEXTTABLE and SCALE_LINEAR_AND_TEXTTABLE | The physical unit of the alternative data representation is defined by the DataPrototype referenced by DcmDspExternalSRDataElementClass. Additionally the definition of a text table mapping can be a defined for DcmDspDataTypeCategory TEXTTABLE and SCALE_LINEAR_AND_TEXTTABLE
                    container DcmDspLinearScale  # This container contains the configuration (parameters) of an linear scale of the alternative Diagnosis Representation.
                      float DcmDspDiagnosisRepresentationDataLowerRange: -Inf..Inf, scope=ECU, set at pre-compile  # Lower Range for this scale of the data in the alternative Diagnosis Representation.
                      float DcmDspDiagnosisRepresentationDataOffset: 0..Inf, scope=ECU, set at pre-compile, default-value=0  # Data offset of the alternative Diagnosis Representation for this scale.
                      float DcmDspDiagnosisRepresentationDataResolution: 0..Inf, scope=ECU, set at pre-compile  # Data resolution of the alternative Diagnosis Representation for this scale.
                      float DcmDspDiagnosisRepresentationDataUpperRange: -Inf..Inf, scope=ECU, set at pre-compile  # Upper Range for this scale of the data in the alternative Diagnosis Representation.
                  container DcmDspAlternativeDataType [0..1]  # This container contains the configuration (parameters) of an alternative Diagnosis Representation by the means of an ApplicationDataType. | Additionally the definition of a text table mapping can be a defined for ApplicationDataTypes of category TEXTTABLE and SCALE_LINEAR_AND_TEXTTABLE.
                    foreign reference DcmApplicationDataType: set at pre-compile, destination-type=APPLICATION-DATA-TYPE  # Alternative Diagnosis Representation for the data defined by the means of a ApplicationPrimitiveDataType of category VALUE or BOOLEAN.
                    container DcmDspTextTableMapping [0..0]  # This container contains the configuration (parameters) of the mapping a DataPrototype typed by AutosarDataType that refer to a CompuMethods of category TEXTTABLE or SCALE_LINEAR_AND_TEXTTABLE. | Each DcmDspTextTableMapping defines a value pair which is used to map the ECU internal value (DcmDspInternalDataValue) to the vale used in the diagnosis representation (DcmDspDiagnosisRepresentationDataValue) and vice versa. The set of all DcmDspTextTableMappings defines the whole mapping of an data.
                      integer DcmDspDiagnosisRepresentationDataValue [0..0]: 0..18446744073709551615, scope=ECU, set at pre-compile, with-auto=true  # The data value in the diagnosis representation.
                      integer DcmDspInternalDataValue [0..0]: 0..18446744073709551615, scope=ECU, set at pre-compile  # The ECU internal data value.
            container DcmDspStopRoutineOut [0..1]  # Provide description of output parameter of Stop subservice for RoutineControl service.
              container DcmDspStopRoutineOutSignal [1..*]: requires-index=true  # Provide description of a routine signal used in RoutineControl service. | The ordering defined via the index attribute of the subcontainers in this list represents the order of the dataOutN elements in the XXX_Stop function call.
                enumeration DcmDspRoutineSignalEndianness [0..1]: {BIG_ENDIAN, LITTLE_ENDIAN, OPAQUE}, scope=ECU, multiplicity set at link in variant link-time / pre-compile in variant post-build+pre-compile, set at link in variant link-time / pre-compile in variant post-build+pre-compile  # Defines the endianness of the data belonging to a Stop Routine Out Signal. | If no DcmDspRoutineSignalEndianness is defined the value of DcmDspDataDefaultEndianness is applicable.
                integer DcmDspRoutineSignalLength [0..1]: 0..65535, scope=ECU, multiplicity set at link in variant link-time / pre-compile in variant post-build+pre-compile, set at link in variant link-time / pre-compile in variant post-build+pre-compile  # Provide the length in bits of the signal in the RoutineControl request/response
                integer DcmDspRoutineSignalPos: 0..65535, scope=ECU, set at link in variant link-time / pre-compile in variant post-build+pre-compile  # Provide the position of the signal in the RoutineControl request/response. | The position is defined in bits.
                enumeration DcmDspRoutineSignalType: {BOOLEAN, SINT16, SINT16_N, SINT32, SINT32_N, SINT8, SINT8_N, UINT16, UINT16_N, UINT32, UINT32_N, UINT8, UINT8_N, VARIABLE_LENGTH}, scope=ECU, set at link in variant link-time / pre-compile in variant post-build+pre-compile  # Provide the type of the signal in the RoutineControl request/response.
                choice container DcmDspArgumentScaling [0..1]  # This container contains the configuration (parameters) of an alternative Diagnosis Representation. Out if this the scaling between Diagnosis and ECU internal representation and vice versa can be calculated.
                  container DcmDspAlternativeDataProps [0..1]  # This container contains the configuration (parameters) of an alternative Diagnosis Representation by the means of ECU configuration parameters.The physical unit of the alternative data representation is defined by the DataPrototype referenced by DcmDspExternalSRDataElementClass. Additionally the definition of a text table mapping can be a defined for DcmDspDataTypeCategory TEXTTABLE and SCALE_LINEAR_AND_TEXTTABLE | The physical unit of the alternative data representation is defined by the DataPrototype referenced by DcmDspExternalSRDataElementClass. Additionally the definition of a text table mapping can be a defined for DcmDspDataTypeCategory TEXTTABLE and SCALE_LINEAR_AND_TEXTTABLE
                    container DcmDspLinearScale  # This container contains the configuration (parameters) of an linear scale of the alternative Diagnosis Representation.
                      float DcmDspDiagnosisRepresentationDataLowerRange: -Inf..Inf, scope=ECU, set at pre-compile  # Lower Range for this scale of the data in the alternative Diagnosis Representation.
                      float DcmDspDiagnosisRepresentationDataOffset: 0..Inf, scope=ECU, set at pre-compile, default-value=0  # Data offset of the alternative Diagnosis Representation for this scale.
                      float DcmDspDiagnosisRepresentationDataResolution: 0..Inf, scope=ECU, set at pre-compile  # Data resolution of the alternative Diagnosis Representation for this scale.
                      float DcmDspDiagnosisRepresentationDataUpperRange: -Inf..Inf, scope=ECU, set at pre-compile  # Upper Range for this scale of the data in the alternative Diagnosis Representation.
                  container DcmDspAlternativeDataType [0..1]  # This container contains the configuration (parameters) of an alternative Diagnosis Representation by the means of an ApplicationDataType. | Additionally the definition of a text table mapping can be a defined for ApplicationDataTypes of category TEXTTABLE and SCALE_LINEAR_AND_TEXTTABLE.
                    foreign reference DcmApplicationDataType: set at pre-compile, destination-type=APPLICATION-DATA-TYPE  # Alternative Diagnosis Representation for the data defined by the means of a ApplicationPrimitiveDataType of category VALUE or BOOLEAN.
                    container DcmDspTextTableMapping [0..0]  # This container contains the configuration (parameters) of the mapping a DataPrototype typed by AutosarDataType that refer to a CompuMethods of category TEXTTABLE or SCALE_LINEAR_AND_TEXTTABLE. | Each DcmDspTextTableMapping defines a value pair which is used to map the ECU internal value (DcmDspInternalDataValue) to the vale used in the diagnosis representation (DcmDspDiagnosisRepresentationDataValue) and vice versa. The set of all DcmDspTextTableMappings defines the whole mapping of an data.
                      integer DcmDspDiagnosisRepresentationDataValue [0..0]: 0..18446744073709551615, scope=ECU, set at pre-compile, with-auto=true  # The data value in the diagnosis representation.
                      integer DcmDspInternalDataValue [0..0]: 0..18446744073709551615, scope=ECU, set at pre-compile  # The ECU internal data value.
        container DcmDspSecurity  # This container contains the configuration ( DSP parameter) for security level configuration (per security level) | Description This container contains Rows of DcmDspSecurityRow
          enumeration DcmRbDspSecurityDelayTimerMonitor [0..1]: {REQUEST_SEED, SEND_KEY}, multiplicity set at link in variant link-time+post-build / pre-compile in variant pre-compile, origin=RB:AR42.1.0.0:2017-01-31, set at link in variant link-time+post-build / pre-compile in variant pre-compile, default-value=REQUEST_SEED  # According to ISO-14229-1 (2006-12-01) Security Access service shall return a NRC requiredTimeDelayNotExpired when requested action will not be taken because theclient?s latest attempt to gain security access was initiated before the server?s required timeout period had been elapsed. This provides an option to OEMs to either decide to send this NRC for either a REQUEST SEED sub-function or SEND KEY sub-function. It is possible to choose here for which of the two it is required to monitor the delay time and send this NRC with this vendor specific attribute.
          enumeration DcmRbDspSecurityNRCExceedNoOfAttempt [0..1]: {NumAttDelayAndNumAttLock, NumAttLock}, multiplicity set at link in variant link-time+post-build / pre-compile in variant pre-compile, origin=RB:AR42.1.0.0:2017-01-31, set at link in variant link-time+post-build / pre-compile in variant pre-compile, default-value=NumAttDelayAndNumAttLock  # This parameter is to choose NRC return value in case of Exceeded Number Invalid Unlock Attempts. Literal "NumAttDelayAndNumAttLock" is in accordance to ISO 14229-1; For every invalid key sent, NRC 35 (INVALID_KEY) is returned till configured no of attempts (NumAttDelay) is reached. When Failed Attempts reaches or exceeds configured value (>= NummAttDelay) NRC 36 (EXCEEDED NUMBER OF ATTEMPTS) is returned. Or In case the failed attempts reaches or exceeds no of attempts to Lock (NumAttLock) ,NRC 36 will be returned. The Literal "NumAttLock" specifys that only on reaching or exceeding Number of attempts for Lock (NumAttLock) ,NRC 36 will be sent. Untill then NRC 35 is returned on invalid attempt.
          boolean DcmRbDspSecurityStoreSeed: origin=RB:AR42.1.0.0:2017-01-31, set at link in variant link-time+post-build / pre-compile in variant pre-compile  # DcmDspSecurity - DcmDspSecurityStoreSeed = TRUE, print DCM_CFG_ON
          float DcmDspSecurityMaxAttemptCounterReadoutTime [0..1]: 0..65535, set at link in variant link-time / pre-compile in variant post-build+pre-compile  # Delay, in seconds, from startup (measured from the first call of the Dcm_MainFunction()), allowed for all AttemptCounter values to be obtained from the Application. | min: A negative value is not allowed.
          container DcmDspSecurityRow [0..31]  # Definition of a single Row of configuration for security level configuration (per security level) | The name of this container is used to define the name of the R-Port through which the DCM accesses the interface SecurityAccess_{SecurityLevel}. The R-Port is named SecurityAccess_{SecurityLevel} where {SecurityLevel} is the name of the container DcmDspSecurityRow. If there is no reference, no check of security level shall be done.
            integer DcmDspSecurityADRSize [0..1]: 1..4294967295, multiplicity set at link in variant link-time / pre-compile in variant post-build+pre-compile, set at link in variant link-time / pre-compile in variant post-build+pre-compile  # Size in bytes of the AccessDataRecord used in GetSeed
            boolean DcmDspSecurityAttemptCounterEnabled: scope=ECU, set at link in variant link-time / pre-compile in variant post-build+pre-compile  # Allows to enable the external storage of the security attempt counter (e.g. to survival a reset of the ECU).
            function name DcmDspSecurityCompareKeyFnc [0..1]: multiplicity set at link in variant link-time / pre-compile in variant post-build+pre-compile, set at link in variant link-time / pre-compile in variant post-build+pre-compile  # Function name to request the result of a key comparison. | Parameter is only relevant if DcmDspSecurityUsePort=="USE_ ASYNCH_FNC". This parameter is related to the interface Xxx_CompareKey.
            float DcmDspSecurityDelayTime: 0..65535, set at link in variant link-time / pre-compile in variant post-build+pre-compile  # Delay time after failed security access in seconds. | This is started after DcmDspSecurityNumAttDelay number of failed security accesses. min: A negative value is not allowed.
            float DcmDspSecurityDelayTimeOnBoot: 0..65535, set at link in variant link-time / pre-compile in variant post-build+pre-compile  # Start delay timer on power on in seconds. | This delay indicates the time at ECU boot power-on time where the Dcm remains in the default session and does not accept a security access. min: A negative value is not allowed.
            function name DcmDspSecurityGetAttemptCounterFnc [0..1]: multiplicity set at link in variant link-time / pre-compile in variant post-build+pre-compile, set at link in variant link-time / pre-compile in variant post-build+pre-compile  # Function name to request a attempt counter. | Parameter is only relevant if DcmDspSecurityUsePort=="USE_ASYNCH_FNC". This parameter is related to the interface Xxx_ GetSecurityAttemptCounter.
            function name DcmDspSecurityGetSeedFnc [0..1]: multiplicity set at link in variant link-time / pre-compile in variant post-build+pre-compile, set at link in variant link-time / pre-compile in variant post-build+pre-compile  # Function name to request a seed. | Parameter is only relevant if DcmDspSecurityUsePort=="USE_ASYNCH_FNC". This parameter is related to the interface Xxx_GetSeed.
            integer DcmDspSecurityKeySize: 1..4294967295, set at link in variant link-time / pre-compile in variant post-build+pre-compile  # size of the security key (in Bytes).
            integer DcmDspSecurityLevel: 1..63, set at pre-compile, symbolic-name-value=true  # Value of Security level. | The locked state cannot be configured explicitly. 1,2,3...63: configuration dependent - Conversion formula to calculate SecurityLevel out of tester requested SecurityAccessType parameter: SecurityLevel = (SecurityAccessType + 1) / 2 Type: Dcm_SecLevelType
            integer DcmDspSecurityNumAttDelay: 1..255, set at link in variant link-time / pre-compile in variant post-build+pre-compile  # Number of failed security accesses after which the delay time is activated
            integer DcmDspSecuritySeedSize: 1..4294967295, set at link in variant link-time / pre-compile in variant post-build+pre-compile  # size of the security seed (in Bytes).
            function name DcmDspSecuritySetAttemptCounterFnc [0..1]: multiplicity set at link in variant link-time / pre-compile in variant post-build+pre-compile, set at link in variant link-time / pre-compile in variant post-build+pre-compile  # Function name to set a attempt counter. | Parameter is only relevant if DcmDspSecurityUsePort=="USE_ASYNCH_FNC". This parameter is related to the interface Xxx_ SetSecurityAttemptCounter.
            enumeration DcmDspSecurityUsePort: {USE_ASYNCH_CLIENT_SERVER, USE_ASYNCH_FNC}, set at pre-compile  # Defines which kind of interface shall be used for security access.
            boolean DcmRbDspSecurityRowUseAsynchronousServerCallPoint [0..1]: multiplicity set at link in variant link-time+post-build / pre-compile in variant pre-compile, origin=RB:AR42.1.0.0:2017-01-31, set at link in variant link-time+post-build / pre-compile in variant pre-compile, default-value=false  # Only relevant in case DcmDspSecurityUsePort is set to USE_DATA_ASYNCH_CLIENT_SERVER.This parameter is used to select the type of Server Handling required.Set the value to TRUE for Asynchronous server call point handling else Synchronous server call point handling is carried out
            integer DcmRbDspSecurityNumAttLock: 0..255, origin=RB:AR42.1.0.0:2017-01-31, set at pre-compile  # Number of failed security accesses after which security access is locked. 0 indicates that the security access will be left untouched and the ECU never locks.
        container DcmDspSession  # This container contains the configuration ( DSP parameter) session control. configuration (per session control) | This container contains Rows of DcmDspSessionRow.
          boolean DcmRbDspSessionParamRecordEnabled [0..1]: multiplicity set at link in variant link-time+post-build / pre-compile in variant pre-compile, origin=RB:AR42.1.0.0:2017-01-31, set at link in variant link-time+post-build / pre-compile in variant pre-compile, default-value=true  # If DcmDspSessionParamRecordEnabled = true, then the session parameter record will be part of session control service positive response. If DcmDspSessionParamRecordEnabled = false, then the session parameter record will not be part of session control service positive response. Session parameter record conatins the P2 Can Server and P2* Can Server times according to ISO15765-3 CAN requirements
          reference DcmRbDspKWPDefaultSesRef [0..1]: multiplicity set at link in variant link-time+post-build / pre-compile in variant pre-compile, origin=RB:AR42.1.0.0:2017-01-31, set at link in variant link-time+post-build / pre-compile in variant pre-compile, destination=DcmDspSessionRow  # The DcmDspKWPDefaultSesRef is a reference container to DcmDspSessionRow. If the KWP protocol is using the Dcm Dsp session and security configurations (i.e. DcmDspSesSecUsedInProtocol is configured to KWP) then configure a Default Session for KWP protocol
          container DcmDspSessionRow [0..31]  # Definition of a single Row of session control configuration (per session control)
            enumeration DcmDspSessionForBoot: {DCM_NO_BOOT, DCM_OEM_BOOT, DCM_SYS_BOOT}, set at link in variant link-time / pre-compile in variant post-build+pre-compile  # This parameter defines whether this diagnostic session allows to jump to Bootloader (OEM Bootloader or System Supplier Bootloader). If this diagnostic session doesn't allow to jump to Bootloader the value DCM_NO_BOOT shall be chosen.
            integer DcmDspSessionLevel: 1..126, set at pre-compile, symbolic-name-value=true  # subFunction value of the DiagnosticSession. | 0, 127 and all values above 127 are reserved by ISO, SWS defines the Dcm_SesCtrlType: 1 DEFAULT_SESSION 2 PROGRAMMING_SESSION 3 EXTENDED_DIAGNOSTIC_SESSION 4 SAFETY_SYSTEM_DIAGNOSTIC_SESSION 5...63 Reserved by Document 64...126 <configuration dependent (according "diagnosticSessionType" parameter DiagnosticSessionControl request> 127...254 Reserved by Document 255 ALL_SESSION_LEVEL
            float DcmDspSessionP2ServerMax: 0..1, set at link in variant link-time / pre-compile in variant post-build+pre-compile  # This is the session value for P2ServerMax in seconds (per Session Control). | The AUTOSAR configuration standard is to use SI units, so this parameter is defined as a float value in seconds. DCM configuration tools must convert this float value to the appropriate value format for the use in the software implementation of DCM.
            float DcmDspSessionP2StarServerMax: 0..100, set at link in variant link-time / pre-compile in variant post-build+pre-compile  # This is the session value for P2*ServerMax in seconds (per Session Control). | The AUTOSAR configuration standard is to use SI units, so this parameter is defined as a float value in seconds. DCM configuration tools must convert this float value to the appropriate value format for the use in the software implementation of DCM.
        container DcmDspVehInfo [0..*]  # This container contains the configuration (parameters) of the "Request vehicle information service" (service $09).
          integer DcmDspVehInfoInfoType: 0..255, scope=ECU, set at link in variant link-time / pre-compile in variant post-build+pre-compile  # value of InfoType. | Within each DcmConfigSet all DcmDspVehInfoInfoType values shall be unique.
          boolean DcmDspVehInfoNODIProvResp [0..1]: multiplicity set at pre-compile, set at pre-compile, default-value=false  # If this is false, the DCM is responsible to fill the number of data items (NODI).If this is true,Provider is responsible to fill the number of data items (NODI) and only one DcmDspVehInfoData container is allowed.
          container DcmDspVehInfoData [1..*]  # Data Item of an InfoType; post-fix of the port interface name.
            integer DcmDspVehInfoDataOrder: 0..255, scope=ECU, set at pre-compile  # Defines the order of the data item in the InfoType; values: 0..255; first data item having the order number 0; the next 1 and so on. | The configuration of order needs to be unique per InfoType.
            function name DcmDspVehInfoDataReadFnc [0..1]: scope=ECU, multiplicity set at pre-compile, set at pre-compile  # Function name for reading InfoType data item.
            integer DcmDspVehInfoDataSize: 0..255, scope=ECU, set at pre-compile  # Size in bytes of the InfoType data item.
            boolean DcmDspVehInfoDataUsePort: scope=ECU, set at pre-compile  # When this parameter is set to true the DCM will access the Data using an R-Port requiring a PortInteface IInfotypeServices_{VehInfoData}. | The R-Port is named InfotypeServices_{VehInfoData} where {VEHINFODATA} is the name of the container DcmDspVehInfoData. In that case, the DcmDspVehInfoDataReadFnc is ignored and the RTE APIs are used. When this parameter is set to false, the DCM calls the function defined in DcmDspVehInfoDataReadFnc.
        container DcmRbDspEcuResetRow [0..*]  # Container to define the resetTypes and the type of reset(jump to bootloader or normal reset ) for each subfunction of EcuReset Service. ResetTypes supported by the ECU but not configured under this container will be considered for normal reset.
          integer DcmRbDspEcuResetType: 0..127, origin=RB:AR42.1.0.0:2017-01-31, set at link in variant link-time / pre-compile in variant post-build+pre-compile, symbolic-name-value=true  # Value of the Ecu Reset Type (subfunction of EcuReset Service)
          enumeration DcmRbDspResetForBoot: {DCM_NO_BOOT, DCM_OEM_BOOT, DCM_SYS_BOOT, DCM_DRIVE_TO_DRIVE}, origin=RB:AR42.1.0.0:2017-01-31, set at link in variant link-time / pre-compile in variant post-build+pre-compile  # This parameter defines whether this resetType allows to jump to Bootloader (OEM Bootloader/ System Supplier Bootloader/ Drive to Drive Jump). If the resetType is not allowed to jump to Boot/Drive, i.e., used for normal reset, the value DCM_NO_BOOT shall be chosen.ResetTypes supported by the ECU but not configured under the container DcmDspEcuResetRow will be considered as DCM_NO_BOOT ( normal reset)
        container DcmRbDspReadDTC [0..1]  # This container contains the configuration (parameters) of the service Read DTC Information - 0x19 (per sub-function type) This container contains Rows of DcmDspReadDTCRow
          integer DcmRbDspReadDTCMaxNumDTCRead: 1..255, origin=RB:AR42.1.0.0:2017-01-31, set at link in variant link-time+post-build / pre-compile in variant pre-compile  # Maximum number of DTC that can be read in 1 service call
          integer DcmRbDspReadDTCMaxNumRecordRead: 1..255, origin=RB:AR42.1.0.0:2017-01-31, set at link in variant link-time+post-build / pre-compile in variant pre-compile  # Max Number of Records that can be read in 1 service call
        container DcmRbDspTestResultByObdmid [0..1]  # This container contains the configuration (parameters) of the "Request on-board monitoring test results" service (Service $06).
          container DcmRbDspTestResultObdmidTid [1..*]  # This container contains the configuration (parameters) of a OBDMID and the assigned TIDs for the "Request on-board monitoring test results" service (Service $06).
            integer DcmRbDspTestResultObdmid: 0..255, origin=RRB:AR42.1.0.0:2017-01-31, set at link in variant link-time / pre-compile in variant post-build+pre-compile  # OBDMID for Service $06
            container DcmRbDspTestResultObdmidTids [1..*]  # This container contains the configuration (parameters) of the TIDs belonging to the OBDMID for the "Request on-board monitoring test results" service (Service $06).
              integer DcmRbDspTestResultObdmidTidUaSid: 0..255, origin=RB:AR42.1.0.0:2017-01-31, set at link in variant link-time / pre-compile in variant post-build+pre-compile  # Unit And Scaling ID for Service $06
              function name DcmRbDspTestResultObdmidGetDTRValueFnc [0..1]: multiplicity set at pre-compile, origin=RB:AR42.1.0.0:2017-01-31, set at pre-compile  # Function name for reading value by TID (DcmRbDspTestResultObdmidGetDTRValueFnc-function).This is only relevant if DcmRbDspTestResultObdmidUsePort==FALSE.
              boolean DcmRbDspTestResultObdmidUsePort: origin=RRB:AR42.1.0.0:2017-01-31, set at pre-compile  # If this is false, the DCM will use the function defined in DcmRbDspTestResultObdmidGetDTRValueFnc.If this is true, R-Port requiring the interface. The name of this port is the name of the container.
              reference DcmRbDspTestResultObdmidTidRef: origin=RB:AR42.1.0.0:2017-01-31, set at link in variant link-time / post-build in variant post-build / pre-compile in variant pre-compile, destination=DcmRbDspTestResultTid  # Link to reported TIDs of this OBDMID | upperMultiplicity / lowerMultiplicity:: At least one TID must be reported for an OBDMID
          container DcmRbDspTestResultTid [1..*]  # This container contains the configuration (parameters) of a single TID for the "Request on-board monitoring test results" service (Service $06). | The DCM will access the Data using an R-Port requiring a PortInterface DTRServices. The R-Port is named DtrServices_<OBDMID>_<TID> where <TID> is the name of the container DcmRbDspTestResultTid and <OBDMID> is the name of the container DcmRbDspTestResultObdmidTid.
            integer DcmRbDspTestResultTestId: 0..255, origin=RB:AR42.1.0.0:2017-01-31, set at link in variant link-time / pre-compile in variant post-build+pre-compile  # Test Id for Service $06
      container DcmPageBufferCfg  # This container contains the configuration (parameters) for Page Buffer handling
        boolean DcmPagedBufferEnabled: scope=ECU, set at pre-compile  # Allow to enable or disable the Page buffer mechanism.If configured as true, paged buffer handling is enabled. If configured as false, paged buffer handling is disabled | true = Page buffer handling enabled false = Page Buffer handling disabled
        float DcmPagedBufferTimeout [0..1]: 0..1, scope=ECU, multiplicity set at link in variant link-time / pre-compile in variant post-build+pre-compile, set at link in variant link-time / pre-compile in variant post-build+pre-compile  # Allow to configure the Timeout in seconds towards the application for filling the next page.This parameter is only relevant if the Page Buffer handling is enabled. (DcmPagedBufferEnabled = TRUE). Defined in the DCM SWS as uint16, this parameter contains a value in milliseconds.The AUTOSAR configuration standard is to use SI units, so this parameter is defined as float value in seconds. DCM configuration tools must convert this float value to the appropriate value format for the use in the software implementation of DCM. A negative value is not allowed. | This parameter is only relevant if the Page Buffer handling is enabled. (DcmPagedBufferEnabled = TRUE) The AUTOSAR configuration standard is to use SI units, so this parameter is defined as float value in seconds. DCM configuration tools must convert this float value to the appropriate value format for the use in the software implementation of DCM. min: A negative value is not allowed. upperMultiplicity: Exactly one Timeout must be specified per configuration. lowerMultiplicity: Exactly one Timeout must be specified per configuration.
      container DcmProcessingConditions [0..1]  # This container contains the configuration ( DSP parameter) for mode arbitration functionality of the Dcm
        container DcmModeCondition [1..*]  # This container contains the configuration of a mode condition or an environmental conditions which can be used as argument in DcmModeRules. | One DcmModeCondition shall contain either one DcmSwcModeRef or one DcmBswModeRef or one DcmSwcSRDataElementRef. Please note that the Dcm acts as well as mode manager. Therefore the references DcmSwcModeRef or one DcmBswModeRef. might point to provided ModeDeclarationGroupPrototypes of the Dcm itself as well as to provided ModeDeclarationGroupPrototypes of other Bsw Modules or software components. In case of a configured DcmSwcModeRef or DcmBswModeRef only the DcmConditionType DCM_EQUALS or DCM_EQUALS_NOT are applicable. In case of DcmSwcSRDataElementRef all literals of DcmConditionType are possible.
          enumeration DcmConditionType: {DCM_EQUALS, DCM_EQUALS_NOT, DCM_GREATER_OR_EQUAL, DCM_GREATER_THAN, DCM_LESS_OR_EQUAL, DCM_LESS_THAN}, set at pre-compile  # This parameter specifies what kind of comparison that is made for the evaluation of the mode condition.
          integer DcmRbSwcSRDataElementValue [0..1]: multiplicity set at link in variant link-time / pre-compile in variant post-build+pre-compile, origin=RB:AR42.2.0.0:2017-07-31, set at link in variant link-time / pre-compile in variant post-build+pre-compile  # This Parameter is used as constant value of type numerical.This value is used for comparison agsinst DcmSRDataElementRef.Enter the value in decimal eg:5,11.
          foreign reference DcmSwcSRDataElementValueRef [0..0]: multiplicity set at pre-compile, set at pre-compile, destination-type=CONSTANT-SPECIFICATION  # Reference to a constant specification defining the compare value for environmental condition.
          instance reference DcmBswModeRef [0..1]: multiplicity set at pre-compile, set at pre-compile, destination-context=MODE-DECLARATION-GROUP-PROTOTYPE, destination-type=MODE-DECLARATION  # This parameter references a mode of a ModeDeclarationGroupPrototype provided by a Basic Software Module used for the condition. | Please note that such ModeDeclarationGroupPrototype are owned by a Basic Software Module Description in the role providedModeGroup.
          instance reference DcmSwcModeRef [0..1]: multiplicity set at pre-compile, set at pre-compile, destination-context=ROOT-SW-COMPOSITION-PROTOTYPE SW-COMPONENT-PROTOTYPE P-PORT-PROTOTYPE MODE-DECLARATION-GROUP-PROTOTYPE, destination-type=MODE-DECLARATION  # This parameter references a mode in a particular mode request port of a software component that is used for the condition.
          reference DcmSwcSRDataElementRef [0..1]: multiplicity set at pre-compile, set at pre-compile, destination=DcmDspExternalSRDataElementClass  # Reference to environmental conditions
        container DcmModeRule [1..*]  # This container contains the configuration of a mode rule which represents a logical expression with DcmModeCondistions or other DcmModeRules as arguments. | All arguments are processed with the operator defined by DcmLogicalOperator, for instance: Argument_A AND Argument_B AND Argument_C
          enumeration DcmLogicalOperator [0..1]: {DCM_AND, DCM_OR}, multiplicity set at pre-compile, set at pre-compile  # This parameter specifies the logical operator to be used in the logical expression. If the expression only consists of a single condition this parameter shall not be used.
          integer DcmModeRuleNrcValue [0..1]: 1..255, scope=ECU, multiplicity set at link in variant link-time / pre-compile in variant pre-compile, set at link in variant link-time / pre-compile in variant pre-compile  # Optional parameter which defines the NRC to be sent in case the mode rule condition is not valid.
          choice reference DcmArgumentRef [1..*]: multiplicity set at pre-compile, requires-index=true, set at pre-compile, destination=[DcmModeCondition, DcmModeRule]  # This is a choice reference either to a mode condition or a an other mode rule serving as sub-expression.
