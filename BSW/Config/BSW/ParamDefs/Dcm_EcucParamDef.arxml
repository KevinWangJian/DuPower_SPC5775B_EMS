[part 2 of 2: package /AUTOSAR_Dcm/EcucModuleDefs]
AUTOSAR XML (schema 4-2-2)
package /AUTOSAR_Dcm/EcucModuleDefs  (continued)
  module definition Dcm [0..1]: category=VENDOR_SPECIFIC_MODULE_DEFINITION, refined-module-def=Dcm, variants pre-compile  (continued)
    container DcmGeneral  # This container contains the configuration (parameters) for Component wide parameters
      boolean DcmDDDIDStorage [0..1]: multiplicity set at pre-compile, set at pre-compile, default-value=false  # This configuration switch defines, whether DDDID definition is stored non-volatile or not. | true: DDDID are stored non-volatile false: DDDID are only maintained volatile
      boolean DcmDevErrorDetect: set at pre-compile  # Preprocessor switch to enable or disable the Development Error Detection (DET) mechanism.
      string DcmHeaderFileInclusion [0..0]: scope=ECU, multiplicity set at pre-compile, set at pre-compile, with-auto=true, regular-expression=[a-zA-Z0-9_]([a-zA-Z0-9\._])*  # Name of the header file(s) to be included by the Dcm module containing the used C-callback declarations.
      boolean DcmRespondAllRequest: scope=ECU, set at pre-compile  # If set to FALSE the DCM will not respond to diagnostic request that contains a service ID which is in the range from 0x40 to 0x7F or in the range from 0xC0 to 0xFF (Response IDs).
      float DcmTaskTime: 1E-4..0.1, set at link in variant link-time / pre-compile in variant post-build+pre-compile  # Allow to configure the time for the periodic cyclic task. Please note: This configuration value shall be equal to the value in the ScheduleManager module. | The AUTOSAR configuration standard is to use SI units, so this parameter is defined as float value in seconds. DCM configuration tools must convert this float value to the appropriate value format for the use in the software implementation of DCM. min: A negative value and zero is not allowed. upperMultiplicity: Exactly one TaskTime must be specified per configuration. lowerMultiplicity: Exactly one TaskTime must be specified per configuration.
      boolean DcmVersionInfoApi: set at pre-compile  # Preprocessor switch to enable or disable the output Version info of the functionality.
      reference DcmVinRef [0..1]: multiplicity set at pre-compile, set at pre-compile, destination=DcmDspDid  # Reference to the Did containing the VIN Information. | This parameter is needed for function Dcm_GetVin
      container DcmRbGeneral  # This container contains the configuration (parameters) for Component wide parameters
        string DcmRbSuppressNRC [0..1]: multiplicity set at link in variant link-time / pre-compile in variant post-build+pre-compile, origin=RB:AR42.1.0.0:2017-01-31, set at link in variant link-time / pre-compile in variant post-build+pre-compile, default-value=11,12,31,7E,7F  # This Parameter is used to configure NRC values which shall be suppressed if functional request received. The NRC values should be entered in Hexadecimal number seperated by comma.e.g 11,12,7E,7E. If configured as 00 then NRC values will not be suppressed. If this Parameter is not configured then default values of NRC will be suppressed.
        boolean DcmRbApplCallRequiredOnReqReception [0..1]: multiplicity set at pre-compile, origin=RB:AR42.1.0.0:2017-01-31, set at pre-compile, default-value=false  # Parameter to enable/disable the invocation of the application function from Dcm StartofReception/CopyRxData/RxIndication when a request is received at the Dcm. Autosar stack already ensures with Autosar 4.0 that every N-PDU is copied immediately to Application buffer (DSL/DSD). This parameter enables the feature which will provide an option for the Customer Teams to start working the receiving data (DSP) even before the reception is completed. This is achieved through the call-outs DcmAppl_StartOfReception, DcmAppl_CopyRxData and DcmAppl_TpRxIndication from Dcm which can provide the buffer pointer, total length, currently received length etc.. If set to TRUE, then DcmAppl_StartOfReception, DcmAppl_CopyRxData and DcmAppl_TpRxIndication will be called from Dcm. If set to FALSE or left unconfigured, then the mentioned functions will not be called from Dcm
        boolean DcmRbApplTxConfirmationRequiredAlways [0..1]: multiplicity set at pre-compile, origin=RB:AR42.1.0.0:2017-01-31, set at pre-compile, default-value=true  # Parameter to enable the Tx confirmation call for application. If the parameter is set to TRUE, then confirmation to the application after transmission of response will be provided even if service is located inside DSP. Also confirmation to the application will be sent in case of suppression of responses in case ApplTxConfirmationRequiredAlways is TRUE. If ApplTxConfirmationRequiredAlways is TRUE, Dcm Appl API DcmAppl_DcmConfirmation will be called from Dcm.
        boolean DcmRbConfirmForDSDGeneratedNegRes: origin=RB:AR42.1.0.0:2017-01-31, set at pre-compile  # To select confirmation for DSD generated negative responses.If set to true, DcmAppl API DcmAppl_DcmConfirmation_DcmNegResp will be called for DSD generated negative responses
        float DcmRbCooperativeSchedulerTaskTime [0..1]: 0..100, multiplicity set at pre-compile, origin=RB:AR42.1.0.0:2017-01-31, set at pre-compile  # Allow to configure the time for the periodic CooperativeScheduler task. Please note: This configuration value shall be equal to the value in the ScheduleManager module. The minimum value for this parameter should always be greater then the DcmTaskTime value. This is to ensure that the Co-operative scheduler runs in the slower raster as compared to DcmTask | The AUTOSAR configuration standard is to use SI units, so this parameter is defined as float value in seconds. DCM configuration tools must convert this float value to the appropriate value format for the use in the software implementation of DCM. A negative value is not allowed.
        boolean DcmRbDemSREnabled [0..1]: multiplicity set at pre-compile, origin=RB:AR42.1.0.0:2017-04-31, set at pre-compile, default-value=false  # Enable / Disable Generation of Sender-Receiver Interfaces for Dem
        boolean DcmRbDiagAdaptSupport [0..1]: multiplicity set at pre-compile, origin=RB:AR42.1.0.0:2017-01-31, set at pre-compile, default-value=false  # Preprocessor switch to enable or disable rba_DiagAdapt Support in DCM.This is used to support vendor specific MEDC17 services along with DCM.
        boolean DcmRbDspSecurityStoreDelayCountAndTimerOnJump [0..1]: multiplicity set at pre-compile, origin=RB:AR42.1.0.0:2017-01-31, set at pre-compile, default-value=false  # Parameter to allow the user to decide on whether DelayCount and DelayTimer values needs to be stored during Boot Loader interactions. If set to TRUE, DelayCount and DelayTimer values shall be stored during Boot Loader interactions. If set to FALSE, DelayCount and DelayTimer values shall not be stored during Boot Loader interactions. If the parameter is left unconfigured, DelayCount and DelayTimer values shall not be stored during Boot Loader interactions.
        float DcmRbEcuResetTime [0..1]: 0..100, multiplicity set at link in variant link-time / pre-compile in variant post-build+pre-compile, origin=RB:AR42.1.0.0:2017-01-31, set at link in variant link-time / pre-compile in variant post-build+pre-compile  # The parameter provides the time taken for reset of the ECU and it is relevant only in case of bootloader jump. If the parameter is configured and during jump from boot using Dsp supported EcuReset service(0x11) or DiagnosticSessionControl service(0x10), if the time configured is greater than the remaining P2/P2* time ,Dcm shall again trigger a wait pend response and shall wait for a positive confirmation before triggering function to perform the reset. The parameter if configured should be in multiples of DcmTaskTime and shoule be less than the P2*Max configured for the protocol used for jump to bootloader. | The AUTOSAR configuration standard is to use SI units, so this parameter is defined as float value in seconds. DCM configuration tools must convert this float value to the appropriate value format for the use in the software implementation of DCM. A negative value is not allowed
        string DcmRbOSCounterId [0..1]: multiplicity set at link in variant link-time / pre-compile in variant post-build+pre-compile, origin=RB:AR42.1.0.0:2017-01-31, set at link in variant link-time / pre-compile in variant post-build+pre-compile  # The counterID is used by OStimer.The user shall configure the parameter as a string, which would be the name of the counter in the AUTOSAR OS
        string DcmRbOSCounterMacro [0..1]: multiplicity set at link in variant link-time / pre-compile in variant post-build+pre-compile, origin=RB:AR42.1.0.0:2017-01-31, set at link in variant link-time / pre-compile in variant post-build+pre-compile  # Macro used to calculate the current system time (Ticks)
        enumeration DcmRbOSTimerUse: origin=RB:AR42.1.0.0:2017-01-31, set at pre-compile  # Choose between Project Specific , AUTOSAR Specific and Cyclic Count Project Specific : CPU timer will be used for timer monitoring. Corresponding Project Specific OScounterMacro and OScounterID has to be configured with this option Project can make necessary changes in file os_bsw.h file which will be included when project specific is chosen AUTOSAR Specific : CPU timer will be used for timer monitoring. Corresponding AUTOSAR Specific OScounterMacro and OScounterID has to be configured with this option Autosar specific needs to be selected if the project wants to use mcu counter. Project can make necessary changes in file Dcm_Cfg_Timer.h file which will be included when autosar specific is chosen Cyclic Count: The Dcm scheduled cycle time will be used as reference for calculating the time. Cyclic Count E.g : If Dcm_mainfunction is scheduled in 5ms rastor & is called twice; The total time elapsed is calculated as Dcm task time X 2 Cyclic Count : With this option , there is no need to configure OScounterID & OScounterMAcro
          ProjectSpecific  # CPU timer will be used for timer monitoring. Corresponding MEDC17 OScounterMacro and OScounterID has to be configured with this option
          AutosarSpecific  # CPU timer will be used for timer monitoring. Corresponding AUTOSAR Specific OScounterMacro and OScounterID has to be configured with this option
          CyclicCount  # Cyclic Count: The Dcm scheduled cycle time will be used as reference for calculating the time. E.g : If Dcm_mainfunction is scheduled in 5ms rastor & is called twice; The total time elapsed is calculated as Dcm task time X 2With this option , there is no need to configure OScounterID & OScounterMAcro
        boolean DcmRbQueuingOfRequestEnabled [0..1]: multiplicity set at pre-compile, origin=RB:AR42.1.0.0:2017-01-31, set at pre-compile  # Parameter to enable/disable the queuing of request reception, which is received in parallel to a running request processing. If set to TRUE, Queuing of request shall be enabled in Dcm. The queuing shall be done with a depth of 1 queued buffer returning FC_CTS to the tester. If the third request arrives, FC_WAIT has to be sent until one of the buffers is released. If set to FALSE or left unconfigured,then Queuing of request shall be disabled in Dcm.
        boolean DcmRbRespondToRequestAfterEcuReset [0..1]: multiplicity set at pre-compile, origin=RB:AR42.1.0.0:2017-01-31, set at pre-compile, default-value=true  # The parameter is used to enable/disable the processing of new tester requests after the successful processing of Dsp EcuReset Service(0x11) request and before the actual reset happens. TRUE - DCM shall respond to further requests after sending the positive response of EcuReset (call of Dcm_TpTxConfirmation ) during reset- processing FALSE - DCM shall ignore all further requests during reset-processing. If the parameter is left unconfigured ,the default value (TRUE )will be taken.
        boolean DcmRbRestoringEnabled [0..1]: multiplicity set at pre-compile, origin=RB:AR42.1.0.0:2017-01-31, set at pre-compile, default-value=false  # Enable / Disable restoring of Diagnostic information (Jump from BootLoader)
        boolean DcmRbRTEsupport: origin=RB:AR42.1.0.0:2017-01-31, set at pre-compile  # Enables RTE Support for Communication control,Diagnostic Session Control and the EcuReset services. If this parameter is set to true RTE ports are generated for the mentioned services and if it is set to FALSE, no RTE ports are generated fro the mentioned servies
        integer DcmRbSignalDefaultValue [0..1]: 0..255, multiplicity set at pre-compile, origin=RB:AR42.1.0.0:2017-01-31, set at pre-compile, default-value=0  # Default value to be configured for Signal Data with gaps.The value configured shall be used to fill the gaps if existing between signal data of a DID.The default value of this parameter is 0.
        boolean DcmRbSingleBufferConceptDisabled [0..1]: multiplicity set at pre-compile, origin=RB:AR42.1.0.0:2017-01-31, set at pre-compile, default-value=false  # Parameter to enable/disable the concept of single buffer sharing for reception and transmission. If set to TRUE, single buffer concept shall be disabled and a separate reception and transmission buffer will be assigned to the protocol. If set to FALSE,single buffer concept shall be enabled and a single buffer will be shared for reception and transmission of protocols. If the parameter is left unconfigured, the single buffer concept shall be used.
        boolean DcmRbStoringEnabled [0..1]: multiplicity set at link in variant link-time+post-build / pre-compile in variant pre-compile, origin=RB:AR42.1.0.0:2017-01-31, set at link in variant link-time+post-build / pre-compile in variant pre-compile, default-value=false  # Enable / Disable storing of Diagnostic information (Jump to BootLoader)
