AUTOSAR XML (schema 4-2-2)
package /AUTOSAR_Crc/EcucModuleDefs
  module definition Crc [0..1]: refined-module-def=Crc, variants pre-compile  # Configuration of the Crc (Crc routines) module.
    container CrcGeneral: multiplicity set at   # Crc general configurations | General configurations of component Crc. The preferred crc polynomials and calculation methods shall be configured here.
      boolean Crc8H2F: multiplicity set at , set at pre-compile, default-value=true  # enable Crc8H2F calculation | Enables / disables CRC 8-bit (2Fh polynomial) calculation methods. If CRC8H2F calculation is enabled the Crc8H2F calculation method must be selected.
      enumeration Crc8H2FMode [0..1]: {CRC_8H2F_RUNTIME, CRC_8H2F_TABLE, CRC_8H2F_HARDWARE}, multiplicity set at pre-compile, set at pre-compile, default-value=CRC_8H2F_TABLE  # Crc8H2F calculation method | Switch to select one of the available Crc 8-bit (2Fh polynomial) calculation methods. If Crc8H2F calculation is enabled the Crc8h2F calculation method must be selected here. If Crc8H2F calculation is disabled the calculation method can be deleted.
      boolean Crc8: multiplicity set at , set at pre-compile, default-value=true  # enable Crc8 calculation | Enables / disables CRC 8-bit (SAE J1850) calculation methods. If Crc8 calculation is enabled the Crc8 calculation method must be selected.
      enumeration Crc8Mode [0..1]: {CRC_8_RUNTIME, CRC_8_TABLE, CRC_8_HARDWARE}, multiplicity set at pre-compile, set at pre-compile, default-value=CRC_8_TABLE  # Crc8 calculation method | Switch to select one of the available CRC 8-bit (SAE J1850) calculation methods. If Crc8 calculation is enabled the Crc8 calculation method must be selected here. If Crc8 calculation is disabled the Crc8 calculation method can be deleted.
      boolean Crc16: multiplicity set at , set at pre-compile, default-value=true  # enable Crc16 calculation | Enables / disables CRC 16-bit (CCITT) calculation methods. If Crc16 calculation is enabled the Crc16 calculation method must be selected.
      enumeration Crc16Mode [0..1]: {CRC_16_RUNTIME, CRC_16_TABLE, CRC_16_HARDWARE}, multiplicity set at pre-compile, set at pre-compile, default-value=CRC_16_TABLE  # Crc16 calculation method | Switch to select one of the available CRC 16-bit (CCITT) calculation methods. If Crc16 calculation is enabled the Crc16 calculation method must be selected here. The Crc16 calculation on hardware is only supported for RH850/R1x and RH850/P1x. If Crc16 calculation is disabled the Crc16 calculation method can be deleted.
      boolean Crc32: multiplicity set at , set at pre-compile, default-value=true  # enable Crc32 calculation | Enables / disables CRC 32-bit (IEEE-802.3 CRC32 Ethernet Standard) calculation methods. If Crc32 calculation is enabled the Crc32 calculation method must be selected.
      enumeration Crc32Mode [0..1]: {CRC_32_RUNTIME, CRC_32_TABLE, CRC_32_HARDWARE}, multiplicity set at pre-compile, set at pre-compile, default-value=CRC_32_TABLE  # Crc32 calculation method | Switch to select one of the available CRC 32-bit (IEEE-802.3 CRC32 Ethernet Standard) calculation methods. If CRC32 calculation is enabled the CRC32 calculation method must be selected here. The CRC32 calculation on hardware is only supported for RH850/R1x and RH850/P1x and the machine families MCU_RB_JDP_UC1 and MCU_RB_IFX_UC1 except the machine devices MCU_RB_JDP_UC1_DEV1_ALL and MCU_RB_IFX_UC1_DEV2_ALL. The hardware can be selected in "CrcRbHWSelection" (For IFX and JDP a default selection is done.). If CRC32 calculation is disabled the Crc32 calculation method can be deleted.
      boolean Crc32P4: multiplicity set at , set at pre-compile, default-value=true  # enable Crc32P4 calculation | Enables / disables CRC 32-bit for E2E Profile 4 (32-bit 0xF4ACFB13 polynomial CRC calculation) calculation methods. If Crc32P4 calculation is enabled the Crc32P4 calculation method must be selected.
      enumeration Crc32P4Mode [0..1]: {CRC_32P4_RUNTIME, CRC_32P4_TABLE, CRC_32P4_HARDWARE}, multiplicity set at pre-compile, set at pre-compile, default-value=CRC_32_TABLE  # Crc32P4 calculation method | Switch to select one of the available CRC 32-bit for E2E Profile 4 (32-bit 0xF4ACFB13 polynomial CRC calculation) calculation methods. If CRC32P4 calculation is enabled the CRC32P4 calculation method must be selected here. The CRC32P4 calculation on hardware status is not supported.
      boolean Crc64: multiplicity set at , set at pre-compile, default-value=true  # enable Crc64 calculation | Enables / disables CRC 64-bit (ECMA) calculation methods. If Crc64 calculation is enabled the Crc64 calculation method must be selected.
      enumeration Crc64Mode [0..1]: {CRC_64_RUNTIME, CRC_64_TABLE, CRC_64_HARDWARE}, multiplicity set at pre-compile, set at pre-compile, default-value=CRC_64_TABLE  # Crc64 calculation method | Switch to select one of the available CRC 64-bit (EMCA) calculation methods. If CRC64 calculation is enabled the CRC64 calculation method must be selected here. The CRC64 calculation on hardware is currently not supported. If CRC64 calculation is disabled the Crc64 calculation method can be deleted.
      boolean CrcVersionInfoApi: multiplicity set at , set at pre-compile, default-value=true  # enable Crc version info | Enables / disables Crc version information.
    container CrcRbHWSelection [0..*]: multiplicity set at pre-compile  # Crc hardware selection | If one Crc variant is configured to calculation on hardware the hardware must be selected here. If no calculation method is configured to hardware the Crc hardware selection can be deleted.This container may maximally exist once.
      boolean CrcRbJDP_or_IFX: multiplicity set at , origin=RB, set at pre-compile, default-value=true  # JDP or IFX | Selection / Deselection of JDP or IFX hardware with microcontroller abstraction layer (MCal)
      boolean CrcRbRH850_R1x: multiplicity set at , origin=RB, set at pre-compile, default-value=false  # RH850_R1x | Selection / Deselection of RH850_R1x
      boolean CrcRbRH850_P1x: multiplicity set at , origin=RB, set at pre-compile, default-value=false  # RH850_P1x | Selection / Deselection of RH850_P1x
    container CrcRbHWRegConfiguration [0..1]: multiplicity set at pre-compile  # Crc hardware register configuration | If CRC is configured to calculation on target Renesas hardware (CrcRbHWConfiguration RH850_R1x or RH850_P1x) the addresses of the base registers of the CRC units can be configured here.
      container CrcRbRegRH850_R1x [0..1]: multiplicity set at pre-compile  # Crc hardware register configuration for RH850_R1x | This container contains the configurations of the CRC base registers for RH850_R1x. The base address of each Crc channel are given in the table. For details see the hardware manual of Renesas microcontroller RH850/R1x Group.
        string CrcRbDCRB0: multiplicity set at , origin=RB, set at pre-compile  # Base address DCRB0 | register address of channel DCRB0_Base (default value is 0xFFF70000)
        string CrcRbDCRB1: multiplicity set at , origin=RB, set at pre-compile  # Base address DCRB1 | register address of channel DCRB1_Base (default value is 0xFFF71000)
        string CrcRbDCRB2: multiplicity set at , origin=RB, set at pre-compile  # Base address DCRB2 | register address of channel DCRB2_Base (default value is 0xFFF72000)
        string CrcRbDCRB3: multiplicity set at , origin=RB, set at pre-compile  # Base address DCRB3 | register address of channel DCRB3_Base (default value is 0xFFF73000)
      container CrcRbRegRH850_P1x [0..1]: multiplicity set at pre-compile  # Crc hardware register configuration for RH850_P1x | This container contains the configurations of the CRC base registers for RH850_P1x. The base address of each Crc channel are given in the table. For details see the hardware manual of Renesas microcontroller RH850/P1H-CE Group.
        string CrcRbDCRB0: multiplicity set at , origin=RB, set at pre-compile  # Base address DCRB0 | register address of channel DCRB0_Base (default value is 0xFFD50000)
        string CrcRbDCRB1: multiplicity set at , origin=RB, set at pre-compile  # Base address DCRB1 | register address of channel DCRB1_Base (default value is 0xFFF70000)
        string CrcRbDCRB2: multiplicity set at , origin=RB, set at pre-compile  # Base address DCRB2 | register address of channel DCRB2_Base (default value is 0xFFD51000)
        string CrcRbDCRB3: multiplicity set at , origin=RB, set at pre-compile  # Base address DCRB3 | register address of channel DCRB3_Base (default value is 0xFFF71000)
        string CrcRbDCRB4: multiplicity set at , origin=RB, set at pre-compile  # Base address DCRB4 | register address of channel DCRB4_Base (default value is 0xFFD20000)
        string CrcRbDCRB5: multiplicity set at , origin=RB, set at pre-compile  # Base address DCRB5 | register address of channel DCRB5_Base (default value is 0xFFF72000)
        string CrcRbDCRB6: multiplicity set at , origin=RB, set at pre-compile  # Base address DCRB6 | register address of channel DCRB6_Base (default value is 0xFFD53000)
        string CrcRbDCRB7: multiplicity set at , origin=RB, set at pre-compile  # Base address DCRB7 | register address of channel DCRB7_Base (default value is 0xFFF3000)
    container CrcRbRevision [1..*]: multiplicity set at pre-compile  # Crc Autosar 4.0 revision | The Autosar 4.0 revision of the CRC calculations can be selected here. Currently Revision_1 and Revision_2 are supported. The selection is mandatory. Exactly one of this container has to exist.
      enumeration CrcRbRev [0..1]: {Revision_1, Revision_2}, multiplicity set at pre-compile, origin=RB, set at pre-compile, default-value=Revision_2  # Autosar 4.0 Revision | Selection of Autosar 4.0 revision of CRC module
    container CrcRbHWConfiguration [0..*]: multiplicity set at pre-compile  # Crc hardware configuration | If at least one Crc calculation method is set to hardware the distribution of the logical cores to the Crc hardware units must be done here. If no hardware calculation method is configured this container can be deleted. For each Crc variant which is configured to hardware a Crc hardware unit must be assigned. For each core a subcontainer CrcRbHWCoreConfiguration must be available.The number of cores and the number of the Crc hardware units depends on the selected hardware :JDP dev 2, IFX dev 2 : 2 cores, 2 crc hw unitsJDP, ST, IFX with device greater 2 : 3 cores, 2 crc hw unitsRH850_R1x: 1 core, 4 crc hw unitsRH850_P1x: 2 cores, 8 crc hw unitsJDP and IFX controllers with device greater 2 have more cores than the available Crc hardware units. Hence one core must calculate with software table solution. For this core all crc hardware units mus be set to the default value '255'. For the renesas controllers it is possible to assign a Crc hardware unit multiple times. For the JDP and IFX controllers it is not allowed.This container may maximally exist once.
      container CrcRbHWCoreConfiguration [1..*]: multiplicity set at pre-compile  # Crc core configuration | This container contains the configuration parameters of one core.
        integer CrcRblogCoreNo [0..1]: 0..10, multiplicity set at pre-compile, origin=RB, set at pre-compile  # logical core number | The logical core number should be matched to the short name of the subcontainer (e.g. logical core number 0 for Core_0).
        integer CrcRbCrc8HW [0..1]: 0..255, multiplicity set at pre-compile, origin=RB, set at pre-compile, default-value=255  # Crc8 hardware unit | number of crc hardware unit for crc8 calculation
        integer CrcRbCrc8h2fHW [0..1]: 0..255, multiplicity set at pre-compile, origin=RB, set at pre-compile, default-value=255  # Crc8h2f hardware unit | number of crc hardware unit for crc8h2f calculation
        integer CrcRbCrc16HW [0..1]: 0..255, multiplicity set at pre-compile, origin=RB, set at pre-compile, default-value=255  # Crc16 hardware unit | number of crc hardware unit for crc16 calculation
        integer CrcRbCrc32HW [0..1]: 0..255, multiplicity set at pre-compile, origin=RB, set at pre-compile, default-value=255  # Crc32 hardware unit | number of crc hardware unit for crc32 calculation
