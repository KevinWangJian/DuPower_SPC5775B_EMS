AUTOSAR XML (schema 4-2-2)
package /AUTOSAR_MemIf/EcucModuleDefs
  module definition MemIf [0..1]: category=VENDOR_SPECIFIC_MODULE_DEFINITION, refined-module-def=MemIf, variants pre-compile  # Memory: Abstraction Interface | Configuration of the MemIf component
    container MemIfGeneral  # Configuration of the memory abstraction interface (Memif) module
      boolean MemIfDevErrorDetect [0..1]: multiplicity set at pre-compile, origin=RB:0.1.0:2011-11-15, set at pre-compile  # Switch for DevErrorDetect
      integer MemIfNumberOfDevices: origin=RB:0.1.0:2011-11-23, set at pre-compile  # Number of devices for MemIf
      boolean MemIfRbFeeUsed [0..1]: multiplicity set at pre-compile, origin=RB:0.1.0:2011-11-21, set at pre-compile  # Status if Fee is configured
      integer MemIfRbNumberOfEADevices [0..1]: multiplicity set at pre-compile, origin=RB:0.1.0:2011-11-21, set at pre-compile  # Number of configured EA/Eep Devices
      boolean MemIfVersionInfoApi [0..1]: multiplicity set at pre-compile, origin=RB:0.1.0:2011-11-21, set at pre-compile  # Switch for VersionInfoApi
      float MemIfMainFunctionCycleTime: 0..1, set at pre-compile, with-auto=true  # Main function cycle time | Defines the cycle time in seconds of the periodic calling of MemIf main function. Cycle time is forwarded from NvM.
