AUTOSAR XML (schema 4-2-2)
package /AUTOSAR_ComStack/EcucModuleDefs
  module definition ComStack: category=VENDOR_SPECIFIC_MODULE_DEFINITION, refined-module-def=ComStack, variants pre-compile  # CUBAS Central Elements: ComStack
    container ComStackRbSettings: multiplicity set at pre-compile  # Configuration settings for CUCEL Central Elements module: ComStack
      enumeration ComStackRbArRelease: origin=RB:42.1.0.0:2016-10-14, set at pre-compile  # Configuration parameter for the AUTOSAR version/revision | Select the AUTOSAR version/revision the project is based on
        AR42_Rev2  # AUTOSAR Version 4.2 Revison 2
