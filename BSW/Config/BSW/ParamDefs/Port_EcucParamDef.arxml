AUTOSAR XML (schema 4-2-2)
package /AUTOSAR_Port/EcucModuleDefs
  module definition Port [0..1]: category=VENDOR_SPECIFIC_MODULE_DEFINITION, variants pre-compile  # MCAL Port Driver | Configuration of the MCAL module for µC ports.
    container PortConfigSet  # Configuration data set | This container is the base of a multiple configuration set.
      container PortContainer [1..*]: multiplicity set at pre-compile  # Port Container | Container collecting the PortPins.
        integer PortNumberOfPortPins [0..1]: 0..4294967295, multiplicity set at pre-compile in variant pre-compile / published-information in variant pre-compile, set at pre-compile in variant pre-compile / published-information in variant pre-compile  # Number of Pins | Number of pins in this Port Container.
        container PortPin [1..*]: multiplicity set at pre-compile  # Pin Container | Configuration of an individual Port pin.
          enumeration PortPinDirection: set at pre-compile in variant pre-compile / published-information in variant pre-compile  # Direction | Configuration of the initial Port pin direction (In or Out).
            PORT_PIN_IN  # In
            PORT_PIN_OUT  # Out
          boolean PortPinDirectionChangeable: set at pre-compile in variant pre-compile / published-information in variant pre-compile  # Direction changeable | Enables/disables if a pin direction is changeable.
          integer PortPinId [0..1]: 0..4294967295, multiplicity set at pre-compile in variant pre-compile / published-information in variant pre-compile, set at pre-compile in variant pre-compile / published-information in variant pre-compile, symbolic-name-value=true  # Pin ID | Numeric identifier of the port pin. This value will be assigned to the pin's symbolic name (i.e. the short name of the PortPin container).
          enumeration PortPinInitialMode: set at pre-compile in variant pre-compile / published-information in variant pre-compile  # Initial mode | Configuration of the initial port pin mode from mode list for use with Port_Init() function. Valid Configuration for RH850 P1-x: PORT_PIN_MODE_DIO PORT_PIN_MODE_AF_IN_1 PORT_PIN_MODE_AF_IN_2 PORT_PIN_MODE_AF_IN_3 PORT_PIN_MODE_AF_IN_4 PORT_PIN_MODE_AF_OUT_1 PORT_PIN_MODE_AF_OUT_2 PORT_PIN_MODE_AF_OUT_3 PORT_PIN_MODE_AF_OUT_4
            PORT_PIN_MODE_DIO
            PORT_PIN_MODE_AF_IN_{1..4}  # Alternative functionality input MUX_{1..4}
            PORT_PIN_MODE_AF_OUT_{1..4}  # Alternative functionality output MUX_{1..4}
          enumeration PortPinLevelValue [0..1]: multiplicity set at pre-compile in variant pre-compile / published-information in variant pre-compile, set at pre-compile in variant pre-compile / published-information in variant pre-compile  # Level | Configuration of the initial pin level for use with Port_Init() function (if the direction is Out).
            PORT_PIN_LEVEL_HIGH  # High
            PORT_PIN_LEVEL_LOW  # Low
          enumeration PortPinMode [0..0]: set at pre-compile in variant pre-compile / published-information in variant pre-compile  # Mode | Configuration of the allowed port pin modes. Valid Configuration for RH850 P1-x: PORT_PIN_MODE_DIO PORT_PIN_MODE_AF_IN_1 PORT_PIN_MODE_AF_IN_2 PORT_PIN_MODE_AF_IN_3 PORT_PIN_MODE_AF_IN_4 PORT_PIN_MODE_AF_OUT_1 PORT_PIN_MODE_AF_OUT_2 PORT_PIN_MODE_AF_OUT_3 PORT_PIN_MODE_AF_OUT_4
            PORT_PIN_MODE_DIO
            PORT_PIN_MODE_AF_IN_{1..4}  # Alternative functionality input {1..4}
            PORT_PIN_MODE_AF_OUT_{1..4}  # Alternative functionality output {1..4}
          boolean PortPinModeChangeable: set at pre-compile in variant pre-compile / published-information in variant pre-compile  # Mode changeable | Enables/disables if a pin mode is changeable.
          boolean PortPinRbAfSetsDirection: origin=RB:0.1.0:2013-10-21, set at pre-compile in variant pre-compile / published-information in variant pre-compile  # Alternative functionality sets direction | Configuration if the pin direction is controlled by PM register setting(PortPinRbAfSetsDirection = false) or Alternative functionality.
          boolean PortPinRbBiDirectional [0..1]: multiplicity set at pre-compile in variant pre-compile / published-information in variant pre-compile, origin=RB:0.1.0:2014-03-31, set at pre-compile in variant pre-compile / published-information in variant pre-compile, default-value=false  # Enable Bi-Directional | This parameter decides whether readback of output value possibel or not. This option can be enabled only for output pins
          enumeration PortPinRbBufferCharacteristicInput [0..1]: multiplicity set at pre-compile in variant pre-compile / published-information in variant pre-compile, origin=RB:0.1.0:2013-10-21, set at pre-compile in variant pre-compile / published-information in variant pre-compile  # Input buffer characteristic | Configuration of the Port pin input buffer characteristics (SHMT1,SHMT4).
            Type_1  # SHMT1
            Type_2  # SHMT4
          enumeration PortPinRbBufferCharacteristicOutput [0..1]: multiplicity set at pre-compile in variant pre-compile / published-information in variant pre-compile, origin=RB:0.1.0:2013-10-21, set at pre-compile in variant pre-compile / published-information in variant pre-compile  # Output buffer characteristic | Configuration of the Port pin output buffer characteristics (400 ohm,200ohm,100ohm,50ohm)
            OUTPUT_BUFFER_SELECTION_1  # 400ohm
            OUTPUT_BUFFER_SELECTION_2  # 200ohm
            OUTPUT_BUFFER_SELECTION_3  # 100ohm
            OUTPUT_BUFFER_SELECTION_4  # 50ohm
          string PortPinRbConnectedTo: origin=RB:0.1.0:2013-10-21, set at pre-compile in variant pre-compile / published-information in variant pre-compile  # Connected to | Customer specific name of Hardware pin.Must be configured in the format for Normal Pins, PORT_PIN_<PortId>_<PinIdex> for JTAG Pins, JPORT_PIN_<PortId>_<PinIdex>
          enumeration PortPinRbOutputType [0..1]: multiplicity set at pre-compile in variant pre-compile / published-information in variant pre-compile, origin=RB:0.1.0:2013-10-21, set at pre-compile in variant pre-compile / published-information in variant pre-compile  # Output type | Output type: Push Pull/Open Drain
            PORT_PIN_OUTPUT_TYPE_PUSH_PULL  # PushPull
            PORT_PIN_OUTPUT_TYPE_EMULATED_NCHANNEL_OPEN_DRAIN  # Emulated_N_ChanneOpenDrain
            PORT_PIN_OUTPUT_TYPE_EMULATED_PCHANNEL_OPEN_DRAIN  # Emulated_P_ChanneOpenDrain
          enumeration PortPinRbPull_UpDown [0..1]: multiplicity set at pre-compile in variant pre-compile / published-information in variant pre-compile, origin=RB:0.1.0:2013-10-21, set at pre-compile in variant pre-compile / published-information in variant pre-compile  # Pull up-down | Configuration if input pin is connected to PullUp or Pulldown resistor.
            PORT_PIN_PULL_UP  # PullUp
            PORT_PIN_PULL_DOWN  # PullDown
          string PortPinRbSignalMap [0..1]: multiplicity set at pre-compile in variant pre-compile / published-information in variant pre-compile, origin=RB:0.1.0:2014-04-03, set at pre-compile in variant pre-compile / published-information in variant pre-compile  # Signal Name | This maps port signal to port pin
    container PortGeneral  # General settings | Configuration of general aspects of the Port module.
      boolean PortDevErrorDetect: set at pre-compile in variant pre-compile / published-information in variant pre-compile  # Development error detection | Enables/disables the detection and notification of development errors. If this parameter is enabled, then extended error checking is performed during runtime; any errors detected by these checks are reported to the Dem module. This feature should be switched off in series software.
      enumeration PortRbDeviceType: {D1V1, D1V2, D2V1, D2V2, D2ED1, D3V1, D3V2, D4V1, D4V2, D5V1, D5ED2}, origin=RB:0.1.0:2014-04-10, set at pre-compile in variant pre-compile / published-information in variant pre-compile, default-value=D5ED2  # Device type | Holds the Device type information to decide on the available resources
      boolean PortRbFilterEnable: origin=RB:0.1.0:2014-2-8, set at pre-compile in variant pre-compile / published-information in variant pre-compile  # Port Filter Support | Enables/disables Port Filter Implementation.If it is enabled all the filters available will be initialized with their default vales
      boolean PortRbHWVerificationTest: origin=RB:0.1.0:2014-04-10, set at pre-compile in variant pre-compile / published-information in variant pre-compile  # Port HW Verification Feature | Enables/disables Hardware verification Functionality.
      boolean PortRbPreCompileSupport: origin=RB:0.1.0:2013-10-21, set at pre-compile in variant pre-compile / published-information in variant pre-compile  # Pre compile support | Enables/disables pre compile support.Ths is enabled if the Configuration is Pre-compile and disabled if its post build configuration
      boolean PortSetPinDirectionApi: set at pre-compile in variant pre-compile / published-information in variant pre-compile  # Set pin direction API | Enables/disables the SetPinDirection() API.
      boolean PortSetPinModeApi: set at pre-compile in variant pre-compile / published-information in variant pre-compile  # Set pin mode API | Enables/disables the SetPinMode() API.
      boolean PortVersionInfoApi: set at pre-compile in variant pre-compile / published-information in variant pre-compile  # Version information API | Enables/disables the GetVersionInfo() API. This functionality can be used e.g. for providing version information to test equipment.
