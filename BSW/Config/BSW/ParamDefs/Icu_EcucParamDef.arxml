AUTOSAR XML (schema 4-2-2)
package /AUTOSAR_Icu/EcucModuleDefs
  module definition Icu [0..1]: category=VENDOR_SPECIFIC_MODULE_DEFINITION, variants pre-compile  # MCAL Icu Driver | Configuration of the Icu (Input Capture Unit) module.
    container IcuConfigSet  # This container contains the configuration parameters and sub containers of the AUTOSAR Icu module.
      integer IcuMaxChannel: 0..65535, set at pre-compile, with-auto=true  # This parameter contains the number of Channels configured. It will be gathered by tools during the configuration stage. | calculationFormula = Number of configured Icu Channels Implementation Type: Icu_ChannelType
      container IcuChannel [1..*]: multiplicity set at pre-compile  # Configuration of an individual ICU channel.
        integer IcuChannelId: 0..65535, scope=ECU, set at pre-compile, symbolic-name-value=true, with-auto=true  # Channel Id of the ICU channel. This value will be assigned to the symbolic name derived of the IcuChannel container short name.
        enumeration IcuDefaultStartEdge: {ICU_BOTH_EDGES, ICU_FALLING_EDGE, ICU_RISING_EDGE}, set at pre-compile  # Configures the default-activation-edge which shall be used for this channel if there was no activation-edge configured by the call of service Icu_SetActivationCondition(). "Both Edges" support is not available for Signal Measurement mode. | In case the Measurement Mode is "IcuSignalMeasurement" and the properties "DutyCycle" or "Period" are set, the edge configured here is used as Default Period Start Edge. Implementation Type: Icu_ActivationType
        enumeration IcuMeasurementMode: {ICU_MODE_EDGE_COUNTER, ICU_MODE_SIGNAL_EDGE_DETECT, ICU_MODE_SIGNAL_MEASUREMENT, ICU_MODE_TIMESTAMP}, set at pre-compile  # Configures the measurement mode of this channel. Currently Time Stamping and Edge Detection modes are not supported. | Implementation Type: Icu_MeasurementModeType
        boolean IcuWakeupCapability [0..0]: set at pre-compile  # Information about the wakeup-capability of this channel. | true: Channel is wakeup capable. false: Channel is not wakeup capable.
        container IcuRbGtmTimChannel  # Icu GTM-TIM Channel Configuration | Configure the Generic Timer Module's(GTM) - Timer Input Module(TIM) channel. These informations will be forwarded to the "rba_Gtm" component configuration. Please refer the DataSheet to select the GTM-TIM Channels and its clock sources. | The information in this container will be forwarded to rba_Gtm component
          integer IcuRb_0_TimHwInst: 0..1, origin=RB:42.1.0.0:2016-10-31, set at pre-compile  # Tim Hardware Instance | The Hardware "instance" where the channel is located. | The TIM hardware instance where the channel is located.
          integer IcuRb_1_TimHwCh: 0..7, origin=RB:42.1.0.0:2016-10-31, set at pre-compile  # Tim Hardware Channel | The used Hardware channel in TIM for Icu | The Hardware channel of TIM submodule used for Icu generation.
          enumeration IcuRb_2_TimIcuClk: origin=RB:42.1.0.0:2016-10-31, set at pre-compile  # CMU clock Divider selection | Selection of Configurable clock divider for the TIM channel(configured for Icu). | For each channel, select the clock source divider to drive the channel. Please note that the selected clock source must also be present in "Clock Management Unit" container in rba_Gtm component.
            CMU_CLK_{0..7}  # Clock Source Divider {0..7}
          integer IcuRb_3_IcuChannelIndex: 0..255, origin=RB:42.1.0.0:2016-10-31, set at pre-compile, with-auto=true  # Channel Index | The index that specifies the location\placement of this channel configuration in an array containing the configurations of all the channels. Note : Do not fill this parameter. This parameter will be updated in the BCT action rba_Gtm_Prepare | Do not fill this parameter. It will be filled automatically during BCT build.
        container IcuSignalEdgeDetection [0..0]  # This container contains the configuration (parameters) in case the measurement mode is "IcuSignalEdgeDetection"
          function name IcuSignalNotification [0..1]: multiplicity set at pre-compile, post-build-variant-multiplicity=true, set at pre-compile  # Notification function for signal notification.
        container IcuSignalMeasurement [0..1]: multiplicity set at pre-compile  # This container contains the configuration (parameters) in case the measurement mode is "IcuSignalMeasurement"
          enumeration IcuSignalMeasurementProperty: {ICU_DUTY_CYCLE, ICU_HIGH_TIME, ICU_LOW_TIME, ICU_PERIOD_TIME}, post-build-variant-value=true, set at pre-compile  # Configures the property that could be measured in case the mode is "IcuSignalMeasurement". | This property can not be changed during runtime. Implementation Type: Icu_SignalMeasurementPropertyType
        container IcuTimestampMeasurement [0..0]  # This container contains the configuration (parameters) in case the measurement mode is "IcuTimestamp"
          enumeration IcuTimestampMeasurementProperty: {ICU_CIRCULAR_BUFFER, ICU_LINEAR_BUFFER}, set at pre-compile  # Configures the handling of the buffer in case the mode is "Timestamp" | Implementation Type: Icu_TimestampBufferType
          function name IcuTimestampNotification [0..1]: multiplicity set at pre-compile, post-build-variant-multiplicity=true, set at pre-compile  # Notification function if the number of requested timestamps | (Notification interval > 0) are acquired.
        container IcuWakeup [0..0]  # This container contains the configuration (parameters) needed to configure a wakeup capable channel
          symbolic name reference IcuChannelWakeupInfo [0..1]: multiplicity set at pre-compile, post-build-variant-multiplicity=true, set at pre-compile, destination=EcuMWakeupSource  # If the wakeup-capability is true the wakeup source referenced is transmitted to the ECU State Manager (EcuM) . | Implementation Type: reference to EcuM_WakeupSourceType
    container IcuGeneral  # Configuration of general ICU parameters.
      boolean IcuDevErrorDetect: set at pre-compile  # Switches the Default Error Tracer (Det) detection and notification ON or OFF. | * true: enabled (ON). * false: disabled (OFF).
      integer IcuIndex: 0..255, set at pre-compile  # Specifies the InstanceId of this module instance. If only one instance is present it shall have the Id 0.
      boolean IcuRbARVersionCheck [0..1]: origin=RB:42.1.0.0:2016-10-31, set at pre-compile  # AUTOSAR Version compatiability Check | Enable\Disable the Intra module check for the AUTOSAR version information. This Icu software is implemented as per AUTOSAR 4.2.2.
      boolean IcuReportWakeupSource [0..0]: set at pre-compile  # Switch for enabling Wakeup source reporting. | true: Report Wakeup source. false: Do not report Wakeup source.
    container IcuOptionalApis  # This container contains all configuration switches for configuring optional API services of the ICU driver.
      boolean IcuDeInitApi: set at pre-compile  # Adds / removes the service Icu_DeInit() from the code. | true: Icu_DeInit() can be used. false: Icu_DeInit() can not be used.
      boolean IcuDisableWakeupApi [0..0]: set at pre-compile  # Adds / removes the service Icu_DisableWakeup() from the code. | true: Icu_DisableWakeup() can be used. false: Icu_DisableWakeup() can not be used.
      boolean IcuEdgeCountApi: set at pre-compile  # Adds / removes all services related to the edge counting functionality as listed below, from the code: Icu_ResetEdgeCount(), Icu_EnableEdgeCount(), Icu_DisableEdgeCount(), Icu_GetEdgeNumbers(). | true: The services listed above can be used. false: The services listed above can not be used.
      boolean IcuEdgeDetectApi [0..0]: set at pre-compile  # Adds / removes the services related to the edge detection functionality, from the code: | Icu_EnableEdgeDetection() and Icu_DisableEdgeDetection(). true: These services can be used. false: These services can not be used.
      boolean IcuEnableWakeupApi [0..0]: set at pre-compile  # Adds / removes the service Icu_EnableWakeup() from the code. | true: Icu_EnableWakeup() can be used. false: Icu_EnableWakeup() can not be used.
      boolean IcuGetDutyCycleValuesApi: set at pre-compile  # Adds / removes the service Icu_GetDutyCycleValues() from the code. | true: Icu_GetDutyCycleValues() can be used. false: Icu_GetDutyCycleValues() can not be used.
      boolean IcuGetInputStateApi [0..0]: set at pre-compile  # Adds / removes the service Icu_GetInputState() from the code. | true: Icu_GetInputState() can be used. false: Icu_GetInputState() can not be used.
      boolean IcuGetTimeElapsedApi: set at pre-compile  # Adds / removes the service Icu_GetTimeElapsed() from the code. | true: Icu_GetTimeElapsed() can be used. false: Icu_GetTimeElapsed() can not be used.
      boolean IcuGetVersionInfoApi: set at pre-compile  # Adds / removes the service Icu_GetVersionInfo() from the code. | true: Icu_GetVersionInfo() can be used. false: Icu_GetVersionInfo() can not be used.
      boolean IcuSetModeApi [0..0]: set at pre-compile  # Adds / removes the service Icu_SetMode() from the code. | true: Icu_SetMode() can be used. false: Icu_SetMode() can not be used.
      boolean IcuSignalMeasurementApi: set at pre-compile  # Adds / removes the services Icu_StartSignalMeasurement() and Icu_StopSignalMeasurement() from the code. | true: Icu_StartSignalMeasurement() and Icu_StopSignalMeasurement() can be used. false: Icu_StartSignalMeasurement() and Icu_StopSignalMeasurement() can not be used.
      boolean IcuTimestampApi [0..0]: set at pre-compile  # Adds / removes all services related to the timestamping functionality as listed below from the code: Icu_StartTimestamp(), Icu_StopTimestamp(), Icu_GetTimestampIndex(). | true: The services listed above can be used. false: The services listed above can not be used.
      boolean IcuWakeupFunctionalityApi [0..0]: set at pre-compile  # Adds / removes the service Icu_CheckWakeup() from the code. | true: Icu_CheckWakeup() can be used. false: Icu_CheckWakeup() cannot be used.
