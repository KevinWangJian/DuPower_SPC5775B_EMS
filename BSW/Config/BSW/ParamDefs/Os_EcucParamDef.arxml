AUTOSAR XML (schema 4-2-2)
package /AUTOSAR_Os/EcucModuleDefs
  module definition Os [0..1]: category=VENDOR_SPECIFIC_MODULE_DEFINITION, refined-module-def=Os, variants pre-compile  # Configuration of the Os (Operating System) module.
    container OsAlarm [0..*]  # An OsAlarm may be used to asynchronously inform or activate a specific task. It is possible to start alarms automatically at system start-up depending on the application mode.
      reference OsAlarmAccessingApplication [0..*]: multiplicity set at pre-compile, set at pre-compile, destination=OsApplication  # Reference to applications which have an access to this object.
      reference OsAlarmCounterRef: set at pre-compile, destination=OsCounter  # Reference to the assigned counter for that alarm
      choice container OsAlarmAction  # This container defines which type of notification is used when the alarm expires.
        container OsAlarmActivateTask [0..1]  # This container specifies the parameters to activate a task.
          reference OsAlarmActivateTaskRef: set at pre-compile, destination=OsTask  # Reference to the task that will be activated by that alarm action
        container OsAlarmCallback [0..1]  # This container specifies the parameters to call a callback OS alarm action.
          function name OsAlarmCallbackName: set at pre-compile  # Name of the function that is called when this alarm callback is triggered.
        container OsAlarmIncrementCounter [0..1]  # This container specifies the parameters to increment a counter.
          reference OsAlarmIncrementCounterRef: scope=ECU, set at pre-compile, destination=OsCounter  # Reference to the counter that will be incremented by that alarm action
        container OsAlarmSetEvent [0..1]  # This container specifies the parameters to set an event
          reference OsAlarmSetEventRef: set at pre-compile, destination=OsEvent  # Reference to the event that will be set by that alarm action
          reference OsAlarmSetEventTaskRef: set at pre-compile, destination=OsTask  # Reference to the task that will be activated by that event
      container OsAlarmAutostart [0..1]  # If present this container defines if an alarm is started automatically at system start-up depending on the application mode.
        integer OsAlarmAlarmTime: 0..18446744073709551615, set at pre-compile  # The relative or absolute tick value when the alarm expires for the first time. Note that for an alarm which is RELATIVE the value must be at bigger than 0.
        enumeration OsAlarmAutostartType: {ABSOLUTE, RELATIVE}, set at pre-compile  # This specifies the type of autostart for the alarm..
        integer OsAlarmCycleTime: 0..18446744073709551615, set at pre-compile  # Cycle time of a cyclic alarm in ticks. If the value is 0 than the alarm is not cyclic.
        reference OsAlarmAppModeRef [1..*]: multiplicity set at pre-compile, set at pre-compile, destination=OsAppMode  # Reference to the application modes for which the AUTOSTART shall be performed
    container OsAppMode [1..*]  # OsAppMode is the object used to define OSEK OS properties for an OSEK OS application mode. | No standard attributes are defined for AppMode. In a CPU, at least one AppMode object has to be defined. [source: OSEK OIL Spec. 2.5] An OsAppMode called OSDEFAULTAPPMODE must always be there for OSEK compatibility.
    container OsApplication [0..*]  # An AUTOSAR OS must be capable of supporting a collection of OS objects (tasks, interrupts, alarms, hooks etc.) that form a cohesive functional unit. This collection of objects is termed an OS-Application. | All objects which belong to the same OS-Application have access to each other. Access means to allow to use these objects within API services. Access by other applications can be granted separately.
      boolean OsTrusted: scope=ECU, set at pre-compile, default-value=false  # Parameter to specify if an OS-Application is trusted or not. | true: OS-Application is trusted false: OS-Application is not trusted (default)
      boolean OsTrustedApplicationDelayTimingViolationCall: scope=ECU, set at pre-compile, default-value=true  # Parameter to specify if a timing violation which occurs within an trusted OS-Application is raised immediately of if it is delayed until the current task returns to the calling OS-Application (return of CallTrustedFunction) | true: violation / call to ProtectionHook() is delayed false: timing violation cause an immediate call to the ProtectionHook().
      boolean OsTrustedApplicationWithProtection: scope=ECU, set at pre-compile, default-value=false  # Parameter to specify if a trusted OS-Application is executed with memory protection or not. | true: OS-Application runs within a protected environment. This means that write access is limited. false: OS-Application has full write access (default)
      reference OsAppAlarmRef [0..*]: scope=ECU, multiplicity set at pre-compile, set at pre-compile, destination=OsAlarm  # Specifies the OsAlarms that belong to the OsApplication.
      reference OsAppCounterRef [0..*]: scope=ECU, multiplicity set at pre-compile, set at pre-compile, destination=OsCounter  # References the OsCounters that belong to the OsApplication.
      reference OsAppEcucPartitionRef [0..1]: multiplicity set at pre-compile, set at pre-compile, destination=EcucPartition  # Denotes which "EcucPartition" is implemented by this "OSApplication".
      reference OsAppIsrRef [0..*]: scope=ECU, multiplicity set at pre-compile, set at pre-compile, destination=OsIsr  # references which OsIsrs belong to the OsApplication
      reference OsAppScheduleTableRef [0..*]: scope=ECU, multiplicity set at pre-compile, set at pre-compile, destination=OsScheduleTable  # References the OsScheduleTables that belong to the OsApplication.
      reference OsAppTaskRef [0..*]: scope=ECU, multiplicity set at pre-compile, set at pre-compile, destination=OsTask  # references which OsTasks belong to the OsApplication
      reference OsRestartTask [0..1]: scope=ECU, multiplicity set at pre-compile, set at pre-compile, destination=OsTask  # Optionally one task of an OS-Application may be defined as Restart Task. | Multiplicity = 1: Restart Task is activated by the Operating System if the protection hook requests it. Multiplicity = 0: No task is automatically started after a protection error happened.
      symbolic name reference OsApplicationCoreRef [0..1]: multiplicity set at pre-compile, set at pre-compile, destination=EcucCoreDefinition  # Reference to the Core Definition in the Ecuc Module where the CoreId is defined. This reference is used to describe to which Core the OsApplication is bound.
      container OsApplicationHooks  # Container to structure the OS-Application-specific hooks
        boolean OsAppErrorHook: scope=ECU, set at pre-compile  # Select the OS-Application error hook. | true: Hook is called false: Hook is not called
        boolean OsAppShutdownHook: scope=ECU, set at pre-compile  # Select the OS-Application specific shutdown hook for the OS-Application. | true: Hook is called false: Hook is not called
        boolean OsAppStartupHook: scope=ECU, set at pre-compile  # Select the OS-Application specific startup hook for the OS-Application. | true: Hook is called false: Hook is not called
      container OsApplicationTrustedFunction [0..*]  # Container to structure the configuration parameters of trusted functions
        function name OsTrustedFunctionName: scope=ECU, set at pre-compile  # Trusted function (as part of a trusted OS-Application) available to other OS-Applications. This also supersedes the OSEK OIL attribute TRUSTED in APPLICATION because the optionality of this parameter is describing that already.
    container OsCounter [0..*]  # Configuration information for the counters that belong to the OsApplication.
      integer OsCounterMaxAllowedValue: 1..18446744073709551615, set at pre-compile  # Maximum possible allowed value of the system counter in ticks.
      integer OsCounterMinCycle: 1..18446744073709551615, set at pre-compile  # The MINCYCLE attribute specifies the minimum allowed number of counter ticks for a cyclic alarm linked to the counter.
      integer OsCounterTicksPerBase: 1..4294967295, set at pre-compile  # The TICKSPERBASE attribute specifies the number of ticks required to reach a counterspecific unit. The interpretation is implementation-specific.
      enumeration OsCounterType: {HARDWARE, SOFTWARE}, scope=ECU, set at pre-compile  # This parameter contains the natural type or unit of the counter.
      float OsSecondsPerTick [0..1]: 0..Inf, scope=ECU, multiplicity set at pre-compile, set at pre-compile  # Time of one counter tick in seconds.
      string OsFormat [0..1]: set at pre-compile, origin=ETAS-RTA-OS_v5.5.1  # A string that specifies a format for each tracepoint.
      reference OsCounterAccessingApplication [0..*]: multiplicity set at pre-compile, set at pre-compile, destination=OsApplication  # Reference to applications which have an access to this object.
      container OsDriver [0..1]  # This Container contains the information who will drive the counter. | This configuration is only valid if the counter has OsCounterType set to HARDWARE. If the container does not exist (multiplicity=0) the timer is managed by the OS internally (OSINTERNAL). If the container exists the OS can use the GPT interface to manage the timer. The user have to supply the GPT channel. If the counter is driven by some other (external to the OS) source (like a TPU for example) this must be described as a vendor specific extension.
        reference OsGptChannelRef [0..1]: scope=ECU, multiplicity set at pre-compile, set at pre-compile, destination=GptChannelConfiguration  # Reference to the GPT channel.
      container OsTimeConstant [0..*]  # Allows the user to define constants which can be e.g. used to compare time values with timer tick values. | A time value will be converted to a timer tick value during generation and can later on accessed via the OsConstName. The conversation is done by rounding time values to the nearest fitting tick value.
        float OsTimeValue: 0..Inf, scope=ECU, set at pre-compile  # This parameter contains the value of the constant in seconds.
    container OsEvent [0..*]  # Representation of OS events in the configuration context. Adopted from the OSEK OIL specification.
      integer OsEventMask [0..1]: 0..18446744073709551615, multiplicity set at pre-compile, set at pre-compile  # If event mask would be set to AUTO in OIL, this parameter should be omitted here.
    container OsIoc [0..1]  # Configuration of the IOC (Inter OS Application Communicator).
      container OsIocCommunication [0..*]  # Representation of a 1:1 or N:1 or N:M (unqueued only) communication between software parts located in different OS-Applications that are bound to the same or to different cores. | The name shall begin with the name of the sending software service and be followed by a unique identifier delivered by the sending software service. In the case of RTE as user attention shall be paid on the fact that uniqueness for identifier names has to be reached over ports, data elements, object instances and maybe additional identification properties (E.g. Case 1:N mapping to 1:1). Example: - <NameSpace>_UniqueID
        integer OsIocBufferLength [0..1]: 0..4294967295, multiplicity set at pre-compile, set at pre-compile  # This attribute defines the size of the IOC internal queue to be allocated for a queued communication. | This configuration information shall allow the optimization of the needed memory for communications requiring buffers within the RTE and within the IOC.
        container OsIocDataProperties [1..*]  # Data properties of the data to be transferred on the IOC communication channel.
          integer OsIocDataPropertyIndex [0..1]: 0..255, multiplicity set at pre-compile, set at pre-compile  # This parameter is used to define in which order the data is send, e.g. whether IocSendGroup(A,B) or IocSendGroup(B,A) shall be used.
          string OsIocInitValue [0..1]: multiplicity set at pre-compile, set at pre-compile  # Initial Value for the data to be transferred on the IOC communication channel.
          foreign reference OsIocDataTypeRef: set at pre-compile, destination-type=IMPLEMENTATION-DATA-TYPE  # This is the type of the data to be transferred on the IOC communication channel. This attribute is necessary to generate the parameter type of the Ioc functions. Additionally this information should be used to compute the data size for necessary data copy operations within the Ioc module. | If more than one attribute is defined, the IOC generator should generate an IocXxxGroup function (Xxx= CHOICE [Send, Receive, Write, Read]). N:1 or N:M communication (Multiplicity of OsIocSenderProperties > 1) is only allowed for multiplicity of OsIocDataTypeRef = 1
        container OsIocReceiverProperties [1..*]  # Representation of receiver properties for one communication. For each OsIocCommunication one (1:1) or many receivers (N:M) have to be defined. This container should be instantiated within an OsIocCommunication.
          enumeration OsIocFunctionImplementationKind [0..1]: {DO_NOT_CARE, FUNCTION, MACRO}, multiplicity set at pre-compile, set at pre-compile, default-value=DO_NOT_CARE  # This parameter is used to select whether this communication is implemented as a macro or as a function.
          function name OsIocReceiverPullCB [0..1]: multiplicity set at pre-compile, set at pre-compile  # This attribute defines the name of a callback function that the IOC shall call on the receiving core for each data reception. | In case of non existence of this attribute no ReceiverPullCB notification shall be applied by the IOC. The name of the function shall begin with the name of the receiving module, followed with a callback name and followed by the IocId. Example: void RTE_ReceiverPullCB_RTE25 (void). If this attribute does not exist, it means that no ReceiverPullCB shall be called (No notification from IOC is required). If this attribute exists the IOC shall call the callback function on the receiving core.
          reference OsIocReceivingOsApplicationRef: set at pre-compile, destination=OsApplication  # This attribute is a reference to the receiving OsApplication instance defined in the configuration file of the OS. | This information allows for the generator to get additional information necessary for the code generation like: * The protection properties of the communicating OsApplications to find out which protections have to be crossed * The core identifiers to find out if an intra or an inter core communication has to be realized * Interrupt details in case of cross core notification to realize over IRQs
        container OsIocSenderProperties [1..*]  # Representation of sender properties for one communication. For each OsIocCommunication one (1:1) or many senders (N:1 or N:M) have to be defined. Multiplicity > 1 (N:1 or N:M communication) is only allowed for Multiplicity of OsIocDataTypeRef = 1. | This container should be instantiated within an OsIocCommunication.
          enumeration OsIocFunctionImplementationKind [0..1]: {DO_NOT_CARE, FUNCTION, MACRO}, multiplicity set at pre-compile, set at pre-compile, default-value=DO_NOT_CARE  # This parameter is used to select whether this communication is implemented as a macro or as a function.
          integer OsIocSenderId [0..1]: 0..255, scope=ECU, multiplicity set at pre-compile, set at pre-compile  # Representation of a sender in a N:1 or N:M communication to distinguish between senders. | This parameter does not exist in 1:1 communication.
          reference OsIocSendingOsApplicationRef: set at pre-compile, destination=OsApplication  # This attribute is a reference to the sending OS-Application instance defined in the configuration file of the OS. | This information shall allows the generator to get additional information necessary for the code generation like: * The protection properties of the communicating OS-Applications to find out which protection boundaries have to be crossed. * The core identifiers to find out if an intra or an inter core communication has to be realized * Interrupt details in case of cross core notification to realize over IRQs
    container OsIsr [0..*]  # The OsIsr container represents an OSEK interrupt service routine.
      enumeration OsIsrCategory: {CATEGORY_1, CATEGORY_2}, set at pre-compile  # This attribute specifies the category of this ISR.
      string OsIsrBudget [0..1]: set at pre-compile, origin=ETAS-RTA-OS_v5.5.1  # Execution budget expressed as a float, then timebase name, then units.
      enumeration OsTraceFilter [0..1]: set at pre-compile, origin=ETAS-RTA-OS_v5.5.1, default-value=ALWAYS  # Describes whether this ISR is traced with RTA-TRACE.
        ALWAYS  # Always trace this ISR
        NEVER  # Never trace this ISR
        RUNTIME  # Allow the user to control tracing of this ISR at runtime.
      string OsIsrStackAllocation [0..1]: set at pre-compile, origin=ETAS-RTA-OS_v5.5.1  # ISR manual stack allocation in bytes.
      integer OsIsrPriority: 0.., set at pre-compile, origin=ETAS-RTA-OS_v5.5.1, symbolic-name-value=true  # The Interrupt Priority.
      string OsIsrAddress: set at pre-compile, origin=ETAS-RTA-OS_v5.5.1  # The Interrupt Vector.
      reference OsIsrResourceRef [0..*]: multiplicity set at pre-compile, set at pre-compile, destination=OsResource  # This reference defines the resources accessed by this ISR.
      reference OsRegSetRef [0..*]: set at pre-compile, origin=ETAS-RTA-OS_v5.5.1, destination=OsRegSet  # A reference to the register sets that are used by this ISR.
      container OsIsrTimingProtection [0..1]  # This container contains all parameters which are related to timing protection | If the container exists, the timing protection is used for this interrupt. If the container does not exist, the interrupt is not supervised regarding timing violations.
        float OsIsrAllInterruptLockBudget [0..1]: 0..Inf, scope=ECU, multiplicity set at pre-compile, set at pre-compile  # This parameter contains the maximum time for which the ISR is allowed to lock all interrupts (via SuspendAllInterrupts() or DisableAllInterrupts()) (in seconds).
        float OsIsrExecutionBudget [0..1]: 0..Inf, scope=ECU, multiplicity set at pre-compile, set at pre-compile  # The parameter contains the maximum allowed execution time of the interrupt (in seconds).
        float OsIsrOsInterruptLockBudget [0..1]: 0..Inf, scope=ECU, multiplicity set at pre-compile, set at pre-compile  # This parameter contains the maximum time for which the ISR is allowed to lock all Category 2 interrupts (via SuspendOSInterrupts()) (in seconds).
        float OsIsrTimeFrame [0..1]: 0..Inf, scope=ECU, multiplicity set at pre-compile, set at pre-compile  # This parameter contains the minimum inter-arrival time between successive interrupts (in seconds).
        container OsIsrResourceLock [0..*]  # This container contains a list of times the interrupt uses resources.
          float OsIsrResourceLockBudget: 0..Inf, scope=ECU, set at pre-compile  # This parameter contains the maximum time the interrupt is allowed to hold the given resource (in seconds).
          reference OsIsrResourceLockResourceRef: scope=ECU, set at pre-compile, destination=OsResource  # Reference to the resource the locking time is depending on
    container OsOS  # OS is the object used to define OSEK OS properties for an OSEK application. | Per CPU exactly one OS object has to be defined.
      integer OsNumberOfCores [0..1]: 1..65535, multiplicity set at pre-compile, set at pre-compile  # Maximum number of cores that are controlled by the OS. | The OS uses the value internally. It depends on the ECU HW.
      enumeration OsScalabilityClass [0..1]: {SC1, SC2, SC3, SC4}, scope=ECU, set at pre-compile  # A scalability class for each System Object "OS" has to be selected. In order to customize the operating system to the needs of the user and to take full advantage of the processor features the operating system can be scaled according to the scalability classes. | If the scalability class is omitted this translates to the OIL AUTO mechanism.
      boolean OsStackMonitoring: scope=ECU, set at pre-compile  # Select stack monitoring of Tasks/Category 2 ISRs | true: Stacks are monitored false: Stacks are not monitored
      enumeration OsStatus: {EXTENDED, STANDARD}, set at pre-compile  # The Status attribute specifies whether a system with standard or extended status has to be used. Automatic assignment is not supported for this attribute.
      boolean OsUseGetServiceId: set at pre-compile  # As defined by OSEK
      boolean OsUseParameterAccess: set at pre-compile  # As defined by OSEK
      boolean OsUseResScheduler: set at pre-compile, default-value=true  # The OsUseResScheduler attribute defines whether the resource RES_SCHEDULER is used within the application.
      integer OsCyclesPerSecond [0..1]: 0.., set at pre-compile, origin=ETAS-RTA-OS_v5.5.1  # Defines the clock speed of the target.
      integer OsTicksPerSecond [0..1]: 0.., set at pre-compile, origin=ETAS-RTA-OS_v5.5.1  # Defines the stopwatch speed of the target.
      function name OsDefaultInterrupt [0..1]: set at pre-compile, origin=ETAS-RTA-OS_v5.5.1  # The name of a handler that catches any unhandled interrupt.
      boolean OsSuppressVectorGen [0..1]: set at pre-compile, origin=ETAS-RTA-OS_v5.5.1, default-value=false  # Suppresses generation of the vector table. Default if absent is false.
      string OsDefTaskStack [0..1]: set at pre-compile, origin=ETAS-RTA-OS_v5.5.1  # Default task stack values. Multiple parameters indicate the target supports multiple stacks.
      string OsDefCat1Stack [0..1]: set at pre-compile, origin=ETAS-RTA-OS_v5.5.1  # Default category 1 stack values. Multiple parameters indicate the target supports multiple stacks.
      string OsDefCat2Stack [0..1]: set at pre-compile, origin=ETAS-RTA-OS_v5.5.1  # Default category 2 stack values. Multiple parameters indicate the target supports multiple stacks.
      container OsHooks  # Container to structure all hooks belonging to the OS
        boolean OsErrorHook: set at pre-compile  # Error hook as defined by OSEK | true: Hook is called false: Hook is not called
        boolean OsPostTaskHook: set at pre-compile  # Post-task hook as defined by OSEK | true: Hook is called false: Hook is not called
        boolean OsPreTaskHook: set at pre-compile  # Pre-task hook as defined by OSEK | true: Hook is called false: Hook is not called
        boolean OsProtectionHook [0..1]: scope=ECU, multiplicity set at pre-compile, set at pre-compile  # Switch to enable/disable the call to the (user supplied) protection hook. | true: Protection hook is called on protection error false: Protection hook is not called
        boolean OsShutdownHook: set at pre-compile  # Shutdown hook as defined by OSEK | true: Hook is called false: Hook is not called
        boolean OsStartupHook: set at pre-compile  # Startup hook as defined by OSEK | true: Hook is called false: Hook is not called
        boolean OsStackFaultHook [0..1]: set at pre-compile, origin=ETAS-RTA-OS_v5.5.1, default-value=false  # Use stack fault hook. Default if absent is false.
      container Param [0..*]  # OS-specific parameter representation.
        string Value: set at pre-compile, origin=ETAS-RTA-OS_v5.5.1  # Value of the parameter
    container OsResource [0..*]  # An OsResource object is used to co-ordinate the concurrent access by tasks and ISRs to a shared resource, e.g. the scheduler, any program sequence, memory or any hardware area.
      enumeration OsResourceProperty: {INTERNAL, LINKED, STANDARD}, set at pre-compile  # This specifies the type of the resource.
      reference OsResourceAccessingApplication [0..*]: multiplicity set at pre-compile, set at pre-compile, destination=OsApplication  # Reference to applications which have an access to this object.
      reference OsResourceLinkedResourceRef [0..1]: multiplicity set at pre-compile, set at pre-compile, destination=OsResource  # The link to the resource. Must be valid if OsResourceProperty is LINKED. If OsResourceProperty is not LINKED the value is ignored.
    container OsScheduleTable [0..*]  # An OsScheduleTable addresses the synchronization issue by providing an encapsulation of a statically defined set of alarms that cannot be modified at runtime.
      integer OsScheduleTableDuration: 0..18446744073709551615, set at pre-compile  # This parameter defines the modulus of the schedule table (in ticks).
      boolean OsScheduleTableRepeating: scope=ECU, set at pre-compile  # true: first expiry point on the schedule table shall be processed at final expiry point delay ticks after the final expiry point is processed. | false: the schedule table processing stops when the final expiry point is processed.
      reference OsSchTblAccessingApplication [0..*]: multiplicity set at pre-compile, set at pre-compile, destination=OsApplication  # Reference to applications which have an access to this object.
      reference OsScheduleTableCounterRef: scope=ECU, set at pre-compile, destination=OsCounter  # This parameter contains a reference to the counter which drives the schedule table.
      container OsScheduleTableAutostart [0..1]  # This container specifies if and how the schedule table is started on startup of the Operating System. The options to start a schedule table correspond to the API calls to start schedule tables during runtime.
        enumeration OsScheduleTableAutostartType: {ABSOLUTE, RELATIVE, SYNCHRON}, set at pre-compile  # This specifies the type of the autostart for the schedule table.
        integer OsScheduleTableStartValue [0..1]: 0..18446744073709551615, scope=ECU, multiplicity set at pre-compile, set at pre-compile  # Absolute autostart tick value when the schedule table starts. Only used if the OsScheduleTableAutostartType is ABSOLUTE. | Relative offset in ticks when the schedule table starts. Only used if the OsScheduleTableAutostartType is RELATIVE.
        reference OsScheduleTableAppModeRef [1..*]: scope=ECU, multiplicity set at pre-compile, set at pre-compile, destination=OsAppMode  # Reference in which application modes the schedule table should be started during startup
      container OsScheduleTableExpiryPoint [1..*]  # The point on a Schedule Table at which the OS activates tasks and/or sets events
        integer OsScheduleTblExpPointOffset: 0..18446744073709551615, set at pre-compile  # The offset from zero (in ticks) at which the expiry point is to be processed.
        container OsScheduleTableEventSetting [0..*]  # Event that is triggered by that schedule table.
          reference OsScheduleTableSetEventRef: set at pre-compile, destination=OsEvent  # Reference to event that will be set by action
          reference OsScheduleTableSetEventTaskRef: set at pre-compile, destination=OsTask
        container OsScheduleTableTaskActivation [0..*]  # Task that is triggered by that schedule table.
          reference OsScheduleTableActivateTaskRef: scope=ECU, set at pre-compile, destination=OsTask  # Reference to task that will be activated by action
        container OsScheduleTblAdjustableExpPoint [0..1]  # Adjustable expiry point
          integer OsScheduleTableMaxLengthen: 0..18446744073709551615, set at pre-compile  # The maximum positive adjustment that can be made to the expiry point offset (in ticks).
          integer OsScheduleTableMaxShorten: 0..18446744073709551615, set at pre-compile  # The maximum negative adjustment that can be made to the expiry point offset (in ticks).
      container OsScheduleTableSync [0..1]  # This container specifies the synchronization parameters of the schedule table.
        integer OsScheduleTblExplicitPrecision [0..1]: 0..18446744073709551615, scope=ECU, multiplicity set at pre-compile, set at pre-compile  # This configuration is only valid if the explicit synchronization is used.
        enumeration OsScheduleTblSyncStrategy: {EXPLICIT, IMPLICIT, NONE}, scope=ECU, origin=AUTOSAR ECUC, set at pre-compile, default-value=NONE  # AUTOSAR OS provides support for synchronization in two ways: explicit and implicit.
    container OsSpinlock [0..*]  # An OsSpinlock object is used to co-ordinate concurrent access by TASKs/ISR2s on different cores to a shared resource.
      enumeration OsSpinlockLockMethod [0..1]: set at pre-compile, origin=ETAS-RTA-OS_v5.5.1, default-value=LOCK_NOTHING  # Determines the locking method for the Spinlock.
        LOCK_ALL_INTERRUPTS  # Lock all interrupts when spinlock is taken.
        LOCK_CAT2_INTERRUPTS  # Lock OS interrupts when spinlock is taken.
        LOCK_NOTHING  # No lock when spinlock is taken.
        LOCK_WITH_RES_SCHEDULER  # Lock RES_SCHEDULER when spinlock is taken.
        NESTABLE_LOCK_ALL_INTERRUPTS  # Lock all interrupts when spinlock is taken. Allow nesting.
        NESTABLE_LOCK_CAT2_INTERRUPTS  # Lock OS interrupts when spinlock is taken. Allow nesting.
        NESTABLE_LOCK_NOTHING  # No lock when spinlock is taken. Allow nesting.
        NESTABLE_LOCK_WITH_RES_SCHEDULER  # Lock RES_SCHEDULER when spinlock is taken. Allow nesting.
        COMMONABLE_LOCK_ALL_INTERRUPTS  # Lock all interrupts when spinlock is taken. Lock is commonable.
        COMMONABLE_LOCK_CAT2_INTERRUPTS  # Lock OS interrupts when spinlock is taken. Lock is commonable.
        COMMONABLE_LOCK_NOTHING  # No lock when spinlock is taken. Lock is commonable.
        COMMONABLE_LOCK_WITH_RES_SCHEDULER  # Lock RES_SCHEDULER when spinlock is taken. Lock is commonable.
        NESTABLE_COMMONABLE_LOCK_ALL_INTERRUPTS  # Lock all interrupts when spinlock is taken. Allow nesting. Lock is commonable.
        NESTABLE_COMMONABLE_LOCK_CAT2_INTERRUPTS  # Lock OS interrupts when spinlock is taken. Allow nesting. Lock is commonable.
        NESTABLE_COMMONABLE_LOCK_NOTHING  # No lock when spinlock is taken. Allow nesting. Lock is commonable.
        NESTABLE_COMMONABLE_LOCK_WITH_RES_SCHEDULER  # Lock RES_SCHEDULER when spinlock is taken. Allow nesting. Lock is commonable.
      reference OsSpinlockAccessingApplication [1..*]: multiplicity set at pre-compile, set at pre-compile, destination=OsApplication  # Reference to OsApplications that have an access to this object.
      reference OsSpinlockSuccessor [0..1]: multiplicity set at pre-compile, set at pre-compile, destination=OsSpinlock  # Reference to OsApplications that have an access to this object. | To check whether a spinlock can be occupied (in a nested way) without any danger of deadlock, a linked list of spinlocks can be defined. A spinlock can only be occupied in the order of the linked list. It is allowed to skip a spinlock. If no linked list is specified, spinlocks cannot be nested.
    container OsTask [0..*]  # This container represents an OSEK task.
      integer OsTaskActivation: 1..4294967295, set at pre-compile  # This attribute defines the maximum number of queued activation requests for the task. A value equal to "1" means that at any time only a single activation is permitted for this task. Note that the value must be a natural number starting at 1.
      integer OsTaskPriority: 0..4294967295, set at pre-compile  # The priority of a task is defined by the value of this attribute. This value has to be understood as a relative value, i.e. the values show only the relative ordering of the tasks. | OSEK OS defines the lowest priority as zero (0); larger values correspond to higher priorities.
      enumeration OsTaskSchedule: {FULL, NON}, set at pre-compile  # The OsTaskSchedule attribute defines the preemptability of the task. | If this attribute is set to NON, no internal resources may be assigned to this task.
      string OsTaskStackAllocation [0..1]: set at pre-compile, origin=ETAS-RTA-OS_v5.5.1  # Task manual stack allocation in bytes.
      string OsTaskWaitStack [0..1]: set at pre-compile, origin=ETAS-RTA-OS_v5.5.1  # Task stack usage when invoking WaitEvent.
      string OsTaskBudget [0..1]: set at pre-compile, origin=ETAS-RTA-OS_v5.5.1  # Execution budget expressed as a float, then timebase name, then units.
      boolean OsTaskCanCallSchedule [0..1]: set at pre-compile, origin=ETAS-RTA-OS_v5.5.1, default-value=true  # TRUE if a TASK calls, or might call, the Schedule() API. System stack usage may be reduced if this can be set FALSE. Ignored if global OS option 'Disallow Schedule()' is TRUE
      enumeration OsTraceFilter [0..1]: set at pre-compile, origin=ETAS-RTA-OS_v5.5.1, default-value=ALWAYS  # Describes whether this Task is traced with RTA-TRACE.
        ALWAYS  # Always trace this Task
        NEVER  # Never trace this Task
        RUNTIME  # Allow the user to control tracing of this Task at runtime.
      reference OsTaskAccessingApplication [0..*]: multiplicity set at pre-compile, set at pre-compile, destination=OsApplication  # Reference to applications which have an access to this object.
      reference OsTaskEventRef [0..*]: multiplicity set at pre-compile, set at pre-compile, destination=OsEvent  # This reference defines the list of events the extended task may react on.
      reference OsTaskResourceRef [0..*]: multiplicity set at pre-compile, set at pre-compile, destination=OsResource  # This reference defines a list of resources accessed by this task.
      reference OsRegSetRef [0..*]: set at pre-compile, origin=ETAS-RTA-OS_v5.5.1, destination=OsRegSet  # A reference to the register sets that are used by this Task.
      container OsTaskAutostart [0..1]  # This container determines whether the task is activated during the system start-up procedure or not for some specific application modes. | If the task shall be activated during the system start-up, this container is present and holds the references to the application modes in which the task is auto-started.
        reference OsTaskAppModeRef [1..*]: multiplicity set at pre-compile, set at pre-compile, destination=OsAppMode  # Reference to application modes in which that task is activated on startup of the OS
      container OsTaskTimingProtection [0..1]  # This container contains all parameters regarding timing protection of the task.
        float OsTaskAllInterruptLockBudget [0..1]: 0..Inf, scope=ECU, multiplicity set at pre-compile, set at pre-compile  # This parameter contains the maximum time for which the task is allowed to lock all interrupts (via SuspendAllInterrupts() or DisableAllInterrupts()) (in seconds).
        float OsTaskExecutionBudget [0..1]: 0..Inf, scope=ECU, multiplicity set at pre-compile, set at pre-compile  # This parameter contains the maximum allowed execution time of the task (in seconds).
        float OsTaskOsInterruptLockBudget [0..1]: 0..Inf, scope=ECU, multiplicity set at pre-compile, set at pre-compile  # This parameter contains the maximum time for which the task is allowed to lock all Category 2 interrupts (via SuspendOSInterrupts()) (in seconds).
        float OsTaskTimeFrame [0..1]: 0..Inf, scope=ECU, multiplicity set at pre-compile, set at pre-compile  # The minimum inter-arrival time between activations and/or releases of a task (in seconds).
        container OsTaskResourceLock [0..*]  # This container contains the worst case time between getting and releasing a given resource (in seconds).
          float OsTaskResourceLockBudget: 0..Inf, scope=ECU, set at pre-compile  # This parameter contains the maximum time the task is allowed to lock the resource (in seconds)
          reference OsTaskResourceLockResourceRef: scope=ECU, set at pre-compile, destination=OsResource  # Reference to the resource used by the task
    container OsRTATarget [0..1]  # Parameters to represent a specific piece of target hardware.
      string OsRTATargetName: set at pre-compile, origin=ETAS-RTA-OS_v5.5.1  # The name of the target system.
      string OsRTATargetVersion [0..1]: set at pre-compile, origin=ETAS-RTA-OS_v5.5.1  # The version number of the target.
      string OsRTATargetVariant [0..1]: set at pre-compile, origin=ETAS-RTA-OS_v5.5.1  # The variant of the target
      container Param [0..*]  # Target-specific parameter representation.
        string Value: set at pre-compile, origin=ETAS-RTA-OS_v5.5.1  # Value of the parameter
    container OsRegSet [0..*]  # Target specific register sets that can be associated with a task or ISR. By association with a task or ISR, the integrator is specifying that a specific task or ISR uses this register set. Having no association defined allows potential optimization.
    container OsTrace [0..1]  # RTA-TRACE Data.
      boolean OsTraceEnabled: set at pre-compile, origin=ETAS-RTA-OS_v5.5.1, default-value=false  # Enables tracing.
      boolean OsTraceCompactID: set at pre-compile, origin=ETAS-RTA-OS_v5.5.1, default-value=false  # Trace with compact identifiers.
      boolean OsTraceCompactTime: set at pre-compile, origin=ETAS-RTA-OS_v5.5.1, default-value=false  # Trace with compact time format.
      boolean OsTraceTgtStack: set at pre-compile, origin=ETAS-RTA-OS_v5.5.1, default-value=false  # Enable stack recording.
      boolean OsTraceTgtTrigger: set at pre-compile, origin=ETAS-RTA-OS_v5.5.1, default-value=false  # Runtime target triggering.
      boolean OsTraceAutoComms: set at pre-compile, origin=ETAS-RTA-OS_v5.5.1, default-value=false  # Initialize trace comms link at startup.
      boolean OsTraceAutoRepeat: set at pre-compile, origin=ETAS-RTA-OS_v5.5.1, default-value=false  # Call set trace repeat at startup.
      integer OsTraceBufferSize: set at pre-compile, origin=ETAS-RTA-OS_v5.5.1  # The trace buffer size (in number of trace records)
      enumeration OsTraceAuto: set at pre-compile, origin=ETAS-RTA-OS_v5.5.1, default-value=NONE  # The autostart type for RTA-TRACE.
        NONE  # Don't automatically start tracing
        BURSTING  # Start tracing in bursting mode (wait till buffer is full before uploading)
        TRIGGERING  # Start tracing, waiting for a trigger.
        FREE_RUNNING  # Start tracing continuously.
      container OsEnumeration [0..1]  # Specifies an enumeration for tracing.
        container Param [0..*]  # Enumeration-specific parameter representation.
          string Value: set at pre-compile, origin=ETAS-RTA-OS_v5.5.1  # Value of the parameter
      container OsTraceTracepoint [0..*]  # Specifies a tracepoint.
        integer OsTraceTracepointID: 0.., set at pre-compile, origin=ETAS-RTA-OS_v5.5.1  # Specifies a tracepoint ID (1-n, 0 indicates auto)
        string OsTraceTracepointFormat [0..1]: set at pre-compile, origin=ETAS-RTA-OS_v5.5.1  # A string that specifies a format for each tracepoint.
      container OsTraceTaskTracepoint [0..*]  # Specifies a task tracepoint.
        integer OsTraceTaskTracepointID: 0.., set at pre-compile, origin=ETAS-RTA-OS_v5.5.1  # Specifies a tracepoint ID (1-n, 0 indicates auto)
        string OsTraceTaskTracepointFormat [0..1]: set at pre-compile, origin=ETAS-RTA-OS_v5.5.1  # A string that specifies a format for each tracepoint.
        reference OsTaskRef [0..1]: set at pre-compile, origin=ETAS-RTA-OS_v5.5.1, destination=OsTask  # A reference to the task owning the tracepoint.
        reference OsIsrRef [0..1]: set at pre-compile, origin=ETAS-RTA-OS_v5.5.1, destination=OsIsr  # A reference to the ISR owning the tracepoint.
      container OsInterval [0..*]  # Specifies a named interval.
        integer OsIntervalID: set at pre-compile, origin=ETAS-RTA-OS_v5.5.1  # Specifies a interval identifier (1-n, 0 indicates auto)
        string OsIntervalFormat [0..1]: set at pre-compile, origin=ETAS-RTA-OS_v5.5.1  # A string that specifies a format for each interval.
      container Param [0..*]  # Trace-specific parameter representation.
        string Value: set at pre-compile, origin=ETAS-RTA-OS_v5.5.1  # Value of the parameter
      container OsClass [0..*]  # Specifies an unnamed trace class.
        enumeration OsClassFilter: set at pre-compile, origin=ETAS-RTA-OS_v5.5.1, default-value=ALWAYS  # Specifies the filtering for a class.
          ALWAYS  # Always trace this class
          NEVER  # Never trace this class
          RUNTIME  # Allow the user to control tracing of this class at runtime.
        boolean OsClassAutostart [0..1]: set at pre-compile, origin=ETAS-RTA-OS_v5.5.1, default-value=false  # For a run-time trace class, this determines whether it is started automatically at runtime
      container OsCategory [0..*]  # Specifies an named trace category.
        integer OsCategoryMask: set at pre-compile, origin=ETAS-RTA-OS_v5.5.1  # Specifies a category mask. 0 represents auto.
        enumeration OsCategoryFilter: set at pre-compile, origin=ETAS-RTA-OS_v5.5.1, default-value=ALWAYS  # Specifies the filtering for a category.
          ALWAYS  # Always trace this category
          NEVER  # Never trace this category
          RUNTIME  # Allow the user to control tracing of this category at runtime.
        boolean OsCategoryAutostart [0..1]: set at pre-compile, origin=ETAS-RTA-OS_v5.5.1, default-value=false  # For a run-time trace category, this determines whether it is started automatically at runtime
package /AUTOSAR_Os/LifeCycleInfoSets
  life cycle info set AUTOSARParameterDefinition
    life-cycle-infos:
      lc-object=BswMBswMModeRequest, lc-state=obsolete, period-begin=ar-release-version=4.2.2
      lc-object=BswMBswMModeDeclarationGroupRef, lc-state=obsolete, period-begin=ar-release-version=4.2.2
      lc-object=BswMBswMModeSwitchNotification, lc-state=obsolete, period-begin=ar-release-version=4.2.2
      lc-object=BswMBswMModeDeclarationGroupRef, lc-state=obsolete, period-begin=ar-release-version=4.2.2
      lc-object=BswMRequestRemoteMode, lc-state=obsolete, period-begin=ar-release-version=4.2.2
      lc-object=BswMModeDeclarationGroupPrototypeRef, lc-state=obsolete, period-begin=ar-release-version=4.2.2
      lc-object=BswMRequestedRemoteMode, lc-state=obsolete, period-begin=ar-release-version=4.2.2
      lc-object=BswMEcuCPartitionRef, lc-state=obsolete, period-begin=ar-release-version=4.2.2
      lc-object=BswMTriggerSlaveRTEStop, lc-state=obsolete
      lc-object=BswMCoreRef, lc-state=obsolete
      lc-object=BswMTriggerStartUpPhase2, lc-state=obsolete
      lc-object=BswMCoreRef, lc-state=obsolete
      lc-object=DcmDspDidInfotypeRef, lc-state=obsolete, period-begin=ar-release-version=4.2.2, remark=p=l-1=This reference is set to obsolete and will be removed in release 4.3. Use DcmDspEnableObdMirror instead.
      lc-object=DcmDspDidPidRef, lc-state=obsolete, period-begin=ar-release-version=4.2.2, remark=p=l-1=This reference is set to obsolete and will be removed in release 4.3. Use DcmDspEnableObdMirror instead.
      lc-object=DcmDspCommonAuthorizationRef, lc-state=obsolete, period-begin=ar-release-version=4.2.2, remark=p=l-1=This reference is set to obsolete and will be removed in release 4.3.
      lc-object=DcmDspRoutineTidRef, lc-state=obsolete, period-begin=ar-release-version=4.2.2, remark=p=l-1=This reference is set to obsolete and will be removed in release 4.3. Use DcmDspEnableObdMirror instead.
      lc-object=DemAgingCycleCounterProcessing, lc-state=obsolete, period-begin=ar-release-version=4.2.2, remark=p=l-1=This reference is set to obsolete and will be removed in release 4.3.
      lc-object=DemOBDDestinationOfEventsRef, lc-state=obsolete, period-begin=ar-release-version=4.2.2, remark=p=l-1=This reference is set to obsolete and will be removed in release 4.3.
      lc-object=EthIfMainFunctionRxTimeout, lc-state=obsolete, period-begin=ar-release-version=4.2.2
      lc-object=EthTSynGlobalTimeDomainId, lc-state=obsolete, period-begin=ar-release-version=4.2.2
      lc-object=FiMDataFixed, lc-state=obsolete
      lc-object=FiMTaskTime, lc-state=obsolete
      lc-object=FlsDemEventParameterRefs, lc-state=obsolete, period-begin=ar-release-version=4.2.2, remark=p=l-1=This container is set to obsolete and will be removed in release 4.3.
      lc-object=FLS_E_COMPARE_FAILED, lc-state=obsolete, period-begin=ar-release-version=4.2.2, remark=p=l-1=This reference is set to obsolete and will be removed in release 4.3.
      lc-object=FLS_E_ERASE_FAILED, lc-state=obsolete, period-begin=ar-release-version=4.2.2, remark=p=l-1=This reference is set to obsolete and will be removed in release 4.3.
      lc-object=FLS_E_READ_FAILED, lc-state=obsolete, period-begin=ar-release-version=4.2.2, remark=p=l-1=This reference is set to obsolete and will be removed in release 4.3.
      lc-object=FLS_E_UNEXPECTED_FLASH_ID, lc-state=obsolete, period-begin=ar-release-version=4.2.2, remark=p=l-1=This reference is set to obsolete and will be removed in release 4.3.
      lc-object=FLS_E_WRITE_FAILED, lc-state=obsolete, period-begin=ar-release-version=4.2.2, remark=p=l-1=This reference is set to obsolete and will be removed in release 4.3.
      lc-object=FlsTstNumberOfTestedCells, lc-state=obsolete, period-begin=ar-release-version=4.2.2
      lc-object=FlsTstNumberOfTestedCells, lc-state=obsolete, period-begin=ar-release-version=4.2.2
      lc-object=FrNmNumberOfClusters, lc-state=obsolete, period-begin=ar-release-version=4.2.2
      lc-object=LinNmComUserDataSupport, lc-state=obsolete
      lc-object=UDPNM_E_NETWORK_TIMEOUT, lc-state=obsolete, period-begin=ar-release-version=4.2.2
      lc-object=UDPNM_E_TCPIP_TRANSMIT_ERROR, lc-state=obsolete, period-begin=ar-release-version=4.2.2
      lc-object=WDGM_E_IMPROPER_CALLER, lc-state=obsolete, period-begin=ar-release-version=4.2.2, remark=p=l-1=This reference is set to obsolete and will be removed in R 4.3
      lc-object=WDGM_E_MONITORING, lc-state=obsolete, period-begin=ar-release-version=4.2.2, remark=p=l-1=use WDGM_E_SUPERVISION instead
      lc-object=WdgMDefensiveBehavior, lc-state=obsolete, period-begin=ar-release-version=4.2.2, remark=p=l-1=This parameter is set to obsolete and will be removed in R 4.3
      lc-object=WdgMCallerIds, lc-state=obsolete, period-begin=ar-release-version=4.2.2, remark=p=l-1=This container is set to obsolete and will be removed in R4.3
      lc-object=WdgMCallerId, lc-state=obsolete, period-begin=ar-release-version=4.2.2, remark=p=l-1=This parameter is set to obsolete and will be removed in R4.3
      lc-object=XfmTransformationBswModuleEntryRef, lc-state=obsolete, period-begin=ar-release-version=4.2.2
