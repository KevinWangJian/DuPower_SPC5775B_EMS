AUTOSAR XML (schema 4-2-2)
package /AUTOSAR_Eth/EcucModuleDefs
  module definition Eth [0..*]: refined-module-def=Eth, post-build-variant-support=true, variants link-time/post-build/pre-compile  # Configuration of the Eth (Ethernet Driver) module.
    container EthConfigSet  # This container contains the configuration parameters and sub containers of the AUTOSAR Eth module.
      container EthCtrlConfig [1..*]  # Configuration of the individual controller
        boolean EthCtrlEnableMii: set at pre-compile  # Enables / Disables Media Independent Interface (MII) for transceiver access
        boolean EthCtrlEnableRxInterrupt: set at pre-compile  # Enables / Disables receive interrupt
        boolean EthCtrlEnableTxInterrupt: set at pre-compile  # Enables / Disables transmit interrupt
        enumeration EthCtrlMacLayerSpeed: {ETH_MAC_LAYER_SPEED_100M, ETH_MAC_LAYER_SPEED_10M}, set at pre-compile, origin=AR  # Autosar specific parameter: Data transfer speed of ethernet controller | ImplementationType: EthCtrlMacLayerSpeed
        integer EthCtrlIdx: 0..255, scope=ECU, set at pre-compile, symbolic-name-value=true  # Specifies the instance ID of the configured controller.
        string EthCtrlPhyAddress [0..1]: multiplicity set at link in variant link-time / post-build in variant post-build / pre-compile in variant pre-compile, post-build-variant-multiplicity=true, post-build-variant-value=true, set at link in variant link-time / post-build in variant post-build / pre-compile in variant pre-compile, max-length=17, min-length=17  # Specifies the unique 48-bit physical address (MAC address) of the controller in network byte order. | Regular Expression: [0-9a-fA-F]{2}[[:-][0-9a-fA-F]{2}]{5}
        integer EthCtrlRxBufLenByte: 0..1536, post-build-variant-value=true, set at link in variant link-time / post-build in variant post-build / pre-compile in variant pre-compile  # Limits the maximum receive buffer length (frame length) in bytes.
        integer EthCtrlTxBufLenByte: 0..1536, post-build-variant-value=true, set at link in variant link-time / post-build in variant post-build / pre-compile in variant pre-compile  # Limits the maximum transmit buffer length (frame length) in bytes.
        integer EthRxBufTotal: 0..255, post-build-variant-value=true, set at link in variant link-time / post-build in variant post-build / pre-compile in variant pre-compile  # Configures the number of receive buffers.
        integer EthTxBufTotal: 0..255, post-build-variant-value=true, set at link in variant link-time / post-build in variant post-build / pre-compile in variant pre-compile  # Configures the number of transmit buffers.
        container EthDemEventParameterRefs [0..1]  # Container for the references to DemEventParameter elements which shall be invoked using the API Dem_ReportErrorStatus in case the corresponding error occurs. The EventId is taken from the referenced DemEventParameter's DemEventId value. The standardized errors are provided in the container and can be extended by vendor specific error references.
          enumeration rba_Eth_DynCreate_ETH_E_ACCESS [0..1]: {Standard, Disabled}, origin=RB:16.0.1:2015-02-10, set at link in variant link-time / post-build in variant post-build / pre-compile in variant pre-compile, default-value=Disabled  # Selects the way how the Eth DemEvent is created. If not set or set to Disabled, no such DemEvent is automatically created. If the dynamic creation of this DemEvent is enabled, the reference to this DemEvent (in parameter rba_Eth_DemEventRef) is also automatically created and shall therefore not be set manually.
          enumeration rba_Eth_DynCreate_ETH_E_ALIGNMENT [0..1]: {Standard, Disabled}, origin=RB:16.0.1:2015-02-10, set at link in variant link-time / post-build in variant post-build / pre-compile in variant pre-compile, default-value=Disabled  # Selects the way how the Eth DemEvent is created. If not set or set to "Disabled", no such DemEvent is automatically created. If the dynamic creation of this DemEvent is enabled, the reference to this DemEvent (in parameter rba_Eth_DemEventRef) is also automatically created and shall therefore not be set manually.
          enumeration rba_Eth_DynCreate_ETH_E_CRC [0..1]: {Standard, Disabled}, origin=RB:16.0.1:2015-02-10, set at link in variant link-time / post-build in variant post-build / pre-compile in variant pre-compile, default-value=Disabled  # Selects the way how the Eth DemEvent is created. If not set or set to "Disabled", no such DemEvent is automatically created. If the dynamic creation of this DemEvent is enabled, the reference to this DemEvent (in parameter rba_Eth_DemEventRef) is also automatically created and shall therefore not be set manually.
          enumeration rba_Eth_DynCreate_ETH_E_OVERSIZEFRAME [0..1]: {Standard, Disabled}, origin=RB:16.0.1:2015-02-10, set at link in variant link-time / post-build in variant post-build / pre-compile in variant pre-compile, default-value=Disabled  # Selects the way how the Eth DemEvent is created. If not set or set to "Disabled", no such DemEvent is automatically created. If the dynamic creation of this DemEvent is enabled, the reference to this DemEvent (in parameter rba_Eth_DemEventRef) is also automatically created and shall therefore not be set manually.
          enumeration rba_Eth_DynCreate_ETH_E_RX_FRAMES_LOST [0..1]: {Standard, Disabled}, origin=Vendor06, set at link in variant link-time / post-build in variant post-build / pre-compile in variant pre-compile, default-value=Disabled  # Selects the way how the Eth DemEvent is created. If not set or set to "Disabled", no such DemEvent is automatically created. If the dynamic creation of this DemEvent is enabled, the reference to this DemEvent (in parameter rba_Eth_DemEventRef) is also automatically created and shall therefore not be set manually.
          enumeration rba_Eth_DynCreate_ETH_E_UNDERSIZEFRAME [0..1]: {Standard, Disabled}, origin=Vendor06, set at link in variant link-time / post-build in variant post-build / pre-compile in variant pre-compile, default-value=Disabled  # Selects the way how the Eth DemEvent is created. If not set or set to "Disabled", no such DemEvent is automatically created. If the dynamic creation of this DemEvent is enabled, the reference to this DemEvent (in parameter rba_Eth_DemEventRef) is also automatically created and shall therefore not be set manually.
          symbolic name reference ETH_E_ACCESS [0..1]: multiplicity set at link in variant link-time / post-build in variant post-build / pre-compile in variant pre-compile, post-build-variant-multiplicity=true, post-build-variant-value=true, set at link in variant link-time / post-build in variant post-build / pre-compile in variant pre-compile, destination=DemEventParameter  # Reference to the DemEventParameter which shall be issued when the error "Controller access failed" has occured.
          symbolic name reference ETH_E_ALIGNMENT [0..1]: multiplicity set at link in variant link-time / post-build in variant post-build / pre-compile in variant pre-compile, post-build-variant-multiplicity=true, post-build-variant-value=true, set at link in variant link-time / post-build in variant post-build / pre-compile in variant pre-compile, destination=DemEventParameter  # Reference to the DemEventParameter which shall be issued when the error "Alignment Error" has occured.
          symbolic name reference ETH_E_CRC [0..1]: multiplicity set at link in variant link-time / post-build in variant post-build / pre-compile in variant pre-compile, post-build-variant-multiplicity=true, post-build-variant-value=true, set at link in variant link-time / post-build in variant post-build / pre-compile in variant pre-compile, destination=DemEventParameter  # Reference to the DemEventParameter which shall be issued when the error "CRC Failure" has occured.
          symbolic name reference ETH_E_LATECOLLISION [0..0]: multiplicity set at link in variant link-time / post-build in variant post-build / pre-compile in variant pre-compile, post-build-variant-multiplicity=true, post-build-variant-value=true, set at link in variant link-time / post-build in variant post-build / pre-compile in variant pre-compile, destination=DemEventParameter  # Reference to the DemEventParameter which shall be issued when the error "Late Collisions" has occured. This parameter is not used in ETNA because collisions cannot be detected in full duplex mode.
          symbolic name reference ETH_E_MULTIPLECOLLISION [0..0]: multiplicity set at link in variant link-time / post-build in variant post-build / pre-compile in variant pre-compile, post-build-variant-multiplicity=true, post-build-variant-value=true, set at link in variant link-time / post-build in variant post-build / pre-compile in variant pre-compile, destination=DemEventParameter  # Reference to the DemEventParameter which shall be issued when the error "Multiple Collisions" has occured. This parameter is not used in ETNA because collisions cannot be detected in full duplex mode.
          symbolic name reference ETH_E_OVERSIZEFRAME [0..1]: multiplicity set at link in variant link-time / post-build in variant post-build / pre-compile in variant pre-compile, post-build-variant-multiplicity=true, post-build-variant-value=true, set at link in variant link-time / post-build in variant post-build / pre-compile in variant pre-compile, destination=DemEventParameter  # Reference to the DemEventParameter which shall be issued when the error "Oversized Frame" has occured.
          symbolic name reference ETH_E_RX_FRAMES_LOST [0..1]: multiplicity set at link in variant link-time / post-build in variant post-build / pre-compile in variant pre-compile, post-build-variant-multiplicity=true, post-build-variant-value=true, set at link in variant link-time / post-build in variant post-build / pre-compile in variant pre-compile, destination=DemEventParameter  # Reference to the DemEventParameter which shall be issued when the error "receive frames lost" has occured.
          symbolic name reference ETH_E_SINGLECOLLISION [0..0]: multiplicity set at link in variant link-time / post-build in variant post-build / pre-compile in variant pre-compile, post-build-variant-multiplicity=true, post-build-variant-value=true, set at link in variant link-time / post-build in variant post-build / pre-compile in variant pre-compile, destination=DemEventParameter  # Reference to the DemEventParameter which shall be issued when the error "Single Collisions" has occured. This parameter is not used in ETNA because collisions cannot be detected in full duplex mode.
          symbolic name reference ETH_E_UNDERSIZEFRAME [0..1]: multiplicity set at link in variant link-time / post-build in variant post-build / pre-compile in variant pre-compile, post-build-variant-multiplicity=true, post-build-variant-value=true, set at link in variant link-time / post-build in variant post-build / pre-compile in variant pre-compile, destination=DemEventParameter  # Reference to the DemEventParameter which shall be issued when the error "Undersized Frame" has occured.
    container EthGeneral  # General configuration of Ethernet Driver module
      boolean EthDevErrorDetect: set at pre-compile  # Switches the Default Error Tracer (Det) detection and notification ON or OFF. | * true: enabled (ON). * false: disabled (OFF).
      boolean EthDSMReInitEnabled [0..1]: origin=RB:3.0.0:2017-05-10, set at pre-compile, default-value=false  # Enables or disables the reporting of DEM events to DSM after the Re-initialisation of DSM has occured
      boolean EthDemEventsEnabled: origin=RB:3.0.0:2017-12-10, set at pre-compile, default-value=false  # This parameter enables or disables the DEM events. Usage: - Set this configuration field to `false` only if the DEM module is not used in the current project. In this case the integrators must provide an implementation for the custom callback because HW timeout must still be reported even if DEM is not configured. For more information, refer to the template files. - Set this configuration field to 'true' only if the DEM module is used in the current project. In this case the custom callback is not necessary because errors are reported via DEM module. Dependency: - IF set to `true`, then the DEM module must be configured in BCT and at least EthCtrlConfig.EthDemEventParameterRefs.ETH_E_ACCESS must be configured for all active EthCtrls. - IF set to `false`, then EthGeneral.EthDSMReInitEnabled must be set to `false` and EthController.DemEventRefs must not be configured for all active EthCtrls."
      boolean EthGetDropCountApi: set at pre-compile  # Enables / Disables Eth_GetDropCount API.
      boolean EthGetEtherStatsApi: set at pre-compile  # Enables / Disables Eth_GetEtherStats API.
      boolean EthGlobalTimeSupport: set at pre-compile  # Enables/Disables the GlobalTime APIs used amongst others by Global Time Synchronization over Ethernet.
      integer EthIndex: 0..255, set at pre-compile  # Specifies the InstanceId of this module instance. If only one instance is present it shall have the Id 0.
      float EthMainFunctionPeriod: 0..Inf, set at pre-compile  # Specifies the period of main function Eth_MainFunction in seconds. Ethernet driver does not require this information but the BSW scheduler.
      integer EthMaxCtrlsSupported: 1..255, set at pre-compile  # Limits the total number of supported controllers.
      boolean EthUpdatePhysAddrFilter: set at pre-compile, default-value=false  # Enables/Disables optional API Eth_UpdatePhysAddrFilter.
      boolean EthVersionInfoApi: set at pre-compile  # Enables / Disables version info API
      integer EthCfgHclkWait: 7..100, set at pre-compile  # Waiting time in microseconds for TSU reset. Minimum 6.4 usec. 20 usec is a good value.
      boolean EthSwSupportTxChecksum: set at pre-compile  # Enables / Disables checksum calculation for IP.
      boolean EthSwSupportRxChecksum: set at pre-compile  # Enables / Disables checksum calculation for IP.
      integer EthMdioClkPeriodWaitCpuCycles: 0..100, set at pre-compile  # MDIO communication to with the transceiver is based on Bit-Bang principle. The CPU needs to wait between individual bits. This configuration defines how long to wait between individual bits during MDIO communication. This number should be configured small to avoid unnecessary active wait for the CPU.
      integer EthHardwareControllerPortNumber: 0..1, set at pre-compile  # ETNA Controller has two ports. This configuration selects which port is in use. Only one port can be active at any given moment.
      container EthCtrlOffloading  # Configuration of hardware offloading features.
        boolean EthCtrlEnableOffloadChecksumICMP: set at pre-compile  # Enables / Disables hardware offloading for ICMP checksums.
        boolean EthCtrlEnableOffloadChecksumIPv4: set at pre-compile  # Enables / Disables hardware offloading for IPv4 checksums.
        boolean EthCtrlEnableOffloadChecksumTCP: set at pre-compile  # Enables / Disables hardware offloading for TCP checksums.
        boolean EthCtrlEnableOffloadChecksumUDP: set at pre-compile  # Enables / Disables hardware offloading for UDP checksums.
