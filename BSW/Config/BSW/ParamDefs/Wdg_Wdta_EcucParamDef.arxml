AUTOSAR XML (schema 4-2-2)
package /AUTOSAR_Wdg/EcucModuleDefs
  module definition Wdg [0..*]: category=VENDOR_SPECIFIC_MODULE_DEFINITION, refined-module-def=Wdg, variants pre-compile/post-build  # MCAL Watchdog driver | Configuration of the Wdg module for controlling the watchdog driver(s) on the CPU.
    container WdgGeneral  # General parameters of Wdg | All general parameters of the watchdog driver are collected here.
      boolean WdgDevErrorDetect: set at pre-compile  # Development error detection | Compile switch to enable / disable development error detection for this module. True: Development error detection enabled False: Development error detection disabled True: Development error detection enabled False: Development error detection disabled
      boolean WdgDisableAllowed: set at pre-compile  # Disabling Watchdog driver during runtime | Compile switch to allow / forbid disabling the watchdog driver during runtime. True: Disabling the watchdog driver at runtime is allowed. False: Disabling the watchdog driver at runtime is not allowed.
      integer WdgIndex: 0..255, set at pre-compile  # Index of watchdog driver | Represents the watchdog driver's ID so that it can be referenced by the watchdog interface.
      float WdgMaxTimeout: 0..65535, set at pre-compile  # Max timeout limit for the wdg timer | The maximum timeout (sec) to which the watchdog trigger condition can be initialized.
      boolean WdgPrecompileSupport: origin=RB:1.0.0:2013-07-10, set at pre-compile  # Pre-compile time configuration variant selection | Compile switch to choose between pre-compile time or post-build configuration. True: Pre-compile time variant selected False: Post-build time (selectable) variant selected
      enumeration WdgReset: set at pre-compile  # Watchdog Reset selection | This Paramater is used to select the Reset option when the Watchdog Counter clock reaches overflow time and causes an internal error.
        WDG_SYSTEM_RESET2  # System Reset2
        WDG_APPLICATION_RESET1  # Application Reset1
      boolean WdgVersionInfoApi: set at pre-compile  # Version information API | Compile switch to enable / disable the version information API True: API enabled False: API disabled
    container WdgPublishedInformation  # Published Information | Container holding all Wdg specific published information parameters
      enumeration WdgTriggerMode: set at pre-compile  # Trigger Mode | Watchdog trigger mode
        WDG_BOTH  # Both modes supported
        WDG_TOGGLE  # Wdg in toggle mode
        WDG_WINDOW  # Wdg in windowed mode
    container WdgSettingsConfig  # Hardware Configuration | Configuration items for the different watchdog settings, including those for external watchdog hardware. Note: All postbuild parameters are handled via this container.
      enumeration WdgDefaultMode [0..0]: set at pre-compile in variant pre-compile / post-build in variant post-build  # Watchdog default init mode | Default mode for watchdog driver initialization. Info: In RH850 P1x variant, default mode(Fast/Slow) is based on the OPBT0:OPWD0MD bit
        WDG_FAST_MODE  # Wdg in fast mode
        WDG_OFF_MODE  # Wdg switched OFF
        WDG_SLOW_MODE  # Wdg in slow mode
      enumeration WdgOverflowtime: set at pre-compile in variant pre-compile / post-build in variant post-build  # Watchdog Overflow interval time | Watchdog Overflow interval time for count clock. This 2 power exponent selection value(2^n: n - 9,10,11,12,13,14,15,16) and WDTACLKI (Watchdog Clock - OPBT0 set) are used to set the counter clock overflow value. eg: Counter clock overflow time = 2^n/WDTACLKI Info: If the Watchdog counter reaches the Overflow time, It generates an Internal error and user configured reset function (System reset 2/Application reset 1)
        WDG_OVF_2_{9..16}  # 2^{9..16}
      container WdgSettingsFast [0..0]  # Hardware settings for Fast mode | Hardware dependent settings for the watchdog driver's "fast'"mode.
        enumeration WdgTimeout [0..0]: set at pre-compile in variant pre-compile / post-build in variant post-build  # Timeout in fast mode (ms) | The timeout (milli seconds) value to which the watchdog timer overflow condition occur. Info: For RH850 P1x variant, WDTACLKI (Watchdog Clock rate) in Fast mode is 8MHz
          WDG_FAST_0_06MS  # 0.06
          WDG_FAST_0_12MS  # 0.12
          WDG_FAST_0_25MS  # 0.25
          WDG_FAST_0_51MS  # 0.51
          WDG_FAST_2_04MS  # 2.04
          WDG_FAST_4_09MS  # 4.09
          WDG_FAST_8_19MS  # 8.19
      container WdgSettingsSlow [0..0]  # Hardware settings for Slow mode | Hardware dependent settings for the watchdog driver's "slow" mode.
        enumeration WdgTimeout [0..0]: set at pre-compile in variant pre-compile / post-build in variant post-build  # Timeout in slow mode (ms) | The timeout (milli seconds) value to which the watchdog timer overflow condition occur. Info: For RH850 P1x variant, WDTACLKI (Watchdog Clock rate) in Slow mode is 0.25MHz
          WDG_SLOW_2_0MS  # 2.0
          WDG_SLOW_4_0MS  # 4.0
          WDG_SLOW_8_1MS  # 8.1
          WDG_SLOW_16_3MS  # 16.3
          WDG_SLOW_32_7MS  # 32.7
          WDG_SLOW_65_5MS  # 65.5
          WDG_SLOW_131_0MS  # 131.0
          WDG_SLOW_262_1MS  # 262.1
