AUTOSAR XML (schema 4-2-2)
package /AUTOSAR_SecOC/EcucModuleDefs
  module definition SecOC [0..1]: refined-module-def=SecOC, variants pre-compile  # Configuration of the SecOC (Secure Onboard Communication) module.
    container SecOCGeneral: multiplicity set at   # SecOC General | Container for common configuration options.
      boolean SecOCDevErrorDetect: multiplicity set at , set at pre-compile, default-value=false  # Default error tracer (Det) | Swithces the default error tracer (Det) detection and notification ON or OFF.
      enumeration SecOCMaxAlignScalarType: {uint8, uint16, uint32}, multiplicity set at , set at pre-compile, default-value=uint32  # SecOC maximum alignment type | The scalar type which has the maximum alignment restrictions on the given platform. This type can be e.g. uint8, uint16 or uint32.
      boolean SecOCVersionInfoApi: multiplicity set at , set at pre-compile, default-value=true  # SecOC version Info | Switches the availability of the SecOC_GetVersionInfo ON or OFF.
      boolean SecOCIgnoreVerificationResult: multiplicity set at , set at pre-compile, default-value=false  # Ignore verification result | Switches the handling of verification result ON or OFF. If the switch is set to true the verification is performed but the verification result is ignored. So if the verification fails the PDU is forwarded to the PduR nevertheless and an error event is set in the Logging Module. The switch is implemented for the test phase and will be ignored in series software.
      float SecOCMainFunctionPeriodRx [0..1]: 0..1, multiplicity set at pre-compile, set at pre-compile, default-value=0.01  # Period of SecOC_MainFunctionRx | Specifies the period of the main function SecOC_MainFunctionRx in seconds
      float SecOCMainFunctionPeriodTx [0..1]: 0..1, multiplicity set at pre-compile, set at pre-compile, default-value=0.01  # Period of SecOC_MainFunctionTx | Specifies the period of the main function SecOC_MainFunctionTx in seconds
      boolean SecOCRbUpdateScheduler: multiplicity set at , origin=RB, set at pre-compile, default-value=false  # Update BSW-Scheduler | Switches the automatic update of the BSW-Scheduler via the Rte on or off. If the switch is set to true the SecOC_MainFunctions are defined in Rte-Header and automatically inserted in BSW-Scheduler in the configured period. If the switch is set to false the SecOC_MainFunctions are defined in the SecOC.h and the scheduler shall be updated by the integrator.
      enumeration SecOCRbCryptMode: {asynchronous, synchronous}, multiplicity set at , origin=RB, set at pre-compile, default-value=asynchronous  # SecOC cryptographic mode | SecOC can call the cryptographic services synchronous (e.g. in the PduR interface functions) or asynchronous (in a cyclic main function). AR defines the asynchronous mode.
      enumeration SecOCQueryFreshnessValue: {CFUNC, RTE}, multiplicity set at , set at post-build, default-value=CFUNC  # SecOC query freshness value | This parameter specifies if the freshness value shall be determined through a C-function or a software component.
    container SecOCSameBufferPduCollection [0..*]: multiplicity set at post-build  # SecOC Buffer configuration that may be used by a collection of Pdus.
      integer SecOCBufferLength: 0..4294967295, multiplicity set at , set at pre-compile, default-value=0  # Buffer length | This parameter defines the length of the buffer for Pdu collection in bytes.
    container SecOCRxPduProcessing [0..*]: multiplicity set at post-build  # SecOC configuration of received PDUs to be verified
      integer SecOCAuthInfoTxLength: 1..65535, multiplicity set at , set at pre-compile, default-value=4  # SecOC authenticator length | This parameter defines the length in bits of the authentication code to be included in the payload of the Secured I-PDU.
      integer SecOCAuthenticationBuildAttempts: 0..65535, multiplicity set at , set at pre-compile, default-value=0  # SecOC number of authentication build attempts | This parameter specifies the number of authentication build attempts.
      integer SecOCAuthenticationVerifyAttempts: 0..65535, multiplicity set at , set at pre-compile, default-value=0  # SecOC number of verification attempts | This parameter specifies the number of authentication verify attempts that are to be carried out when the verification of the authentication information failed for a given Secured I_PDU. If zero is set then only one authentication verification attempt is done.
      integer SecOCDataId: 0..65535, multiplicity set at , set at pre-compile  # SecOC data identifier | This parameter defines a unique numerical identifier for the Secured I-PDU.
      integer SecOCFreshnessValueLength: 0..64, multiplicity set at , set at pre-compile, default-value=0  # SecOC freshness value length | This parameter defines the length in bits of the Freshness Value.
      integer SecOCFreshnessValueTxLength: 0..64, multiplicity set at , set at pre-compile, default-value=0  # SecOC freshness value payload length | This parameter defines the length in bits of the Freshness Value to be included in the payload of the Secured I-PDU. This length is specific to the least significant bits of the complete Freshness Counter. If the parameter is 0 no Fresh-ness Value is included in the Secured I-PDU.
      integer SecOCFreshnessValueId: 0..65535, multiplicity set at , set at pre-compile  # SecOC freshness value id | This parameter specifies the local freshness identifier used to generate the freshness value used to generate or verify a MAC.
      integer SecOCKeyId [0..1]: 0..65535, multiplicity set at pre-compile, set at pre-compile  # SecOC key identifier | This parameter specifies the local Key identifier of the stored Key used to generate or verify a MAC. The association between a key and an identifier shall be done with the function SecOC_AssociateKey.
      boolean SecOCUseFreshnessTimestamp: multiplicity set at , set at pre-compile, default-value=false  # SecOC use freshness timestamp | This parameter specifies whether the Freshness Value is generated through individual Freshness Counters or by a Timestamps. The value is set to TRUE when Timestamps are used.
      enumeration SecOCRbRxPduCryptIF [0..1]: {Csm_rba_CryptoBCL, Csm_rba_CryptoHSM, None}, multiplicity set at pre-compile, origin=RB, set at pre-compile  # SecOC cryptographic interface | The cryptographic interface of the Pdu. If it is not set here the default cryptographic interface set in container SecOCRbCryptInterface is used.
      reference SecOCSameBufferPduRef [0..1]: multiplicity set at pre-compile, set at pre-compile, destination=SecOCSameBufferPduCollection  # Reference to Buffer collection | This reference is used to collect Pdus that are using the same SecOC buffer.
      reference SecOCRxAuthServiceConfigRef [0..1]: multiplicity set at pre-compile, set at pre-compile, destination=CsmJob  # Reference to Csm Job | This reference is used to define which crypto service function is called for authentication.
      container SecOCRxAuthenticPduLayer: multiplicity set at   # SecOC configuration of authentic PDU
        reference SecOCRxAuthenticLayerPduRef [0..1]: multiplicity set at pre-compile, set at pre-compile, destination=Pdu  # Reference to authentic PDU | Reference to the global Pdu.
      container SecOCRxSecuredPduLayer: multiplicity set at   # SecOC configuration of secured PDU
        integer SecOCRxSecuredLayerPduId [0..1]: 0..65535, multiplicity set at pre-compile, set at pre-compile, symbolic-name-value=true  # SecOC identifier of secured PDU | PDU identifier assigned by SecOC module. Used by PduR for SecOC_PduRRxIndication.
        reference SecOCRxSecuredLayerPduRef [0..1]: multiplicity set at pre-compile, set at pre-compile, destination=Pdu  # Reference to the secured PDU | Reference to the global Pdu.
    container SecOCTxPduProcessing [0..*]: multiplicity set at post-build  # SecOC configuration of transmitted PDUs to be secured
      integer SecOCAuthInfoTxLength: 1..65535, multiplicity set at , set at pre-compile, default-value=4  # SecOC authentication length | This parameter defines the length in bits of the authentication code to be included in the payload of the Secured I-PDU.
      integer SecOCAuthenticationBuildAttempts: 0..65535, multiplicity set at , set at pre-compile, default-value=0  # SecOC number of authentication build attempts | This parameter specifies the number of authentication build attempts.
      integer SecOCDataId: 0..65535, multiplicity set at , set at pre-compile  # SecOC data identifier | This parameter defines a unique numerical identifier for the Secured I-PDU.
      integer SecOCFreshnessValueLength: 0..64, multiplicity set at , set at pre-compile, default-value=0  # SecOC freshness value length | This parameter defines the length in bits of the Freshness Value.
      integer SecOCFreshnessValueTxLength: 0..64, multiplicity set at , set at pre-compile, default-value=0  # SecOC freshness value payload length | This parameter defines the length in bits of the Freshness Value to be included in the payload of the Secured I-PDU. This length is specific to the least significant bits of the complete Freshness Counter. If the parameter is 0 no Fresh-ness Value is included in the Secured I-PDU.
      integer SecOCFreshnessValueId: 0..65535, multiplicity set at , set at pre-compile  # SecOC freshness value id | This parameter specifies the local freshness identifier used to generate the freshness value used to generate or verify a MAC.
      integer SecOCKeyId [0..1]: 0..65535, multiplicity set at pre-compile, set at pre-compile  # SecOC key identifier | This parameter specifies the local Key identifier of the stored Key used to generate or verify a MAC. The association between a key and an identifier shall be done with the function SecOC_AssociateKey.
      boolean SecOCUseFreshnessTimestamp: multiplicity set at , set at pre-compile, default-value=false  # SecOC use freshness timestamp | This parameter specifies whether the Freshness Value is generated through individual Freshness Counters or by a Timestamps. The value is set to TRUE when Timestamps are used.
      boolean SecOCProvideTxTruncatedFreshnessValue: multiplicity set at , set at pre-compile, default-value=false  # SecOC provide sender truncated freshness value | This parameter specifies if the sender query freshness function provides the truncated freshness info instead of generating this by SecOC. In this case, SecOC shall add this data to the Authentic PDU instead of truncating the freshness value.
      enumeration SecOCRbTxPduCryptIFRef [0..1]: {Csm_rba_CryptoBCL, Csm_rba_CryptoHSM, None}, multiplicity set at pre-compile, origin=RB, set at pre-compile  # SecOC cryptographic interface | The cryptographic interface of the Pdu. If it is not set here the default cryptographic interface set in container SecOCRbCryptInterface is used.
      boolean SecOCRbClearBufferAfterTransmit [0..1]: multiplicity set at pre-compile, set at pre-compile, default-value=false  # SecOCRB Clear buffers after transmit | If this parameter is set to true, SecOC doesn't wait for TxConfirmation to clear the buffers and instead clears the buffers and resets the PDU state to idle directly after passing the secured PDU to the PduR.
      reference SecOCSameBufferPduRef [0..1]: multiplicity set at pre-compile, set at pre-compile, destination=SecOCSameBufferPduCollection  # Reference to Buffer collection | This reference is used to collect Pdus that are using the same SecOC buffer.
      reference SecOCTxAuthServiceConfigRef [0..1]: multiplicity set at pre-compile, set at pre-compile, destination=CsmJob  # Reference to Csm Job | This reference is used to define which crypto service function is called for authentication.
      container SecOCTxAuthenticPduLayer: multiplicity set at   # SecOC configuration of authentic PDU
        integer SecOCTxAuthenticLayerPduId [0..1]: 0..65535, multiplicity set at pre-compile, set at pre-compile, symbolic-name-value=true  # SecOC identifier of authentic PDU | PDU identifier assigned by SecOC module. Used by PduR for SecOC_PduRTransmit.
        reference SecOCTxAuthenticLayerPduRef [0..1]: multiplicity set at pre-compile, set at pre-compile, destination=Pdu  # Reference to authentic PDU | Reference to the global Pdu.
      container SecOCTxSecuredPduLayer: multiplicity set at   # SecOC configuration of secured PDU
        integer SecOCTxSecuredLayerPduId [0..1]: 0..65535, multiplicity set at pre-compile, set at pre-compile, symbolic-name-value=true  # SecOC identifier of secured PDU | PDU identifier assigned by SecOC module. Used by PduR for confirmation (SecOC_PduRTxConfirmation) and for TriggerTransmit.
        reference SecOCTxSecuredLayerPduRef [0..1]: multiplicity set at pre-compile, set at pre-compile, destination=Pdu  # Reference to secured PDU | Reference to the global Pdu.
    container SecOCRbSubUnits [0..1]: multiplicity set at post-build  # Configuration of SecOC sub units
      container SecOCRbPduRInterface [0..1]: multiplicity set at post-build  # Configuration of SecOC PduR interface
        boolean SecOCRbAuthDirect: multiplicity set at , origin=RB, set at pre-compile, default-value=true  # Direct authentication | Switches the authentication during direct transmission ON or OFF.
        boolean SecOCRbAuthTrigger: multiplicity set at , origin=RB, set at pre-compile, default-value=false  # Triggered authentication | Switches the authentication during triggered transmission ON or OFF (currently not supported)
        boolean SecOCRbAuthProtocol: multiplicity set at , origin=RB, set at pre-compile, default-value=false  # Authentication protocol | Switches the authentication during transport protocol ON or OFF (currently not supported)
        boolean SecOCRbVerifyDirect: multiplicity set at , origin=RB, set at pre-compile, default-value=true  # Direct verification | Switches the verification during direct reception ON or OFF.
        boolean SecOCRbVerifyProtocol: multiplicity set at , origin=RB, set at pre-compile, default-value=false  # Verification protocol | Switches the verification during transport protocol ON or OFF (currently not supported)
      container SecOCRbFreshInterface [0..1]: multiplicity set at post-build  # Configuration of SecOC freshness interface
        enumeration SecOCRbTimeMgm: {None, External}, multiplicity set at , origin=RB, set at pre-compile, default-value=None  # SecOC timer management | Selects the timer management
        enumeration SecOCRbCountMgm: {None}, multiplicity set at , origin=RB, set at pre-compile, default-value=None  # SecOC counter management | Selects the counter management (currently not supported)
        container SecOCRbFreshErrorHandling [0..1]: multiplicity set at post-build  # Container for Freshness Value Error Handling
          boolean SecOCRbFreshErrorHandlingEnabled: multiplicity set at , origin=RB, set at pre-compile, default-value=false  # Error Handling for Freshness Value in RB Layer | Enable Error Handling for Freshness Value in RB layer
          boolean SecOCRbFreshErrorLengthByteWise: multiplicity set at , origin=RB, set at pre-compile, default-value=false  # Error Handling for Freshness Value Length | Enable Error Handling to check if Freshness Value length is a multiple of 8 bits
          boolean SecOCRbFreshErrorTruncLength: multiplicity set at , origin=RB, set at pre-compile, default-value=false  # Error Handling for Truncated Freshness Value Length | Enable Error Handling to check if Truncated Freshness Value Length is exactly 8 bits
      container SecOCRbCryptInterface [0..1]: multiplicity set at post-build  # SecOC cryptographic interface container
        enumeration SecOCCryptDefaultInterface [0..1]: {Csm_rba_CryptoBCL, Csm_rba_CryptoHSM, None}, multiplicity set at pre-compile, origin=RB, set at pre-compile, default-value=Csm_rba_CryptoBCL  # SecOC default cryptographic interface | Selects the default cryptographic interface. This cryptographic interface is set for all Rx and Tx pdus. It can be overwriten for each pdu in the pdu specific configuration with exception of "Csm" and "None". These interfaces are always set for all pdu even if pdu specific configuration is already set or not.
