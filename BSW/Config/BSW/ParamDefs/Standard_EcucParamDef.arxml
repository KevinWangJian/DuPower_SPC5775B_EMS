AUTOSAR XML (schema 4-2-2)
package /AUTOSAR_Standard/EcucModuleDefs
  module definition Standard: category=VENDOR_SPECIFIC_MODULE_DEFINITION, refined-module-def=Standard, variants pre-compile  # CUBAS Central Elements: Standard | CUBAS Central Elements:Standard
    container StandardRbSettings  # Configuration settings for CUCEL Central Elements module: Standard
      enumeration StandardRbArRelease: origin=RB:42.1.0.0:2016-10-14, set at pre-compile  # Configuration parameter for the AUTOSAR version/revision | Select the AUTOSAR version/revision the project is based on
        AR42_Rev2  # AUTOSAR Version 4.2 Revison 2
