AUTOSAR XML (schema 4-2-2)
package /AUTOSAR_Gpt/EcucModuleDefs
  module definition Gpt: category=VENDOR_SPECIFIC_MODULE_DEFINITION, post-build-variant-support=true, refined-module-def=Gpt, variants pre-compile  # MCAL GPT Driver | Configuration of the MCAL GPT (General Purpose Timer) module.
    container GptChannelConfigSet  # Channel Configuration data set | Defines one data set of post-build configuration. Which of these data sets is actually active is controlled by EcuM. Data sets can only be switched at initialization time.
      container GptChannelConfiguration [1..1000]: multiplicity set at pre-compile, post-build-variant-multiplicity=true  # Channel container | Configuration of an individual GPT channel. Note: - Configure the subcontainer "Stm channel parameters" or "Gtm channel parameters" when the lower layer selection is not a SwTimer(software timer). In other words, configure the sub container, only when the lower layer used is either Stm or Gtm(if supported).
        integer GptChannelId: 0..4294967295, set at pre-compile, symbolic-name-value=true, with-auto=true  # Gpt channel id | Channel Id of the GPT channel. This value will be assigned to the symbolic name derived of the GptChannelConfiguration container short name. Please don't assign any value to this parameter. It would be calculated automatically.
        enumeration GptChannelMode: post-build-variant-value=true, set at pre-compile  # Gpt channel mode | Specifies the behaviour of the timer channel after the target time is reached.
          GPT_CH_MODE_CONTINOUS  # Timer restarts after reaching the target time
          GPT_CH_MODE_ONESHOT  # Timer stops after reaching the target time
        float GptChannelTickFrequency [0..0]: post-build-variant-value=true, set at pre-compile  # Gpt channel tick frequency | Specifies the tick frequency of the timer channel in Hz.
        integer GptChannelTickValueMax [0..0]: 0..1.84467440737095E+19, post-build-variant-value=true, set at pre-compile  # Gpt channel tick value max | Maximum value in ticks, the timer channel is able to count. With the next tick, the timer rolls over to zero.
        boolean GptEnableWakeup [0..0]: post-build-variant-value=true, set at pre-compile  # Gpt enable wakeup | Enables wakeup capability of MCU for a channel. Note:The wake-up feature is currently not supported and hence this switch shall be disabled.
        function name GptNotification [0..1]: multiplicity set at pre-compile, post-build-variant-multiplicity=true, post-build-variant-value=true, set at pre-compile  # Gpt notification | Function pointer to callback function (for non-wakeup notification)
        enumeration GptRbTimerPeripheral: origin=RB:v0.1.0:2015-09-12, set at pre-compile  # Hardware peripheral | Selection of Hardware peripheral unit.The available peripheral is
          Gpt_Prv_StmTimer_e  # STM TIMER
          Gpt_Prv_GtmTimer_e  # GTM TIMER
        reference GptChannelClkSrcRef [0..0]: post-build-variant-value=true, set at pre-compile, destination=nil  # Reference to Gpt clock reference | Reference to the GptClockReferencePoint from which the channel clock is derived
        container GptRbGtmChannel [0..1]: multiplicity set at pre-compile, post-build-variant-multiplicity=true  # Gtm channel parameters | This container contains the configuration (parameters) in case the hardware timer channel(s) are located Gtm.
          enumeration GptRbGtmCmuClkDivSel: origin=RB v0.1.0 20161-12-7, post-build-variant-value=true, set at pre-compile  # CMU Clock Divider selection | Selection of Configurable clock divider for the ATOM channel(configured for Gpt)
            CMU_CLK_{0..7}  # Clock Source Divider {0..7}
          integer GptRbGtmHwChannel: origin=RB v0.1.0 20161-12-7, post-build-variant-value=true, set at pre-compile  # Atom Hardware Channel | The used Hardware Chnnale for ATOM in Gpt
          integer GptRbGtmHwChannelIndex: origin=RB v0.1.0 20161-12-7, post-build-variant-value=true, set at pre-compile, with-auto=true  # Channel Index | The index that specifies the location\placement of this channel configuration in an array containing the configurations of all the channels. Note : Do not fill this parameter. This parameter will be updated in the BCT action rba_Gtm_Prepare
          integer GptRbGtmInstance: origin=RB v0.1.0 20161-12-7, post-build-variant-value=true, set at pre-compile  # Atom Hardware Instance | The Hardware instance where the channel is located.
        container GptRbStmChannel [0..1]: multiplicity set at pre-compile, post-build-variant-multiplicity=true  # Stm channel parameters | This container contains the configuration (parameters) in case the hardware timer channel(s) are located on a PITIMER peripheral instance (Gpt_Prv_StmTimer_e was chosen).
          integer GptRbStmHwChannel: 0..3, origin=RB:v0.1.0:2015-04-15, post-build-variant-value=true, set at pre-compile  # Stm perhipheral channel | Specify which timer channel is used.
          integer GptRbStmHwChannelIndex: 0..4294967295, origin=RB:v0.1.0:2016-03-23, post-build-variant-value=true, set at pre-compile, with-auto=true  # Stm Hw channel Index | Assignment of Index (or) ID to locate the Stm hardware instance and channel from Stm configuration set.
          integer GptRbStmHwCompareRegister: 0..3, origin=RB:v0.1.0:2016-03-24, post-build-variant-value=true, set at pre-compile  # compare register selection | Selection of compare register for the Stm Hardware timer channel.
          integer GptRbStmInstance: 0.., origin=RB:v0.1.0:2015-04-15, post-build-variant-value=true, set at pre-compile  # Stm perhipheral instance | Specify the configured Hardware instance.
          string GptRbStmIntSelection: origin=RB:v0.1.0:2016-03-29, post-build-variant-value=true, set at pre-compile  # Interrupt selection for chosen timer channel | Each channel can be mapped to an interrupt. Select the appropriate interrupt for the configured channel by referring either the Data sheet or the BSW doc of "Stm" module.
        container GptWakeupConfiguration [0..1]: multiplicity set at pre-compile  # Gpt wakeup configuration | Function pointer to callback function (for non-wakeup notification).
          string GptWakeupSourceRef: post-build-variant-value=true, set at pre-compile  # Gpt wakeup ref | In case the wakeup-capability is true this value is transmitted to the Ecu State Manager. Implementation Type: reference to EcuM_WakeupSourceType.
    container GptConfigurationOfOptApiServices  # Gpt Configuration of optional API services | This container contains all configuration switches for configuring optional API services of the GPT driver
      boolean GptDeinitApi: set at pre-compile  # Gpt deinitialization API | Adds / removes the service Gpt_DeInit() from the code.
      boolean GptEnableDisableNotificationApi: set at pre-compile  # Gpt enable notification API | Adds / removes the services Gpt_EnableNotification() and Gpt_DisableNotification from the code.
      boolean GptTimeElapsedApi: set at pre-compile  # Gpt time elapsed API | Adds / removes the service Gpt_GetTimeElapsed() from the code.
      boolean GptTimeRemainingApi: set at pre-compile  # Gpt time remaining API | Adds / removes the service Gpt_GetTimeRemaining() from the code.
      boolean GptVersionInfoApi: set at pre-compile  # Gpt versionInfo API | Adds / removes the service Gpt_GetVersionInfo() from the code.
      boolean GptWakeupFunctionalityApi [0..0]: set at pre-compile  # Gpt wakeup functionality API | Adds / removes the services Gpt_SetMode(), Gpt_EnableWakeup() Gpt_DisableWakeup() and Gpt_CheckWakeup() from the code.
    container GptDriverConfiguration  # Gpt driver configuration | This container contains the module-wide configuration (parameters) of the GPT Driver
      boolean GptDevErrorDetect: set at pre-compile  # Gpt error detection | Enables / disables development error detection.
      enumeration GptRbBuildEnvironment: origin=RB:v0.1.0:2015-12-11, set at pre-compile  # Compilation and Build Environment | Selection of Post build time or Pre compile time environment.
        GPT_RB_POSTBUILD  # Change configuration sets during run time
        GPT_RB_PRECOMPILE  # Project runs with only one configuration set
      boolean GptRbCheckAutosarVersion: origin=RB:v0.1.0:2015-04-15, set at pre-compile  # Gpt Enable AUTOSAR version checking | Enables / disables AUTOSAR file version checking.
      string GptRbCompilerSpecificKeyword [0..1]: multiplicity set at pre-compile, origin=RB:v0.1.0:2015-04-15, set at pre-compile  # Compiler specific keyword | Compiler specific keyword for interrupt handler functions, if required, e.g :
      enumeration GptRbTimerSelection: origin=RB:v0.1.0:2015-12-11, set at pre-compile  # Lower layer timer selection | Select the type of lower layer timer to be used for GPT.
        GPT_RB_LOWERLAYER_SWTIMER  # Software Timer used as Lower layer
        GPT_RB_LOWERLAYER_HWTIMER  # Hardware Timer used as Lower layer
      enumeration GptRbTimerValueType: origin=RB:v0.1.0:2016-04-05, set at pre-compile  # Gpt Timer Value type | Type to represent the maximum value, the Gpt counter can reach. The selection shall be - 16 Bit counter type - Maximum value of 65535 32 Bit counter type - Maximum value of 4294967295
        GPT_RB_VALUETYPE_32BITS  # Gpt runs with 32Bit timer
        GPT_RB_VALUETYPE_64BITS  # Gpt runs with 64Bit timer
      boolean GptReportWakeupSource [0..0]: set at pre-compile  # GPT report wakeup source | Enables / disables wakeup source reporting
      container GptClockReferencePoint [0..0]  # Gpt clock reference point | This container contains a parameter, which represents a reference to a container of the type McuClockReference Point (defined in module MCU).
        reference GptClockReference [0..0]: set at pre-compile, destination=nil  # GPT clock reference | Reference to a container of the type McuClockReference Point, to select an input clock. The configuration editor for the GPT module can support the integrator by only allowing a selection of those clock reference points that can be connected physically to the GPT hardware peripheral. The desired frequency (desired by GPT) has to be the same as the selected and provided frequency of the MCU configuration. This has to be checked automatically.
