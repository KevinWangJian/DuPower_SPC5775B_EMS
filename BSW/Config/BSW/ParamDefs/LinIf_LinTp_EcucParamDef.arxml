AUTOSAR XML (schema 4-2-2)
package /AUTOSAR_LinTp/EcucModuleDefs
  module definition LinTp [0..1]: post-build-variant-support=true, refined-module-def=LinTp, variants link-time/post-build/pre-compile  # Lin Interface Transport Layer | Configuration of the LIN Transport Protocol(with vendor specific enhancements of RB).
    container LinTpGeneral  # Container that holds all LIN transport protocol general parameters.
      boolean LinTpChangeParameterApi [0..0]: set at pre-compile  # This parameter, if set to true, enables the LinTp_ChangeParameterRequest Api for this Module.This parameter is not supported
      boolean LinTpVersionInfoApi: set at pre-compile  # Switches the LinTp_GetVersionInfo function ON or OFF.
    container LinTpGlobalConfig  # This container contains the global configuration parameters of the LinTp.
      integer LinTpMaxRxNSduCnt [0..0]: 0..65535, set at pre-compile  # Maximum number of NSdus. This parameter is needed only in case of post-build loadable implementation using static memory allocation.
      integer LinTpMaxTxNSduCnt [0..0]: 0..65535, set at pre-compile  # Maximum number of NSdus. This parameter is needed only in case of post-build loadable implementation using static memory allocation.
      container LinTpChannelConfig [0..*]: multiplicity set at link in variant link-time / post-build in variant post-build / pre-compile in variant pre-compile  # This container contains the channel specific configuration parameters of LinTp.
        boolean LinTpDropNotRequestedNad [0..0]: post-build-variant-value=true, set at link in variant link-time / post-build in variant post-build / pre-compile in variant pre-compile, default-value=true  # Configures if TP Frames of not requested LIN-Slaves are dropped or not.This parameter is not supported | TRUE: Drop TP Frames of not requested LIN-Slaves FALSE: Keep TP Frames of not requested LIN-Slaves
        boolean LinTpScheduleChangeDiag: post-build-variant-value=true, set at link in variant link-time / post-build in variant post-build / pre-compile in variant pre-compile, default-value=false  # Enables or disables the call of BswM_LinTp_RequestMode() to diagnostic request/response schedule. | false: BswM is not called true: BswM is called
        float LinTpSRCFTimer: origin=RB:2015-04-10, post-build-variant-value=true, set at pre-compile, default-value=0.0  # Monitors the Slave Response Consecutive Frame timing in LinTp. Unit is Seconds. The SRCF timer denotes the time between sending the First Frame and the LIN slave being able to send the next consecutive frame.
        string LinTpTimeoutCallbackName [0..1]: origin=RB:2016-07-26, set at pre-compile  # Function defined by application layer and used by LinTp in order to notify LinTp timeout notification. This parameter name will be used in generating function external prototype.
        integer LinTpInterleavedClientTimer [0..1]: origin=RB:2016-07-26, set at pre-compile, default-value=0  # Monitoring timer for the normal interleaved communication on bus with-in diagnostics mode and LinTp start this timer when Last MRF frame is placed successfully on bus.
        integer LinTpMaxNumberOfRespPendingFrames: 0..65535, post-build-variant-value=true, set at link in variant link-time / post-build in variant post-build / pre-compile in variant pre-compile  # Specifies the Maximum number of response pending frames that can be allowed before the ongoing reception is aborted.
        float LinTpP2Max: 0.05..2, post-build-variant-value=true, set at link in variant link-time / post-build in variant post-build / pre-compile in variant pre-compile  # Monitors the P2* timing (Enhanced P2 timing) parameter in LinTp. Unit is Seconds. The P2* timer denotes the time between sending a NRC 0x78 and the LINslave being able to provide data for a response. | Note that the minimum value of LinTpP2Max shall be more than or equal to the value of LinTpP2Timing.
        float LinTpP2Timing: 0.05..0.5, post-build-variant-value=true, set at link in variant link-time / post-build in variant post-build / pre-compile in variant pre-compile  # Monitors the P2 timing parameter in LinTp. Unit is Seconds. The P2 timer denotes the time between reception of the last frame of a diagnostic request on the LIN bus and the slave node being able to provide data for a response. The maximum value defines the time after which a slave node must received a slave response header before it discards its response.
        symbolic name reference LinTpChannelRef: set at link in variant link-time / post-build in variant post-build / pre-compile in variant pre-compile, destination=ComMChannel  # Index of the channel this LinTp channel belongs to.
      container LinTpRxNSdu [0..*]: multiplicity set at link in variant link-time / post-build in variant post-build / pre-compile in variant pre-compile, post-build-variant-multiplicity=true  # This container exists once for each received N-SDU on any channel the node is connected to.
        float LinTpNcr [0..0]: 0..1, multiplicity set at link in variant link-time / post-build in variant post-build / pre-compile in variant pre-compile, post-build-variant-multiplicity=true, post-build-variant-value=true, set at link in variant link-time / post-build in variant post-build / pre-compile in variant pre-compile  # Value in seconds of the N_Cr timeout. N_Cr is the time until reception of the next Consecutive Frame N_PDU. This parameter is not supported
        integer LinTpDl: 1..4095, set at pre-compile  # Data Length Code of this RxNsdu. In case of variable length message, this value indicates the minimum data length. Range of minimum length is 1 to 4095.Note that this is not relevant for Tx. The reason for this is to have identical structures for Tx and Rx.
        integer LinTpRxNSduId [0..0]: 0..65535, set at pre-compile, symbolic-name-value=true  # The identifier of the Transport Protocol message. This ID will be used by upper layers to call LinTp_ChangeParameter and LinTp_CancelReceive.
        integer LinTpRxNSduNad: 0..255, post-build-variant-value=true, set at link in variant link-time / post-build in variant post-build / pre-compile in variant pre-compile  # A N-SDU transported on LIN is identified using the NAD for the specific slave.
        reference LinTpRxNSduPduRef: scope=ECU, post-build-variant-value=true, set at link in variant link-time / post-build in variant post-build / pre-compile in variant pre-compile, destination=Pdu  # Reference to the global PDU
        symbolic name reference LinTpRxNSduChannelRef: set at link in variant link-time+post-build / pre-compile in variant pre-compile, destination=ComMChannel  # Index of the channel this N-SDU belongs to.
      container LinTpTxNSdu [0..*]: multiplicity set at link in variant link-time / post-build in variant post-build / pre-compile in variant pre-compile, post-build-variant-multiplicity=true  # This container exists once for each transmitted N-SDU on any channel the node is connected to.
        integer LinTpMaxBufReq: 0..255, post-build-variant-value=true, set at link in variant link-time / post-build in variant post-build / pre-compile in variant pre-compile  # This parameter defines the maximum number of times the LinTp should request upper layer for the Tx Buffer. It is also used to limit the number of retries for PduR_LinTpCopyTxData when no timer is active.
        float LinTpNas: 0..1, post-build-variant-value=true, set at link in variant link-time / post-build in variant post-build / pre-compile in variant pre-compile  # Value in seconds of the N_As timeout. N_As is the time for transmission of a LIN frame (any N_PDU) on the part of the sender.
        float LinTpNcs [0..1]: 0..Inf, multiplicity set at link in variant link-time / post-build in variant post-build / pre-compile in variant pre-compile, post-build-variant-multiplicity=true, post-build-variant-value=true, set at link in variant link-time / post-build in variant post-build / pre-compile in variant pre-compile  # Value in seconds of the performance requirement of N_Cs. N_Cs is the time which elapses between the transmit request of a CF N-PDU until the transmit request of the next CF N-PDU.
        integer LinTpTxNSduId: 0..65535, set at pre-compile, symbolic-name-value=true  # The identifier of the Transport Protocol message. This ID will be the one that is communicated with upper layers.
        integer LinTpTxNSduNad: 0..255, post-build-variant-value=true, set at link in variant link-time / post-build in variant post-build / pre-compile in variant pre-compile  # A N-SDU transported on LIN is identified using the NAD for the specific slave.
        reference LinTpTxNSduPduRef: scope=ECU, post-build-variant-value=true, set at link in variant link-time / post-build in variant post-build / pre-compile in variant pre-compile, destination=Pdu  # Reference to the global PDU
        symbolic name reference LinTpTxNSduChannelRef: set at link in variant link-time+post-build / pre-compile in variant pre-compile, destination=ComMChannel  # Index of the channel this N-SDU belongs to.
