AUTOSAR XML (schema 4-2-2)
package /AUTOSAR_Fls/EcucModuleDefs
  module definition Fls [0..*]: category=VENDOR_SPECIFIC_MODULE_DEFINITION, refined-module-def=Fls, variants pre-compile  # Memory: Flash Driver | Configuration of the Fls (internal or external flash driver) module.
    container FlsConfigSet  # Configuration data set | Container for runtime configuration parameters of the flash driver
      integer FlsAcErase [0..0]: 0..4294967295, set at pre-compile  # Address offset in RAM for erase code | Address offset in RAM to which the erase flash access code shall be loaded. Used as function pointer to access the erase flash access code.
      integer FlsAcWrite [0..0]: 0..4294967295, set at pre-compile  # Address offset in RAM for write code | Address offset in RAM to which the write flash access code shall be loaded. Used as function pointer to access the write flash access code.
      float FlsCallCycle [0..0]: 0..1, set at pre-compile  # Cycle time of main function | Cycle time of calls of the flash driver's main function (in seconds).
      enumeration FlsDefaultMode: {MEMIF_MODE_FAST, MEMIF_MODE_SLOW}, set at pre-compile  # Default of FLS device mode | Default setting of the FLS device moder after initialization.
      function name FlsJobEndNotification [0..1]: multiplicity set at pre-compile, set at pre-compile  # Job End Notification | Function that is called after a job has been processed successfully.
      function name FlsJobErrorNotification [0..1]: multiplicity set at pre-compile, set at pre-compile  # Job Error Notification | Function that is called after a job has been aborted with an error.
      integer FlsMaxReadFastMode [0..1]: 0..4294967295, multiplicity set at pre-compile, set at pre-compile  # Read bytes in fast mode | The maximum number of bytes to read or compare in one cycle of the flash driver's job processing function in fast mode.
      integer FlsMaxReadNormalMode [0..1]: 0..4294967295, multiplicity set at pre-compile, set at pre-compile  # Read bytes in normal mode | The maximum number of bytes to read or compare in one cycle of the flash driver's job processing function in normal mode.
      integer FlsMaxWriteFastMode [0..1]: 0..4294967295, multiplicity set at pre-compile, set at pre-compile  # Write bytes in fast mode | The maximum number of bytes to write in one cycle of the flash driver's job processing function in fast mode.
      integer FlsMaxWriteNormalMode [0..1]: 0..4294967295, multiplicity set at pre-compile, set at pre-compile  # Write bytes in normal mode | The maximum number of bytes to write in one cycle of the flash driver's job processing function in normal mode.
      integer FlsProtection [0..0]: 0..4294967295, set at pre-compile  # Protection settings | Erase/write protection settings. Only relevant if supported by hardware.
      string FlsRbDeviceID [0..1]: multiplicity set at pre-compile, origin=RB:1.0.0:2011-09-09, set at pre-compile, max-length=32, min-length=1  # Device ID used (freely configurable) | Configuration of Fls Device ID is not supported anymore! Configuring this parameter will be ignored by the driver.
      enumeration FlsRbDeviceType: origin=RB:1.0.0:2011-09-09, set at pre-compile  # Device type | Flash device type.
        RBA_FLSIFX_DFLASH0  # Infineon Data Flash 0
        RBA_FLSIFX_UCB  # Infineon UCB Flash
        RBA_FLSIFX_PFLASH0  # Infineon Program Flash 0
        RBA_FLSIFX_PFLASH1  # Infineon Program Flash 1
        RBA_FLSIFX_DFLASH0_HSM  # Infineon HSM Data Flash 0
        RBA_FLSJDP_PFLASH0  # JDP Program Flash 0
        RBA_FLSJDP_PFLASH1  # JDP Program Flash 1
        RBA_FLSJDP_DFLASH0  # JDP Data Flash
        RBA_FLSJDP_DFLASH0_HSM  # JDP Data Flash HSM
        RBA_FLSJDP_PFLASH0_HSM  # JDP Program Flash HSM
        RBA_FLSJDP_UTEST  # JDP UTEST Flash (one-time-programmable)
        RBA_FLSMPC56XX_LPD_PFLASH0  # Freescale MPC 5643 Leopard Program Flash 0
        RBA_FLSMPC56XX_LPD_PFLASH1  # Freescale MPC 5643 Leopard Program Flash 1
        RBA_FLSMPC56XX_LPD_DFLASH  # Freescale MPC 5643 Leopard Data Flash
        RBA_FLSSPC56XL_70XX_PFLASH0  # STMICROELECTRONICS SPC56XL70XX Device Program Flash 0
        RBA_FLSSPC56XL_70XX_PFLASH1  # STMICROELECTRONICS SPC56XL70XX Device Program Flash 1
        RBA_FLSSPC56XL_70XX_DFLASH  # STMICROELECTRONICS SPC56XL70XX Device Data Flash
        RBA_FLSMPC56XX_KOMODO_PFLASH  # Freescale MPC 5675K Komodo Program Flash 0
        RBA_FLSMPC56XX_KOMODO_DFLASH  # Freescale MPC 5675K Komodo Data Flash
        RBA_FLSMPC56XX_BOLERO_PFLASH0  # Freescale MPC 5646C Bolero Program Flash 0
        RBA_FLSMPC56XX_BOLERO_PFLASH1  # Freescale MPC 5646C Bolero Program Flash 1
        RBA_FLSMPC56XX_BOLERO_DFLASH  # Freescale MPC 5646C Bolero Data Flash
        RBA_FLSSPC58XX_CHORUS_PFLASH0  # ST Chorus Program Flash 0
        RBA_FLSSPC58XX_CHORUS_PFLASH1  # ST Chorus Program Flash 1
        RBA_FLSSPC58XX_CHORUS_DFLASH  # ST Chorus Data Flash
        RBA_FLSV850FX4_DFLASH  # Renesas V850Fx4 Data Flash
        RBA_FLSV850FX4_PFLASH  # Renesas V850Fx4 Program Flash
        RBA_FLSV850R1X_PFLASH0  # Renesas V850R1x Program Flash 0
        RBA_FLSV850R1X_PFLASH1  # Renesas V850R1x Program Flash 1
        RBA_FLSV850R1X_DFLASH  # Renesas V850R1x Data Flash
        RBA_FLSV850R1X_CRASHDATA  # Renesas V850R1x Crash Data Flash
        RBA_FLSRH850P1XC_BMDATA  # Renesas RH850 Boot-Manager Data Flash
        RBA_FLSRH850P1XC_CRASHDATA  # Renesas RH850 Crash Data Flash
        RBA_FLSRH850P1XC_DFLASH0  # Renesas RH850 BANK-A Data Flash
        RBA_FLSRH850P1XC_DFLASH0_HSM  # Renesas RH850 BANK-B Data Flash for HSM
        RBA_FLSRH850P1XC_PFLASH0  # Renesas RH850 BANK-A Code Flash
        RBA_FLSRH850P1XC_PFLASH1  # Renesas RH850 BANK-B Code Flash
        RBA_FLSRH850P1XC_CFGAREA  # Renesas RH850 Config Area
        RBA_FLSSTV0991_PFLASH0  # STV0991 Program Flash 0
        RBA_FLSSTV0991_PFLASH1  # STV0991 Program Flash 1
        RBA_FLSSTV0991_DFLASH  # STV0991 Data Flash
        RBA_FLSPC_DFLASH  # Data flash emulation for PC-based testing
        RBA_FLS_ZYNQ_DFLASH  # ZYNQ ULTRASCALE DFLASH
        RBA_FLS_ZYNQ_PFLASH  # ZYNQ ULTRASCALE PFLASH
        RBA_FLSS25FSXXXS_DFLASH  # RCARH3 SERIAL DFLASH
        RBA_FLSS25FSXXXS_PFLASH  # RCARH3 SERIAL PFLASH
        RBA_FLSS25FSXXXS_DFLASH0_HSM  # RCARH3 SERIAL DFLASH HSM
        RBA_FLSHYPERFLASH_DFLASH  # RCARH3 HYPER DFLASH
        RBA_FLSHYPERFLASH_PFLASH  # RCARH3 HYPER PFLASH
      container FlsDemEventParameterRefs [0..0]  # Container for the references to DemEventParameter elements which shall be invoked using the Dem_ReportErrorStatus API in case the corresponding error occurs. The EventId is taken from the referenced DemEventParameter's DemEventId value. The standardized e
        reference FLS_E_COMPARE_FAILED [0..0]: set at pre-compile, destination=DemEventParameter  # Failed compare event | Reference to the DemEventParameter which shall be issued when the error "Flash compare failed (HW)" has occurred.
        reference FLS_E_ERASE_FAILED [0..0]: set at pre-compile, destination=DemEventParameter  # Failed erase event | Reference to the DemEventParameter which shall be issued when the error "Flash erase failed (HW)" has occurred.
        reference FLS_E_READ_FAILED [0..0]: set at pre-compile, destination=DemEventParameter  # Failed read event | Reference to the DemEventParameter which shall be issued when the error "Flash read failed (HW)" has occurred.
        reference FLS_E_UNEXPECTED_FLASH_ID [0..0]: set at pre-compile, destination=DemEventParameter  # Failed Flash ID detection event | Reference to the DemEventParameter which shall be issued when the error "Unexptected Flash ID (HW)" has occurred.
        reference FLS_E_WRITE_FAILED [0..0]: set at pre-compile, destination=DemEventParameter  # Failed write event | Reference to the DemEventParameter which shall be issued when the error "Flash write failed (HW)" has occurred.
      container FlsExternalDriver [0..0]  # This container is present for external Flash drivers only. Internal Flash drivers do not use the parameter listed in this container, hence its multiplicity is 0 for internal drivers.
        symbolic name reference FlsSpiReference [0..*]: multiplicity set at pre-compile, set at pre-compile, destination=SpiSequence  # Reference to SPI sequence (required for external Flash drivers).
      container FlsSectorList  # Sector list | List of flashable sectors and pages.
        container FlsSector [1..*]: multiplicity set at pre-compile  # Sector descriptor | Configuration description of a flashable sector.
          integer FlsNumberOfSectors: 0..65535, set at pre-compile  # Number of identical sectors | Number of continuous sectors with identical values for FlsSectorSize and FlsPageSize. The parameter FlsSectorStartAddress denotes the start address of the first sector.
          integer FlsPageSize: 0..4294967295, set at pre-compile  # Page size | Size of one page of this sector.
          integer FlsSectorSize: 0..4294967295, set at pre-compile  # Sector size | Size of this sector.
          integer FlsSectorStartaddress: 0..4294967295, set at pre-compile  # Sector start address | Start address of the first sector.
    container FlsGeneral  # General Parameters | Container for general parameters of the flash driver. These parameters are always pre-compile.
      boolean FlsAcLoadOnJobStart [0..0]: set at pre-compile, default-value=false  # The flash driver shall load the flash access code to RAM whenever an erase or write job is started and unload (overwrite) it after that job has been finished or canceled. | true: Flash access code loaded on job start / unloaded on job end or error. false: Flash access code not loaded to / unloaded from RAM at all.
      integer FlsBaseAddress [0..1]: 0..4294967295, multiplicity set at pre-compile, set at pre-compile  # Base address | The flash memory start address for user. This parameter defines the lower boundary for read / write / erase and compare jobs. Not necessary to configure. Automatically considered by the Fls script according to machine type configured.
      boolean FlsCancelApi: set at pre-compile  # Activation of FlsCancel API | Compile switch to enable and disable the Fls_Cancel function.
      boolean FlsCompareApi: set at pre-compile  # Activation of FlsCompare API | Compile switch to enable and disable the Fls_Compare function.
      boolean FlsDevErrorDetect: set at pre-compile  # Activation of Development Error Detection mode | Pre-processor switch to enable and disable development error detection.
      integer FlsDriverIndex [0..1]: 0..254, multiplicity set at pre-compile, set at pre-compile, symbolic-name-value=true  # Index of the driver, used by FEE.
      boolean FlsGetJobResultApi: set at pre-compile  # Activation of the Fls_GetJobResult function | Compile switch to enable and disable the Fls_GetJobResult function.
      boolean FlsGetStatusApi: set at pre-compile  # Activation of the Fls_GetStatus function | Compile switch to enable and disable the Fls_GetStatus function.
      boolean FlsRbBlankCheckApi: origin=RB:1.0.0:2011-09-09, set at pre-compile  # Activation of Fls_BlankCheck API | Pre-processor switch to enable / disable the API to check for the erase pattern within a certain address area.
      boolean FlsRbDeactivateDeviceApi [0..1]: multiplicity set at pre-compile, origin=RB:1.0.0:2011-09-09, set at pre-compile  # Activation of Device Deactivation API | Deactivation of Device Id feature is not supported anymore. Configuration of FlsRbDeactivateDeviceApi will be ignored by the script of Fls.
      integer FlsRbHclk [0..1]: multiplicity set at pre-compile, origin=RB:1.0.0:2011-09-09, set at pre-compile  # CPU clock frequency [MHz] (only for V850R1x devices). | CPU clock frequency [MHz] that is used by the Low level driver's library for intialization of the device (only necessary for TI devices and V850R1x devices).
      integer FlsRbLibRamAddr [0..1]: multiplicity set at pre-compile, origin=RB:1.0.0:2011-09-09, set at pre-compile  # RAM address required to locate Library provided by vendor(only necessary for code flash users of V850R1x). | Address required for copying the FCL code to RAM from the code flash area (applicable for boot loader programming sequence) --> Only necessary for Code Flash users of Renesas V850R1x device.
      enumeration FlsRbMachineType [0..1]: multiplicity set at pre-compile, origin=RB:1.0.0:2011-09-09, set at pre-compile  # Machine type | Controller type.
        MCU_RB_IFX_UC1_DEV2  # IFX Dev2 Production Device
        MCU_RB_IFX_UC1_DEV2_B  # IFX Dev2 (B Silicon) Production Device
        MCU_RB_IFX_UC1_DEV3  # IFX Dev3 Production Device
        MCU_RB_IFX_UC1_DEV3_C  # IFX Dev3 (C Silicon) Production Device
        MCU_RB_IFX_UC1_DEV3_D  # IFX Dev3 (D Silicon) Production Device
        MCU_RB_IFX_UC1_DEV3_HSM  # IFX Dev3 (D Silicon) Production Device HSM
        MCU_RB_IFX_UC1_DEV4  # IFX Dev4 Production Device
        MCU_RB_IFX_UC1_DEV4_B  # IFX Dev4 (B Silicon) Production Device
        MCU_RB_IFX_UC1_DEV4_HSM  # IFX Dev4 (B Silicon) Production Device HSM
        MCU_RB_IFX_UC1_DEV4_40NM_A  # IFX Dev4 40nm (A Silicon) Production Device
        MCU_RB_IFX_UC1_DEV5_40NM_A  # IFX Dev5 40nm (A Silicon) Production Device
        MCU_RB_IFX_UC1_DEV5_40NM_HSM  # IFX Dev5 40nm (A Silicon) Production Device HSM
        MCU_RB_IFX_UC1_DEV5_40NM_A_HSM  # IFX Dev5 40nm (A Silicon) Production Device HSM
        MCU_RB_IFX_UC1_DEV5_40NM_B  # IFX Dev5 40nm (B Silicon) Production Device
        MCU_RB_IFX_ADAS_TC397QA_B  # IFX Dev5 40nm Production Device
        MCU_RB_JDP_UC1_DEV1  # JDP Dev1 Production Device
        MCU_RB_JDP_UC1_DEV2_C2  # JDP Dev2 (Cut 2) Production Device
        MCU_RB_JDP_UC1_DEV3_C2  # JDP Dev3 (Cut 2) Production Device
        MCU_RB_JDP_UC1_DEV3_HSM  # JDP Dev3 (Cut 2) Production Device HSM
        MCU_RB_JDP_UC1_DEV4_C2  # JDP Dev4 (Cut 2) Production Device
        MCU_RB_JDP_UC1_DEV4_HSM  # JDP Dev4 (Cut 2) Production Device HSM
        MCU_RB_ST_UC1_DEV3PLUS_C1  # ST Dev3 Plus
        MCU_RB_JDP_UC1_DEV3_HSM  # ST Dev3 Plus HSM
        MCU_RB_ST_UC1_DEV3_40NM_C3  # ST Dev3 Plus C3
        MCU_RB_ST_CHORUS_1M_C1  # ST Chorus 1M C1
        MCU_RB_ST_CHORUS_2M_C1  # ST Chorus 2M C1
        MCU_RB_ST_CHORUS_4M_C1  # ST Chorus 4M C1
        MCU_RB_MPC56XX_LPD  # Freescale MPC 5643 Leopard Device
        MCU_RB_SPC56XL_70XX  # STMicroelectronics SPC56XL70XX Device
        MCU_RB_SPC56XL_70XX_64K  # STMicroelectronics SPC56XL70XX Device 64K
        MCU_RB_MPC56XX_KOMODO  # Freescale MPC 5675 Komodo Device
        MCU_RB_MPC56XX_BOLERO  # Freescale MPC 5646C Bolero Device
        MCU_RB_V850FX4_512K  # Renesas V850Fx4-512K
        MCU_RB_V850FX4_768K  # Renesas V850Fx4-768K
        MCU_RB_V850FX4_1M  # Renesas V850Fx4-1M
        MCU_RB_V850FX4_1_5M  # Renesas V850Fx4-1.5M
        MCU_RB_V850R1X_256K  # Renesas V850R1x with 256Kb Code Flash
        MCU_RB_V850R1X_256K_REDUCED  # Renesas V850R1x with 256Kb Code Flash reduced by Crash Data
        MCU_RB_V850R1X_512K  # Renesas V850R1x with 512Kb Code Flash
        MCU_RB_V850R1X_512K_REDUCED  # Renesas V850R1x with 512Kb Code Flash reduced by Crash Data
        MCU_RB_V850R1X_1M  # Renesas V850R1x with 1Mb Code Flash
        MCU_RB_V850R1X_1M_REDUCED  # Renesas V850R1x with 1Mb Code Flash reduced by Crash Data
        MCU_RB_RH850P1XC_DEV3  # Renesas RH850P1x Dev3
        MCU_RB_RH850P1XC_DEV3_REDUCED  # Renesas RH850P1x Dev3 reduced by Crash Data
        MCU_RB_RH850P1XC_DEV3_6S  # Renesas RH850P1x Dev3 6 sectors
        MCU_RB_RH850P1XC_DEV3_REDUCED_6S  # Renesas RH850P1x Dev3 6 sectors reduced by Crash Data
        MCU_RB_RH850P1XC_DEV3_HSM  # Renesas RH850P1x Dev3 with HSM active
        MCU_RB_RH850P1XC_DEV4  # Renesas RH850P1x Dev4
        MCU_RB_RH850P1XC_DEV4_REDUCED  # Renesas RH850P1x Dev4 reduced by Crash Data
        MCU_RB_RH850P1XC_DEV4_HSM  # Renesas RH850P1x Dev4 with HSM active
        MCU_RB_RH850P1XC_DEV5  # Renesas RH850P1x Dev5
        MCU_RB_RH850P1XC_DEV5_REDUCED  # Renesas RH850P1x Dev5 reduced by Crash Data
        MCU_RB_RH850P1XC_DEV5_HSM  # Renesas RH850P1x Dev5 with HSM active
        MCU_RB_STV0991  # STV0991 QSPI Flash
        MCU_RB_ZYNQ_V3H_SERIAL  # ZYNQ ULTRASCALE FLASH-128M
        MCU_RB_RCARH3_SERIAL  # RCAR RPC SERIAL FLASH-16M
        MCU_RB_RCAR_V3M_SERIAL  # RCAR RPC SERIAL FLASH-64M
        MCU_RB_RCAR_V3H_SERIAL  # RCAR RPC SERIAL FLASH-128M
        MCU_RB_RCAR_H3_HYPERFLASH  # RCAR RPC HYPER FLASH-64M
        MCU_RB_PC  # PC-based simulation environment 6 sectors each 64kB
        MCU_RB_PC_4SEC_64KB  # PC-based simulation environment 4 sectors each 64kB
        MCU_RB_PC_8SEC_16KB  # PC-based simulation environment 8 sectors each 16kB
        MCU_RB_PC_6SEC_128KB  # PC-based simulation environment 6 sectors each 128kB
        MCU_RB_PC_8SEC_64KB  # PC-based simulation environment 8 sectors each 64kB
      boolean FlsRbP1xSupportOlderDevice [0..1]: multiplicity set at pre-compile, origin=RB:1.0.0:2011-09-09, set at pre-compile  # Support P1x Dev5EDv1 device and P1x Dev4v1 device(only for RH850P1x devices). | Compile Switch to Enable the Support for P1x Dev5EDV1 device and P1x Dev4V1 Device (only necessary for RH850P1x devices).Configure this parameter as True while using P1x Dev5EDV1 and P1x Dev4V1 controllers.
      boolean FlsRbSuspendApi [0..1]: multiplicity set at pre-compile, origin=RB:1.0.0:2011-09-09, set at pre-compile  # Activation of the Suspend/Resume feature | Pre-processor switch to enable / disable the suspend/resume feature (only possible for certain devices).
      boolean FlsSetModeApi: set at pre-compile  # Activation of the Fls_SetMode function | Compile switch to enable and disable the Fls_SetMode function.
      integer FlsTotalSize [0..1]: 0..4294967295, multiplicity set at pre-compile, set at pre-compile  # Amount of flash memory bytes | The total amount of flash memory in bytes (This parameter in conjunction with FLS_BASE_ADDRESS defines the upper boundary for read / write / erase and compare jobs). Not necessary to configure this tag anymore as the information of total size of configured sectors will be automatically computed and considered by the Fls script based on user configuration.
      boolean FlsUseInterrupts [0..0]: set at pre-compile, default-value=false  # Job processing triggered by hardware interrupt. | true: Job processing triggered by interrupt (hardware controlled). false: Job processing not triggered by interrupt (software controlled)
      boolean FlsVersionInfoApi: set at pre-compile  # Activation of FlsVersionInfo API | Pre-processor switch to enable / disable the API to read out the modules version information.
    container FlsPublishedInformation  # Additional published parameters not covered by CommonPublishedInformation container.
      integer FlsAcLocationErase [0..0]: 0..4294967295, set at published-information  # Position in RAM, to which the erase flash access code has to be loaded. | Only relevant if the erase flash access code is not position independent. If this information is not provided it is assumed that the erase flash access code is position independent and that therefore the RAM position can be freely configured.
      integer FlsAcLocationWrite [0..0]: 0..4294967295, set at published-information  # Position in RAM, to which the write flash access code has to be loaded. | Only relevant if the write flash access code is not position independent. If this information is not provided it is assumed that the write flash access code is position independent and that therefore the RAM position can be freely configured.
      integer FlsAcSizeErase [0..0]: 0..4294967295, set at published-information  # Number of bytes in RAM needed for the erase flash access code.
      integer FlsAcSizeWrite [0..0]: 0..4294967295, set at published-information  # Number of bytes in RAM needed for the write flash access code.
      float FlsEraseTime [0..0]: set at published-information  # Maximum time to erase one complete flash sector.
      integer FlsErasedValue [0..1]: 0..4294967295, multiplicity set at pre-compile, set at pre-compile  # Erase pattern | The contents of an erased flash memory cell.
      string FlsExpectedHwId [0..0]: set at published-information  # Unique identifier of the hardware device that is expected by this driver (the device for which this driver has been implemented). | Only relevant for external flash drivers.
      integer FlsSpecifiedEraseCycles [0..1]: 0..4294967295, multiplicity set at pre-compile, set at pre-compile  # Maximum erase cycles | Number of erase cycles specified for the flash device (usually given in the device data sheet). If the number of specified erase cycles depends on the operating environment (temperature, voltage, ...) during reprogramming of the flash device, the minimum number for which a data retention of atleast 15 years over the temperature range from -40°C .. +125°C can be guaranteed shall be given. Fls will ignore the configuration of this tag as it is not considered for any purpose, hence it is not necessary to configure this tag any more!
      float FlsWriteTime [0..0]: set at pre-compile  # Maximum page programming time | Maximum time to program one complete flash page.
