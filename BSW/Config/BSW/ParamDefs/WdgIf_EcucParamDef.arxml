AUTOSAR XML (schema 4-2-2)
package /AUTOSAR_WdgIf/EcucModuleDefs
  module definition WdgIf [0..1]: category=VENDOR_SPECIFIC_MODULE_DEFINITION, refined-module-def=WdgIf, variants pre-compile  # Watchdog Interface | Configuration of the WdgIf (Watchdog Interface) module (with vendor specific enhancements of RB).
    container WdgIfDevice [1..*]: multiplicity set at pre-compile  # Configuration set for WdgIf | It contains the information for the selection of a particular Watchdog device in case multiple Watchdog drivers are connected.
      integer WdgIfDeviceIndex: 0..255, scope=ECU, set at pre-compile, symbolic-name-value=true  # Watchdog interface identifier | Represents the watchdog interface ID so that it can be referenced by the watchdog manager.
      symbolic name reference WdgIfDriverRef: set at pre-compile, destination=WdgGeneral  # Watchdog driver reference | Reference to the watchdog drivers that are controlled by the watchdog interface.
    container WdgIfGeneral  # Watchdog interface general | This container collects all generic watchdog interface parameters.
      boolean WdgIfDevErrorDetect: set at pre-compile  # Development error enable | Switches the development error detection and notification on or off. true: detection and notification is enabled. false: detection and notification is disabled.
      string WdgIfRbExtWdgModuleName [0..1]: multiplicity set at pre-compile, origin=RB:1.0.0:2012-09-28, set at pre-compile  # External Watchdog Module name | This is module name of the External Watchdog Module. This parameter is to help generating the Api names to be used inside WdgIf from Io External Device controller. If this parameter is not configured, Vendor specific(related to Bosch specific IoExtDev module) External Watchdog interfaces will not be generated. This shall be configured with exact Module name, as it should appear in the Prefix for the generated Api's.
      boolean WdgIfVersionInfoApi: set at pre-compile  # Version information | Pre-processor switch to enable / disable the service returning the version information. true: Version information service enabled false: Version information service disabled
