AUTOSAR XML (schema 4-2-2)
package /AUTOSAR_Pwm/EcucModuleDefs
  module definition Pwm: category=VENDOR_SPECIFIC_MODULE_DEFINITION, variants pre-compile  # Configuration of Pwm (Pulse Width Modulation) module.
    container PwmChannelConfigSet  # This container contains the configuration parameters and sub containers of the AUTOSAR Pwm module.
      integer PwmRbMaxChannel [0..1]: 0..65535, origin=RB:42.1.0.0:2016-11-01, set at pre-compile, with-auto=true  # PwmMaxChannel | This parameter contains the number of Channels configured. It will be gathered by tools during the configuration stage. | calculationFormula = Number of configured Icu Channels Implementation Type: Pwm_ChannelType
      container PwmChannel [1..*]  # Configuration of an individual PWM channel.
        enumeration PwmChannelClass: {PWM_FIXED_PERIOD, PWM_FIXED_PERIOD_SHIFTED, PWM_VARIABLE_PERIOD}, multiplicity set at pre-compile, set at pre-compile  # Class of PWM Channel. | ImplementationType: Pwm_ChannelClassType
        integer PwmChannelId [0..1]: 0..4294967295, set at pre-compile, symbolic-name-value=true, with-auto=true  # Channel Id of the PWM channel. This value will be assigned to the symbolic name derived of the PwmChannel container short name.
        integer PwmDutycycleDefault: 0..32768, set at pre-compile  # Value of duty cycle used for Initialization | 0, represents 0% 0x8000 represents 100%
        enumeration PwmIdleState: {PWM_HIGH, PWM_LOW}, set at pre-compile  # The parameter PWM_IDLE_STATE represents the output state of the PWM after the signal is stopped (e.g. call of Pwm_SetOutputToIdle).
        function name PwmNotification [0..1]: multiplicity set at pre-compile, set at pre-compile  # Definition of the Callback function.When the notification support is ON then configure Notification function else it is left empty and default Null_Ptr is assigned
        float PwmPeriodDefault: 0..Inf, set at pre-compile  # Value of period used for Initialization.(in seconds).
        enumeration PwmPolarity: {PWM_HIGH, PWM_LOW}, set at pre-compile  # Defines the starting polarity of each PWM channel.
        boolean PwmRbChannelActive: origin=RB:42.1.0.0:2016-11-01, set at pre-compile  # PwmChannelActive | Check for the channel to be active or dead
        enumeration PwmRbHWPeripheral: origin=RB:42.1.0.0:2016-11-01, set at pre-compile  # PwmHWPeripheral | Hardware peripheral of the channel
          Pwm_Prv_HwGtm_e  # GTM TIMER
        reference PwmMcuClockReferencePoint [0..0]: scope=ECU, set at pre-compile, destination=McuClockReferencePoint  # This parameter contains reference to the McuClockReferencePoint
        container PwmRbGtmAtomChannel [0..1]  # Gtm Channel Parameters | Container for configuration of GTM - ATOM specific parameters
          integer PwmRb_b_GtmHWInstance: 0..2, origin=RB:42.1.0.0:2016-11-01, set at pre-compile  # GTM Hardware Instance | Selection of Hardware Instance of GTM
          integer PwmRb_c_GtmHWChannel: 0..7, origin=RB:42.1.0.0:2016-11-01, set at pre-compile  # GTM Hardware Channel | Selection of Hardware Channel of GTM
          enumeration PwmRb_d_GtmClksource: origin=RB:42.1.0.0:2016-11-01, set at pre-compile  # CMU clock source | Selection of Clock sources for GTM Channel
            CMU_CLK_{0..7}  # Clock Source Divider {0..7}
          integer PwmRb_e_GtmIndex [0..1]: origin=RB:42.1.0.0:2016-11-01, with-auto=true  # Gtm-Atom Hardware index | Selection of GTM harware index
    container PwmConfigurationOfOptApiServices
      boolean PwmDeInitApi: set at pre-compile  # Adds / removes the service Pwm_DeInit() from the code.
      boolean PwmGetOutputState: set at pre-compile
      boolean PwmSetDutyCycleApi: set at pre-compile
      boolean PwmSetOutputToIdle: set at pre-compile
      boolean PwmSetPeriodAndDuty: set at pre-compile
      boolean PwmVersionInfoApi: set at pre-compile  # Switch to indicate that the Pwm_ GetVersionInfo is supported
    container PwmGeneral
      boolean PwmDevErrorDetect: set at pre-compile  # Switches the Default Error Tracer (Det) detection and notification ON or OFF. | * true: enabled (ON). * false: disabled (OFF).
      boolean PwmDutycycleUpdatedEndperiod: set at pre-compile  # Switch for enabling the update of the duty cycle parameter at the end of the current period. | TRUE: update of duty cycle is done at the end of period of currently generated waveform (current waveform is finished). FALSE: update of duty cycle is done immediately (just after service call, current waveform is cut).
      integer PwmIndex: 0..4294967295, set at pre-compile  # Specifies the InstanceId of this module instance. If only one instance is present it shall have the Id 0.
      boolean PwmPeriodUpdatedEndperiod: set at pre-compile  # Switch for enabling the update of the period parameter at the end of the current period. | TRUE: Duty cycle is updated at the end of the current period. FALSE: Duty cycle may be updated prior to the end of the current period
      boolean PwmRbGTMused: origin=RB:42.1.0.0:2016-11-01, set at pre-compile  # GTM usage by PWM | Switch to indicate GTM is Used by Pwm | TRUE:Gtm module is used FALSE: Gtm Module is not used
      boolean PwmRbNotificationSupport: origin=RB:42.1.0.0:2014-10-14, set at pre-compile  # PwmNotificationSupport | Switch to indicate that the notifications are supported | TRUE:Pwm signal edge notifications are switched on FALSE:Pwm signal edge notifications are switched off
      boolean PwmRbPreCompileVariant: origin=RB:42.1.0.0:2016-11-01, set at pre-compile  # Set PreCompile support ON | Selection of Pre compile time environment. | True:Pre compile variant enabled False:Pre compile variant not enabled
      boolean PwmRbVersionCheckAutosar: origin=RB:42.1.0.0:2014-10-14, set at pre-compile  # PwmEnable AUTOSAR version checking | Enables / disables AUTOSAR file version checking. - If enabled the respective AUTOSAR file versions are checked. In case of a missmatch an error is reported during compilaton. - If disabled, versions are not checked. Use this option, for example, if you want to mix AUTOSAR versions. | True:Pre compile variant enabled False:Pre compile variant not enabled
    container PwmRbDriverConfiguration [0..1]  # Pwm driver configuration | This container contains the configuration (parameters) of the Pwm Driver
      string PwmRbKeywordCompiler [0..1]: origin=RB:42.1.0.0:2014-10-14, set at pre-compile  # Compiler specific keyword | Compiler specific keyword for interrupt handler functions, if required, e.g : - GHS uses "__interrupt" keyword - Diab uses "__interrupt__" keyword.
