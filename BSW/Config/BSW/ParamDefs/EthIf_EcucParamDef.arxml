AUTOSAR XML (schema 4-2-2)
package /AUTOSAR_EthIf/EcucModuleDefs
  module definition EthIf [0..1]: category=VENDOR_SPECIFIC_MODULE_DEFINITION, refined-module-def=EthIf, variants pre-compile  # Configuration of the EthIf (Ethernet Interface) module.
    container EthIfConfigSet  # Collecting container for all parameters with post-build configuration classes.
      container EthIfController [1..*]  # This container contains the configuration of EthIfController.
        integer EthIfCtrlIdx: 0..255, scope=ECU, set at pre-compile, symbolic-name-value=true, with-auto=true  # EthIfCtrlIdx (automatically generated) | This parameter provides a zero-based consecutive index of the Ethernet Communication Controllers. Upper layer BSW modules and the EthIf itself use this index to identify a Ethernet CC.
        integer EthIfCtrlMtu: 64..9000, scope=ECU, post-build-variant-value=true, set at link in variant link-time / post-build in variant post-build / pre-compile in variant pre-compile  # Specifies the maximum transmission unit (MTU) of the EthIfCtrl in [bytes]. | Note: in case a VLAN tag is used for the EthIfCtrl, the MTU is 4 bytes smaller than the maximum payload size of an Ethernet frame which can be transmitted on the network.
        integer EthIfMaxTxBufsTotal [0..0]: 1..4294967295, set at pre-compile  # EthIfMaxTxBufsTotal (currently unused) | Limits the total number of transmit buffers.
        integer EthIfVlanId [0..1]: 0..4095, scope=ECU, multiplicity set at link in variant link-time / post-build in variant post-build / pre-compile in variant pre-compile, post-build-variant-multiplicity=true, post-build-variant-value=true, set at link in variant link-time / post-build in variant post-build / pre-compile in variant pre-compile  # A virtual-LAN is identified by this attribute according to IEEE 802.1Q.
        symbolic name reference EthIfEthTrcvRef [0..1]: scope=ECU, multiplicity set at link in variant link-time / post-build in variant post-build / pre-compile in variant pre-compile, post-build-variant-multiplicity=true, post-build-variant-value=true, set at link in variant link-time / post-build in variant post-build / pre-compile in variant pre-compile, destination=EthIfTransceiver  # Reference to an Ethernet transceiver, which is handled by the Ethernet Interface.
        symbolic name reference EthIfPhysControllerRef: scope=ECU, post-build-variant-value=true, set at link in variant link-time / post-build in variant post-build / pre-compile in variant pre-compile, destination=EthIfPhysController  # Reference to a physical Ethernet controller, which is handled by the Ethernet Interface.
        choice reference EthIfSwitchRefOrPortGroupRef [0..1]: multiplicity set at link in variant link-time / post-build in variant post-build / pre-compile in variant pre-compile, post-build-variant-multiplicity=true, post-build-variant-value=true, set at link in variant link-time / post-build in variant post-build / pre-compile in variant pre-compile, destination=[EthIfSwitch, EthIfSwitchPortGroup]  # The choice reference allows to configure either the EthIfController references an EthIfSwitch or an EthIfSwitchPortGroup. | Reference to a EthIfSwitchPortGroup. In case port groups are controlled by PNC EthIfSwitchPortGroupRefSemantics shall have the value ETHIF_SWITCH_PORT_GROUP_LINK_INFO. In case port groups are controlled by the EhtIfController EthIfSwitchPortGroupRefSemantics shall have the value ETHIF_SWITCH_PORT_GROUP_CONTROL.
      container EthIfFrameOwnerConfig [1..*]  # Configuration of Ethernet frame owner
        integer EthIfFrameType: 0..65535, post-build-variant-value=true, set at link in variant link-time / post-build in variant post-build / pre-compile in variant pre-compile  # Selects the Ethernet frame type.
        integer EthIfOwner [0..0]: 0..255, post-build-variant-value=true, set at link in variant link-time / post-build in variant post-build / pre-compile in variant pre-compile  # EthIfOwner (unused) | Selects the owner of an Ethernet frame type. The owner is a zero based index into the callback function configuration 'EthIfRxIndicationConfig'. I.e. an Ethernet frame of type IPv4 (0x800) at index 0 will call the first callback function configured in 'EthIfRxIndicationConfig'.
        symbolic name reference EthIfRxIndicationRef: origin=RB:AR41.19.0.0:2015-09-10, post-build-variant-value=true, set at link in variant link-time / post-build in variant post-build / pre-compile in variant pre-compile, destination=EthIfRxIndicationConfig  # RB (Vendor06) specific parameter: Reference to the RxIndication function.
        symbolic name reference EthIfTxConfirmationRef [0..1]: origin=RB:AR41.19.0.0:2015-09-10, post-build-variant-value=true, set at link in variant link-time / post-build in variant post-build / pre-compile in variant pre-compile, destination=EthIfTxConfirmationConfig  # RB (Vendor06) specific parameter: Reference to the TxConfirmation function.
      container EthIfPhysController [1..*]  # This container contains the configuration of EthIfPhysController. | The usage of EthIfEthCtrlRef and EthIfWEthCtrlRef is exclusive OR.
        integer EthIfPhysControllerIdx [0..0]: 0..255, scope=ECU, set at pre-compile, symbolic-name-value=true  # EthIfPhysControllerIdx (Currently unused). | This parameter provides a zero-based consecutive index of the physical Ethernet controllers. Upper layer BSW modules and the Ethernet Interface itself use this index to identify a physical Ethernet controller.
        symbolic name reference EthIfEthCtrlRef: scope=ECU, post-build-variant-value=true, set at link in variant link-time / post-build in variant post-build / pre-compile in variant pre-compile, destination=EthCtrlConfig  # Reference to a physical Ethernet controller, which is handled by a specific Ethernet controller driver.
        symbolic name reference EthIfWEthCtrlRef [0..0]: scope=ECU, post-build-variant-value=true, set at link in variant link-time / post-build in variant post-build / pre-compile in variant pre-compile, destination=WEthCtrlConfig  # EthIfWEthCtrlRef (currently unused) | Reference to a physical Wireless Ethernet controller, which is handled by a specific Wireless Ethernet controller driver.
        container EthIfPhysCtrlRxMainFunctionPriorityProcessing [0..0]: multiplicity set at pre-compile  # EthIfPhysCtrlRxMainFunctionPriorityProcessing (currently unused) | Configuration of ingress FIFO based main function processing.
          integer EthIfPhysCtrlRxIndicationIterations [0..0]: 0..18446744073709551615, set at pre-compile  # EthIfPhysCtrlRxIndicationIterations (currently unused) | Max number of Ethernet frames polled per main function invocation.
          float EthIfPhysCtrlRxMainFunctionPeriod [0..0]: set at pre-compile  # EthIfPhysCtrlRxMainFunctionPeriod (currently unused) | Specifies the period of main function in seconds.
          symbolic name reference EthIfPhysCtrlRxIngressFifoRef [0..0]: set at pre-compile, destination=EthCtrlConfigIngressFifo  # EthIfPhysCtrlRxIngressFifoRef (currently unused) | Reference to the reception FIFO.
      container EthIfRxIndicationConfig [1..*]  # Configuration of receive callback functions.
        function name EthIfRxIndicationFunction: post-build-variant-value=true, set at link in variant link-time / post-build in variant post-build / pre-compile in variant pre-compile  # Specifies receive indication callback function.
      container EthIfSwitch [0..*]  # This container contains the configuration of EthIfSwitches.
        integer EthIfSwitchIdx [0..0]: 0..255, scope=ECU, set at pre-compile, symbolic-name-value=true  # EthIfSwitchIdx (currently unused) | This parameter provides a zero-based consecutive index of the Ethernet Interface Switches. Upper layer BSW modules and the EthIf itself use this index to identify a Ethernet Switch.
        symbolic name reference EthIfSwitchRef: scope=ECU, post-build-variant-value=true, set at link in variant link-time / post-build in variant post-build / pre-compile in variant pre-compile, destination=EthSwtConfig  # Reference to a Ethernet Switch, which is handled by a specific Ethernet Switch driver.
      container EthIfSwitchMgmtInfoIndicationConfig [0..0]: multiplicity set at pre-compile  # EthIfSwitchMgmtInfoIndicationConfig (currently unused) | Configuration of Switch Management callback function.
        function name EthIfSwitchMgmtInfoIndicationFunction [0..0]: post-build-variant-value=true, set at link in variant link-time / post-build in variant post-build / pre-compile in variant pre-compile  # EthIfSwitchMgmtInfoIndicationFunction (currently unused) | Enables/Disables the ingress Switch management info indication redirected call to upper layers who registered for the call.
      container EthIfSwitchPortGroup [0..*]  # This container contains the configuration of EthIfSwitchPortGroups. | If EthIfSwitchPortGroups are controlled by PNC one EthIfSwitchPortGroup per PNC shall exist. The host port shall be part of all EthIfSwitchPortGroups. The up link port of a master switch and the up link port of the slave switch shall be part of all EthIfSwitchPortGroups that contain EthSwtPorts belonging to the slave switch.
        integer EthIfSwitchPortGroupIdx: 0..255, scope=ECU, set at pre-compile, symbolic-name-value=true, with-auto=true  # EthIfSwitchPortGroupIdx (automatically generated) | This parameter provides a zero-based consecutive index of the Ethernet Switch Port Groups. Upper layer BSW modules and the EthIf itself use this index to identify an Ethernet Switch Port Group.
        enumeration EthIfSwitchPortGroupRefSemantics [0..1]: {ETHIF_SWITCH_PORT_GROUP_CONTROL, ETHIF_SWITCH_PORT_GROUP_LINK_INFO}, post-build-variant-value=true, set at link in variant link-time / post-build in variant post-build / pre-compile in variant pre-compile  # Defines how the EthIfSwitchRefOrPortGroupRef refering to a EthIfSwitchPortGroup shall be interpreted.
        symbolic name reference EthIfPortRef [1..*]: post-build-variant-value=true, set at link in variant link-time / post-build in variant post-build / pre-compile in variant pre-compile, destination=EthSwtPort  # Reference to an Ethernet Switch Port.
      container EthIfSwitchTimeStampIndicationConfig [0..0]: multiplicity set at pre-compile  # EthIfSwitchTimeStampIndicationConfig (currently unused) | Configuration of Switch timestamp indications.
        function name EthIfSwitchEgressTimeStampIndicationFunction [0..0]: post-build-variant-value=true, set at link in variant link-time / post-build in variant post-build / pre-compile in variant pre-compile  # EthIfSwitchEgressTimeStampIndicationFunction (currently unused) | Enables/Disables to upper layers an egress timestamp indication function.
        function name EthIfSwitchIngressTimeStampIndicationFunction [0..0]: post-build-variant-value=true, set at link in variant link-time / post-build in variant post-build / pre-compile in variant pre-compile  # EthIfSwitchIngressTimeStampIndicationFunction (currently unused) | Enables/Disables to upper layers an ingress timestamp indication function.
      container EthIfTransceiver [0..*]  # This container contains the configuration of EthIfTransceiver. | The usage of EthIfEthTrcvRef and EthIfWEthTrcvRefis exclusive OR.
        integer EthIfTransceiverIdx [0..0]: 0..255, scope=ECU, set at pre-compile, symbolic-name-value=true  # EthIfTransceiverIdx (currently unused) | This parameter provides a zero-based consecutive index of the Ethernet transceivers. Upper layer BSW modules and the Ethernet Interface itself use this index to identify an Ethernet tranceiver.
        symbolic name reference EthIfEthTrcvRef: scope=ECU, post-build-variant-value=true, set at link in variant link-time / post-build in variant post-build / pre-compile in variant pre-compile, destination=EthTrcvConfig  # Reference to an Ethernet transceiver, which is handled by a specific Ethernet transceiver driver.
        symbolic name reference EthIfWEthTrcvRef [0..0]: scope=ECU, post-build-variant-value=true, set at link in variant link-time / post-build in variant post-build / pre-compile in variant pre-compile, destination=WEthTrcvConfig  # EthIfWEthTrcvRef (currently unused) | Reference to an Wireless Ethernet transceiver, which is handled by a specific Wireless Ethernet transceiver driver.
      container EthIfTrcvLinkStateChgConfig [0..0]  # EthIfTrcvLinkStateChgConfig (currently unused). | Specifies link state change callback function
        function name EthIfTrcvLinkStateChgFunction [0..0]: post-build-variant-value=true, set at link in variant link-time / post-build in variant post-build / pre-compile in variant pre-compile  # EthIfTrcvLinkStateChgFunction (currently unused). | Specifies link state change callback function
      container EthIfTxConfirmationConfig [0..*]  # Configuration of transmit indication callback functions.
        function name EthIfTxConfirmationFunction: post-build-variant-value=true, set at link in variant link-time / post-build in variant post-build / pre-compile in variant pre-compile  # Specifies transmit indication callback function
    container EthIfGeneral  # This container contains the general configuration parameters of the Ethernet Interface.
      boolean EthIfDevErrorDetect: set at pre-compile, default-value=false  # Switches the development error detection and notification on or off. | * true: detection and notification is enabled. * false: detection and notification is disabled.
      boolean EthIfEnableRxInterrupt: set at pre-compile  # Enables / Disables receive interrupt.
      boolean EthIfEnableTxInterrupt: set at pre-compile  # Enables / Disables the transmit interrupt.
      boolean EthIfEnableWEthApi [0..0]: multiplicity set at pre-compile, set at pre-compile, default-value=false  # EthIfEnableWEthApi (currently unused) | Enables / Disables API's for WEth / WEthTrcv
      boolean EthIfGetAndResetMeasurementDataApi [0..0]: set at pre-compile, default-value=false  # EthIfGetAndResetMeasurementDataApi (currently unused) | Enables / Disables the Get and Reset Measurement Data API
      boolean EthIfGetBaudRate [0..0]: set at pre-compile  # EthIfGetBaudRate (currently unused) | Enables / Disables GetBaudRate API.
      boolean EthIfGetCounterState [0..0]: set at pre-compile  # EthIfGetCounterState (currently unused) | Enables / Disables GetCounterState API.
      boolean EthIfGetCtrlIdxList [0..0]: set at pre-compile, default-value=false  # EthIfGetCtrlIdxList (currently unused) | Enables / Disables GetCtrlIdxList API.
      boolean EthIfGetTransceiverWakeupModeApi [0..0]: multiplicity set at pre-compile, set at pre-compile, default-value=false  # EthIfGetTransceiverWakeupModeApi (currently unused) | Enables / Disables EthIf_GetTransceiverWakeupMode API
      boolean EthIfGetVlanIdSupport: set at pre-compile, default-value=false  # Enables / Disables GetVlanId API.
      boolean EthIfGlobalTimeSupport: set at pre-compile  # Enables/Disables the Global Time APIs used amongst others by Global Time Synchronization over Ethernet.
      integer EthIfVirtualAddressFilterSize [0..1]: 1..255, origin=RB:42.3.5.0:2017-11-20, set at pre-compile  # Specifies the size of virtual address filter over all configured EthCtrls. It should be set to the overall number of simultaneously used multicast IP addresses and the size MUST NOT be greater than the summed capacity of physical address filters of all configured EthCtrls. Dependency: This parameter is only valid if Eth.EthGeneral.EthUpdatePhysAddrFilter is enabled. If multicast communication is not used, then Eth.EthGeneral.EthUpdatePhysAddrFilter should be disabled in Eth and EthIfVirtualAddressFilterSize should not be configured.
      float EthIfMainFunctionPeriod: 0..Inf, set at pre-compile  # Specifies the period of main function EthIf_MainFunctionRx and EthIf_MainFunctionTx in seconds. Ethernet Interface does not require this information but the BSW scheduler.
      float EthIfMainFunctionStatePeriod: 0..Inf, multiplicity set at pre-compile, set at pre-compile  # Specifies the period of main function EthIf_MainFunctionState in seconds. Ethernet Interface does not require this information but the BSW scheduler.
      integer EthIfMaxTrcvsTotal [0..0]: 1..255, set at pre-compile  # EthIfMaxTrcvsTotal (currently unused) | Limits the total number of transceivers.
      float EthIfPortStartupActiveTime [0..1]: 0.001..65.535, multiplicity set at link in variant link-time / post-build in variant post-build / pre-compile in variant pre-compile, post-build-variant-multiplicity=true, post-build-variant-value=true, set at link in variant link-time+post-build / pre-compile in variant pre-compile  # Denote the time delay in seconds after the mode "ETHTRCV_MODE_ACTIVE" of all EthIfSwitchPorts are requested via EthIf_StartAllPorts. | This is only used for ports in EthIfSwtPortGroups which are not referenced by a EthIfController.
      string EthIfPublicCddHeaderFile [0..*]: scope=ECU, multiplicity set at pre-compile, set at pre-compile, max-length=32, min-length=1  # Defines header files for callback functions which shall be included in case of CDDs. Range of characters is 1.. 32.
      integer EthIfRxIndicationIterations [0..1]: 0..65535, set at pre-compile  # Maximum number of Ethernet frames per Ethernet controller polled from the Ethernet driver within EthIf_MainFunctionRx.
      boolean EthIfSetForwardingModeApi [0..0]: set at pre-compile, default-value=false  # EthIfSetForwardingModeApi (currently unused) | Enables /disables EthIf_SetForwardingMode API.
      boolean EthIfStartAutoNegotiation [0..0]: set at pre-compile  # EthIfStartAutoNegotiation (currently unused) | Enables / Disables StartAutoNegotiation API.
      boolean EthIfSwitchManagementSupport [0..0]: set at pre-compile  # EthIfSwitchManagementSupport (currently unused) | Enables/Disables the Switch management APIs to support a Switch-port specific communication attribute access.
      float EthIfSwitchOffPortTimeDelay [0..1]: 0.001..65.535, multiplicity set at link in variant link-time / post-build in variant post-build / pre-compile in variant pre-compile, post-build-variant-multiplicity=true, post-build-variant-value=true, set at link in variant link-time+post-build / pre-compile in variant pre-compile  # Denote the time delay in seconds after the mode "ETHTRCV_MODE_DOWN" of a EthIfSwitchPortGroup will be executed. | This is only used for EthIfSwtPortGroups which not referenced by a EthIfController. The time delay shall be greater than the UdpNm timings, because UdpNm shall finish its shutdown handling. (Repeat Message State, Prepare Bus-Sleep state, Bus-Sleep state).
      integer EthIfTrcvLinkStateChgMainReload: 1..255, set at pre-compile  # Specifies the frequency of transceiver link state change checks in each | period of main function EthIf_MainFunctionTx.
      boolean EthIfVerifyConfigApi [0..0]: set at pre-compile, default-value=false  # EthIfVerifyConfigApi (currently unused) | Enables /disables EthIf_VerifyConfig API.
      boolean EthIfVersionInfoApi: set at pre-compile, default-value=false  # Enables / Disables version info API
      boolean EthIfVersionInfoApiMacro [0..0]: set at pre-compile, default-value=false  # EthIfVersionInfoApiMacro (currently unused) | Enables / Disables version info API macro implementation.
      boolean EthIfWakeUpSupport [0..0]: set at pre-compile, default-value=false  # EthIfWakeUpSupport (currently unused) | Configures if wakeup is supported or not.
