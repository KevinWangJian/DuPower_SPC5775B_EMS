AUTOSAR XML (schema 4-2-2)
package /RB/RBA/rba_Dma/EcucModuleDefs
  module definition rba_Dma: category=VENDOR_SPECIFIC_MODULE_DEFINITION, variants pre-compile  # MCAL rba_Dma Driver | Configuration of the rba_Dma module.
    container rba_DmaConfigSet  # Configuration Data Sets | This container contains the configuration parameters and sub containers of rba_Dma module.
      container rba_Dmachannel [1..*]: multiplicity set at pre-compile  # rba_Dma channel | This is the container of Dma channel
        integer rba_Dma_A1_ChannelNumber: 0..15, origin=RB:42.1.0.0:2016-10-05, set at pre-compile  # DMA channel number | Used Dma channel Number
        enumeration rba_Dma_A2_DataSize: origin=RB:42.1.0.0:2016-10-06, set at pre-compile  # DMA transfer data size | Dma transfer data size
          DMA_DATASIZE_BITS_8  # 8 data bits
          DMA_DATASIZE_BITS_16  # 16 data bits
          DMA_DATASIZE_BITS_32  # 32 data bits
          DMA_DATASIZE_BITS_64  # 64 data bits
          DMA_DATASIZE_BITS_128  # 128 data bits
        enumeration rba_Dma_A3_srcdirection: origin=RB:42.1.0.0:2016-10-07, set at pre-compile  # DMA source address count direction | Specifies the count direction of the source address
          DMA_SRC_COUNTDIRECTION_FIXED  # SRC address fixed
          DMA_SRC_COUNTDIRECTION_INCREMENT  # SRC address incremented
          DMA_SRC_COUNTDIRECTION_DECREMENT  # SRC address decremented
        enumeration rba_Dma_A4_destdirection: origin=RB:42.1.0.0:2016-10-08, set at pre-compile  # DMA destination address count direction | Specifies the count direction of the destination address.
          DMA_DST_COUNTDIRECTION_FIXED  # SRC address fixed
          DMA_DST_COUNTDIRECTION_INCREMENT  # SRC address incremented
          DMA_DST_COUNTDIRECTION_DECREMENT  # SRC address decremented
        boolean rba_Dma_A5_TXISR: origin=RB:42.1.0.0:2016-10-09, set at pre-compile  # DMA transfer complete ISR | Selection of transmission complete ISR is ON or OFF
        enumeration rba_Dma_A6_cont_on_error: origin=RB:42.1.0.0:2016-10-07, set at pre-compile  # DMA transfer continue on transfer error | Transfer error case DMA transfer disable setting
          RBA_DMA_TRANSFERERROR_TRANS_ENABLE  # Dma cycles continue on transfer error
          RBA_DMA_TRANSFERERROR_TRANS_DISABLE  # Dma cycles stop on transfer error
        boolean rba_Dma_A7_PEID2 [0..1]: origin=RB:42.1.0.0:2016-10-12, set at pre-compile  # Channel master PEID2 | Channel master PEID setting Specifies the PEID information of the master assigned to the channel.If not selected default reset value of this bit will be generated. | DMnnCM — DMAC Channel Master Setting has this bit which Specifies the PEID information of the master assigned to the channel.
        boolean rba_Dma_A8_PEID1 [0..1]: origin=RB:42.1.0.0:2016-10-13, set at pre-compile  # Channel master PEID1 | Channel master PEID setting Specifies the PEID information of the master assigned to the channel.If not selected default reset value of this bit will be generated. | DMnnCM — DMAC Channel Master Setting has this bit which Specifies the PEID information of the master assigned to the channel.
        boolean rba_Dma_A9_PEID0 [0..1]: origin=RB:42.1.0.0:2016-10-14, set at pre-compile  # Channel master PEID0 | Channel master PEID setting Specifies the PEID information of the master assigned to the channel.If not selected default reset value of this bit will be generated. | DMnnCM — DMAC Channel Master Setting has this bit which Specifies the PEID information of the master assigned to the channel.
        boolean rba_Dma_D1_SPID4 [0..1]: origin=RB:42.1.0.0:2016-10-15, set at pre-compile  # Channel master SPID4 | Specifies the SPID information used by the master assigned to the channel.If not selected default reset value of this bit will be generated. | DMnnCM — DMAC Channel Master Setting has this bit which Specifies the SPID information of the master assigned to the channel.
        boolean rba_Dma_D2_SPID3 [0..1]: origin=RB:42.1.0.0:2016-10-16, set at pre-compile  # Channel master SPID3 | Specifies the SPID information used by the master assigned to the channel.If not selected default reset value of this bit will be generated. | DMnnCM — DMAC Channel Master Setting has this bit which Specifies the SPID information of the master assigned to the channel.
        boolean rba_Dma_D3_SPID2 [0..1]: origin=RB:42.1.0.0:2016-10-17, set at pre-compile  # Channel master SPID2 | Specifies the SPID information used by the master assigned to the channel.If not selected default reset value of this bit will be generated. | DMnnCM — DMAC Channel Master Setting has this bit which Specifies the SPID information of the master assigned to the channel.
        boolean rba_Dma_D4_SPID1 [0..1]: origin=RB:42.1.0.0:2016-10-18, set at pre-compile  # Channel master SPID1 | Specifies the SPID information used by the master assigned to the channel.If not selected default reset value of this bit will be generated. | DMnnCM — DMAC Channel Master Setting has this bit which Specifies the SPID information of the master assigned to the channel.
        boolean rba_Dma_D5_SPID0 [0..1]: origin=RB:42.1.0.0:2016-10-19, set at pre-compile  # Channel master SPID0 | Specifies the SPID information used by the master assigned to the channel.If not selected default reset value of this bit will be generated. | DMnnCM — DMAC Channel Master Setting has this bit which Specifies the SPID information of the master assigned to the channel.
        boolean rba_Dma_D6_UM [0..1]: origin=RB:42.1.0.0:2016-10-20, set at pre-compile  # Channel master UM | Specifies the UM information of the master assigned to the channel.If not selected default reset value of this bit will be generated. | DMnnCM — DMAC Channel Master Setting has this bit Specifies the UM information of the master assigned to the channel.
    container rba_DmaGeneral: multiplicity set at pre-compile  # General Settings | Configuration of general rba_Dma parameters.
      boolean rba_D1_DeverrorON: origin=RB:42.1.0.0:2016-10-20, set at pre-compile  # DMA Dev error detect | Switches the Default Error Tracer (Det) detection ON or OFF.
      integer rba_D2_ModuleID: origin=RB:42.1.0.0:2016-10-21, set at pre-compile  # DMA Module ID | Selection of Dma module ID
