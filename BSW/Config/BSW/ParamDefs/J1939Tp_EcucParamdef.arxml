AUTOSAR XML (schema 4-2-2)
package /AUTOSAR_J1939Tp/EcucModuleDefs
  module definition J1939Tp [0..1]: post-build-variant-support=true, variants link-time/post-build/pre-compile  # J1939Tp(J1939 Transport Protocol) is an AUTOSAR module, based on the specifications of SAE J1939-21. This Container allows the configuration of this module. Additional Information : This module is only present in the Autosar 4.0 compliant Diagnosis Stack, and not in Autosar 3.1 or 3.2 stack
    container J1939TpConfiguration  # This container contains the configuration parameters and sub containers of the J1939Tp module that define the communication paths. This container is a MultipleConfigurationContainer, i.e. this container and its sub-containers exist once per configuration set. Currently, Post Build/Link Time Configuration is not supported in J1939Tp, and hence, all j1939Tp related containers must be configured in one Configuration Set
      container J1939TpRxChannel [0..*]  # This container describes a reception channel of the J1939Tp module. One channel is used for all N-SDUs that share the same source address (SA) and the same destination address (BAM: DA = 0xFF, CMDT: DA != 0xFF). There exists no validation error/warning to check if the ParameterGroupNumbers configured contain the same SA and DA. This has to be ensured by the configurator. Additional Info : In an RxChannel, only one of the Parameter Groups configured, can be active at any point of time. If you require parallel reception of Parameter Groups, configure them in different RxChannels.
        boolean J1939TpRxCancellationSupport [0..0]: multiplicity set at pre-compile, set at pre-compile, default-value=false  # Enable receive cancellation using the API J1939Tp_CancelReceive() for this channel.
        integer J1939TpRxDa [0..1]: 0..255, multiplicity set at post-build in variant link-time+post-build / pre-compile in variant pre-compile, post-build-variant-multiplicity=true, post-build-variant-value=true, set at post-build in variant link-time+post-build / pre-compile in variant pre-compile  # Destination address (DA) of this channel. The parameter is required only for Metadata enabled configuration. The Destination Address passed as metadata to J1939Tp will be validated against the configured J1939TpRxDa. If the RxProtocol is configured as J1939TP_CMDT then the allowed values are 0 to 253. If the RxProtocol is configured as J1939TP_BAM then the allowed value is only 255. Configuration of the value 254 is Invalid and is treated as NULL or Invalid Address.
        boolean J1939TpRxDynamicBlockCalculation [0..1]: multiplicity set at pre-compile, set at pre-compile, default-value=false  # Enable dynamic calculation of "number of packets that can be sent" value in TP.CM_CTS, based on the size of buffers in upper layers reported via StartOfReception and PduR_J1939TpCopyRxData.
        integer J1939TpRxDynamicBufferRatio [0..0]: 0..100, multiplicity set at pre-compile, set at pre-compile, default-value=80  # Percentage of available buffer that shall be used for retry. | This parameter is only applicable when "J1939TpRxRetrySupport" and "J1939TpRxDynamicBlockCalculation" are enabled.
        integer J1939TpRxPacketsPerBlock [0..1]: 1..255, multiplicity set at pre-compile, set at pre-compile, default-value=16  # Number of TP.DT frames the receiving J1939Tp module allows the sender to send before waiting for another TP.CM_CTS. This parameter is transmitted in the TP.CM_CTS frame, and is thus only relevant for reception of messages via CMDT. When J1939TpRxDynamicBlockCalculation is enabled, this parameter specifies a maximum for the calculated value. For further details on this parameter value see SAE J1939/21.
        enumeration J1939TpRxProtocolType [0..1]: {J1939TP_PROTOCOL_BAM, J1939TP_PROTOCOL_CMDT}, multiplicity set at pre-compile, set at pre-compile  # Protocol type of the referencing connection, which is either BAM or CMDT. The BAM Protocol is used for 1:n transmission/reception and does not support Flow Control Frames The CMDT Protocol is used for 1:1 transmission/reception and involves the transmission of Flow Control frames from the receiver to transmitter, in order to provide the receiving capabilities to the sender For more information on the frames, please refer SAEJ1939-21 specification.
        boolean J1939TpRxRetrySupport [0..0]: multiplicity set at pre-compile, set at pre-compile, default-value=false  # Enable support for triggering repetition of failed transmission using TP.CM_CTS with a packet number that has already been sent. Retransmission is triggered when a sequence number is missing or a timeout occurs during reception.
        integer J1939TpRxSa [0..1]: 0..253, multiplicity set at post-build in variant link-time+post-build / pre-compile in variant pre-compile, post-build-variant-multiplicity=true, post-build-variant-value=true, set at post-build in variant link-time+post-build / pre-compile in variant pre-compile  # Source address (SA) of this channel. This parameter is only required for channels with fixed SA which use N-PDUs with MetaData.
        container J1939TpRxCmNPdu  # This N-PDU represents the TP.CM frame of a J1939 transport protocol session. TP.CM is used both by BAM and CMDT to initialize the connection. For CMDT, it is also used to abort the connection. More information on the content of this frame in case of BAM and CMDT can be found in SAE J1939-21 specification.
          integer J1939TpRxCmNPduId: 0..65535, scope=ECU, set at pre-compile, symbolic-name-value=true  # The N-PDU identifier used for communication with CanIf. This is the Id that will be used by CanIf when it calls J1939Tp_RxIndication and it helps J1939Tp to map the received frame to the correct ParameterGroup
          reference J1939TpRxCmNPduRef: post-build-variant-value=true, set at post-build in variant link-time+post-build / pre-compile in variant pre-compile, destination=Pdu  # Reference to the Pdu object representing the N-PDU. The reference configured here is also used in the CanIfRxPduCfg. The mapping of Pdus between CanIf and J1939Tp is achieved by configuration of this reference.
        container J1939TpRxDtNPdu  # This N-PDU represents the TP.DT frame of a J1939 transport protocol session. TP.DT is used both by BAM and CMDT to transfer the contents of an N-SDU. More information on the content of this frame can be found in SAE J1939-21 specifications.
          integer J1939TpRxDtNPduId: 0..65535, scope=ECU, set at pre-compile, symbolic-name-value=true  # The N-PDU identifier used for communication with CanIf. This is the Id that will be used by CanIf when it calls J1939Tp_RxIndication and it helps J1939Tp to map the received frame to the correct ParameterGroup
          reference J1939TpRxDtNPduRef: post-build-variant-value=true, set at post-build in variant link-time+post-build / pre-compile in variant pre-compile, destination=Pdu  # Reference to the Pdu object representing the N-PDU. The reference configured here is also used in the CanIfRxPduCfg. The mapping of Pdus between CanIf and J1939Tp is achieved by configuration of this reference.
        container J1939TpRxPg [1..*]  # Parameter group received by the J1939 transport layer.
          boolean J1939TpRxPgDynLength: set at pre-compile  # This flag is set to TRUE when the N-SDU refers to a PGN with variable length. When this parameter is set to TRUE, it allows the sender to transmit data of length less than eight bytes directly, without using the BAM or CMDT Protocols. Additional Info: When this parameter is set to TRUE, it is mandatory to configure J1939TpRxDirectNPdu for this Parameter Group. When this parameter is set to FALSE, J1939TpRxDirectNPdu must not be configured for this Parameter Group. | Please note: When this attribute is TRUE, the sub container J1939TpRxDirectNPdu is required.
          integer J1939TpRxPgPGN: 0..262143, set at pre-compile  # PGN of the referenced N-SDUs.
          container J1939TpRxDirectNPdu [0..1]  # This N-PDU represents the short frame that is used for a dynamic length PGN when it has a length of less that 8 bytes. When this container is configured, it allows the sender to transmit data of length less than eight bytes directly, without using the BAM or CMDT Protocols. Additional Info: When this container is configured, it is mandatory to configure J1939TpRxPgDynLength as TRUE for this Parameter Group. When this container is not configured, J1939TpRxPgDynLength must be configured FALSE, for this Parameter Group | Please note: This sub container is only necessary when J1939TpRxPgDynLength is TRUE.
            integer J1939TpRxDirectNPduId: 0..65535, scope=ECU, set at pre-compile, symbolic-name-value=true  # The N-PDU identifier used for communication with CanIf. This is the Id that will be used by CanIf when it calls J1939Tp_RxIndication and it helps J1939Tp to map the received frame to the correct ParameterGroup
            reference J1939TpRxDirectNPduRef: post-build-variant-value=true, set at post-build in variant link-time+post-build / pre-compile in variant pre-compile, destination=Pdu  # Reference to the Pdu object representing the N-PDU. The reference configured here is also used in the CanIfRxPduCfg. The mapping of Pdus between CanIf and J1939Tp is achieved by configuration of this reference.
          container J1939TpRxNSdu  # This container describes the parameters that are relevant for the reception of a specific N-SDU.
            integer J1939TpRxNSduId [0..0]: 0..65535, scope=ECU, set at pre-compile, symbolic-name-value=true  # This is a unique identifier for a received N-SDU. This Id is used in the CancelReceive and ChangeParameter API call.
            reference J1939TpRxNSduRef: post-build-variant-value=true, set at post-build in variant link-time+post-build / pre-compile in variant pre-compile, destination=Pdu  # Reference to the Pdu object representing the N-SDU. The reference configured here is also used in the PduRSrcPdu. The mapping of Pdus between PduR and J1939Tp is achieved by configuration of this reference.
        container J1939TpTxFcNPdu [0..1]  # This N-PDU represents the TP.CM frame that is used in reverse direction for a J1939 transport protocol session using the CMDT protocol type. TP.CM in reverse direction is used for intermediate and final acknowledgement of received data and to abort the connection. | Please note: This sub container is only required when J1939TpRxProtocolType is J1939TP_PROTOCOL_CMDT or when it is not configured at all.
          integer J1939TpTxFcNPduTxConfId: 0..65535, scope=ECU, set at pre-compile, symbolic-name-value=true  # The N-PDU identifier used for Tx confirmation from CanIf. This is the Id that will be used by CanIf when it calls J1939Tp_TxConfirmation and it helps J1939Tp to map the received confirmation to the correct ParameterGroup
          reference J1939TpTxFcNPduRef: post-build-variant-value=true, set at post-build in variant link-time+post-build / pre-compile in variant pre-compile, destination=Pdu  # Reference to the Pdu object representing the N-PDU. The reference configured here is also used in the CanIfTxPduCfg. The mapping of Pdus between CanIf and J1939Tp is achieved by configuration of this reference. | Please note: When two channels have identical but exchanged source and destination addresses, the Pdu referenced by this parameter is shared with J1939TpTxCmNPduRef of the corresponding J1939TpTxChannel.
      container J1939TpTxChannel [0..*]  # This container describes a transmission channel of the J1939Tp module. One channel is used for all N-SDUs that share the same source address (SA) and the same destination address (BAM: DA = 0xFF, CMDT: DA != 0xFF). There exists no validation error/warning to check if the ParameterGroupNumbers configured contain the same SA and DA. This has to be ensured by the configurator. Additional Info : In a TxChannel, only one of the Parameter Groups configured, can be active at any point of time. If you require parallel Transmission of Parameter Groups, configure them in different TxChannels.
        boolean J1939TpTxCancellationSupport [0..1]: multiplicity set at pre-compile, set at pre-compile, default-value=false  # Enable transmit cancellation using the API J1939Tp_CancelTransmit() for this channel.
        integer J1939TpTxDa [0..0]: 0..253, multiplicity set at post-build in variant link-time+post-build / pre-compile in variant pre-compile, post-build-variant-multiplicity=true, post-build-variant-value=true, set at post-build in variant link-time+post-build / pre-compile in variant pre-compile  # Destination address (DA) of this channel. This parameter is only required for channels with fixed DA which use N-PDUs with MetaData containing the DA.
        boolean J1939TpTxDynamicBlockCalculation [0..1]: multiplicity set at pre-compile, set at pre-compile, default-value=false  # Enable dynamic calculation of "maximum number of packets that can be sent" value in TP.CM_RTS, based on the available amount of data in upper layers reported via PduR_J1939TpCopyTxData.
        integer J1939TpTxMaxPacketsPerBlock [0..1]: 1..255, multiplicity set at pre-compile, set at pre-compile, default-value=255  # Maximum number of TP.DT frames the transmitting J1939Tp module is ready to send before waiting for another TP.CM_CTS. This parameter is transmitted in the TP.CM_RTS frame, and is thus only relevant for transmission of messages via CMDT. When J1939TpTxDynamicBlockCalculation is enabled, this parameter specifies a maximum for the calculated value. For further details on this parameter value see SAE J1939/21.
        enumeration J1939TpTxProtocolType [0..1]: {J1939TP_PROTOCOL_BAM, J1939TP_PROTOCOL_CMDT}, multiplicity set at pre-compile, set at pre-compile  # Protocol type of the referencing connection, which is either BAM or CMDT. The BAM Protocol is used for 1:n transmission/reception and does not support Flow Control Frames The CMDT Protocol is used for 1:1 transmission/reception and involves the transmission of Flow Control frames from the receiver to transmitter, in order to provide the receiving capabilities to the sender For more information on the frames, please refer SAEJ1939-21 specification. The parameter is optional for the Metadata Enabled Configuration. The ProtocolType for a Metadata enabled Configuration is decided based on the Destination Address passed by Upper Layer. If the Destination Address is passed as 0xFF then Protocol is selected as BAM else CMDT.
        boolean J1939TpTxRetrySupport [0..0]: multiplicity set at pre-compile, set at pre-compile, default-value=false  # Enable support for repetition of failed transmission using TP.CM_CTS with a packet number that has already been sent. Retransmission is handled via the retry feature of PduR_J1939TpCopyTxData.
        integer J1939TpTxSa [0..0]: 0..253, multiplicity set at post-build in variant link-time+post-build / pre-compile in variant pre-compile, post-build-variant-multiplicity=true, post-build-variant-value=true, set at post-build in variant link-time+post-build / pre-compile in variant pre-compile  # Source address (SA) of this channel. This parameter is only required for channels with fixed SA which use N-PDUs with MetaData.
        container J1939TpRxFcNPdu [0..1]  # This N-PDU represents the TP.CM frame that is used in reverse direction for a J1939 transport protocol session using the CMDT protocol type. TP.CM in reverse direction is used for intermediate(CTS) and final acknowledgement of received data and to abort the connection. For more information on CTS, ABORT and EndOfMessageACK frames, refer to SAE J1939-21 apecifications | Please note: This sub container is only required when J1939TpRxProtocolType is J1939TP_PROTOCOL_CMDT or when it is not configured at all.
          integer J1939TpRxFcNPduId: 0..65535, scope=ECU, set at pre-compile, symbolic-name-value=true  # The N-PDU identifier used for communication with CanIf. This is the Id that will be used by CanIf when it calls J1939Tp_RxIndication and it helps J1939Tp to map the received frame to the correct ParameterGroup.
          reference J1939TpRxFcNPduRef: post-build-variant-value=true, set at post-build in variant link-time+post-build / pre-compile in variant pre-compile, destination=Pdu  # Reference to the Pdu object representing the N-PDU. The reference configured here is also used in the CanIfRxPduCfg. The mapping of Pdus between CanIf and J1939Tp is achieved by configuration of this reference. | Please note: When two channels have identical but exchanged source and destination addresses, the Pdu referenced by this parameter is shared with J1939TpRxCmNPduRef of the corresponding J1939TpRxChannel.
        container J1939TpTxCmNPdu  # This N-PDU represents the TP.CM frame of a J1939 transport protocol session. TP.CM is used both by BAM and CMDT to initialize the connection. For CMDT, it is also used to abort the connection. More information on the content of this frame in case of BAM and CMDT can be found in SAE J1939-21 specification
          integer J1939TpTxCmNPduTxConfId: 0..65535, scope=ECU, set at pre-compile, symbolic-name-value=true  # The N-PDU identifier used for Tx confirmation from CanIf. This is the Id that will be used by CanIf when it calls J1939Tp_TxConfirmation and it helps J1939Tp to map the received confirmation to the correct ParameterGroup
          reference J1939TpTxCmNPduRef: post-build-variant-value=true, set at post-build in variant link-time+post-build / pre-compile in variant pre-compile, destination=Pdu  # Reference to the Pdu object representing the N-PDU. The reference configured here is also used in the CanIfTxPduCfg. The mapping of Pdus between CanIf and J1939Tp is achieved by configuration of this reference.
        container J1939TpTxDtNPdu  # This N-PDU represents the TP.DT frame of a J1939 transport protocol session. TP.DT is used both by BAM and CMDT to transfer the contents of an N-SDU. More information on the content of this frame can be found in SAE J1939-21 specifications.
          integer J1939TpTxDtNPduTxConfId: 0..65535, scope=ECU, set at pre-compile, symbolic-name-value=true  # The N-PDU identifier used for Tx confirmation from CanIf. This is the Id that will be used by CanIf when it calls J1939Tp_TxConfirmation and it helps J1939Tp to map the received confirmation to the correct ParameterGroup.
          reference J1939TpTxDtNPduRef: post-build-variant-value=true, set at post-build in variant link-time+post-build / pre-compile in variant pre-compile, destination=Pdu  # Reference to the Pdu object representing the N-PDU. The reference configured here is also used in the CanIfTxPduCfg. The mapping of Pdus between CanIf and J1939Tp is achieved by configuration of this reference.
        container J1939TpTxPg [1..*]  # Parameter group transmitted by the J1939 transport layer.
          boolean J1939TpTxPgDynLength: set at pre-compile  # This flag is set to TRUE when the N-SDU refers to a PGN with variable length. When this parameter is set to TRUE, it allows the sender to transmit data of length less than eight bytes directly, without using the BAM or CMDT Protocols. Additional Info: When this parameter is set to TRUE, it is mandatory to configure J1939TpTxDirectNPdu for this Parameter Group. When this parameter is set to FALSE, J1939TpTxDirectNPdu must not be configured for this Parameter Group | Please note: When this attribute is TRUE, the sub container J1939TpTxDirectNPdu is required.
          integer J1939TpTxPgPGN: 0..262143, set at pre-compile  # Defines the PGN which is represented by the N-SDU.For more information on PGN, refer to SAE J1939-21 specification.
          container J1939TpTxDirectNPdu [0..1]  # This N-PDU represents the short frame that is used for a dynamic length PGN when it has a length of less that 8 bytes. When this container is configured, it allows the sender to transmit data of length less than eight bytes directly, without using the BAM or CMDT Protocols. Additional Info: When this container is configured, it is mandatory to configure J1939TpTxPgDynLength as TRUE for this Parameter Group. When this container is not configured, J1939TpTxPgDynLength must be configured FALSE, for this Parameter Group. | Please note: This sub container is only necessary when J1939TpTxPgDynLength is TRUE.
            integer J1939TpTxDirectNPduTxConfId: 0..65535, scope=ECU, set at pre-compile, symbolic-name-value=true  # The N-PDU identifier used for Tx confirmation from CanIf. This is the Id that will be used by CanIf when it calls J1939Tp_TxConfirmation and it helps J1939Tp to map the received confirmation to the correct ParameterGroup.
            reference J1939TpTxDirectNPduRef: post-build-variant-value=true, set at post-build in variant link-time+post-build / pre-compile in variant pre-compile, destination=Pdu  # Reference to the Pdu object representing the N-PDU. The reference configured here is also used in the CanIfTxPduCfg. The mapping of Pdus between CanIf and J1939Tp is achieved by configuration of this reference.
          container J1939TpTxNSdu  # This container describes the parameters that are relevant for the transmission of a specific N-SDU.
            integer J1939TpTxNSduId: 0..65535, scope=ECU, set at pre-compile, symbolic-name-value=true  # The N-SDU identifier used for communication with PduR. This is the Id that will be used by CanIf when it calls J1939Tp_Transmit and it helps J1939Tp to start a transmission on the correct the correct ParameterGroup.
            reference J1939TpTxNSduRef: post-build-variant-value=true, set at post-build in variant link-time+post-build / pre-compile in variant pre-compile, destination=Pdu  # Reference to the Pdu object representing the N-SDU. The reference configured here is also used in the PduRDestPdu The mapping of Pdus between PduR and J1939Tp is achieved by configuration of this reference.
    container J1939TpGeneral  # This container describes the general configuration parameters of the J1939Tp module.
      boolean J1939TpCancellationSupport [0..1]: multiplicity set at pre-compile, set at pre-compile, default-value=false  # Enable transmit and receive cancellation. The APIs J1939Tp_CancelTransmit() and J1939Tp_CancelReceive() will only be available when this parameter is enabled. | The APIs J1939Tp_CancelTransmit() and J1939Tp_CancelReceive() will only be available when this parameter is enabled.
      boolean J1939TpDevErrorDetect: set at pre-compile  # Switches the Development Error Detection and Notification. DET Error Reporting is presently not supported in J1939Tp. Hence, this parameter must be configured FALSE | * true: enabled (ON). * false: disabled (OFF).
      float J1939TpMainFunctionPeriod: 0..0.255, scope=ECU, set at pre-compile  # Allow to configure the time for the MainFunction (in seconds). This is used by J1939Tp to monitor the different Timing parameters specified by SAE J1939-21 and AUTOSAR | Please note: This configuration value shall be equal to the value in the ScheduleManager module.
      float J1939TpTxConfTimeout: 0..65.535, set at pre-compile  # Timeout in seconds for the CanIf Tx confirmation. The Timer starts when CanIf_Transmit is called by J1939Tp requesting for the transmission of a frame. The Timer ends when CanIf calls J1939Tp_TxConfirmation for the transmitted frame. If no Tx Confirmation is received from canIf, after this time, the J1939Tp assumes that an N-PDU could not be transmitted. | Please note: The Tx confirmation timeout should be set to a value that enabled detection of a lost Tx confirmation in time, and that ensures that normal transmission delay caused by lower message priority does not lead to an error.
      boolean J1939TpVersionInfoApi: set at pre-compile  # The function J1939Tp_GetVersionInfo is configurable (On/Off) by this configuration parameter. If configured True, J1939Tp will return the version information when J1939Tp_getVersionInfo is called.
      boolean J1939TpMetaDataSupport [0..1]: origin=RB:AR42.1.0.0:2017-01-31, set at pre-compile, default-value=false  # Metadata Support Enabled. The parameter is used to Enable the Metadata Feature for J1939Tp.
