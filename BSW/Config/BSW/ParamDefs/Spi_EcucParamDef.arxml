AUTOSAR XML (schema 4-2-2)
package /AUTOSAR_Spi/EcucModuleDefs
  module definition Spi: category=VENDOR_SPECIFIC_MODULE_DEFINITION, refined-module-def=Spi, variants pre-compile  # SPI Handler/Driver | Configuration of the Spi (Serial Peripheral Interface) module.
    container SpiDriver  # Driver configuration | Configuration of one instance (if multiplicity is 1, it is the sole configuration) of an SPI driver.
      integer SpiMaxChannel [0..1]: 0..255, multiplicity set at pre-compile, set at pre-compile, with-auto=true  # Num of channel configured | This parameter contains the number of Channels con-figured. It will be gathered by tools during the configuration stage. This parameter is currently not supported.
      integer SpiMaxJob [0..1]: 0..65535, multiplicity set at pre-compile, set at pre-compile, with-auto=true  # Num of job configured | Total number of Jobs configured. This parameter is currently not supported.
      integer SpiMaxSequence [0..1]: 0..255, multiplicity set at pre-compile, set at pre-compile, with-auto=true  # Num of sequence configured | Total number of Sequences configured. This parameter is currently not supported.
      container SpiChannel [1..*]: multiplicity set at pre-compile  # Channel | Configuration of a SPI channel.
        integer SpiChannelId: 0..65535, set at pre-compile, symbolic-name-value=true, with-auto=true  # Channel ID | Numeric identifier of the SPI channel.
        enumeration SpiChannelType: set at pre-compile, with-auto=true  # Buffer type | This parameter specifies the used buffer type which can be external (EB) or internal (IB).
          EB  # External Buffer
          IB  # Internal Buffer
        integer SpiDataWidth: 1..16, set at pre-compile, with-auto=true  # Data width | Data width of a transmitted data unit (SPI word).
        integer SpiDefaultData: 0..4294967295, set at pre-compile, with-auto=true  # Default data | The default data to be transmitted when the pointer to the TX buffer passed to Spi_WriteIB (for internal buffer) or to Spi_SetupEB (for external buffer) is a NULL_PTR.
        integer SpiEbMaxLength [0..1]: 0..65535, multiplicity set at pre-compile, set at pre-compile, with-auto=true  # EB maximum length | This parameter contains the maximum size (in bytes) of data buffers in case of EB channels and only.
        enumeration SpiHwUnitSynchronous [0..1]: {Asynchronous, Synchronous}, multiplicity set at pre-compile, set at pre-compile, with-auto=true  # HW unit synchronous | If SpiHwUnitSynchronous is set to "Synchronous", the SpiChannel uses its containing SpiDriver in a synchronous manner. If it is set to "Asynchronous", it uses the driver in an asynchronous way. If the parameter is not set, the SpiChannel uses the driver also in an asynchronous way.
        integer SpiIbNBuffers [0..1]: 0..65535, multiplicity set at pre-compile, set at pre-compile, with-auto=true  # IB maximum buffers | This parameter contains the maximum number of data buffers in case of IB channels and only. This parameter is currently not supported.
        enumeration SpiRbEdl: {TRUE, FALSE}, origin=RB:0.1.0:2016-01-01, set at pre-compile  # EnableEDL | This parameter defines if extended data length transmission is used or not for channel transmission. This configuration should match with the HW unit configuration used for transmitting the job under which this channel is referenced.
        enumeration SpiTransferStart [0..1]: multiplicity set at pre-compile, set at pre-compile, with-auto=true  # Transfer start | This parameter defines the starting bit of a transmission.
          LSB  # LSB first
          MSB  # MSB first
      container SpiExternalDevice [1..*]: multiplicity set at pre-compile  # External device | Configuration of the communication settings of an external device.
        float SpiBaudrate [0..1]: multiplicity set at pre-compile, set at pre-compile, with-auto=true  # Baudrate | This parameter is the communication baud rate specified in kBaud. This parameter is currently not supported.
        enumeration SpiCsIdentifier: set at pre-compile  # CS identifier | This parameter is the symbolic name to identify the chip select (CS) allocated to this job.
          SPI_CSIH_FE  # Chip Select 0
          SPI_CSIH_FD  # Chip Select 1
          SPI_CSIH_FB  # Chip Select 2
          SPI_CSIH_F7  # Chip Select 3
          SPI_CSIH_EF  # Chip Select 4
          SPI_CSIH_DF  # Chip Select 5
          SPI_CSIH_BF  # Chip Select 6
          SPI_CSIH_7F  # Chip Select 7
        enumeration SpiCsPolarity [0..1]: multiplicity set at pre-compile, set at pre-compile, with-auto=true  # CS active polarity | This parameter defines the active polarity of the chip select.
          HIGH  # High
          LOW  # Low
        enumeration SpiCsSelection [0..1]: multiplicity set at pre-compile, set at pre-compile, with-auto=true  # CS handled by | AUTOSAR definition of this parameter is unclear. This parameter is currently not supported.
          CS_VIA_GPIO  # GPIO
          CS_VIA_PERIPHERAL_ENGINE  # SPI HW
        enumeration SpiDataShiftEdge [0..1]: multiplicity set at pre-compile, set at pre-compile, with-auto=true  # Data shift edge | This parameter defines the clock edge which is used to shift the data onto the SPI bus. This parameter is currently not supported.
          LEADING  # Leading
          TRAILING  # Trailing
        boolean SpiEnableCs [0..1]: multiplicity set at pre-compile, set at pre-compile, with-auto=true  # Enable CS | AUTOSAR definition of this parameter is unclear. This parameter is currently not supported.
        enumeration SpiHwUnit: set at pre-compile  # HW unit | This parameter is the symbolic name to identify the HW SPI microcontroller peripheral allocated to this job.
          CSIH{0..3}  # Spi{0..3}
        integer SpiRbDevDelayInact [0..1]: 0..100000, multiplicity set at pre-compile, origin=RB:0.1.0:2016-01-01, set at pre-compile, with-auto=true  # Inactive delay | Inactive delay in nanoseconds after release of the slave select output and before asserting the next slave select output cycle.
        integer SpiRbDevDelayLead [0..1]: 0..100000, multiplicity set at pre-compile, origin=RB:0.1.0:2016-01-01, set at pre-compile, with-auto=true  # Leading delay | Leading delay in nanoseconds after asserting the slave select output until clock signal will start.
        integer SpiRbDevDelayTrail [0..1]: 0..100000, multiplicity set at pre-compile, origin=RB:0.1.0:2016-01-01, set at pre-compile, with-auto=true  # Trailing delay | Trailing delay in nanoseconds before releasing the slave select output after the clock signal has finished.
        integer SpiRbHwUnitCfg: 0..65535, origin=RB:0.1.0:2016-01-01, set at pre-compile  # HW unit cfg | The HW configuration id used by the job.
        enumeration SpiRbIdleState [0..1]: {ACTIVE, INACTIVE}, multiplicity set at pre-compile, origin=RB:0.1.0:2016-01-01, set at pre-compile  # Idle state | The state of chip select after data is transmitted on SPI bus.
        enumeration SpiShiftClockIdleLevel [0..1]: multiplicity set at pre-compile, set at pre-compile, with-auto=true  # Clock idle level | This parameter defines the SPI shift clock idle level. This parameter is currently not supported.
          HIGH  # High
          LOW  # Low
        float SpiTimeClk2Cs [0..1]: 0..0.0001, multiplicity set at pre-compile, set at pre-compile, with-auto=true  # Clock to CS time | Timing between clock and chip select (in seconds). This parameter allows to use a range of values from 0 up to 0.0001 seconds. This parameter is currently not supported.
      container SpiJob [1..*]: multiplicity set at pre-compile  # Job | Configuration of a SPI job.
        function name SpiJobEndNotification [0..1]: multiplicity set at pre-compile, set at pre-compile, with-auto=true  # End notification function | This parameter is a reference to a notification function called at the end of the job (callback function).
        integer SpiJobId: 0..65535, set at pre-compile, symbolic-name-value=true, with-auto=true  # Job ID | Numeric identifier of the SPI job.
        integer SpiJobPriority [0..1]: 0..3, multiplicity set at pre-compile, set at pre-compile, with-auto=true  # Priority | Priority of the job: 0 := lowest to 3 := highest priority. The lowest priority shall be used for most cases. Please note that the order of jobs of a sequence must be with decreasing priority (highest prio first, lowest prio last, same prio OK). This parameter is currently not supported.
        enumeration SpiRbJobTrsmMod [0..1]: multiplicity set at pre-compile, origin=RB:0.1.0:2016-01-01, set at pre-compile, with-auto=true  # Transmission mode | Transmission mode of the job which may be single or continuous.
          SINGLE  # Single
          CONTINUOUS  # Continuous
        reference SpiDeviceAssignment: set at pre-compile, destination=SpiExternalDevice  # Device assignment | Reference to the external device used by this job.
        container SpiChannelList [1..*]: multiplicity set at pre-compile  # Channel list | References to SPI channels and their order within the job.
          integer SpiChannelIndex: 0..255, set at pre-compile, with-auto=true  # Channel index | This parameter specifies the order of channels within the job. It shall start at 0 for the 1st channel and increment with every consecutive channel.
          reference SpiChannelAssignment: set at pre-compile, destination=SpiChannel  # Channel assignment | Reference to the SPI channel to be used by this job.
      container SpiRbHwunit [1..4]: multiplicity set at pre-compile  # Hw unit | This container specifies the HW units to be initialised and the configuration
        integer SpiRbHWConfiguration: set at pre-compile  # Initial HW configuration | The HW configuration id used by the HW unit during initialisation.
        enumeration SpiRbHWMode: set at pre-compile  # Operation mode | The operation mode of the HW unit. i.e. either master or slave. The HW unit is initialised to the specified mode.
          MASTER  # Master Mode
          SLAVE  # Slave Mode
      container SpiSequence [1..*]: multiplicity set at pre-compile  # Sequence | Configuration of a SPI sequence.
        boolean SpiInterruptibleSequence [0..1]: multiplicity set at pre-compile, set at pre-compile, with-auto=true  # Interruptible sequence | This parameter specifies if this sequence may be interrupted at job boundaries.
        function name SpiSeqEndNotification [0..1]: multiplicity set at pre-compile, set at pre-compile, with-auto=true  # End notification function | This parameter is a reference to a notification function.
        integer SpiSequenceId: 0..65535, set at pre-compile, symbolic-name-value=true, with-auto=true  # Sequence ID | Numeric identifier of the SPI sequence.
        reference SpiJobAssignment [1..*]: multiplicity set at pre-compile, set at pre-compile, destination=SpiJob  # Job assignment | The job referenced by the sequence. Currently each sequence can have only one job.
    container SpiGeneral  # General settings | General configuration settings for SPI-Handler.
      boolean SpiCancelApi [0..1]: multiplicity set at pre-compile, set at pre-compile, with-auto=true  # Cancel API | Switches the Spi_Cancel function ON or OFF. Cancel functionality is not supported, set it to OFF. This parameter is currently not supported.
      integer SpiChannelBuffersAllowed: 0..2, set at pre-compile  # Channel buffers allowed | Selects the SPI Handler/Driver Channel Buffers usage allowed and delivered. IB = 0; EB = 1; IB/EB = 2 The current implementation only supports external buffers. Therefore this parameter must be set to 1.
      integer SpiDataWidth [0..1]: 1..32, multiplicity set at pre-compile, set at pre-compile, with-auto=true  # Data width | This parameter is the width of a transmitted data unit. This parameter is currently not supported. Instead the data width is configured for each channel .
      integer SpiDefaultData [0..1]: 0..4294967295, multiplicity set at pre-compile, set at pre-compile, with-auto=true  # Default data | The default data to be transmitted when (for internal buffer or external buffer) the pointer passed to Spi_WriteIB (for internal buffer) or to Spi_SetupEB (for external buffer) is NULL. This parameter is currently not supported.
      boolean SpiDevErrorDetect: set at pre-compile  # Development error detection | Switches the Development Error Detection and Notification ON or OFF.
      boolean SpiHwStatusApi: set at pre-compile  # HW status API | Switches the Spi_GetHWUnitStatus function ON or OFF.
      boolean SpiInterruptibleSeqAllowed [0..1]: multiplicity set at pre-compile, set at pre-compile, with-auto=true  # Interruptible sequence allowed | Switches the Interruptible Sequences handling functionality ON or OFF. This functionality is currently not supported. dependency: This parameter depends on SPI_LEVEL_DELIVERED value. It is only used for SPI_LEVEL_DELIVERED configured to 1 or 2
      integer SpiLevelDelivered: 0..2, set at pre-compile  # Level delivered | Selects the SPI Handler/Driver level of scalable functionality that is available and delivered.
      integer SpiRbAsyncMaxLength [0..1]: 1..128, multiplicity set at pre-compile, origin=RB:0.1.0:2016-03-14, set at pre-compile, with-auto=true  # Maximum bytes for Asynchronous transmission | This parameter contains the maximum number of bytes that can be transmitted in asynchronous mode. The CSIH peripheral can transmit maximum of 128 bytes(64 words) in asynchronous mode for master operation.
      boolean SpiRbCheckErrors: origin=RB:0.1.0:2016-01-01, set at pre-compile  # Enable error check | Switches if hardware errors are to be to checked or not.
      function name SpiRbDemReportErrorStatus: origin=RB:0.1.0:2016-01-01, set at pre-compile  # DEM Report Error function | The api to which the DEM errors should be reported. It should be Dem_ReportErrorStatus
      integer SpiRbEbMaxLength: 1..65535, origin=RB:0.1.0:2016-03-14, set at pre-compile  # EB max length | This parameter contains the maximum size (in bytes) of data buffers that can be transmitted in both synchronous mode and asynchronous mode. This parameter is valid only for external buffers. Currently only external buffers are supported.
      boolean SpiRbEnableInterruptSlavemode: origin=RB:0.1.0:2016-01-01, set at pre-compile  # Enable Interrupt in slave mode | Enable/disable interrupts in slave mode SpiLevelDelivered should be configured as 1 or 2 for slave mode
      integer SpiRbErrorBitmask: origin=RB:0.1.0:2016-01-01, set at pre-compile  # Error Bitmask | The bitmask of errors to be checked
      boolean SpiRbInitHwUnits: origin=RB:0.1.0:2016-01-01, set at pre-compile  # Disable Re-configuration of HW unit at runtime | Enable/disable reconfiguration of HW units during run time When the HW unit configuration during initialisation does not match the HW unit configuration required by the job, this feature allows to reconfigure the HW unit with different configuration during runtime.
      integer SpiRbMaxHWunitCfg: 0..255, origin=RB:0.1.0:2016-01-01, set at pre-compile  # Maximum HW unit cfg | Define the maximum number of hardware configurations.
      integer SpiRbNumberCsihInstances: 0..255, origin=RB:0.1.0:2016-01-01, set at pre-compile  # Number of CSIH instances | Define the maximum number of CSIH instances available. It should be configured as 4.
      boolean SpiRbPmmDts: origin=RB:0.1.0:2017-03-17, set at pre-compile  # PMM DTS transfer support | Enable\Disable DMA-DTS transfer
      boolean SpiRbSlaveModeEnable: origin=RB:0.1.0:2016-01-01, set at pre-compile  # Enable slave mode | Enable/disable slave mode SpiLevelDelivered should be configured as 1 or 2 for slave mode
      enumeration SpiRbVariant: origin=RB:0.1.0:2016-01-01, set at pre-compile  # Variant | Choose the variant used.
        SPI_RH850_R1X  # RH850_R1X
        SPI_RH850_P1X  # RH850_P1X
      boolean SpiVersionInfoApi: set at pre-compile  # Version information API | Switches the Spi_GetVersionInfo function ON or OFF.
      container SpiRbInterruptAddress [1..4]: multiplicity set at pre-compile  # Receive Interrupt Address | Address of the CSIHTIR interrupt of used HW units
        integer SpiRbAddress: origin=RB:0.1.0:2016-01-01, set at pre-compile  # Receive Interrupt Address | For RH850P1X
      container Spi_Csih_HwRegCfg [1..*]: multiplicity set at pre-compile  # HW Register Config | This container holds CSIH module register configuration parameters and its values
        enumeration Spi_Csih_Chip_select_0: origin=RB:0.1.0:2014-12-29, set at pre-compile  # Chip Select 0 | Selects the active output level of chip select signal 0.
          SPI_CSIH0  # Active Low
          SPI_CSIH1  # Active high
        enumeration Spi_Csih_Chip_select_1: origin=RB:0.1.0:2014-12-29, set at pre-compile  # Chip Select 1 | Selects the active output level of chip select signal 1.
          SPI_CSIH0  # Active Low
          SPI_CSIH1  # Active high
        enumeration Spi_Csih_Chip_select_2: origin=RB:0.1.0:2014-12-29, set at pre-compile  # Chip Select 2 | Selects the active output level of chip select signal 2.
          SPI_CSIH0  # Active Low
          SPI_CSIH1  # Active high
        enumeration Spi_Csih_Chip_select_3: origin=RB:0.1.0:2014-12-29, set at pre-compile  # Chip Select 3 | Selects the active output level of chip select signal 3.
          SPI_CSIH0  # Active Low
          SPI_CSIH1  # Active high
        enumeration Spi_Csih_Chip_select_4: origin=RB:0.1.0:2014-12-29, set at pre-compile  # Chip Select 4 | Selects the active output level of chip select signal 4.
          SPI_CSIH0  # Active Low
          SPI_CSIH1  # Active high
        enumeration Spi_Csih_Chip_select_5: origin=RB:0.1.0:2014-12-29, set at pre-compile  # Chip Select 5 | Selects the active output level of chip select signal 5.
          SPI_CSIH0  # Active Low
          SPI_CSIH1  # Active high
        enumeration Spi_Csih_Chip_select_6: origin=RB:0.1.0:2014-12-29, set at pre-compile  # Chip Select 6 | Selects the active output level of chip select signal 6.
          SPI_CSIH0  # Active Low
          SPI_CSIH1  # Active high
        enumeration Spi_Csih_Chip_select_7: origin=RB:0.1.0:2014-12-29, set at pre-compile  # Chip Select 7 | Selects the active output level of chip select signal 7.
          SPI_CSIH0  # Active Low
          SPI_CSIH1  # Active high
        enumeration Spi_Csih_Clk_inv: origin=RB:0.1.0:2014-12-29, set at pre-compile  # Clock inversion | Configures CSIHSCK clock inversion function.
          SPI_CSIH0  # High Level
          SPI_CSIH1  # Low Level
        enumeration Spi_Csih_Css_Lst: origin=RB:0.1.0:2014-12-29, set at pre-compile  # CSS after last bit transfer | Selects the chip select signal behavior after last data transfer.
          SPI_CSIH0  # Active level
          SPI_CSIH1  # Inactive level
        enumeration Spi_Csih_DCS: origin=RB:0.1.0:2014-12-29, set at pre-compile  # Data consistency check | Enables/disables Data Consistency Check.
          SPI_CSIH0  # Disabled
          SPI_CSIH1  # Enabled
        enumeration Spi_Csih_EDL: origin=RB:0.1.0:2014-12-29, set at pre-compile  # EDL mode | Enables/disables Extended Data Length (EDL) mode.
          SPI_CSIH0  # Disabled
          SPI_CSIH1  # Enabled
        enumeration Spi_Csih_IdleStCtrl_enable: origin=RB:0.1.0:2015-06-16, set at pre-compile  # Idle state control mode | Enables/disables Idle state control mode.
          SPI_CSIH0  # Disabled
          SPI_CSIH1  # Enabled
        enumeration Spi_Csih_Job_En: origin=RB:0.1.0:2014-12-29, set at pre-compile  # Enable job mode | Enables/disables job mode.
          SPI_CSIH0  # Disabled
          SPI_CSIH1  # Enabled
        enumeration Spi_Csih_LoopBack: origin=RB:0.1.0:2014-12-29, set at pre-compile  # Loop-Back mode | Controls loop-back mode (LBM).
          SPI_CSIH0  # Deactivate
          SPI_CSIH1  # Activate
        enumeration Spi_Csih_Mem_bypass: origin=RB:0.1.0:2014-12-29, set at pre-compile  # Memory Bypass | Bypasses the memory for transmission and/or reception data.
          SPI_CSIH0  # Memory Mode
          SPI_CSIH1  # Direct Access Mode
        enumeration Spi_Csih_Memory_mode: origin=RB:0.1.0:2014-12-29, set at pre-compile  # Memory mode | Selects the memory mode.
          SPI_CSIH0  # FIFO
          SPI_CSIH1  # Dual buffer
          SPI_CSIH2  # Transmit-only buffer
        enumeration Spi_Csih_Prio: origin=RB:0.1.0:2014-12-29, set at pre-compile  # Priority based communication | Sets the CPU-controlled priority-based communication function.
          SPI_CSIH0  # Disable
          SPI_CSIH1  # Enable
        enumeration Spi_Csih_Recp_enable: origin=RB:0.1.0:2014-12-29, set at pre-compile  # Enable Reception | Enables/disables reception.
          SPI_CSIH0  # Disabled
          SPI_CSIH1  # Enabled
        enumeration Spi_Csih_Sampling_time: origin=RB:0.1.0:2014-12-29, set at pre-compile  # Set Sampling time | Sets the internal sampling time for receive data input.
          SPI_CSIH0  # Standard sampling
          SPI_CSIH1  # Shifted sampling
        enumeration Spi_Csih_Slave_select: origin=RB:0.1.0:2014-12-29, set at pre-compile  # Enable Slave Select | Enables/disables the slave select function.
          SPI_CSIH0  # Disabled
          SPI_CSIH1  # Enabled
        enumeration Spi_Csih_Stop_com: origin=RB:0.1.0:2014-12-29, set at pre-compile  # Stop Communication | Stops communication at the end of the current job.
          SPI_CSIH0  # No action
          SPI_CSIH1  # Stop communication
        integer Spi_Csih_Time_out: 0..31, origin=RB:0.1.0:2014-12-29, set at pre-compile  # Timeout in FIFO mode | Selects the time-out setting in FIFO mode.
        enumeration Spi_Csih_Trans_enable: origin=RB:0.1.0:2014-12-29, set at pre-compile  # Enable Transmission | Enables/disables transmission.
          SPI_CSIH0  # Disabled
          SPI_CSIH1  # Enabled
        container Spi_Csih_BR_PreConf [0..1]: multiplicity set at pre-compile  # Baudrate Pre-Configuration P1x | This container holds 4 different communication baud rates that can be pre-configured. One of these baud rates can be selected for each chip select later.
          enumeration Spi_Csih_BaudrateBand: origin=RB:0.1.0:2015-06-05, set at pre-compile, default-value=SPI_CSIH_ALPHA_0  # Select Operation Mode and Baudrate band | This parameter holds the operation mode and appropriate Baudrate band under which the 4 Pre-Configured Baudrates can be best fitted.
            SPI_CSIH_ALPHA_0  # Baudrate band 0 -> 19536.02 to 20000000 Hz (Master Mode)
            SPI_CSIH_ALPHA_1  # Baudrate band 1 -> 9768.01 to 20000000 Hz (Master Mode)
            SPI_CSIH_ALPHA_2  # Baudrate band 2 -> 4884.00 to 20000000 Hz (Master Mode)
            SPI_CSIH_ALPHA_3  # Baudrate band 3 -> 2442.00 to 10000000 Hz (Master Mode)
            SPI_CSIH_ALPHA_4  # Baudrate band 4 -> 1221.00 to 5000000 Hz (Master Mode)
            SPI_CSIH_ALPHA_5  # Baudrate band 5 -> 610.50 to 2500000 Hz (Master Mode)
            SPI_CSIH_ALPHA_6  # Baudrate band 6 -> 305.25 to 1250000 Hz (Master Mode)
            SPI_CSIH_ALPHA_7  # External clock (Slave mode)
          float Spi_Csih_Baudrate_0: 0..20000000, origin=RB:0.1.0:2015-06-05, set at pre-compile, default-value=1000000  # Baudrate Pre-Config 0 (Master mode) | This parameter gives the first choice out of 4 pre-configurable baud rates and allows using a range of values in Hz.
          float Spi_Csih_Baudrate_1: 0..20000000, origin=RB:0.1.0:2015-06-05, set at pre-compile, default-value=1000000  # Baudrate Pre-Config 1 (Master mode) | This parameter gives the second choice out of 4 pre-configurable baud rates and allows using a range of values in Hz.
          float Spi_Csih_Baudrate_2: 0..20000000, origin=RB:0.1.0:2015-06-05, set at pre-compile, default-value=1000000  # Baudrate Pre-Config 2 (Master mode) | This parameter gives the third choice out of 4 pre-configurable baud rates and allows using a range of values in Hz.
          float Spi_Csih_Baudrate_3: 0..20000000, origin=RB:0.1.0:2015-06-05, set at pre-compile, default-value=1000000  # Baudrate Pre-Config 3 (Master mode) | This parameter gives the last choice out of 4 pre-configurable baud rates and allows using a range of values in Hz.
        container Spi_Csih_BR_PreConfR1x [0..1]: multiplicity set at pre-compile  # Baudrate Pre-Configuration R1x | This container holds 4 different communication baud rates that can be pre-configured. One of these baud rates can be selected for each chip select later.
          integer Spi_Csih_Baudrate{0..3}: 0..4095, origin=RB:0.1.0:2015-06-05, set at pre-compile  # Baudrate Pre-Config {0..3} | This container contains the CSIHnBRS{0..3} register setting. In slave mode configure 0.
          enumeration Spi_Csih_Opn_mode: origin=RB:0.1.0:2015-06-05, set at pre-compile  # Select operation mode and reference clock | Selection of the operation mode and the reference clock value.
            SPI_CSIH0  # Master mode(PCLK)
            SPI_CSIH1  # Master mode(PCLK/2)
            SPI_CSIH2  # Master mode(PCLK/4)
            SPI_CSIH3  # Master mode(PCLK/8)
            SPI_CSIH4  # Master mode(PCLK/16)
            SPI_CSIH5  # Master mode(PCLK/32)
            SPI_CSIH6  # Master mode(PCLK/64)
            SPI_CSIH7  # Slave mode(External clock)
        container Spi_Csih_HwCfgReg [8..8]  # Register Config | This container holds CSIH Configuration register configuration parameters. This container must be configured 8 times. Each configuration corresponds to one chip select.
          enumeration Spi_Csih_Select_CKP_DAP: origin=RB:0.1.0:2014-12-29, set at pre-compile  # Select Clock phase & Data phase | Selects Clock phase and Data phase.
            SPI_CSIH{0..3}  # Clock&Data phase{0..3}
          enumeration Spi_Csih_Select_DIR: origin=RB:0.1.0:2014-12-29, set at pre-compile  # Select Direction | Selects the serial data direction of chip select signal x.
            SPI_CSIH0  # MSB First
            SPI_CSIH1  # LSB First
          integer Spi_Csih_Select_DL: 0..15, origin=RB:0.1.0:2014-12-29, set at pre-compile  # Select Data Length | Selects the data length for chip select signal x.
          integer Spi_Csih_Select_Hold_time: 0..15, origin=RB:0.1.0:2014-12-29, set at pre-compile  # Select hold time | Selects the Hold time for chip select signal x.
          enumeration Spi_Csih_Select_Idle_Enfor: origin=RB:0.1.0:2014-12-29, set at pre-compile  # Select Idle enforcement | Selects the idle enforcement configuration for chip select x.
            SPI_CSIH0  # Idle_enforce0
            SPI_CSIH1  # Idle_enforce1
          integer Spi_Csih_Select_Idle_time: 0..7, origin=RB:0.1.0:2014-12-29, set at pre-compile  # Select Idle time | Selects the idle time for chip select signal x.
          integer Spi_Csih_Select_Inter_time: 0..15, origin=RB:0.1.0:2014-12-29, set at pre-compile  # Select inter_data delay time | Selects the inter-data delay time for chip select signal x.
          enumeration Spi_Csih_Select_Parity: origin=RB:0.1.0:2014-12-29, set at pre-compile  # Select the Parity | Selects the parity for sending or receiving chip select signal x.
            SPI_CSIH{0..3}  # SPI Parity_Selection {0..3}
          enumeration Spi_Csih_Select_Recessive: origin=RB:0.1.0:2014-12-29, set at pre-compile  # Select the Recessive config | Selects the recessive configuration for broadcasting for chip select x.
            SPI_CSIH0  # Dominant
            SPI_CSIH1  # Recessive
          integer Spi_Csih_Select_setup_time: 0..15, origin=RB:0.1.0:2014-12-29, set at pre-compile  # Select setup time | Selects the Setup time for chip select signal x.
          enumeration Spi_Csih_Set_Baudrate: origin=RB:0.1.0:2014-12-29, set at pre-compile  # Set Baudrate | This parameter allows to select a baudrate for the chip select signal.
            SPI_CSIH{0..3}  # Baudrate Pre-Config {0..3}
    container SpiPmmConfig [0..1]: multiplicity set at pre-compile  # PMM Configuration | Configuration of a SPI with PMM
      integer SpiCsihUnit: 0..3, multiplicity set at pre-compile, origin=RB:0.1.0:2017-03-17, set at pre-compile  # CSIH HW Channel | CSIH hardware unit
      integer SpiTg: 0..7, multiplicity set at pre-compile, origin=RB:0.1.0:2017-03-17, set at pre-compile  # Transfer group | Specify the transfer group
      integer SpiTgPriority: 0..5, multiplicity set at pre-compile, origin=RB:0.1.0:2017-03-17, set at pre-compile  # Transfer group Priority | Specifying the priority of the transfer group
