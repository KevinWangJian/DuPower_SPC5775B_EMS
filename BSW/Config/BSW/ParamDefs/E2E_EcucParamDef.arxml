AUTOSAR XML (schema 4-2-2)
package /AUTOSAR_E2E/EcucModuleDefs
  module definition E2E [0..1]: variants pre-compile  # RB specific configuration of the E2E (E2E routines) module.
    container E2ERbGeneral: multiplicity set at   # E2E general configurations | General configuration of component E2E. The general configuration defines the functions, provided by the E2E module.
      boolean E2ERbVersionInfoApi: multiplicity set at , origin=RB, set at pre-compile, default-value=true  # E2E version information API configuration | Enables the functions for reading the module version information. For E2EVersionInfoApi the default value is "enabled". For disabling of E2EVersionInfoApi voting is required.
      boolean E2ERbStateMachine: multiplicity set at , origin=RB, set at pre-compile, default-value=true  # E2E state machine configuration | Switch to enable/disable availability of the generic state handling methods.
      boolean E2ERbProfile1: multiplicity set at , origin=RB, set at pre-compile, default-value=true  # E2E profile 1 configuration | Switch to enable/disable the availability of the E2E profile 1 communication protection method. If E2ERbProfile1 calculation is enabled the Crc calculation method Crc8 must be selected in the configuration of the module Crc. For E2ERbProfile1 the default value is "enabled".
      boolean E2ERbProfile2: multiplicity set at , origin=RB, set at pre-compile, default-value=true  # E2E profile 2 configuration | Switch to enable/disable availability of the E2E profile 2 communication protection method. If E2ERbProfile2 calculation is enabled the Crc calculation method Crc8 must be selected in the configuration of the module Crc. For E2ERbProfile2 the default value is "enabled".
      boolean E2ERbProfile4: multiplicity set at , origin=RB, set at pre-compile, default-value=true  # E2E profile 4 configuration | Switch to enable/disable availability of the E2E profile 4 communication protection method. If E2ERbProfile4 calculation is enabled the Crc calculation method Crc32P4 must be selected in the configuration of the module Crc. For E2ERbProfile4 the default value is "enabled".
      enumeration E2ERbHeaderBitOrderProfile4: {ORDER_UNCHANGED, ORDER_FLIPPED}, multiplicity set at , origin=RB, set at pre-compile, default-value=ORDER_FLIPPED  # E2E profile 4: bit order of header information | Defines if the bit order of elements within the message header is changed.ORDER_UNCHANGED: order is not changedORDER_FLIPPED: order is flipped
      boolean E2ERbProfile5: multiplicity set at , origin=RB, set at pre-compile, default-value=true  # E2E profile 5 configuration | Switch to enable/disable availability of the E2E profile 5 communication protection method. If E2ERbProfile5 calculation is enabled the Crc calculation method Crc16 must be selected in the configuration of the module Crc. For E2ERbProfile5 the default value is "enabled".
      enumeration E2ERbHeaderBitOrderProfile5: {ORDER_UNCHANGED, ORDER_FLIPPED}, multiplicity set at , origin=RB, set at pre-compile, default-value=ORDER_UNCHANGED  # E2E profile 5: bit order of header information | Defines if the bit order of elements within the message header is changed.ORDER_UNCHANGED: order is not changedORDER_FLIPPED: order is flipped
      enumeration E2ERbDataIDBitOrderProfile5: {ORDER_UNCHANGED, ORDER_FLIPPED}, multiplicity set at , origin=RB, set at pre-compile, default-value=ORDER_UNCHANGED  # E2E profile 5: bit order of Data ID | Defines if the bit order of the Data ID used for CRC calculation is changed.ORDER_UNCHANGED: order is not changedORDER_FLIPPED: order is flipped
      boolean E2ERbProfile6: multiplicity set at , origin=RB, set at pre-compile, default-value=true  # E2E profile 6 configuration | Switch to enable/disable availability of the E2E profile 6 communication protection method. If E2ERbProfile6 calculation is enabled the Crc calculation method Crc16 must be selected in the configuration of the module Crc. For E2ERbProfile6 the default value is "enabled".
      enumeration E2ERbHeaderBitOrderProfile6: {ORDER_UNCHANGED, ORDER_FLIPPED}, multiplicity set at , origin=RB, set at pre-compile, default-value=ORDER_FLIPPED  # E2E profile 6: bit order of header information | Defines if the bit order of elements within the message header is changed.ORDER_UNCHANGED: order is not changedORDER_FLIPPED: order is flipped
      enumeration E2ERbDataIDBitOrderProfile6: {ORDER_UNCHANGED, ORDER_FLIPPED}, multiplicity set at , origin=RB, set at pre-compile, default-value=ORDER_FLIPPED  # E2E profile 6: bit order of Data ID | Defines if the bit order of the Data ID used for CRC calculation is changed.ORDER_UNCHANGED: order is not changedORDER_FLIPPED: order is flipped
      boolean E2ERbProfile7: multiplicity set at , origin=RB, set at pre-compile, default-value=true  # E2E profile 7 configuration | Switch to enable/disable availability of the E2E profile 7 communication protection method. If E2ERbProfile7 calculation is enabled the Crc calculation method Crc64 must be selected in the configuration of the module Crc. For E2ERbProfile7 the default value is "enabled".
      enumeration E2ERbHeaderBitOrderProfile7: {ORDER_UNCHANGED, ORDER_FLIPPED}, multiplicity set at , origin=RB, set at pre-compile, default-value=ORDER_FLIPPED  # E2E profile 7: bit order of header information | Defines if the bit order of elements within the message header is changed.ORDER_UNCHANGED: order is not changedORDER_FLIPPED: order is flipped
      boolean E2ERbCheckStatusTypeCompatibilityMode: multiplicity set at , origin=RB, set at pre-compile, default-value=true  # Check Status Type Compatibility Mode (E2E_P0XCheckStatusType) | Switch to enable/disable the compatibility to AUTOSAR for E2E_P01CheckStatusType and E2E_P02CheckStatusType. If compatibility mode is enabled then the E2E_P0XCheckStatusType is implemented like originaly in the AUTOSAR specification defined (default). If the compatibility mode is disabled the E2E_P0XCheckStatusType is implemented like originaly in the Autosar specification before 4.2 defined to use similar values like in Profile 5 and 6.
      enumeration E2ERbCheckParameterType: {E2E_INTEGRATED, E2E_MANUAL, E2E_NONE}, multiplicity set at , origin=RB, set at pre-compile, default-value=E2E_INTEGRATED  # Check Parameter Type (E2E_P0XConfigType) | Defines the method to check the contents of the configuration structure of type E2E_P0XConfigType.E2E_INTEGRATED: Check is integrated within the E2E_P0XProtect/E2E_P0XCheck functions. This means the check is executed every time E2E_P0XProtect or E2E_P0XCheck is called and will increase the security by preventing unexpected behavior of the function in case of a misconfiguration but slightly increase the runtime.E2E_MANUAL: Check is available as additional function. The function rba_E2E_P0XCheckConfigType() can be called once or multiple times (depends on the use case) before E2E_P0XProtect/E2E_P0XCheck is called.E2E_NONE: Additional checks are disabled. This will slighty reduce the runtime of E2E_P0XProtect/E2E_P0XCheck.
      boolean E2ERbDevTest [0..1]: multiplicity set at pre-compile, origin=RB, set at pre-compile, default-value=false  # Additional testing defines for unit tests | Generate additional defines for testing. This parameter needs to be disabled in production code! Default: false
      container E2ERbCrcManualDefinitions [0..1]: multiplicity set at pre-compile  # Crc manual definitions | This container contains the START- and XOR-values for the manual correction of the crc calculation.
        enumeration E2ERbCrc8ManualValues: {xFF, x00}, multiplicity set at , origin=RB, set at pre-compile, default-value=xFF  # Crc8 START-/XOR-values | If manual correction for the crc calculation is enabled, the Crc8 START- and XOR-values must be given here.
        boolean E2ERbCrc8FirstCall: multiplicity set at , origin=RB, set at pre-compile, default-value=true  # Crc8 firstCall configuration | It can be configured if the Crc library provides the parameter Crc_IsFirstCall in the interface for the crc8 calculation.
