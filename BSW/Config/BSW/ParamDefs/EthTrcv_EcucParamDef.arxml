AUTOSAR XML (schema 4-2-2)
package /AUTOSAR_EthTrcv/EcucModuleDefs
  module definition EthTrcv [0..*]: category=VENDOR_SPECIFIC_MODULE_DEFINITION, refined-module-def=EthTrcv, variants pre-compile  # Configuration of Ethernet Transceiver Driver module
    container EthTrcvConfigSet  # This container contains the configuration parameters and sub containers of the AUTOSAR EthTrcv module.
      container EthTrcvConfig [1..*]  # Configuration of the individual transceiver
        boolean EthTrcvAutoNegotiationEnabled: post-build-variant-value=true, set at link in variant link-time / post-build in variant post-build / pre-compile in variant pre-compile  # Specifies if Auto-Negotiation is enabled (TRUE) or disabled (FALSE) for determination of the Ethernet transceiver speed.
        enumeration EthTrcvConnNeg: {TRCV_CONN_NEG_AUTO, TRCV_CONN_NEG_MASTER, TRCV_CONN_NEG_SLAVE}, post-build-variant-value=true, set at link in variant link-time / post-build in variant post-build / pre-compile in variant pre-compile  # Specifies the connection negotiation of the Ethernet transceiver link.
        integer EthTrcvCtrlIdx: 0..255, post-build-variant-value=true, set at link in variant link-time / post-build in variant post-build / pre-compile in variant pre-compile  # Specifies the controller used for MII access to the transceiver
        enumeration EthTrcvDriverMiiApi: {ETHTRCV_DRIVER_SUPPORT_ASYNC_MIICOMMUNICATION, ETHTRCV_DRIVER_SUPPORT_NO_ASYNC_MIICOMMUNICATION, ETHTRCV_DRIVER_SUPPORT_OAWAPI_TO_PROVIDE_MII_FUNCTIONALITY}, origin=RB, post-build-variant-value=true, set at link in variant link-time / post-build in variant post-build / pre-compile in variant pre-compile, default-value=ETHTRCV_DRIVER_SUPPORT_OAWAPI_TO_PROVIDE_MII_FUNCTIONALITY  # The communication from EthTrcv to Phy-hardware is managed by Mac (controller) hardware and SW. The SW-API is defined by Autosar by Eth_ReadMii and Eth_WriteMii. To avoid blocking of micro-controller during Mii-(MDio)-communication this API is defined to be asynchron. But some controllers does not support interrupts (by Mac- hardware) when a Mii(Mdio) word is written/received. These SW-controllers-drivers may not support asynchron communication. With this (EthTrcvDriverMiiAPI) configuration parameter it is possible to define the capability of Eth-Driver: ETHTRCV_DRIVER_SUPPORT_OAWAPI_TO_PROVIDE_MII_FUNCTIONALITY is the default configuraion parameter. It is defined at RB that each Eth-controller-driver shall provides its capability to communicate async or sync by OAW-API: String Eth_Aspect_MiiBehaviour(). EthTrcv uses this OAW-API so configurator does not need to know the features of the EthDriver. If there is an error at validation in EthTrcv, Eth-driver is not RB conform and then configurator needs to know the capability of Eth-driver and should configure other parameters here (EthTrcvDriverMiiApi). ETHTRCV_DRIVER_SUPPORT_ASYNC_MIICOMMUNICATION: Driver supports async communication and calls EthTrcv_ReadMiiIndication or EthTrcv WriteMiiIndication function after each Eth_ReadMii and Eth_WriteMii. ETHTRCV_DRIVER_SUPPORT_NO_ASYNC_MIICOMMUNICATION: Driver does not support async communication and is not allowed to call EthTrcv_ReadMiiIndication nor EthTrcv WriteMiiIndication.
        enumeration EthTrcvDuplexMode: {ETHTRCV_DUPLEX_MODE_FULL, ETHTRCV_DUPLEX_MODE_HALF}, post-build-variant-value=true, set at link in variant link-time / post-build in variant post-build / pre-compile in variant pre-compile  # Specifies the duplex mode of the Ethernet transceiver link if Auto-Negotiation is disabled. This parameter is ignored if Auto-Negotiation is enabled.
        integer EthTrcvIdx: 0..255, scope=ECU, set at pre-compile, symbolic-name-value=true  # Specifies the instance ID of the configured transceiver.
        integer EthTrcvMiiIdx: 0..255, post-build-variant-value=true, set at link in variant link-time / post-build in variant post-build / pre-compile in variant pre-compile  # Specifies the transceiver index used for MII access to the transceiver
        enumeration EthTrcvPhysLayerType [0..1]: {TRCV_PHYS_LAYER_TYPE_BASE_T, TRCV_PHYS_LAYER_TYPE_BROADR_REACH}, multiplicity set at link in variant link-time / post-build in variant post-build / pre-compile in variant pre-compile, post-build-variant-multiplicity=true, post-build-variant-value=true, set at link in variant link-time / post-build in variant post-build / pre-compile in variant pre-compile  # Specifies the physical layer type of the Ethernet transceiver link.
        enumeration EthTrcvSpeed: {TRCV_SPEED_10, TRCV_SPEED_100, TRCV_SPEED_1000}, post-build-variant-value=true, set at link in variant link-time / post-build in variant post-build / pre-compile in variant pre-compile  # Specifies the speed of the Ethernet transceiver link in [MBit/s]. If AutoNegotiation is enabled this is the maximum speed advertised for Auto-Negotiation.
        function name EthTrcvWakeUpCallout [0..1]: multiplicity set at pre-compile, set at pre-compile  # Configuration of the call-out name.
        symbolic name reference EthTrcvIcuChannelRef [0..1]: multiplicity set at pre-compile, set at pre-compile, destination=IcuChannel  # Reference to the IcuChannel to enable/disable the interrupts for wakeups.
        container EthTrcvDemEventParameterRefs [0..1]  # Container for the references to DemEventParameter elements which shall be invoked using the API Dem_ReportErrorStatus API in case the corresponding error occurs. The EventId is taken from the referenced DemEventParameter's DemEventId value. The standardized errors are provided in the container and can be extended by vendor specific error references.
          enumeration EthTrcvRbDynCreate_ETHTRCV_E_ACCESS [0..1]: {Disabled, Standard}, origin=RB, set at pre-compile, default-value=Disabled  # Dynamically create DemEvent | Selects the way how the example DemEvent is created. If not set or set to &quot;Disabled&quot;, no such DemEvent is automatically created. If the dynamic creation of this DemEvent is enabled, the reference to this DemEvent (in parameter rba_Example_DemEventRef) is also automatically created and shall therefore not be set manually.
          symbolic name reference ETHTRCV_E_ACCESS [0..1]: multiplicity set at link in variant link-time / post-build in variant post-build / pre-compile in variant pre-compile, post-build-variant-multiplicity=true, post-build-variant-value=true, set at link in variant link-time / post-build in variant post-build / pre-compile in variant pre-compile, destination=DemEventParameter  # Reference to the DemEventParameter which shall be issued when the error "Transceiver access failed" has occurred.
        container EthTrcvTrcvSpecificParam [0..1]  # Transceiver specific parameters.
          container EthTrcvBCM [0..1]  # Special Container for BCM Transceivers. Currently supported transceivers are BCM89810 and BCM89811
            enumeration EthTrcvHwConnectionMode [0..1]: {ETHTRCV_RGMII, ETHTRCV_RGMII_DELAY, ETHTRCV_MII_LITE}, origin=RB, set at pre-compile, default-value=ETHTRCV_MII_LITE  # RB (Vendor06) specific parameter: configuration of MII mode between the Eth MAC and the Eth Phy.
            enumeration EthTrcvHwReverseMode [0..1]: {ETHTRCV_NO_REVERSE, ETHTRCV_REVERSE}, origin=RB, set at pre-compile, default-value=ETHTRCV_NO_REVERSE  # RB (Vendor06) specific parameter: configuration of reverse MII mode between the Eth MAC and the Eth Phy.
            enumeration EthTrcvMasterSlaveMode [0..1]: {ETHTRCV_MASTER, ETHTRCV_SLAVE}, origin=RB, set at pre-compile, default-value=ETHTRCV_MASTER  # RB (Vendor06) specific parameter: configuration of master slave configuration for the Eth Phy.
          container EthTrcvTJA1100 [0..1]  # Special Container for TJA1100.
            enumeration EthTrcvAUTO_OP [0..1]: {ETHTRCV_AUTO_OP_MANAGED, ETHTRCV_AUTO_AUTONOM}, origin=RB, set at pre-compile, default-value=ETHTRCV_AUTO_OP_MANAGED  # RB (Vendor06) specific parameter: Reg 18 Bit14: 0 = managed operation; 1 = autonomous operation
            enumeration EthTrcvAUTO_PWD [0..1]: {ETHTRCV_AUTO_PWD_DISABLED, ETHTRCV_AUTO_PWD_ENABLED}, origin=RB, set at pre-compile, default-value=ETHTRCV_AUTO_PWD_DISABLED  # RB (Vendor06) specific parameter: Reg 18 Bit1: 0 = autonomous power-down disabled 1 = autonomous power-down enabled
            enumeration EthTrcvCONFIG_INH [0..1]: {ETHTRCV_CONFIG_INH_OFF_IN_DIS_MODE, ETHTRCV_CONFIG_INH_ON_IN_DIS_MODE}, origin=RB, set at pre-compile, default-value=ETHTRCV_CONFIG_INH_ON_IN_DIS_MODE  # RB (Vendor06) specific parameter: Reg17 Bit1, 0 = INH switched off in Disable mode; 1 = INH switched on in Disable mode
            enumeration EthTrcvJUMBO_ENABLE [0..1]: {ETHTRCV_4KB_SUPPORT, ETHTRCV_16KB_SUPPORT}, origin=RB, set at pre-compile, default-value=ETHTRCV_16KB_SUPPORT  # RB (Vendor06) specific parameter: Reg 19 Bit2: 0 = packets up to 4 kB supported; 1 = packets up to 16 kB supported
            enumeration EthTrcvLED_ENABLE [0..1]: {ETHTRCV_LED_OUTPUT_DISABLED, ETHTRCV_LED_OUTPUT_ENABLED}, origin=RB, set at pre-compile, default-value=ETHTRCV_LED_OUTPUT_DISABLED  # RB (Vendor06) specific parameter: Reg 18 Bit3: 0 = LED output disabled; WAKE input enabled 1 = LED output enabled; WAKE input disabled
            enumeration EthTrcvLED_MODE [0..1]: {ETHTRCV_LED_MODE_LINK_UP, ETHTRCV_LED_MODE_FRAME_RECEPTION, ETHTRCV_LED_MODE_SYMBOL_ERROR, ETHTRCV_LED_MODE_CRS_SIGNAL}, origin=RB, set at pre-compile, default-value=ETHTRCV_LED_MODE_LINK_UP  # RB (Vendor06) specific parameter: Reg 18 Bit5:4: 0 = link up 1 = frame reception 2 = symbol error 3 = CRS signal
            enumeration EthTrcvLINK_LENGTH [0..1]: {ETHTRCV_LINK_LENGTH_LESS15M, ETHTRCV_LINK_LENGTH_LONGER15M}, origin=RB, set at pre-compile, default-value=ETHTRCV_LINK_LENGTH_LESS15M  # RB (Vendor06) specific parameter: Reg 18 Bit13:12: 0 = less 15m 1 = longer 15m
            enumeration EthTrcvLPS_ACTIVE [0..1]: {ETHTRCV_LPS_ACTIVE_DISABLED, ETHTRCV_LPS_ACTIVE_ENABLED}, origin=RB, set at pre-compile, default-value=ETHTRCV_LPS_ACTIVE_DISABLED  # RB (Vendor06) specific parameter: Reg 18 Bit0: 0 = automatic transition from Normal to Sleep Request when LPS code group received disabled 1 = automatic transition from Normal to Sleep Request when LPS code group received enabled
            enumeration EthTrcvMII_DRIVER [0..1]: {ETHTRCV_MII_DRIVER_STANDARD, ETHTRCV_MII_DRIVER_REDUCED}, origin=RB, set at pre-compile, default-value=ETHTRCV_MII_DRIVER_STANDARD  # RB (Vendor06) specific parameter: Reg 18 Bit15: 0 = PHY configured as Slave; 1 = PHY configured as Master
            enumeration EthTrcvMII_MODE [0..1]: {ETHTRCV_MII, ETHTRCV_RMII_50MHZ, ETHTRCV_RMII_25MHZ, ETHTRCV_REVERSE_MII}, origin=RB, set at pre-compile, default-value=ETHTRCV_MII  # RB (Vendor06) specific parameter: Reg 18 Bit15: 0 = PHY configured as Slave; 1 = PHY configured as Master
            enumeration EthTrcvMasterSlaveMode [0..1]: {ETHTRCV_MASTER, ETHTRCV_SLAVE}, origin=RB, set at pre-compile, default-value=ETHTRCV_MASTER  # RB (Vendor06) specific parameter: Reg 18 Bit15: 0 = PHY configured as Slave; 1 = PHY configured as Master
            enumeration EthTrcvSLEEP_REQUEST_TO [0..1]: {ETHTRCV_400US, ETHTRCV_1MS, ETHTRCV_4MS, ETHTRCV_16MS}, origin=RB, set at pre-compile, default-value=ETHTRCV_1MS  # RB (Vendor06) specific parameter: Reg 19 Bit1:0: sleep request time-out
            enumeration EthTrcvSW_CONFIGURATION [0..1]: {ETHTRCV_IGNORE_SW_CONFIGURATION, ETHTRCV_USE_SW_CONFIGURAION}, origin=RB, set at pre-compile, default-value=ETHTRCV_USE_SW_CONFIGURAION  # RB (Vendor06) specific parameter: If ETHTRCV_IGNORE_SW_CONFIGURATION, no SW-reset is done and the configurator should ensure that configuration parameters available at pin-strap-configuration should be same in SW-configuration. This is to avoid a hang up of TJA1100 A2 Sample if config values are different from pin-strap configuration. Anyhow all registers are written at init-time to configure config parameters not available in pin-starp-configuration.
            enumeration EthTrcvTX_AMPLITUDE [0..1]: {ETHTRCV_TX_AMPLITUDE_500MV, ETHTRCV_TX_AMPLITUDE_750MV, ETHTRCV_TX_AMPLITUDE_1000MV, ETHTRCV_TX_AMPLITUDE_1250MV}, origin=RB, set at pre-compile, default-value=ETHTRCV_TX_AMPLITUDE_1000MV  # RB (Vendor06) specific parameter: Reg 18 Bit11:10: 0 = 500mV 1 = 750mV 2 = 1000mV 3= 1250mV
            container EthTrcvAccess [0..1]  # Container gives EthTrcv Driver information about access to a single Eth transceiver.
              container EthTrcvDioAccess [0..1]  # Container gives Eth transceiver driver information about accessing ports and port pins. In addition relation between Eth transceiver hardware pin names and Dio port access information is given. If a Eth transceiver hardware has no Dio interface, there is no instance of this container.
                container EthTrcvDioChannelAccess [0..*]  # Container gives DIO channel access by single Eth transceiver channel.
                  enumeration EthTrcvDioHardwareInterfaceType: {Enable, LinkSignalisation, Wake, Inhibit}, origin=RB, set at pre-compile, default-value=Enable  # Type of Pin-functionality. According this value the EthTrcv-SW derives the corresponding Hardware-Pin for specific functionality.
                  string EthTrcvHardwareInterfaceName: origin=RB, set at pre-compile  # Eth transceiver hardware interface name. It is typically the name of a pin. From a Dio point of view it is a single channel.
                  choice reference EthTrcvDioSymNameRef: origin=RB, set at pre-compile, destination=DioChannel  # Choice Reference to a DIO Channel.
        container EthTrcvWakeupMap [0..7]  # Container for the mapping of wake up reasons to wake up sources. At least one container is needed if EthTrcvWakeUpSupport is not ETHTRCV_WAKEUP_NOT_SUPPORTED.
          enumeration EthTrcvWakeupReason: {ETHTRCV_WUR_BUS, ETHTRCV_WUR_GENERAL, ETHTRCV_WUR_INTERNAL, ETHTRCV_WUR_PIN, ETHTRCV_WUR_POWER_ON, ETHTRCV_WUR_RESET, ETHTRCV_WUR_SYSERR}, post-build-variant-value=true, set at link in variant link-time / post-build in variant post-build / pre-compile in variant pre-compile  # This parameter defines the transceiver wake up reasons.
          symbolic name reference EthTrcvWakeupSourceRef: set at pre-compile, destination=EcuMWakeupSource  # Configures the wake-up source defined in EcuM.
    container EthTrcvGeneral  # General configuration of Ethernet Transceiver Driver module
      enumeration EthTrcvAutosarVersion: {Legacy, AR4_0_2, AR4_0_3}, origin=RB, set at pre-compile  # Naming convention for symbolic names are generated according autosar version: Lecacy: no prefix AR4.0.2: Dio_ (ecuc_sws_2108) AR4.0.3: DioConf_DioChannel_
      boolean EthTrcvDevErrorDetect: set at pre-compile  # Switches the Default Error Tracer (Det) detection and notification ON or OFF. | * true: enabled (ON). * false: disabled (OFF).
      boolean EthTrcvGetBaudRateApi: set at pre-compile  # Enables / Disables EthTrcv_GetBaudRate API
      boolean EthTrcvGetDuplexModeApi: set at pre-compile  # Enables / Disables EthTrcv_GetDuplexMode API
      boolean EthTrcvGetLinkStateApi: set at pre-compile  # Enables / Disables EthTrcv_GetLinkState API
      boolean EthTrcvGetTransceiverModeApi: set at pre-compile  # Enables / Disables EthTrcv_GetTransceiverMode API
      boolean EthTrcvGetTransceiverWakeupModeApi [0..1]: multiplicity set at pre-compile, set at pre-compile  # Enables / Disables EthTrcv_GetTransceiverWakeupMode API
      enumeration EthTrcvHardwareType: {DP83822, BCM89811, TJA1100, NO_PHY, RTL9000AA}, origin=RB, set at pre-compile  # RB (Vendor06) specific parameter: Type of the used Hardware
      integer EthTrcvIndex: 0..255, set at pre-compile  # Specifies the InstanceId of this module instance. If only one instance is present it shall have the Id 0.
      float EthTrcvMainFunctionPeriod [0..1]: 0..Inf, multiplicity set at pre-compile, set at pre-compile  # Specifies the period of main function EthTrcv_MainFunction in seconds.
      integer EthTrcvMaxTrcvsSupported: 0..255, set at pre-compile, default-value=1
      boolean EthTrcvSetTransceiverModeApi: set at pre-compile  # Enables / Disables EthTrcv_SetTransceiverMode API
      boolean EthTrcvStartAutoNegotiationApi: set at pre-compile  # Enables / Disables EthTrcv_StartAutoNegotiation API
      boolean EthTrcvVersionInfoApi: set at pre-compile  # Enables / Disables version info API
      boolean EthTrcvVersionInfoApiMacro: set at pre-compile  # Enables / Disables version info API macro implementation
      enumeration EthTrcvWakeUpSupport: {ETHTRCV_WAKEUP_BY_INTERRUPT, ETHTRCV_WAKEUP_BY_POLLING, ETHTRCV_WAKEUP_NOT_SUPPORTED}, set at pre-compile  # Configures wake-up to polling or interrupt or to not used/not supported. In case no wake up is supported by the hardware, the BSWMD pre-configuration shall be set to ETHTRCV_WAKEUP_NOT_SUPPORTED.
