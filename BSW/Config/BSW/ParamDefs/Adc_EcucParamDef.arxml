AUTOSAR XML (schema 4-2-2)
package /AUTOSAR_Adc/EcucModuleDefs
  module definition Adc [0..1]: category=VENDOR_SPECIFIC_MODULE_DEFINITION, refined-module-def=Adc, variants pre-compile  # MCAL Analog/Digital Converter | Configuration of the Adc (Analog Digital Conversion) module for MCAL.
    container AdcConfigSet  # Configuration data set | This is the base container that contains the post-build selectable configuration parameters
      container AdcHwUnit [1..*]: multiplicity set at pre-compile  # HW unit | This container contains the Driver configuration (parameters) depending on grouping of channels This container could contain HW specific parameters which are not defined in the Standardized Module Definition. They must be added in the Vendor Specific Module Definition.
        enumeration AdcClockSource [0..0]: set at pre-compile  # Clock source | The ADC module specific clock input for the conversion unit can statically be configured to select different clock sources if provided by hardware. Enumeration literals are defined vendor specific.
          CLOCK0  # Clock0
          CLOCK1  # Clock1
        enumeration AdcHwUnitId: {ADC0, ADC1}, set at pre-compile, symbolic-name-value=true  # Unit ID | Description: Numeric ID of the HW Unit. This symbolic name allows accessing Hw Unit data. Enumeration literals are defined vendor specific.
        integer AdcPrescale [0..0]: 0..65535, set at pre-compile  # Prescale | Optional ADC module specific clock prescale factor, if supported by hardware. ImplementationType: Adc_PrescaleType
        container AdcChannel [1..*]: multiplicity set at pre-compile  # Channel | This container contains the channel configuration (parameters) depending on the hardware capability. The organization of this data structure could contain dependencies to the microcontroller so this is left up to the implementer and its location is left up to the configuration. Note: Since a AdcChannel can be part of several AdcGroups, this container is not realized as a subcontainer of AdcGroup but instead as a subcontainer of AdcHwUnit.
          integer AdcChannelConvTime [0..0]: set at pre-compile  # Conversion time | Configuration of conversion time, i.e. the time during which the analogue value is converted into digital representation, (in clock cycles) for each channel, if supported by hardware. ImplementationType: Adc_ConversionTimeType
          integer AdcChannelHighLimit [0..0]: set at pre-compile  # High limit | High limit - used for limit checking.
          integer AdcChannelId [0..0]: 0..1024, set at pre-compile  # Channel ID | This parameter defines the assignment of the channel to the physical ADC hardware channel. ImplementationType: Adc_ChannelType
          boolean AdcChannelLimitCheck [0..0]: set at pre-compile  # Limit Check | Enables or disables limit checking for an ADC channel.
          integer AdcChannelLowLimit [0..0]: set at pre-compile  # Low limit | Low limit - used for limit checking.
          enumeration AdcChannelRangeSelect [0..0]: set at pre-compile  # Range select | In case of active limit checking: defines which conversion values are taken into account related to the boarders defined with AdcChannelLowLimit and AdcChannelHighLimit. Implementation Type: Adc_ChannelRangeSelectType
            ADC_RANGE_ALWAYS  # Complete range
            ADC_RANGE_BETWEEN  # Range between low and high
            ADC_RANGE_NOT_BETWEEN  # Range above high or below low
            ADC_RANGE_NOT_OVER_HIGH  # Range below high
            ADC_RANGE_NOT_UNDER_LOW  # Range above low
            ADC_RANGE_OVER_HIGH  # Range above high
            ADC_RANGE_UNDER_LOW  # Range blow low
          enumeration AdcChannelRefVoltsrcHigh [0..0]: {ADC_VLTHIGH_TST1, ADC_VLTHIGH_TST2}, set at pre-compile  # Reference source | Upper reference voltage source for each channel. Enumeration literals are defined vendor specific.
          enumeration AdcChannelRefVoltsrcLow [0..0]: {ADC_VLTLOW_TST1, ADC_VLTLOW_TST2}, set at pre-compile  # Low reference source | Lower reference voltage source for each channel. Enumeration literals are defined vendor specific.
          integer AdcChannelResolution [0..0]: 1..63, set at pre-compile  # Resolution | Channel resolution in bits. ImplementationType: Adc_ResolutionType
          integer AdcChannelSampTime [0..0]: set at pre-compile  # Sample time | Configuration of sampling time, i.e. the time during which the value is sampled, (in clock cycles) for each channel, if supported by hardware. ImplementationType: Adc_SamplingTimeType
          enumeration ConnectedTo: {ADC0I0, ADC0I1, ADC0I2, ADC0I3, ADC0I4, ADC0I5, ADC0I6, ADC0I7, ADC0I8, ADC0I9, ADC0I10, ADC0I11, ADC0I12, ADC0I13, ADC0I14, ADC0I15, ADC0I16, ADC0I17, ADC0I18, ADC0I19, ADC1I0, ADC1I1, ADC1I2, ADC1I3, ADC1I4, ADC1I5, ADC1I6, ADC1I7, ADC1I8, ADC1I9, ADC1I10, ADC1I11, ADC1I12, ADC1I13, ADC1I14, ADC1I15, ADC1I16, ADC1I17, ADC1I18, ADC1I19}, origin=RB:0.1.0:2012-02-12, set at pre-compile, symbolic-name-value=true  # Connected To | This parameter defines the mapping of the physical ADC hardware channel with the analog signal specified by Channel container ShortName. ImplementationType: Adc_ChannelType
        container AdcGroup [1..*]: multiplicity set at pre-compile  # Group | This container contains the Group configuration (parameters).
          enumeration AdcGroupAccessMode [0..0]: set at pre-compile, default-value=ADC_ACCESS_MODE_SINGLE  # Access mode | Type of access mode to group conversion results. ImplementationType: Adc_GroupAccessModeType
            ADC_ACCESS_MODE_SINGLE  # Single value access mode
            ADC_ACCESS_MODE_STREAMING  # Streaming access mode
          enumeration AdcGroupConversionMode [0..1]: multiplicity set at pre-compile, set at pre-compile, default-value=ADC_CONV_MODE_ONESHOT  # Conversion mode | Type of conversion mode supported by the driver.
            ADC_CONV_MODE_CONTINUOUS  # Continous conversion
            ADC_CONV_MODE_ONESHOT  # Single conversion
          integer AdcGroupId [0..1]: 0..1023, multiplicity set at pre-compile, set at pre-compile, with-auto=true  # Group ID | Numeric ID of the group.
          enumeration AdcGroupPriority: {GROUP_PRIO_LOW_0, GROUP_PRIO_1, GROUP_PRIO_2, GROUP_PRIO_3, GROUP_PRIO_HIGH_4}, set at pre-compile, default-value=GROUP_PRIO_2  # Priority | Priority level of the AdcGroup.
          enumeration AdcGroupReplacement [0..0]: set at pre-compile  # Replacement mechanism | Replacement mechanism, which is used on ADC group level, if a group conversion is interrupted by a group which has a higher priority. ImplementationType: Adc_GroupReplacementType Note: This parameter is for Future Use only. Configuring this parameter will not modify the behaviour of the module.
            ADC_GROUP_REPL_ABORT_RESTART  # Abort/Restart mechanism on group level
            ADC_GROUP_REPL_SUSPEND_RESUME  # Suspend/Resume mechanism on group level
          enumeration AdcGroupTriggSrc: set at pre-compile, default-value=ADC_TRIGG_SRC_SW  # Type of trigger | Type of source event that starts a group conversion.
            ADC_TRIGG_SRC_HW  # Group trigger by hardware
            ADC_TRIGG_SRC_SW  # Group trigger by software
            ADC_TRIGG_SRC_ADTIMER_SW  # Group trigger by AD Timer software
          enumeration AdcHwTrigSignal [0..1]: multiplicity set at pre-compile, set at pre-compile, default-value=ADC_HW_TRIG_BOTH_EDGES  # Active trigger edge | Configures on which edge of the hardware trigger signal the driver should react, i.e. start the conversion (only if supported by the ADC hardware).
            ADC_HW_TRIG_BOTH_EDGES  # React on both edges of trigger
            ADC_HW_TRIG_FALLING_EDGE  # React on the falling edge of trigger
            ADC_HW_TRIG_RISING_EDGE  # React on the rising edge of trigger
          integer AdcHwTrigTimer [0..0]: set at pre-compile  # Reload value of trigger timer | Reload value of the ADC module embedded timer (only if supported by ADC hardware). ImplementationType: Adc_HwTriggerTimerType
          function name AdcNotification [0..1]: multiplicity set at pre-compile, set at pre-compile  # Callback function | Callback function for each group.
          boolean AdcRbConvertUnusedChannels [0..1]: multiplicity set at pre-compile, origin=RB:v0.1.0:2014-06-02, set at pre-compile, default-value=false  # Include unused channels for conversion | Determines whether to include or not, the unused channels which are not listed in Channel container.
          boolean AdcRbGroupSyncEnabled [0..1]: multiplicity set at pre-compile, origin=RB:v0.1.0:2016-10-05, set at pre-compile, default-value=false  # Enable Synchronized conversion along with other HW unit | Determines whether this group conversion can be started synchronously along with similar groups of other HW unit, when Adc_Rb_SyncStartHwUnitsGroupConversion API is called.
          enumeration AdcRbHwTrigGTMPreMuxSignal [0..1]: {TIM0_IRQ_0_SIGNAL, TIM0_IRQ_1_SIGNAL, TIM0_IRQ_2_SIGNAL, TIM0_IRQ_3_SIGNAL, TIM0_IRQ_4_SIGNAL, TIM0_IRQ_5_SIGNAL, TIM0_IRQ_6_SIGNAL, TIM0_IRQ_7_SIGNAL, TIM1_IRQ_0_SIGNAL, TIM1_IRQ_1_SIGNAL, TIM1_IRQ_2_SIGNAL, TIM1_IRQ_3_SIGNAL, TIM1_IRQ_4_SIGNAL, TIM1_IRQ_5_SIGNAL, TIM1_IRQ_6_SIGNAL, TIM1_IRQ_7_SIGNAL, ATOM0_OUT_0_SIGNAL, ATOM0_OUT_0_N_SIGNAL, ATOM0_OUT_1_SIGNAL, ATOM0_OUT_1_N_SIGNAL, ATOM0_OUT_2_SIGNAL, ATOM0_OUT_2_N_SIGNAL, ATOM0_OUT_3_SIGNAL, ATOM0_OUT_3_N_SIGNAL, ATOM0_OUT_4_SIGNAL, ATOM0_OUT_5_SIGNAL, ATOM0_OUT_6_SIGNAL, ATOM0_OUT_7_SIGNAL, ATOM1_OUT_0_SIGNAL, ATOM1_OUT_0_N_SIGNAL, ATOM1_OUT_1_SIGNAL, ATOM1_OUT_1_N_SIGNAL, ATOM1_OUT_2_SIGNAL, ATOM1_OUT_2_N_SIGNAL, ATOM1_OUT_3_SIGNAL, ATOM1_OUT_3_N_SIGNAL, ATOM1_OUT_4_SIGNAL, ATOM1_OUT_5_SIGNAL, ATOM1_OUT_6_SIGNAL, ATOM1_OUT_7_SIGNAL, ATOM2_OUT_0_SIGNAL, ATOM2_OUT_0_N_SIGNAL, ATOM2_OUT_1_SIGNAL, ATOM2_OUT_1_N_SIGNAL, ATOM2_OUT_2_SIGNAL, ATOM2_OUT_2_N_SIGNAL, ATOM2_OUT_3_SIGNAL, ATOM2_OUT_3_N_SIGNAL, ATOM2_OUT_4_SIGNAL, MCS0_IRQ_0_SIGNAL, MCS0_IRQ_1_SIGNAL, MCS0_IRQ_2_SIGNAL, MCS0_IRQ_3_SIGNAL, MCS0_IRQ_4_SIGNAL, MCS0_IRQ_5_SIGNAL, MCS0_IRQ_6_SIGNAL, MCS0_IRQ_7_SIGNAL, MCS0_IRQ_8_SIGNAL, MCS1_IRQ_0_SIGNAL, MCS1_IRQ_1_SIGNAL, MCS1_IRQ_2_SIGNAL, MCS1_IRQ_3_SIGNAL, MCS1_IRQ_4_SIGNAL, MCS1_IRQ_5_SIGNAL, NO_HWTRG_GTMPREMUX_SIGNAL}, multiplicity set at pre-compile, origin=RB:v0.1.0:2013-12-02, set at pre-compile, default-value=NO_HWTRG_GTMPREMUX_SIGNAL  # Pre MUX signal | Configures the GTM output signal to be used as HW trigger for Adc group conversion.
          enumeration AdcRbHwTrigMuxSignal [0..1]: {PORT_PIN_ADTRG_SIGNAL, GTM_PREMUX_XX_SIGNAL, NO_HWTRG_MUX_SIGNAL}, multiplicity set at pre-compile, origin=RB:v0.1.0:2013-12-02, set at pre-compile, default-value=NO_HWTRG_MUX_SIGNAL  # MUX signal | Configures the trigger input (Port pin or GTM) to be used as HW trigger for Adc group conversion.
          integer AdcRbTimerCyclicDelay [0..1]: 25..69905033, multiplicity set at pre-compile, origin=RB:v0.1.0:2016-10-05, set at pre-compile, default-value=100000  # AD Timer Cyclic Delay | Configures the cyclic time delay (in nano seconds) after which Adc conversion has to repeat itself, if "Group trigger by AD Timer software" is selected as "Type of trigger" for this group.
          integer AdcRbTimerInitialDelay [0..1]: 25..69905033, multiplicity set at pre-compile, origin=RB:v0.1.0:2016-10-05, set at pre-compile, default-value=100000  # AD Timer Initial Delay | Configures the initial time delay (in nano seconds) after which Adc conversion has to begin after the respective start function is called by the user, if "Group trigger by AD Timer software" is selected as "Type of trigger" for this group.
          enumeration AdcStreamingBufferMode [0..0]: set at pre-compile, default-value=ADC_STREAM_BUFFER_CIRCULAR  # Type of buffer | Configure streaming buffer as "linear buffer" (i.e. the ADC Driver stops the conversion as soon as the stream buffer is full) or as "ring buffer" (wraps around if the end of the stream buffer is reached). ImplementationType: Adc_StreamBufferModeType
            ADC_STREAM_BUFFER_CIRCULAR  # Use ring buffer
            ADC_STREAM_BUFFER_LINEAR  # Stop when buffer is full
          integer AdcStreamingNumSamples [0..0]: 1..255, set at pre-compile  # Number of values to be acquired | Number of ADC values to be acquired per channel in streaming access mode. Note: in single access mode this parameter assumes value 1, since only one sample per channel is processed.
          reference AdcGroupDefinition [1..*]: multiplicity set at pre-compile, set at pre-compile, destination=AdcChannel  # Assign Channels to Group for converting once | Assignment of AdcChannels to a AdcGroups for converting once. ImplementationType: Adc_GroupDefType
          reference AdcGroupDefinitionConvFour [0..*]: multiplicity set at pre-compile, origin=RB:v0.1.0:2014-09-17, set at pre-compile, destination=AdcChannel  # Assign Channels to Group for converting 4 times | Assignment of AdcChannels to AdcGroup for converting 4 times. (It is appropriate to add HW triggered channels here) ImplementationType: Adc_GroupDefType
        container AdcRbPerformSelfTestChannels [0..1]: multiplicity set at pre-compile  # Channels to Perform Terminal Level Self Diagnosis | This container contains the list of even and odd channels to be used for terminal/pin level self test when "Perform Terminal Level Self Diagnosis under Self Test" is set to True under "General settings".
          enumeration AdcRbEvenChannel: origin=RB:0.1.0:2015-03-27, set at pre-compile, symbolic-name-value=true  # Assign Even Channel for Self Test in this Hw Unit | This parameter defines assigning of a Even physical ADC hardware channel for performing terminal/pin level self test. ImplementationType: Adc_ChannelType
            ADCI0  # Channel 0
            ADCI2  # Channel 2
            ADCI4  # Channel 4
            ADCI6  # Channel 6
            ADCI8  # Channel 8
            ADCI10  # Channel 10
            ADCI12  # Channel 12
            ADCI14  # Channel 14
            ADCI16  # Channel 16
            ADCI18  # Channel 18
          enumeration AdcRbOddChannel: origin=RB:0.1.0:2015-03-27, set at pre-compile, symbolic-name-value=true  # Assign Odd Channel for Self Test in this Hw Unit | This parameter defines assigning of a Odd physical ADC hardware channel for performing terminal/pin level self test. ImplementationType: Adc_ChannelType
            ADCI1  # Channel 1
            ADCI3  # Channel 3
            ADCI5  # Channel 5
            ADCI7  # Channel 7
            ADCI9  # Channel 9
            ADCI11  # Channel 11
            ADCI13  # Channel 13
            ADCI15  # Channel 15
            ADCI17  # Channel 17
            ADCI19  # Channel 19
        container AdcRbPinTestGroup [0..1]: multiplicity set at pre-compile  # Pin test group | This container contains the Pin Test Group configuration parameters to be used when "Enable Pin test" is set to True under "General settings".
          integer AdcGroupId: 0..1023, set at pre-compile, with-auto=true  # Group ID | Numeric ID of the group.
          enumeration AdcGroupPriority: {GROUP_PRIO_LOW_0, GROUP_PRIO_1, GROUP_PRIO_2, GROUP_PRIO_3, GROUP_PRIO_HIGH_4}, set at pre-compile, default-value=GROUP_PRIO_2  # Priority | Priority level of the Pin test group.
          reference AdcGroupDefinition [1..*]: multiplicity set at pre-compile, set at pre-compile, destination=AdcChannel  # Assign Channels to Pin test Group | Assignment of Adc Channels to Pin Test Group. ImplementationType: Adc_GroupDefType
        container AdcRbSelfTestC5PGroup [0..1]: multiplicity set at pre-compile  # Cyclic five point self test group | This container contains the Cyclic five point self test Group configuration parameters to be used when "Enable Cyclic five point self test" is set to True under "General settings".
          integer AdcGroupId: 0..1023, set at pre-compile, with-auto=true  # Group ID | Numeric ID of the group.
          enumeration AdcGroupPriority: {GROUP_PRIO_LOW_0, GROUP_PRIO_1, GROUP_PRIO_2, GROUP_PRIO_3, GROUP_PRIO_HIGH_4}, set at pre-compile, default-value=GROUP_PRIO_2  # Priority | Priority level of the Cyclic five point self test group.
    container AdcGeneral  # General settings | General configuration (parameters) of the ADC Driver software module.
      boolean AdcDeInitApi [0..1]: multiplicity set at pre-compile, set at pre-compile, default-value=true  # Enable Adc_DeInit function | Adds / removes the service Adc_DeInit() from the code. true: Adc_DeInit() can be used. false: Adc_DeInit() can not be used.
      boolean AdcDevErrorDetect [0..1]: multiplicity set at pre-compile, set at pre-compile, default-value=false  # Development error detection | Switches the Development Error Detection and Notification ON or OFF.true: Enabled. false: Disabled.
      boolean AdcEnableLimitCheck [0..0]: set at pre-compile, default-value=false  # Enable limit checking | Enables or disables limit checking feature in the ADC driver.
      boolean AdcEnableQueuing [0..0]: set at pre-compile, default-value=false  # Activate queuing mechanism | Determines, if the queuing mechanism is active in case of priority mechanism disabled. Note: If priority mechanism is enabled, queuing mechanism is always active and the parameter ADC_ENABLE_QUEUING is not evaluated. true: Enabled. false: Disabled.
      boolean AdcEnableStartStopGroupApi: set at pre-compile, default-value=true  # Enable Adc_StartGroupConversion function | Adds / removes the services Adc_StartGroupConversion() and Adc_StopGroupConversion() from the code. true: Adc_StartGroupConversion() and Adc_StopGroupConversion() can be used. false: Adc_StartGroupConversion() and Adc_StopGroupConversion() can not be used.
      boolean AdcGrpNotifCapability [0..1]: multiplicity set at pre-compile, set at pre-compile, default-value=false  # Activate group notification mechanism | Determines, if the group notification mechanism (the functions to enable and disable the notifications) is available at runtime.
      boolean AdcHwTriggerApi: set at pre-compile, default-value=true  # Enable Adc_EnableHardwareTrigger function | Adds / removes the services Adc_EnableHardwareTrigger() and Adc_DisableHardwareTrigger() from the code.
      enumeration AdcPriorityImplementation [0..0]: set at pre-compile, default-value=ADC_PRIORITY_HW  # Activate priority mechanism | Determines whether a priority mechanism is available for prioritization of the conversion requests and if available, the type of prioritization mechanism. The selection applies for groups with trigger source software and trigger source hardware. Two types of prioritization mechanism can be selected. The hardware prioritization mechanism (AdcPriorityHw) uses the ADC hardware features for prioritization of the software conversion requests and hardware trigger signals for groups with trigger source hardware. The mixed hardware and software prioritization mechanism (AdcPriorityHwSw) uses the ADC hardware features for prioritization of ADC hardware trigger for groups with trigger source hardware and a software implemented prioritization mechanism for groups with trigger source software. The group priorities for software triggered groups are typically configured with lower priority levels than the group priorities for hardware triggered groups. ImplementationType: Adc_PriorityImplementationType
        ADC_PRIORITY_HW  # Hardware priority mechanism
        ADC_PRIORITY_HW_SW  # Hard- and software priority mechanism
        ADC_PRIORITY_NONE  # priority mechanism not available
      boolean AdcRbCautionCheckEnable [0..1]: multiplicity set at pre-compile, origin=RB:0.1.0:2015-01-20, set at pre-compile, default-value=false  # Enable Caution Check | Adds / removes the Caution check related services - Adc_Prv_LL_CautionCheck_AllGroups and Adc_Prv_LL_CautionCheck_RelatedGroup from the driver.
      boolean AdcRbCheckConversionStatusNoLockApi [0..1]: multiplicity set at pre-compile, origin=RB:0.1.0:2014-12-12, set at pre-compile, default-value=false  # Enable Adc_Rb_CheckConversionStatus_No_Lock function | Adds / removes the service Adc_Rb_CheckConversionStatus_No_Lock() from the code.
      enumeration AdcRbClockInternal [0..1]: {ADC_CLOCK_30_MHZ_FOR_CPU_CLOCK_120MHZ, ADC_CLOCK_40_MHZ_FOR_CPU_CLOCK_160MHZ_OR_240MHZ}, multiplicity set at pre-compile, origin=RB:v0.1.0:2016-10-06, set at pre-compile, default-value=ADC_CLOCK_40_MHZ_FOR_CPU_CLOCK_160MHZ_OR_240MHZ  # Adc internal clock used for AD Timer | Holds the internal clock information for calculating AD timer count value.
      enumeration AdcRbDeviceType: {D2V2, D3V1, D3V2, D4V1, D4V2, D5V1, D5ED2}, origin=RB:v0.1.0:2014-04-10, set at pre-compile, default-value=D5ED2  # Define Device type | Holds the Device type information to decide on the available resources
      boolean AdcRbEndofConversionIntEnable [0..1]: multiplicity set at pre-compile, origin=RB:0.1.0:2016-10-05, set at pre-compile, default-value=false  # Enable End of Conversion Interrupt | Adds / removes the End of Conversion Interrupt Service Routine from the code.
      boolean AdcRbPerformADCnvCirSelfTest [0..1]: multiplicity set at pre-compile, origin=RB:0.1.0:2015-11-12, set at pre-compile, default-value=false  # Perform AD Conversion Circuit Self Diagnosis under Self Test | Adds / removes the AD Conversion Circuit Self Diagnosis related service from Adc_Rb_SelfTest API.
      boolean AdcRbPerformExtRefVoltTest [0..1]: multiplicity set at pre-compile, origin=RB:0.1.0:2015-11-12, set at pre-compile, default-value=false  # Perform External Reference Voltage Test under Self Test | Adds / removes the External Reference Voltage Test related service from Adc_Rb_SelfTest API.
      enumeration AdcRbPerformExtRefVoltTestCh [0..1]: {ADC0I0, ADC0I1, ADC0I2, ADC0I3, ADC0I4, ADC0I5, ADC0I6, ADC0I7, ADC0I8, ADC0I9, ADC0I10, ADC0I11, ADC0I12, ADC0I13, ADC0I14, ADC0I15, ADC0I16, ADC0I17, ADC0I18, ADC0I19, ADC1I0, ADC1I1, ADC1I2, ADC1I3, ADC1I4, ADC1I5, ADC1I6, ADC1I7, ADC1I8, ADC1I9, ADC1I10, ADC1I11, ADC1I12, ADC1I13, ADC1I14, ADC1I15, ADC1I16, ADC1I17, ADC1I18, ADC1I19}, multiplicity set at pre-compile, origin=RB:0.1.0:2015-11-12, set at pre-compile, symbolic-name-value=true, default-value=ADC0I0  # Select Channel to Perform External Reference Voltage Test | This parameter defines assigning of a physical ADC hardware channel for performing External Reference Voltage Test. ImplementationType: Adc_ChannelType
      integer AdcRbPerformExtRefVoltTestLth [0..1]: 0..4095, multiplicity set at pre-compile, origin=RB:0.1.0:2015-11-12, set at pre-compile, default-value=4010  # Lower Threshold for External Reference Voltage Test | This parameter defines the lower threshold for External Reference Voltage Test. When the converted value is lesser than this threshold, then the test is said to be FAILED.
      integer AdcRbPerformExtRefVoltTestUth [0..1]: 0..4095, multiplicity set at pre-compile, origin=RB:0.1.0:2015-11-12, set at pre-compile, default-value=4090  # Upper Threshold for External Reference Voltage Test | This parameter defines the Upper threshold for External Reference Voltage Test. When the converted value is greater than this threshold, then the test is said to be FAILED.
      boolean AdcRbPerformTerLvlSelfTest [0..1]: multiplicity set at pre-compile, origin=RB:0.1.0:2015-11-12, set at pre-compile, default-value=false  # Perform Terminal Level Self Diagnosis under Self Test | Adds / removes the Terminal Level Self Diagnosis related service from Adc_Rb_SelfTest API. Terminal Level Self Diagnosis when enabled, makes use of the Even and Odd channels configured for every Hw Unit under the container "Channels to Perform Terminal Level Self Diagnosis".
      boolean AdcRbPinTestEnable [0..1]: multiplicity set at pre-compile, origin=RB:0.1.0:2014-05-05, set at pre-compile, default-value=false  # Enable Pin test | Adds / removes the Pin test related service from the driver
      boolean AdcRbPreCompileSupport [0..1]: multiplicity set at pre-compile, origin=RB:v0.1.0:2014-04-16, set at pre-compile, default-value=false  # Pre-Compile Support | Switches the Pre Compile Support ON or OFF.true: Enabled. false: Disabled.
      boolean AdcRbReadGroupNoLockApi [0..1]: multiplicity set at pre-compile, origin=RB:0.1.0:2014-12-12, set at pre-compile, default-value=false  # Enable Adc_Rb_ReadGroup_No_Lock function | Adds / removes the service Adc_Rb_ReadGroup_No_Lock() from the code. true: API can be used. false: API can not be used.
      boolean AdcRbSCLEnable [0..1]: multiplicity set at pre-compile, origin=RB:v0.1.0:2014-04-17, set at pre-compile, default-value=false  # Enable Supply check logic | Adds / removes the Supply check logic related service - Adc_Rb_ReadSCLGroup API from the code. Note: It is recommended to enable Adc_EnableHardwareTrigger function also to use supply check logic.
      boolean AdcRbSelfTestC5PEnable [0..1]: multiplicity set at pre-compile, origin=RB:0.1.0:2011-12-05, set at pre-compile, default-value=false  # Enable Cyclic five point self test | Adds / removes the cyclic five point self test related service from the driver
      boolean AdcRbSelfTestI3PEnable [0..1]: multiplicity set at pre-compile, origin=RB:0.1.0:2011-12-06, set at pre-compile, default-value=false  # Enable Initial three point self test | Adds / removes the initial three point self test related service from the driver
      boolean AdcRbStartStopGroupNoLockApi [0..1]: multiplicity set at pre-compile, origin=RB:0.1.0:2014-12-12, set at pre-compile, default-value=false  # Enable Adc_StartGroupConversion_No_Lock function | Adds / removes the service Adc_Rb_StartGroupConversion_No_Lock() from the code.
      boolean AdcRbSyncStartHwUnitsGroupConversionApi [0..1]: multiplicity set at pre-compile, origin=RB:0.1.0:2016-10-05, set at pre-compile, default-value=false  # Enable Adc_Rb_SyncStartHwUnitsGroupConversion function | Adds / removes the service Adc_Rb_SyncStartHwUnitsGroupConversion() from the code.
      boolean AdcReadGroupApi: set at pre-compile, default-value=true  # Enable Adc_ReadGroup function | Adds / removes the service Adc_ReadGroup() and Adc_Rb_CompleteGroupConversion() from the code. true: APIs can be used. false: APIs can not be used.
      enumeration AdcResultAlignment [0..0]: set at pre-compile, default-value=ADC_ALIGN_RIGHT  # Define Alignment | Alignment of ADC raw results in ADC result buffer (left/right alignment). Implementation Type: Adc_ResultAlignmentType
        ADC_ALIGN_LEFT  # Left alignment
        ADC_ALIGN_RIGHT  # Right alignment
      boolean AdcVersionInfoApi: set at pre-compile, default-value=false  # Enable Adc_GetVersionInfo function | Adds / removes the service Adc_GetVersionInfo() from the code. true: Adc_GetVersionInfo() can be used.
    container AdcPublishedInformation [0..0]  # Published Information | Additional published parameters not covered by CommonPublishedInformation container. Note that these parameters do not have any configuration class setting, since they are published information.
      boolean AdcChannelValueSigned [0..0]: set at pre-compile, default-value=false  # Sign information of channel | Information whether the result value of the ADC driver has sign information (true) or not (false). If the result shall be interpreted as signed value it shall apply to C-language rules.
      boolean AdcGroupFirstChannelFixed [0..0]: set at pre-compile, default-value=false  # First channel information | Information whether the first channel of an ADC Channel group can be configured (false) or is fixed (true) to a value determined by the ADC HW Unit.
      integer AdcMaxChannelResolution [0..0]: 1..63, set at pre-compile, default-value=12  # Channel resolution | Maximum Channel resolution in bits (does not specify accuracy).
