AUTOSAR XML (schema 4-2-2)
package /AUTOSAR_Xcp/EcucModuleDefs
  module definition Xcp [0..1]: category=VENDOR_SPECIFIC_MODULE_DEFINITION, refined-module-def=Xcp, variants pre-compile  # Configuration of the XCP (Universal Calibration Protocol) module with vendor specific enhancements of RB).
    container XcpA2LFile [0..1]  # Xcp A2L File | Contains parameters for A2L-file generation. Only relevant if Xcp component shall generate A2L file.
      integer XcpTimeoutT1 [0..1]: 0..65535, set at pre-compile, origin=RB, default-value=250  # Timeout T1 [ms] (optional) | Timeout value for slave response after command.
      integer XcpTimeoutT2 [0..1]: 0..65535, set at pre-compile, origin=RB, default-value=250  # Timeout T2 [ms] (optional) | Timeout value for slave response after command BUILD_CHECKSUM.
      integer XcpTimeoutT7 [0..1]: 0..65535, set at pre-compile, origin=RB, default-value=0  # Timeout T7 [ms] (optional) | Timeout value for master after slave error response.
      float XcpCpuLoadMaxTotal [0..1]: set at pre-compile, origin=RB  # CPU Load Max Total [0=0%, 1=100%] (optional) | Total CPU load limit regarding the DAQ measurement.
      float XcpCoreLoadMaxTotal [0..1]: set at pre-compile, origin=RB:19.0.0:2015-09-30  # CPU Core Load Max Total [0=0%, 1=100%] (optional) | TotalCORELoad limit regarding all cores
      container XcpCoreLoad [0..*]  # This container specifies additional CPU load parameters for one CPU core for A2L-file according to ASAM XCP Specification.
        integer XcpCoreNr: 0..65535, set at pre-compile, origin=RB:19.0.0:2015-09-30  # Core Nr | Specifies the CPU core reference number for which the CPU load parameter are configured
        float XcpCoreLoadMax [0..1]: set at pre-compile, origin=RB:19.0.0:2015-09-30  # CPU Core Load Max [0=0%, 1=100%] (optional) | CORELoad limit regarding all CpuLoadConsumption* parts assigned to Core(CoreNr)
        container XcpCpuLoadConsumption [1..4]  # This container specifies all CPU load consumption parameter according to ASAM XCP specification for one transport layer type.
          enumeration XcpCpuLoadConsumptionTransportLayerType: {CAN, ETHERNET_TCP, ETHERNET_UDP, FLEXRAY}, set at pre-compile, origin=RB:19.0.0:2015-09-30  # CPU Load Consumption Transport Layer Type | Specifies for which Transport Layer Type the CPU Load Consumption parameters in this container are configured.
          float XcpCpuLoadConsumptionDaqDaqFactor [0..1]: set at pre-compile, origin=RB:19.0.0:2015-09-30  # CPU Load Consumption DAQ - DAQ Factor [s] (optional) | Basic CPU load to be considered for each DAQ list.
          float XcpCpuLoadConsumptionDaqOdtFactor [0..1]: set at pre-compile, origin=RB:19.0.0:2015-09-30  # CPU Load Consumption DAQ - Odt Factor [s] (optional) | Basic CPU load to be considered for each ODT.
          float XcpCpuLoadConsumptionDaqOdtEntryFactor [0..1]: set at pre-compile, origin=RB:19.0.0:2015-09-30  # CPU Load Consumption DAQ - OdtEntry Factor [s] (optional) | CPU load caused by the handling of one single ODT entry.
          float XcpCpuLoadConsumptionStimDaqFactor [0..1]: set at pre-compile, origin=RB:19.0.0:2015-09-30  # CPU Load Consumption STIM - DAQ Factor [s] (optional) | Basic CPU load to be considered for each DAQ list of the copying processes from Queue to Variable.
          float XcpCpuLoadConsumptionStimOdtFactor [0..1]: set at pre-compile, origin=RB:19.0.0:2015-09-30  # CPU Load Consumption STIM - Odt Factor [s] (optional) | Basic CPU load to be considered for processing each ODT of the copying processes from Queue to Variable.
          float XcpCpuLoadConsumptionStimOdtEntryFactor [0..1]: set at pre-compile, origin=RB:19.0.0:2015-09-30  # CPU Load Consumption STIM - OdtEntry Factor [s] (optional) | CPU load caused by the handling of one single ODT entry of the copying processes from Queue to Variable.
          float XcpCpuLoadConsumptionQueueOdtFactor [0..1]: set at pre-compile, origin=RB:19.0.0:2015-09-30  # CPU Load Consumption Queue - Odt Factor [s] (optional) | Basic CPU load to be considered for buffering each ODT into the transmission queue.
          float XcpCpuLoadConsumptionQueueOdtElementLoad [0..1]: set at pre-compile, origin=RB:19.0.0:2015-09-30  # CPU Load Consumption Queue - OdtElement Load [s] (optional) | CPU load caused by copying one single element.
          float XcpCpuLoadConsumptionQueueStimOdtFactor [0..1]: set at pre-compile, origin=RB:19.0.0:2015-09-30  # CPU Load Consumption Queue STIM - Odt Factor [s] (optional) | Basic CPU load to be considered for buffering each ODT into the reception queue.
          float XcpCpuLoadConsumptionQueueStimOdtElementLoad [0..1]: set at pre-compile, origin=RB:19.0.0:2015-09-30  # CPU Load Consumption Queue STIM - OdtElement Load [s] (optional) | CPU load caused by copying one single element.
          container XcpCpuLoadConsumptionDaqOdtEntrySizeFactorTable [0..*]  # This container specifies CPU Load Consumption parameters for copy an ODT_ENTRY.
            integer XcpCpuLoadConsumptionDaqSize: 0..65535, set at pre-compile, origin=RB:19.0.0:2015-09-30  # CPU Load Consumption DAQ - Size | Parameter of Odt Entry Size Factor Table for DAQ. Integer value, unit is per Byte.
            float XcpCpuLoadConsumptionDaqSizeFactor: set at pre-compile, origin=RB:19.0.0:2015-09-30  # CPU Load Consumption DAQ - Size Factor [s] | Computing time for the copying of an ODT_ENTRY contents of the magnitude SIZE. If an ODT entry has a size which is not described by any of the table records, the next smaller size entry shall be applied. If no smaller size is defined, the next larger size shall be applied.
          container XcpCpuLoadConsumptionStimOdtEntrySizeFactorTable [0..*]  # This container specifies CPU Load Consumption parameters for copy an ODT_ENTRY.
            integer XcpCpuLoadConsumptionStimSize: 0..65535, set at pre-compile, origin=RB:19.0.0:2015-09-30  # CPU Load Consumption STIM - Size | Parameter of Odt Entry Size Factor Table for STIM. Integer value, unit is per Byte
            float XcpCpuLoadConsumptionStimSizeFactor: set at pre-compile, origin=RB:19.0.0:2015-09-30  # CPU Load Consumption STIM - Size Factor [s] | Computing time for the copying of an ODT_ENTRY contents of the magnitude SIZE. If an ODT entry has a size which is not described by any of the table records, the next smaller size entry shall be applied. If no smaller size is defined, the next larger size shall be applied.
      container XcpEventChannelA2L [0..*]  # This container specifies additional XcpEventChannel information for A2L-file. It can refer to a specific event channel, to a set of several event channels or to no specific event channel. When no reference is given, this event channel A2L information will be printed to all event channels, that do not have a referencing container.
        integer XcpEventChannelMinCycleTimeCycle [0..1]: 1..255, set at pre-compile, origin=RB  # Event Channel Min Cycle Time (optional) | Minimum cycle time (time distance) for triggering of the event
        float XcpCpuLoadMax [0..1]: set at pre-compile, origin=RB  # CPU Load Max [0=0%, 1=100%] (optional) | CPU load limit for one single event.
        float XcpCoreLoadEpMax [0..1]: set at pre-compile, origin=RB:19.0.0:2015-09-30  # Core Load EP Max [0=0%, 1=100%] (optional) | CORELoadDAQ limit for one single event part (EP).
        reference XcpCoreLoadEpRef [0..1]: set at pre-compile, origin=RB:19.0.0:2015-09-30, destination=XcpCoreLoad  # Core Load EP Ref (optional) | Reference to XcpCoreLoad. This reference gives the information on which CPU core the EventChannel runs.
        reference XcpEventChannelRef [0..*]: set at pre-compile, origin=RB, destination=XcpEventChannel  # Event Channel Ref (optional) | Reference to XcpEventChannel.
      container XcpTransportLayerA2L [0..*]  # This container specifies additional XcpTransportLayer information for A2L-file. These containers link the XcpEventChannelA2L information to the different transport layers.
        integer XcpMaxBusLoad [0..1]: 0..100, set at pre-compile, origin=RB, default-value=100  # Max Bus Load [%] (optional) | This indicates the maximum available busload in percent.[0 - 100%]
        boolean XcpOneTlPerCanCtrlBDRConfig [0..1]: set at pre-compile, origin=RB:AR42.1.4.0:2016-09-30, default-value=false  # Create one TL for each CanControllerBaudrateConfig into the A2L-file. (optional) | Enables/disables the output of one TL per CanControllerBaudrateConfig in the A2L-file. If disabled only the DefaultCanControllerBaudrateConfig is generated.
        reference XcpTransportLayerRef: set at pre-compile, origin=RB, destination=XcpTransportLayer  # Transport Layer Ref | Reference to the XCP transport layer.
        reference XcpEventChannelA2LRef [0..*]: set at pre-compile, origin=RB, destination=XcpEventChannelA2L  # Event Channel A2L Ref (optional) | Reference to the XCP event channel A2L.
        reference XcpCoreLoadQueueRef [0..1]: set at pre-compile, origin=RB:19.0.0:2015-09-30, destination=XcpCoreLoad  # Core Load Queue Ref (optional) | Reference to XcpCoreLoad. This reference gives the information on which CPU core the transmit processing is done. In case of CAN, where the TxConfirmation interrupt is processed. In case of Ethernet and FlexRay, where the Xcp_BusMainFunctionTx() is processed.
        reference XcpCoreLoadQueueStimRef [0..1]: set at pre-compile, origin=RB:19.0.0:2015-09-30, destination=XcpCoreLoad  # Core Load Queue Stim Ref (optional) | Reference to XcpCoreLoad. This reference gives the information on which CPU core the receive processing is done (mostly where RxIndication interrupt is processed). If this parameter is not filled out, XcpCoreLoadQueueRef will be used instead.
    container XcpConfig  # Xcp Configuration
      container XcpEventChannel [0..*]  # This container contains the configuration of event channels on the XCP slave.
        string XcpEventChannelName: set at pre-compile, origin=RB, max-length=101, min-length=1  # Event Channel Name (A2L-file) | Event Channel Name (for a2l, max. length 101)
        string XcpEventChannelShortName: set at pre-compile, origin=RB, max-length=9, min-length=1  # Event Channel Short Name | Event Channel Short Name (for SW + a2l, max. length 9). Out of this parameter, XCP generates a task to be scheduled: Xcp_EventChannel_ EventChannelShortName
        integer XcpEventChannelNumber [0..1]: 0..65534, set at pre-compile, symbolic-name-value=true, with-auto=true  # Event Channel Number | Index number of the event channel.
        integer XcpEventChannelPriority: 0..255, set at pre-compile  # Event Channel Priority | Priority of the event channel (0xFF = highest)
        integer XcpEventChannelTimeCycle: 0..255, set at pre-compile  # Event Channel Time Cycle (A2L-file) | The event channel time cycle indicates which sampling period is used to process this event channel. A value of 0 means "Not cyclic"
        enumeration XcpEventChannelTimeUnit: {TIMESTAMP_UNIT_1PS, TIMESTAMP_UNIT_10PS, TIMESTAMP_UNIT_100PS, TIMESTAMP_UNIT_1NS, TIMESTAMP_UNIT_10NS, TIMESTAMP_UNIT_100NS, TIMESTAMP_UNIT_1US, TIMESTAMP_UNIT_10US, TIMESTAMP_UNIT_100US, TIMESTAMP_UNIT_1MS, TIMESTAMP_UNIT_10MS, TIMESTAMP_UNIT_100MS, TIMESTAMP_UNIT_1S}, set at pre-compile  # Event Channel Time Unit (A2L-file) | This configuration parameter indicates the unit of the event channel time cycle. - TIMESTAMP_UNIT_100MS indicates Unit is 100 millisecond - TIMESTAMP_UNIT_100NS indicates Unit is 100 nanosecond - TIMESTAMP_UNIT_100PS indicates Unit is 100 picosecond - TIMESTAMP_UNIT_100US indicates Unit is 100 microsecond - TIMESTAMP_UNIT_10MS indicates Unit is 10 millisecond - TIMESTAMP_UNIT_10NS indicates Unit is 10 nanosecond - TIMESTAMP_UNIT_10PS indicates Unit is 10 picosecond - TIMESTAMP_UNIT_10US indicates Unit is 10 microsecond - TIMESTAMP_UNIT_1MS indicates Unit is 1 millisecond - TIMESTAMP_UNIT_1NS indicates Unit is 1 nanosecond - TIMESTAMP_UNIT_1PS indicates Unit is 1 picosecond - TIMESTAMP_UNIT_1S indicates Unit is 1 second - TIMESTAMP_UNIT_1US indicates Unit is 1 microsecond
        enumeration XcpEventChannelType: {DAQ, STIM}, set at pre-compile  # Event Channel Type | This configuration parameter indicates what kind of DAQ list can be allocated to this event channel. - DAQ indicates only DAQ lists with DIRECTION = DAQ supported - STIM indicates only DAQ lists with DIRECTION = STIM supported
        reference XcpEventChannelRefComplementaryBypass [0..1]: set at pre-compile, origin=RB, destination=XcpEventChannel  # Event Channel Ref Complementary Bypass (optional, A2L-file) | Reference to XcpEventChannel to print COMPLEMENTARY_BYPASS_EVENT_CHANNEL_NUMBER to A2L-file. This can be used to make a combination of two event channels building a bypassing raster. A bypassing tool can use this information to display the available bypass events of an ECU. A DAQ EventChannel shall refer to the STIM EventChannel which writes data in the same cycle. A STIM EventChannel shall refer to the DAQ EventChannel which measures data in the same cycle
      container XcpTransportLayer [1..*]  # This container contains the configuration of the transport layers.
        string XcpTransportLayerName [0..1]: set at pre-compile, origin=RB, max-length=101, min-length=1  # Transport Layer Name (optional, A2L-file) | Xcp Transport Layer Name
        enumeration XcpTransportLayerType: {CAN, ETHERNET_TCP, ETHERNET_UDP, FLEXRAY}, set at pre-compile, origin=RB:10.2.0:2013-11-27  # Transport Layer Type | Xcp Transport Layer Type.
        integer XcpDaqMemoryLimit [0..1]: 0..4294967295, set at pre-compile, origin=RB  # DAQ memory limit [byte] (optional) | The size of RAM allocated for dynamic DAQ configuration in Bytes. Xcp DAQ memory limit [byte] shall have the RAM size value which can be divided by 4. If not configured, value in XcpGeneral will be used to calculate this value. Set to zero, if you have PD RAM available, but do not want to use it with this transport layer.
        integer XcpDaqMemoryLimitEmulationDevice [0..1]: 0..4294967295, set at pre-compile, origin=RB  # DAQ memory limit Emulation Device [byte] (optional, MDG1) | The size of RAM allocated for dynamic DAQ configuration in Bytes in emulation device (ED) RAM area. If not configured, value in XcpGeneral will be used to calculate this value. Set to zero, if you have ED RAM available, but do not want to use it with this transport layer. Not available in Production Devices, only in Emulation Device If a ED memory is configured, Transport Layer will be duplicated in the A2L. Xcp DAQ memory limit Emulation Device [byte] shall have the RAM size value which can be divided by 4.
        integer XcpMaxCto: 8..255, set at pre-compile, origin=RB  # MAX_CTO | MAX_CTO shows the maximum length of a CTO packet in bytes for this transport layer.
        integer XcpMaxDto: 8..65535, set at pre-compile  # MAX_DTO | MAX_DTO shows the maximum length of a DTO packet in bytes for this transport layer.
        enumeration XcpDaqOverloadIndication [0..1]: {NO_OVERLOAD_INDICATION, OVERLOAD_INDICATION_PID, OVERLOAD_INDICATION_EVENT}, set at pre-compile, origin=RB:10.2.0:2013-11-27, default-value=NO_OVERLOAD_INDICATION  # DAQ Overload Indication (optional) | This indicates the method used to indicate the DAQ overload situation. - NO_OVERLOAD_INDICATION indicates No overload indication - OVERLOAD_INDICATION_PID indicates overload indication in MSB of PID - OVERLOAD_INDICATION_EVENT indicates overload indication by Event Packet
        enumeration XcpIdentificationFieldType [0..1]: {ABSOLUTE, RELATIVE_BYTE, RELATIVE_WORD, RELATIVE_WORD_ALIGNED}, set at pre-compile, origin=ATUTOSAR_ECUC, default-value=ABSOLUTE  # Identification Field Type (optional) | Type of Identification Field the slave will use when transferring DAQ Packets to the master. The master has to use the same Type of Identification Field when transferring STIM Packets to the slave. - ABSOLUTE indicates identification type Absolute ODT number - RELATIVE_BYTE indicates identification field type Relative ODT number, absolute DAQ list number (BYTE) - RELATIVE_WORD indicates identification field type Relative ODT number, absolute DAQ list number (WORD) - RELATIVE_WORD_ALIGNED indicates identification field type Relative ODT number, absolute DAQ list number (WORD, aligned)
        enumeration XcpTimestampType [0..1]: {NO_TIME_STAMP, ONE_BYTE, TWO_BYTE, FOUR_BYTE}, set at pre-compile, origin=ATUTOSAR_ECUC, default-value=NO_TIME_STAMP  # Timestamp Type (optional) | This parameter indicates the number of bytes used for the timestamp field. In case No_TIME_STAMP is selected the timestamp field is not available. - NO_TIME_STAMP indicates no timestamp field - ONE_BYTE indicates one byte timestamp field - TWO_BYTE indicates two byte timestamp field - FOUR_BYTE indicates four bytes timestamp field
        enumeration XcpOdtOptimization [0..1]: {OM_DEFAULT, OM_ODT_TYPE_32}, set at pre-compile, origin=RB:19.2.0:2015-11-30, default-value=OM_DEFAULT  # ODT Optimization (optional) | This parameter defines if optimized copy-routines for copying the OdtEntries are used. It defines the largest copy-routine available. Note: This parameter does not define the largest possible datatype. A multiple of the copy-routine is also possible - OM_DEFAULT indicates no optimization. The default safe-copy routine is used - OM_ODT_TYPE_32 indicates that optimized copy routines for two and four bytes are used
        enumeration XcpConsistency [0..1]: {EVENT, DAQ, ODT, NONE}, set at pre-compile, origin=RB:20.4.0:2016-04-26, default-value=ODT  # Consistency (optional) | This parameter defines which CONSISTENCY is used. It has no impact on the Xcp-Implementation. The integrator has to place the calls of the EventChannel-Functions in the correct locations to achieve the requested consistency.
        integer XcpTransportLayerId [0..1]: 0..255, set at pre-compile, origin=RB, symbolic-name-value=true, with-auto=true  # Transport Layer Id (generated) | ID of the transport layer. Needed for separation of different transport layer.
        boolean XcpFrameConcatenation [0..1]: set at pre-compile, origin=RB, default-value=false  # Frame Concatenation (only Ethernet and FlexRay) | Enables/Disables the concatenation of several XCP protocol layer packtes into one transport layer frame (with transport layer headers).
        container XcpTransportLayerFlexRay [0..1]  # This container contains the additional needed XCPonFlexRay parameters in case XcpTransportLayerType is FLEXRAY
          integer XcpFrTimeoutT1Flx [0..1]: 0..65535, set at pre-compile, origin=RB, default-value=250  # Timeout T1_FLX [ms] (optional, A2L-file) | Timeout value for slave response after FlexRay transport layer command FLX_ASSIGN.
          integer XcpFrNax: 0..255, set at pre-compile, origin=RB  # NAX (Node Address for XCP) | Every node in a cluster that is an XCP slave has to have a NAX. The NAX has to be unique within the FlexRay cluster.
          boolean XcpFrSequenceCorrection: set at pre-compile, origin=RB  # Sequence Correction | Enables/Disables the possibility of sequence correcting. The 1-byte field CTR is added to XCP Header and allows to detect missing packets and to correct sequencing errors.
          enumeration XcpFrPacketAlignment: {PACKET_ALIGNMENT_8, PACKET_ALIGNMENT_16, PACKET_ALIGNMENT_32}, set at pre-compile, origin=RB:15.0.0:2014-06-26  # Packet Alignment | Packet Alignment indicates the alignment a slave uses for its XCP packets. The performance for accessing the contents of the XCP messages can be increased when an XCP packet starts on an aligned address.
        container XcpRxPdu [1..*]  # This container specifies received PDUs.
          enumeration XcpRxPacketType: {CMD, CMD_STIM, STIM, VARIABLE}, set at pre-compile, origin=RB:10.2.0:2013-11-27  # Rx Packet Type (A2L-file) | This indicates the packet type for which the xcp pdu is created. - CMD indicates Command packet type - CMD_STIM indicates Command and STIM packet type - STIM indicates STIM packet type
          integer XcpRxPduId [0..1]: 0..65535, set at pre-compile, symbolic-name-value=true, with-auto=true  # Rx Pdu Id (generated) | ID of the PDU that will be received via a Xcp_<module>RxIndication.
          reference XcpRxPduRef: set at post-build in variant post-build / pre-compile in variant pre-compile, destination=Pdu  # Rx Pdu Ref | This name uniquely identifies a group of type "XcpRxPduRef"
          reference XcpEventChannelRef [0..1]: set at pre-compile, origin=RB, destination=XcpEventChannel  # Event Channel Ref (optional, A2L-file) | Reference to XcpEventChannel. XcpEventChannelRef of RxPdu must be empty for XcpVersion VERSION_1_0 and VERSION_1_1. For XCPonCAN XcpEventChannelRef can be configured if XcpRxPacketType is STIM
        container XcpTxPdu [1..*]  # This container specifies transmission PDUs.
          enumeration XcpTxPacketType: {RES_ERR, EV_SERV, RES_ERR_EV_SERV, DAQ, RES_ERR_EV_SERV_DAQ, VARIABLE}, set at pre-compile, origin=RB:10.2.0:2013-11-27  # Tx Packet Type | This indicates the packet type for which the Xcp PDU is created.
          integer XcpTxPduId [0..1]: 0..65535, set at pre-compile, symbolic-name-value=true, with-auto=true  # Tx Pdu Id (generated) | The PDU identifier, which has to be used by the lower layer BSW module for TxConfirmations or TriggerTransmits.
          reference XcpTxPduRef: set at post-build in variant post-build / pre-compile in variant pre-compile, destination=Pdu  # Tx Pdu Ref | Reference to the external PDU definition.
          reference XcpEventChannelRef [0..1]: set at pre-compile, origin=RB, destination=XcpEventChannel  # Event Channel Ref (optional) | Reference to XcpEventChannel XcpEventChannelRef of TxPdu must be empty for XcpVersion VERSION_1_0 and VERSION_1_1. XcpEventChannelRef can be configured if XcpTxPacketType is DAQ for XCPOnCAN
    container XcpGeneral  # This container contains the general configuration parameters of the XCP.
      enumeration XcpProductLine: {OTHER, CSMOSAR, MDG1}, set at pre-compile, origin=RB:11.1.0:2012-12-20  # Product Line | Select product line for pre-filled XCP template files and validation checks.
      enumeration XcpVersion: {VERSION_1_0, VERSION_1_1, VERSION_1_2, VERSION_1_3, VERSION_1_4}, set at pre-compile, origin=RB:11.1.0:2012-12-20  # XCP Version | Version of XCP protocol and transport layer. If lower version numbers are configured, not all features are supported.
      boolean XcpCalibrationCal [0..1]: set at pre-compile, origin=RB, default-value=false  # Calibration (CAL) (optional) | Enables/Disables the ASAM XCP feature online memory calibration (CAL)
      boolean XcpPageSwitchingPag [0..1]: set at pre-compile, origin=RB, default-value=false  # Page Switching (PAG) (optional) | Enables/Disables the ASAM XCP feature page switching (PAG). XcpPageSwitchingPag may only be enabled if XcpCalibrationCal is enabled.
      boolean XcpSynchronousDataAcquisitionDaq [0..1]: set at pre-compile, origin=RB, default-value=false  # Synchronous Data Acquisition (DAQ) (optional) | Enables/Disables the ASAM XCP feature Synchronous Data Acquisition (DAQ).
      boolean XcpSynchronousDataStimulationStim [0..1]: set at pre-compile, origin=RB, default-value=false  # Synchronous Data Stimulation (STIM) (optional) | Enables/Disables the ASAM XCP feature Synchronous Data Stimulation (STIM). XcpSynchronousDataStimulationStim may only be enabled if XcpSynchronousDataAcquisitionDaq is enabled.
      integer XcpDaqMemoryLimit: 0..4294967295, set at pre-compile, origin=RB  # Daq Memory Limit [byte] | Total Memory for DAQ configurations for ALL protocol layers. Daq Memory Limit [byte] shall have the RAM size value which can be divided by 4. This Parameter is the calculatory base for PD transport layers' DAQ Memory Limit in A2L, if not specified differently directly in the XcpTransportLayer config.
      integer XcpDaqMemoryLimitEmulationDevice [0..1]: 0..4294967295, set at pre-compile, origin=RB, default-value=0  # Daq Memory Limit Emulation Device [byte] (optional, MDG1) | Total Memory for DAQ configurations for ALL protocol layers in emulation device (ED) RAM area. Not available in Production Devices, only in Emulation Device. Daq Memory Limit Emulation Device [byte] shall have the RAM size value which can be divided by 4. If you enter a value here, all transport layers with an empty DAQ Memory Limit Emulation Device will be duplicated in the A2L file. This Parameter is the calculatory base for ED transport layers' DAQ Memory Limit in A2L, if not specified differently directly in the XcpTransportLayer config.
      float XcpDaqQueueFactor [0..1]: 1..128, set at pre-compile, origin=RB:17.0.0:2015-03-18, default-value=2  # Daq Queue Factor (optional) | This parameter decides, how many memory is reserved for DAQ queues. E.g. 2 means, that two full measurement cycles fit into the queue without overload.
      integer XcpStimQueueFactor [0..1]: 1..128, set at pre-compile, origin=RB:17.0.0:2015-03-18, default-value=3  # Stim Queue Factor (optional) | This parameter decides, how many memory is reserved for STIM queues. E.g. 3 means, that three complete stimulation cycles fit into the queue.
      boolean XcpSecondSlaveInstance [0..1]: set at pre-compile, origin=RB, default-value=false  # Second Slave Instance (optional) | If two XCP Masters shall be able to connect at the same time, enable this feature.
      boolean XcpDaqRamShifting [0..1]: set at pre-compile, origin=RB, default-value=false  # DAQ RAM Shifting (optional) | Enables/disables shifting of DAQ RAM after DAQ config is finished by the master. This is only available, when more than one protocol layer is configured. DAQ RAM Shifting enables the optimal ram utilization, but can lead to ERR_MEM_OVERFLOW, when not enough ram for both protocol layers is available.
      integer XcpDaqRamShiftSize [0..1]: 128..32768, set at pre-compile, origin=RB, default-value=1024  # DAQ RAM Shift Size [byte] (optional) | Defines the maximum amount of bytes which is shifted during one Xcp_MainFunction call. This value must be divisible by 4.
      enumeration XcpOdtOptimizationErrorReaction [0..1]: {FALLBACK_TO_OM_DEFAULT, ABORT_CONFIGURATION}, set at pre-compile, origin=RB:19.2.0:2015-11-30, default-value=FALLBACK_TO_OM_DEFAULT  # ODT Optimization - Error Reaction (optional) | Defines the reaction if an error during the DAQ-configuration is detected. An error is e.g. if the copy routine for the OdtEntry is not the same for all OdtEntries in one Odt. From ASAM v1.4 on when the value is ABORT_CONFIGURATION and ODT Optimization is other than OM_DEFAULT the OPTIMISATION_TYPE_ODT_STRICT is generated in the A2L.
      boolean XcpResumeMode [0..1]: set at pre-compile, origin=RB:18.2.0:2015-07-27, default-value=false  # Resume Mode (optional) | Enables/Disables the ASAM XCP feature RESUME mode
      boolean XcpBlockTransferUpload [0..1]: set at pre-compile, origin=RB, default-value=false  # Block Transfer Upload (optional) | Enables/Disables the ASAM XCP feature SLAVE_BLOCK_MODE (block transfer from slave to master)
      boolean XcpBlockTransferDownload [0..1]: set at pre-compile, origin=RB, default-value=false  # Block Transfer Download (optional) | Enables/Disables the ASAM XCP feature MASTER_BLOCK_MODE (block transfer from master to slave)
      boolean XcpSeedAndKey [0..1]: set at pre-compile, origin=RB, default-value=false  # Seed And Key (optional) | Enables/Disables the XCP Seed and Key Feature. If XcpSeedAndKey is enabled, a protected resource can be UNLOCKed (using UNLOCK command) by using SEED (Using GET_SEED command) User function XcpAppl_GetSeed is called in GET_SEED to generate seed for unlock key calculation. User function XcpAppl_Unlock is called in UNLOCK to reads key or collects parts of the key, concatenate them, then checks if given key is valid.
      string XcpSeedAndKeyExternalFunction [0..1]: set at pre-compile, origin=RB  # Seed And Key External Function (optional, A2L-file) | Name of the Seed And Key function including file extension without path. This file is used by XCP master.
      boolean XcpCommandChecksum [0..1]: set at pre-compile, origin=RB:10.2.0:2013-11-27, default-value=false  # Command BUILD_CHECKSUM | This is a boolean parameter which indicates if checksum is supported for BUILD_CHECKSUM command. XcpCommandChecksum supports: - False -Checksum is not supported, - True - User defined algorithm, in externally calculated function. In product line MDG1 please use USER_DEFINED for checksum calculation.
      integer XcpMtaBlockSizeAlign [0..1]: 1..65535, set at pre-compile, origin=RB:16.2.0:2015-02-20, default-value=1  # MTA BLOCK SIZE ALIGN (optional) | This parameter provides limitations of slave device for the alignment of MTA and block size for BUILD_CHECKSUM. This parameter can be configured when XcpCommandChecksum is true. Also XcpVersion VERSION_1_3 or higher must be configured.
      boolean XcpCmdReceivedNotification [0..1]: set at pre-compile, origin=RB  # CMD Received Notification (optional) | Enables/Disables call of user function XcpAppl_CmdReceived() for every received command
      boolean XcpConnectTransportLayerCallout [0..1]: set at pre-compile, origin=RB:17.0.0:2015-03-24, default-value=false  # Connect TransportLayer Callout (optional) | Enables/Disables call of user function XcpAppl_ConnectTransportLayer() to allow connection from this TransportLayer or not
      boolean XcpMemoryReadProtection [0..1]: set at pre-compile, origin=RB, default-value=false  # Memory Read Protection (optional) | Enables/Disables the protection for reading data from memory. User function XcpAppl_MemoryReadProtection() is called if enabled, which checks if it is allowed to read from memory. This parameter is mandatory to enable in product line MDG1.
      boolean XcpMemoryWriteProtection [0..1]: set at pre-compile, origin=RB, default-value=false  # Memory Write Protection (optional) | Enables/Disables the protection for writing data into memory. User function XcpAppl_MemoryWriteProtection() is called if enabled, which checks if it is allowed to write into memory. This parameter is mandatory to enable in product line MDG1.
      boolean XcpUploadDownloadMemoryAccessByAppl [0..1]: set at pre-compile, origin=RB, default-value=false  # Upload/Download Memory Access By Appl (optional) | Enables/Disables call of user functions XcpAppl_MemRead() and XcpAppl_MemWrite() which read/write data. If disabled, generic build in functions are used for memory access. This parameter must be enabled for MDG1 product line
      boolean XcpDaqStimMemoryAccessByAppl [0..1]: set at pre-compile, origin=RB:20.3.0:2016-03-28, default-value=false  # DAQ/STIM Memory Access By Appl (optional) | Enables/Disables call of user functions XcpAppl_OdtEntryRead() and XcpAppl_OdtEntryWrite() which read/write data. If disabled, generic build in functions are used for memory access.
      boolean XcpStaticAddressTransformation [0..1]: set at pre-compile, origin=RB:20.5.0:2016-05-31, default-value=false  # Static address transformation (optional) | Enables/Disables the call of the user fuction XcpAppl_StaticAddressTransformation. If enabled all addresses for UPLOAD/DOWNLOAD/DAQ/STIM are passed to this function where they can be replaced by another address.
      boolean XcpCommandGetCommModeInfo [0..1]: set at pre-compile, origin=RB:17.2.0:2015-05-30, default-value=false  # Command GET_COMM_MODE_INFO (optional) | Enables/disabled optional command GET_COMM_MODE_INFO which provides communication supported information.
      boolean XcpCommandGetId [0..1]: set at pre-compile, origin=RB, default-value=false  # Command GET_ID (optional) | Enables/Disables command GET_ID to get the Identification from slave. User function XcpAppl_GetIdSlave() is called if enabled
      boolean XcpCommandUserCmd [0..1]: set at pre-compile, origin=RB:18.0.0:2015-06-30, default-value=false  # Command USER_CMD (optional) | Enables/Disables optional User Defined command USER_CMD
      boolean XcpCommandModifyBits [0..1]: set at pre-compile, origin=RB:17.2.0:2015-05-30, default-value=false  # Command MODIFY_BITS (optional) | Enables/Disables command MODIFY_BITS, which allows to modify bits in an atomic way.
      boolean XcpCommandsGetPagInfo [0..1]: set at pre-compile, origin=RB:17.2.0:2015-05-30, default-value=false  # Commands GET_PAG..._INFO (optional) | Enables/Disables optional commands GET_PAG_PROCESSOR_INFO, GET_SEGMENT_INFO, GET_PAGE_INFO
      boolean XcpCommandGetDaqListMode [0..1]: set at pre-compile, origin=RB:18.2.0:2015-07-29, default-value=false  # Command GET_DAQ_LIST_MODE (optional) | Enables/Disables optional command GET_DAQ_LIST_MODE which returns information on the current mode of the specified DAQ list.
      boolean XcpCommandReadDaq [0..1]: set at pre-compile, origin=RB:18.2.0:2015-08-30, default-value=false  # Command READ_DAQ (optional) | Enables/Disables optional command READ_DAQ. The command reads one ODT entry of a DAQ list defined by the DAQ list pointer.
      boolean XcpCommandsGetDaqInfo [0..1]: set at pre-compile, origin=RB:18.2.0:2015-07-24, default-value=false  # Commands GET_DAQ_..._INFO (optional) | Enables/Disables optional commands GET_DAQ_PROCESSOR_INFO, GET_DAQ_RESOLUTION_INFO, GET_DAQ_EVENT_INFO
      boolean XcpDevErrorDetect: set at pre-compile  # Development Error Detection | Switches the Development Error Detection and Notification on or off.
      float XcpMainFunctionPeriod: 0..INF, set at pre-compile  # Xcp_MainFunction() calling period [s] | The XCP does not require this information but the BSW scheduler, which invokes the main function, needs it in order to plan its tasks. Example Period : for 10ms = 0.01
      float XcpEthMainFunctionPeriod [0..1]: 0..INF, set at pre-compile, origin=RB:20.0.0:2015-12-16  # Xcp_EthMainFunctionTx() Calling period [s] (optional) | The XCP on Ethernet does not require this information but the BSW scheduler, which invokes the main function, needs it in order to plan its tasks. If Xcp on ETHERNET_TCP or Xcp on ETHERNET_UDP is configured, XcpEthMainFunctionPeriod parameter must be configured. Example Period : for 1ms = 0.001
      boolean XcpEventChannelScheduling [0..1]: set at pre-compile, origin=RB:3.0.0:2017-07-20, default-value=false  # Schedule event channels in BSW via BSWMD template | If set to TRUE all the configured event channels will be scheduled in the BSW via BSWMD template.
      integer XcpTimestampTicks [0..1]: 1..65535, set at pre-compile  # Timestamp Ticks (optional) | This parameter defines the timestamp that will increment based TIMESTAMP_TICKS per unit and wrap around if an overflow occurs.
      enumeration XcpTimestampUnit [0..1]: {TIMESTAMP_UNIT_1PS, TIMESTAMP_UNIT_10PS, TIMESTAMP_UNIT_100PS, TIMESTAMP_UNIT_1NS, TIMESTAMP_UNIT_10NS, TIMESTAMP_UNIT_100NS, TIMESTAMP_UNIT_1US, TIMESTAMP_UNIT_10US, TIMESTAMP_UNIT_100US, TIMESTAMP_UNIT_1MS, TIMESTAMP_UNIT_10MS, TIMESTAMP_UNIT_100MS, TIMESTAMP_UNIT_1S}, set at pre-compile  # Timestamp Unit (optional) | This parameter indicates the resolution of the data acquisition clock of the slave when transferring data to master. - TIMESTAMP_UNIT_100MS indicates Unit is 100 millisecond - TIMESTAMP_UNIT_100NS indicates Unit is 100 nanosecond - TIMESTAMP_UNIT_100PS indicates Unit is 100 picosecond - TIMESTAMP_UNIT_100US indicates Unit is 100 microsecond - TIMESTAMP_UNIT_10MS indicates Unit is 10 millisecond - TIMESTAMP_UNIT_10NS indicates Unit is 10 nanosecond - TIMESTAMP_UNIT_10PS indicates Unit is 10 picosecond - TIMESTAMP_UNIT_10US indicates Unit is 10 microsecond - TIMESTAMP_UNIT_1MS indicates Unit is 1 millisecond - TIMESTAMP_UNIT_1NS indicates Unit is 1 nanosecond - TIMESTAMP_UNIT_1PS indicates Unit is 1 picosecond - TIMESTAMP_UNIT_1S indicates Unit is 1 second - TIMESTAMP_UNIT_1US indicates Unit is 1 microsecond In product line MDG1, please use 1, 10 or 100 US.
      boolean XcpVersionInfoApi: set at pre-compile  # Version Info Api | Enables/disables the existence of the XCP_GetVersionInfo() API service.
      reference XcpNvRamBlockIdRef [0..2]: set at pre-compile, origin=RB:18.2.0:2015-07-27, destination=NvMBlockDescriptor  # Nv Ram Block Id Reference (optional) | This reference is used for Resume Mode to point to the corresponding NvM block for XCP
