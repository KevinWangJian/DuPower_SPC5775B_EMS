AUTOSAR XML (schema 4-2-2)
package /AUTOSAR_Compiler/EcucModuleDefs
  module definition Compiler: category=VENDOR_SPECIFIC_MODULE_DEFINITION, refined-module-def=Compiler, variants pre-compile  # CUBAS Central Elements: Compiler
    container CompilerRbSettings  # Configuration settings for CUCEL Central Elements module: Compiler
      enumeration CompilerRbArRelease: origin=RB:42.1.0.0:2016-10-14, set at pre-compile  # Configuration parameter for the AUTOSAR version/revision | Select the AUTOSAR version/revision the project is based on
        AR42_Rev2  # AUTOSAR Version 4.2 Revison 2
      enumeration CompilerRbCompilerAbstraction: origin=RB:2.0.0:2013-06-12, set at pre-compile  # Configuration parameter for activation of the compiler abstraction feature. | If CompilerRbCompilerAbstraction is set to "ACTIVATE", the compiler abstraction macros (FUNC, VAR, ...) will be activated. That means that the macro parameters "memclass" and "prtclass" are used and therefore in the header "Compiler_Cfg.h" the #defines have to be set to module-specific values. If "DEACTIVATE" is chosen the compiler abstraction macros are deactivated and the header "Compiler_Cfg.h" must not be instrumented during integration.
        ACTIVATE  # Activate compiler abstraction macros (FUNC, VAR, ...)
        DEACTIVATE  # Deactivate compiler abstraction macros (FUNC, VAR, ...)
      string CompilerRbInlineDefinition: origin=RB:2.0.0:2013-06-12, set at pre-compile, default-value=inline  # Configuration parameter to define the native declaration of the definition of an inline function INLINE | Specify the native declaration which is used by the compiler to define an inline function (e.g. inline, _inline, _inline_)
      string CompilerRbLocalInlineDefinition: origin=RB:2.0.0:2013-06-12, set at pre-compile, default-value=inline  # Configuration parameter to define the native declaration of the definition of the local inline function LOCAL_INLINE | Specify the native declaration which is used by the compiler to define a local inline function (e.g. static inline __attribute__ ((always_inline)))
