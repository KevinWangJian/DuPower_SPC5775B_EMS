AUTOSAR XML (schema 4-2-2)
package /ETAS_Project/EcucModuleConfigurationValuess
  module config Com: implementation-config-variant=VARIANT-PRE-COMPILE
    ComConfig_0 (ComConfig): ComConfigurationId=0
      51 x ComIPdu, all with ComIPduSignalProcessing=IMMEDIATE:
        PEU_0B4h_Can_Network_CANNODE_0: ComIPduDirection=RECEIVE, ComTimeout=0.1, ComIPduHandleId=11, ComIPduErrorNotification=Com_RxTOCbk_PEU_0B4h_Can_Network_CANNODE_0, ComIpduNotificationCallback=Com_RxCbk_PEU_0B4h_Can_Network_CANNODE_0, ComIPduType=NORMAL, ComFirstTimeout=0.0, ComIPduGroupRef=ComIPduGroup_Rx, ComIPduSignalRef=V_DC, ComIPduSignalRef=V_DCValidity, ComPduIdRef=PEU_0B4h_Can_Network_CANNODE_0_PduR2Com
        VCU_1E3h_Can_Network_CANNODE_0: ComIPduDirection=RECEIVE, ComTimeout=0.2, ComIPduHandleId=15, ComIPduErrorNotification=Com_RxTOCbk_VCU_1E3h_Can_Network_CANNODE_0, ComIpduNotificationCallback=Com_RxCbk_VCU_1E3h_Can_Network_CANNODE_0, ComIPduType=NORMAL, ComFirstTimeout=0.0, ComIPduGroupRef=ComIPduGroup_Rx, ComIPduSignalRef=PTHVCntctrReq, ComIPduSignalRef=ChrgrStatPTHVCntctrClsAlwd, ComIPduSignalRef=ChrgrStatPTHVCntctOpnrAlwd, ComIPduSignalRef=RollingCounter_1E3h, ComIPduSignalRef=CheckSum_1E3h, ComPduIdRef=VCU_1E3h_Can_Network_CANNODE_0_PduR2Com
        PEU_18Bh_Can_Network_CANNODE_0: ComIPduDirection=RECEIVE, ComTimeout=0.1, ComIPduHandleId=12, ComIPduErrorNotification=Com_RxTOCbk_PEU_18Bh_Can_Network_CANNODE_0, ComIpduNotificationCallback=Com_RxCbk_PEU_18Bh_Can_Network_CANNODE_0, ComIPduType=NORMAL, ComFirstTimeout=0.0, ComIPduGroupRef=ComIPduGroup_Rx, ComIPduSignalRef=InvADCCrntV, ComIPduSignalRef=InvADCCrnt, ComPduIdRef=PEU_18Bh_Can_Network_CANNODE_0_PduR2Com
        VCU_ABS_23Ch_Can_Network_CANNODE_0: ComIPduDirection=RECEIVE, ComTimeout=0.2, ComIPduHandleId=17, ComIPduErrorNotification=Com_RxTOCbk_VCU_ABS_23Ch_Can_Network_CANNODE_0, ComIpduNotificationCallback=Com_RxCbk_VCU_ABS_23Ch_Can_Network_CANNODE_0, ComIPduType=NORMAL, ComFirstTimeout=0.0, ComIPduGroupRef=ComIPduGroup_Rx, ComIPduSignalRef=VehicleSpeedStatus, ComIPduSignalRef=VehicleSpeed, ComIPduSignalRef=MessageCounter_23Ch, ComIPduSignalRef=CheckSum_23Ch, ComPduIdRef=VCU_ABS_23Ch_Can_Network_CANNODE_0_PduR2Com
        DCDC_303h_Can_Network_CANNODE_0: ComIPduDirection=RECEIVE, ComTimeout=1.0, ComIPduHandleId=9, ComIPduErrorNotification=Com_RxTOCbk_DCDC_303h_Can_Network_CANNODE_0, ComIpduNotificationCallback=Com_RxCbk_DCDC_303h_Can_Network_CANNODE_0, ComIPduType=NORMAL, ComFirstTimeout=0.0, ComIPduGroupRef=ComIPduGroup_Rx, ComIPduSignalRef=I_LDC_In, ComIPduSignalRef=CDU_HVILWarning, ComPduIdRef=DCDC_303h_Can_Network_CANNODE_0_PduR2Com
        VCU_BCM_1F1h_Can_Network_CANNODE_0: ComIPduDirection=RECEIVE, ComTimeout=0.2, ComIPduHandleId=18, ComIPduErrorNotification=Com_RxTOCbk_VCU_BCM_1F1h_Can_Network_CANNODE_0, ComIpduNotificationCallback=Com_RxCbk_VCU_BCM_1F1h_Can_Network_CANNODE_0, ComIPduType=NORMAL, ComFirstTimeout=0.0, ComIPduGroupRef=ComIPduGroup_Rx, ComIPduSignalRef=SysPwrMd, ComIPduSignalRef=SysOpnlMd, ComIPduSignalRef=SysVolMdV, ComIPduSignalRef=SysVolV, ComIPduSignalRef=SysVol, ComIPduSignalRef=SysVolMd, ComPduIdRef=VCU_BCM_1F1h_Can_Network_CANNODE_0_PduR2Com
        Tester_748h_Can_Network_CANNODE_0: ComIPduDirection=RECEIVE, ComIPduHandleId=13, ComIPduType=NORMAL, ComIPduGroupRef=ComIPduGroup_Rx, ComIPduSignalRef=TesterDiagRequestData_BMS, ComPduIdRef=Tester_748h_Can_Network_CANNODE_0_PduR2Com
        VCU_IPK_1F2h_Can_Network_CANNODE_0: ComIPduDirection=RECEIVE, ComTimeout=0.2, ComIPduHandleId=20, ComIPduErrorNotification=Com_RxTOCbk_VCU_IPK_1F2h_Can_Network_CANNODE_0, ComIpduNotificationCallback=Com_RxCbk_VCU_IPK_1F2h_Can_Network_CANNODE_0, ComIPduType=NORMAL, ComFirstTimeout=0.0, ComIPduGroupRef=ComIPduGroup_Rx, ComIPduSignalRef=SysBPM, ComIPduSignalRef=SysBPMEnbd, ComPduIdRef=VCU_IPK_1F2h_Can_Network_CANNODE_0_PduR2Com
        VCU_SRS_163h_Can_Network_CANNODE_0: ComIPduDirection=RECEIVE, ComTimeout=0.2, ComIPduHandleId=22, ComIPduErrorNotification=Com_RxTOCbk_VCU_SRS_163h_Can_Network_CANNODE_0, ComIpduNotificationCallback=Com_RxCbk_VCU_SRS_163h_Can_Network_CANNODE_0, ComIPduType=NORMAL, ComFirstTimeout=0.0, ComIPduGroupRef=ComIPduGroup_Rx, ComIPduSignalRef=VehCrshTyp, ComIPduSignalRef=RollingCounter, ComIPduSignalRef=SRSCheckSum, ComPduIdRef=VCU_SRS_163h_Can_Network_CANNODE_0_PduR2Com
        VCU_353h_Can_Network_CANNODE_0: ComIPduDirection=RECEIVE, ComTimeout=1.0, ComIPduHandleId=16, ComIPduErrorNotification=Com_RxTOCbk_VCU_353h_Can_Network_CANNODE_0, ComIpduNotificationCallback=Com_RxCbk_VCU_353h_Can_Network_CANNODE_0, ComIPduType=NORMAL, ComFirstTimeout=0.0, ComIPduGroupRef=ComIPduGroup_Rx, ComIPduSignalRef=VehSpdAvgDrvnV, ComIPduSignalRef=VehSpdAvgDrvn, ComPduIdRef=VCU_353h_Can_Network_CANNODE_0_PduR2Com
        Tester_7DFh_Can_Network_CANNODE_0: ComIPduDirection=RECEIVE, ComIPduHandleId=14, ComIPduType=NORMAL, ComIPduGroupRef=ComIPduGroup_Rx, ComIPduSignalRef=TesterDiagRequestData_Fun, ComPduIdRef=Tester_7DFh_Can_Network_CANNODE_0_PduR2Com
        VCU_HCM_55Fh_Can_Network_CANNODE_0: ComIPduDirection=RECEIVE, ComTimeout=2.0, ComIPduHandleId=19, ComIPduErrorNotification=Com_RxTOCbk_VCU_HCM_55Fh_Can_Network_CANNODE_0, ComIpduNotificationCallback=Com_RxCbk_VCU_HCM_55Fh_Can_Network_CANNODE_0, ComIPduType=NORMAL, ComFirstTimeout=0.0, ComIPduGroupRef=ComIPduGroup_Rx, ComIPduSignalRef=FrontCompStatFdbck, ComIPduSignalRef=FrontCmprElctrCrnt, ComIPduSignalRef=FrontPTCStatFdbck, ComIPduSignalRef=FrontPTCElctrCrnt, ComPduIdRef=VCU_HCM_55Fh_Can_Network_CANNODE_0_PduR2Com
        OBC_604h_Can_Network_CANNODE_0: ComIPduDirection=RECEIVE, ComTimeout=1.0, ComIPduHandleId=10, ComIPduErrorNotification=Com_RxTOCbk_OBC_604h_Can_Network_CANNODE_0, ComIpduNotificationCallback=Com_RxCbk_OBC_604h_Can_Network_CANNODE_0, ComIPduType=NORMAL, ComFirstTimeout=0.0, ComIPduGroupRef=ComIPduGroup_Rx, ComIPduSignalRef=OBCChgVolt, ComIPduSignalRef=OBCChgCurrent, ComIPduSignalRef=OBCMaxChrgVoltage, ComIPduSignalRef=OBCMaxChrgCurrent, ComIPduSignalRef=OBCStatus, ComIPduSignalRef=OBCCurrentFltCode, ComIPduSignalRef=OBCHistoryFltCode, ComPduIdRef=OBC_604h_Can_Network_CANNODE_0_PduR2Com
        VCU_IPK_362h_Can_Network_CANNODE_0: ComIPduDirection=RECEIVE, ComTimeout=10.0, ComIPduHandleId=21, ComIPduErrorNotification=Com_RxTOCbk_VCU_IPK_362h_Can_Network_CANNODE_0, ComIpduNotificationCallback=Com_RxCbk_VCU_IPK_362h_Can_Network_CANNODE_0, ComIPduType=NORMAL, ComFirstTimeout=0.0, ComIPduGroupRef=ComIPduGroup_Rx, ComIPduSignalRef=HighPreVehOdo, ComIPduSignalRef=HighPreVehOdoV, ComPduIdRef=VCU_IPK_362h_Can_Network_CANNODE_0_PduR2Com
        BMS_329h_Can_Network_CANNODE_0: ComIPduDirection=SEND, ComTimeout=0.1, ComIPduHandleId=5, ComIPduType=NORMAL, ComFirstTimeout=0.1, ComIPduGroupRef=ComIPduGroup_Tx, ComIPduSignalRef=MesCellTempNumIndex, ComIPduSignalRef=CellTempMes1, ComIPduSignalRef=CellTempMes2, ComIPduSignalRef=CellTempMes3, ComIPduSignalRef=CellTempMes4, ComIPduSignalRef=CellTempMes5, ComIPduSignalRef=CellTempMes6, ComIPduSignalRef=CellTempMes7, ComPduIdRef=BMS_329h_Can_Network_CANNODE_0_Com2PduR
          ComTxIPdu: ComMinimumDelayTime=0.0, ComTxIPduUnusedAreasDefault=255
            ComTxModeFalse
              ComTxMode: ComTxModeNumberOfRepetitions=0, ComTxModeMode=PERIODIC, ComTxModeTimeOffset=0.0, ComTxModeTimePeriod=0.1, ComTxModeRepetitionPeriod=0
            ComTxModeTrue
              ComTxMode: ComTxModeNumberOfRepetitions=0, ComTxModeMode=PERIODIC, ComTxModeTimeOffset=0.0, ComTxModeTimePeriod=0.1, ComTxModeRepetitionPeriod=0
        BMS_503h_Can_Network_CANNODE_0: ComIPduDirection=SEND, ComTimeout=0.1, ComIPduHandleId=7, ComIPduType=NORMAL, ComFirstTimeout=0.1, ComIPduGroupRef=ComIPduGroup_Tx, ComIPduSignalRef=BMSCellQuantity, ComIPduSignalRef=BMSTempProbeQuantity, ComIPduSignalRef=RealSOC, ComIPduSignalRef=HVIsoValue, ComPduIdRef=BMS_503h_Can_Network_CANNODE_0_Com2PduR
          ComTxIPdu: ComMinimumDelayTime=0.0, ComTxIPduUnusedAreasDefault=255
            ComTxModeFalse
              ComTxMode: ComTxModeNumberOfRepetitions=0, ComTxModeMode=PERIODIC, ComTxModeTimeOffset=0.0, ComTxModeTimePeriod=0.1, ComTxModeRepetitionPeriod=0
            ComTxModeTrue
              ComTxMode: ComTxModeNumberOfRepetitions=0, ComTxModeMode=PERIODIC, ComTxModeTimeOffset=0.0, ComTxModeTimePeriod=0.1, ComTxModeRepetitionPeriod=0
        BMS_501h_Can_Network_CANNODE_0: ComIPduDirection=SEND, ComTimeout=0.1, ComIPduHandleId=6, ComIPduType=NORMAL, ComFirstTimeout=0.1, ComIPduGroupRef=ComIPduGroup_Tx, ComIPduSignalRef=HVIsoWarning, ComIPduSignalRef=HVILWarning, ComIPduSignalRef=SOCLowWarning, ComIPduSignalRef=TempDiffWarning, ComIPduSignalRef=TempHighWarning, ComIPduSignalRef=PackOvWarning, ComIPduSignalRef=PackUvWarning, ComIPduSignalRef=CellOvWarning, ComIPduSignalRef=CellUvWarning, ComIPduSignalRef=SOCHighWarning, ComIPduSignalRef=SOCFastChgWarning, ComIPduSignalRef=PwrBatPackMismatchWarning, ComIPduSignalRef=BMSCelConsistencyWarning, ComIPduSignalRef=BMSVolHighWarning, ComIPduSignalRef=EnergyConsumptionPer, ComIPduSignalRef=RestEnergy, ComIPduSignalRef=ThermalAlarm, ComIPduSignalRef=ThermalAlarmV, ComPduIdRef=BMS_501h_Can_Network_CANNODE_0_Com2PduR
          ComTxIPdu: ComMinimumDelayTime=0.0, ComTxIPduUnusedAreasDefault=255
            ComTxModeFalse
              ComTxMode: ComTxModeNumberOfRepetitions=0, ComTxModeMode=PERIODIC, ComTxModeTimeOffset=0.0, ComTxModeTimePeriod=0.1, ComTxModeRepetitionPeriod=0
            ComTxModeTrue
              ComTxMode: ComTxModeNumberOfRepetitions=0, ComTxModeMode=PERIODIC, ComTxModeTimeOffset=0.0, ComTxModeTimePeriod=0.1, ComTxModeRepetitionPeriod=0
        BMS_1D8h_Can_Network_CANNODE_0: ComIPduDirection=SEND, ComTimeout=0.01, ComIPduHandleId=0, ComIPduType=NORMAL, ComFirstTimeout=0.01, ComIPduGroupRef=ComIPduGroup_Tx, ComIPduSignalRef=HVCntctrStat, ComIPduSignalRef=HVBatFltSevrtyStat, ComIPduSignalRef=HVCntctrStatARC, ComIPduSignalRef=ChrgrStatPTHVCntctrReq, ComIPduSignalRef=HVBatPrcdCrntV, ComIPduSignalRef=HVBatPrcdCrnt, ComIPduSignalRef=BMSlightReq, ComPduIdRef=BMS_1D8h_Can_Network_CANNODE_0_Com2PduR
          ComTxIPdu: ComMinimumDelayTime=0.0, ComTxIPduUnusedAreasDefault=255
            ComTxModeFalse
              ComTxMode: ComTxModeNumberOfRepetitions=0, ComTxModeMode=PERIODIC, ComTxModeTimeOffset=0.0, ComTxModeTimePeriod=0.01, ComTxModeRepetitionPeriod=0
            ComTxModeTrue
              ComTxMode: ComTxModeNumberOfRepetitions=0, ComTxModeMode=PERIODIC, ComTxModeTimeOffset=0.0, ComTxModeTimePeriod=0.01, ComTxModeRepetitionPeriod=0
        BMS_795h_Can_Network_CANNODE_0: ComIPduDirection=SEND, ComTimeout=0.0, ComIPduHandleId=20, ComIPduType=NORMAL, ComFirstTimeout=0.0, ComIPduGroupRef=ComIPduGroup_Tx, ComIPduSignalRef=BMSDTCSeriousLevel, ComIPduSignalRef=BMSDTCHighByte, ComIPduSignalRef=BMSDTCLowByte, ComIPduSignalRef=BMSDTCFailureTypeByte, ComIPduSignalRef=BMSDTCStatus, ComIPduSignalRef=BMSDTCType, ComPduIdRef=BMS_795h_Can_Network_CANNODE_0_Com2PduR
          ComTxIPdu: ComMinimumDelayTime=0.0, ComTxIPduUnusedAreasDefault=255
            ComTxModeFalse
              ComTxMode: ComTxModeNumberOfRepetitions=0, ComTxModeMode=DIRECT, ComTxModeTimeOffset=0, ComTxModeTimePeriod=0, ComTxModeRepetitionPeriod=0
            ComTxModeTrue
              ComTxMode: ComTxModeNumberOfRepetitions=0, ComTxModeMode=DIRECT, ComTxModeTimeOffset=0, ComTxModeTimePeriod=0, ComTxModeRepetitionPeriod=0
        BMS_3D7h_Can_Network_CANNODE_0: ComIPduDirection=SEND, ComTimeout=0.01, ComIPduHandleId=1, ComIPduType=NORMAL, ComFirstTimeout=0.01, ComIPduGroupRef=ComIPduGroup_Tx, ComIPduSignalRef=HVBatPackPrcdVltgV, ComIPduSignalRef=HVBatPackPrcdVltg, ComPduIdRef=BMS_3D7h_Can_Network_CANNODE_0_Com2PduR
          ComTxIPdu: ComMinimumDelayTime=0.0, ComTxIPduUnusedAreasDefault=255
            ComTxModeFalse
              ComTxMode: ComTxModeNumberOfRepetitions=0, ComTxModeMode=PERIODIC, ComTxModeTimeOffset=0.0, ComTxModeTimePeriod=0.01, ComTxModeRepetitionPeriod=0
            ComTxModeTrue
              ComTxMode: ComTxModeNumberOfRepetitions=0, ComTxModeMode=PERIODIC, ComTxModeTimeOffset=0.0, ComTxModeTimePeriod=0.01, ComTxModeRepetitionPeriod=0
        BMS_606h_Can_Network_CANNODE_0: ComIPduDirection=SEND, ComTimeout=0.0, ComIPduHandleId=19, ComIPduType=NORMAL, ComFirstTimeout=0.0, ComIPduGroupRef=ComIPduGroup_Tx, ComIPduSignalRef=StopChargingReson, ComIPduSignalRef=BEM_CRM00, ComIPduSignalRef=BEM_CRMAA, ComIPduSignalRef=BEM_CML, ComIPduSignalRef=BEM_CRO, ComIPduSignalRef=BEM_CCS, ComIPduSignalRef=BEM_CST, ComIPduSignalRef=BEM_CSD, ComIPduSignalRef=BEM_Other, ComIPduSignalRef=CEM_BRM, ComIPduSignalRef=CEM_BCP, ComIPduSignalRef=CEM_BRO, ComIPduSignalRef=CEM_BCS, ComIPduSignalRef=CEM_BCL, ComIPduSignalRef=CEM_BST, ComIPduSignalRef=CEM_BSD, ComIPduSignalRef=CEM_Other, ComIPduSignalRef=BMSStopChargeFaultCode1, ComIPduSignalRef=BMSStopChargeFaultCode2, ComIPduSignalRef=BMSStopChargeFaultCode3, ComIPduSignalRef=BMSStopChargeFaultCode4, ComIPduSignalRef=BMSStopChargeFaultCode5, ComIPduSignalRef=BMSStopChargeFaultCode6, ComIPduSignalRef=BMSStopChargeFaultCode7, ComIPduSignalRef=BMSStopChargeFaultCode8, ComIPduSignalRef=CHGStopChargeFaultCode1, ComIPduSignalRef=CHGStopChargeFaultCode2, ComIPduSignalRef=CHGStopChargeFaultCode3, ComIPduSignalRef=CHGStopChargeFaultCode4, ComIPduSignalRef=CHGStopChargeFaultCode5, ComIPduSignalRef=CHGStopChargeFaultCode6, ComIPduSignalRef=CHGStopChargeFaultCode7, ComIPduSignalRef=CHGStopChargeFaultCode8, ComPduIdRef=BMS_606h_Can_Network_CANNODE_0_Com2PduR
          ComTxIPdu: ComMinimumDelayTime=0.0, ComTxIPduUnusedAreasDefault=255
            ComTxModeFalse
              ComTxMode: ComTxModeNumberOfRepetitions=0, ComTxModeMode=DIRECT, ComTxModeTimeOffset=0, ComTxModeTimePeriod=0, ComTxModeRepetitionPeriod=0
            ComTxModeTrue
              ComTxMode: ComTxModeNumberOfRepetitions=0, ComTxModeMode=DIRECT, ComTxModeTimeOffset=0, ComTxModeTimePeriod=0, ComTxModeRepetitionPeriod=0
        BMS_598h_Can_Network_CANNODE_0: ComIPduDirection=SEND, ComTimeout=0.1, ComIPduHandleId=8, ComIPduType=NORMAL, ComFirstTimeout=0.1, ComIPduGroupRef=ComIPduGroup_Tx, ComIPduSignalRef=BatLf, ComIPduSignalRef=ChrgPlugStatus, ComIPduSignalRef=PreChrgUnitRdy, ComIPduSignalRef=BMSChrgStatus, ComIPduSignalRef=HVSystemStatus, ComIPduSignalRef=TotalBatteryCap, ComPduIdRef=BMS_598h_Can_Network_CANNODE_0_Com2PduR
          ComTxIPdu: ComMinimumDelayTime=0.0, ComTxIPduUnusedAreasDefault=255
            ComTxModeFalse
              ComTxMode: ComTxModeNumberOfRepetitions=0, ComTxModeMode=PERIODIC, ComTxModeTimeOffset=0.0, ComTxModeTimePeriod=0.1, ComTxModeRepetitionPeriod=0
            ComTxModeTrue
              ComTxMode: ComTxModeNumberOfRepetitions=0, ComTxModeMode=PERIODIC, ComTxModeTimeOffset=0.0, ComTxModeTimePeriod=0.1, ComTxModeRepetitionPeriod=0
        BMS_509h_Can_Network_CANNODE_0: ComIPduDirection=SEND, ComTimeout=0.5, ComIPduHandleId=11, ComIPduType=NORMAL, ComFirstTimeout=0.5, ComIPduGroupRef=ComIPduGroup_Tx, ComIPduSignalRef=RechgEnergyStorSysNumb, ComIPduSignalRef=CurRechgEnergyStorSysIndex, ComIPduSignalRef=RechgEnergyStorSysCodeLength, ComIPduSignalRef=RechgEnergyStorSysCodeIndex, ComIPduSignalRef=RechgEnergyStorSysCode1, ComIPduSignalRef=RechgEnergyStorSysCode2, ComIPduSignalRef=RechgEnergyStorSysCode3, ComIPduSignalRef=RechgEnergyStorSysCode4, ComIPduSignalRef=RechgEnergyStorSysCode5, ComIPduSignalRef=RechgEnergyStorSysCode6, ComPduIdRef=BMS_509h_Can_Network_CANNODE_0_Com2PduR
          ComTxIPdu: ComMinimumDelayTime=0.0, ComTxIPduUnusedAreasDefault=255
            ComTxModeFalse
              ComTxMode: ComTxModeNumberOfRepetitions=0, ComTxModeMode=PERIODIC, ComTxModeTimeOffset=0.0, ComTxModeTimePeriod=0.5, ComTxModeRepetitionPeriod=0
            ComTxModeTrue
              ComTxMode: ComTxModeNumberOfRepetitions=0, ComTxModeMode=PERIODIC, ComTxModeTimeOffset=0.0, ComTxModeTimePeriod=0.5, ComTxModeRepetitionPeriod=0
        BMS_605h_Can_Network_CANNODE_0: ComIPduDirection=SEND, ComTimeout=0.0, ComIPduHandleId=18, ComIPduType=NORMAL, ComFirstTimeout=0.0, ComIPduGroupRef=ComIPduGroup_Tx, ComIPduSignalRef=FullChargeRemainingTime, ComIPduSignalRef=RequestChargeCurrent, ComIPduSignalRef=ChargingVoltage, ComPduIdRef=BMS_605h_Can_Network_CANNODE_0_Com2PduR
          ComTxIPdu: ComMinimumDelayTime=0.0, ComTxIPduUnusedAreasDefault=255
            ComTxModeFalse
              ComTxMode: ComTxModeNumberOfRepetitions=0, ComTxModeMode=DIRECT, ComTxModeTimeOffset=0, ComTxModeTimePeriod=0, ComTxModeRepetitionPeriod=0
            ComTxModeTrue
              ComTxMode: ComTxModeNumberOfRepetitions=0, ComTxModeMode=DIRECT, ComTxModeTimeOffset=0, ComTxModeTimePeriod=0, ComTxModeRepetitionPeriod=0
        BMS_7C8h_Can_Network_CANNODE_0: ComIPduDirection=SEND, ComTimeout=0.0, ComIPduHandleId=21, ComIPduType=NORMAL, ComFirstTimeout=0.0, ComIPduGroupRef=ComIPduGroup_Tx, ComIPduSignalRef=BMSDiagResponseData, ComPduIdRef=BMS_7C8h_Can_Network_CANNODE_0_Com2PduR
          ComTxIPdu: ComMinimumDelayTime=0.0, ComTxIPduUnusedAreasDefault=255
            ComTxModeFalse
              ComTxMode: ComTxModeNumberOfRepetitions=0, ComTxModeMode=DIRECT, ComTxModeTimeOffset=0, ComTxModeTimePeriod=0, ComTxModeRepetitionPeriod=0
            ComTxModeTrue
              ComTxMode: ComTxModeNumberOfRepetitions=0, ComTxModeMode=DIRECT, ComTxModeTimeOffset=0, ComTxModeTimePeriod=0, ComTxModeRepetitionPeriod=0
        BMS_596h_Can_Network_CANNODE_0: ComIPduDirection=SEND, ComTimeout=0.2, ComIPduHandleId=10, ComIPduType=NORMAL, ComFirstTimeout=0.2, ComIPduGroupRef=ComIPduGroup_Tx, ComIPduSignalRef=MaxBatTmp, ComIPduSignalRef=MaxCellTempNumb, ComIPduSignalRef=MinBatTmp, ComIPduSignalRef=MinCellTempNumb, ComPduIdRef=BMS_596h_Can_Network_CANNODE_0_Com2PduR
          ComTxIPdu: ComMinimumDelayTime=0.0, ComTxIPduUnusedAreasDefault=255
            ComTxModeFalse
              ComTxMode: ComTxModeNumberOfRepetitions=0, ComTxModeMode=PERIODIC, ComTxModeTimeOffset=0.0, ComTxModeTimePeriod=0.2, ComTxModeRepetitionPeriod=0
            ComTxModeTrue
              ComTxMode: ComTxModeNumberOfRepetitions=0, ComTxModeMode=PERIODIC, ComTxModeTimeOffset=0.0, ComTxModeTimePeriod=0.2, ComTxModeRepetitionPeriod=0
        BMS_3DAh_Can_Network_CANNODE_0: ComIPduDirection=SEND, ComTimeout=0.01, ComIPduHandleId=2, ComIPduType=NORMAL, ComFirstTimeout=0.01, ComIPduGroupRef=ComIPduGroup_Tx, ComIPduSignalRef=HVBCP_LngTrmChrgPwr, ComIPduSignalRef=HVBCP_CrnkChrgPwrV, ComIPduSignalRef=HVBCP_ShrtTrmChrgPwr, ComIPduSignalRef=ChrgPeakTimeFactor, ComIPduSignalRef=HVBatSOCHiRes, ComIPduSignalRef=BMSChecksum_3DAh, ComPduIdRef=BMS_3DAh_Can_Network_CANNODE_0_Com2PduR
          ComTxIPdu: ComMinimumDelayTime=0.0, ComTxIPduUnusedAreasDefault=255
            ComTxModeFalse
              ComTxMode: ComTxModeNumberOfRepetitions=0, ComTxModeMode=PERIODIC, ComTxModeTimeOffset=0.0, ComTxModeTimePeriod=0.01, ComTxModeRepetitionPeriod=0
            ComTxModeTrue
              ComTxMode: ComTxModeNumberOfRepetitions=0, ComTxModeMode=PERIODIC, ComTxModeTimeOffset=0.0, ComTxModeTimePeriod=0.01, ComTxModeRepetitionPeriod=0
        BMS_32Ah_Can_Network_CANNODE_0: ComIPduDirection=SEND, ComTimeout=0.02, ComIPduHandleId=4, ComIPduType=NORMAL, ComFirstTimeout=0.02, ComIPduGroupRef=ComIPduGroup_Tx, ComIPduSignalRef=MesCellVoltNumIndex, ComIPduSignalRef=Mes1CellVolt, ComIPduSignalRef=Mes1CellBalState, ComIPduSignalRef=Mes2CellVolt, ComIPduSignalRef=Mes2CellBalState, ComIPduSignalRef=Mes3CellVolt, ComIPduSignalRef=Mes3CellBalState, ComPduIdRef=BMS_32Ah_Can_Network_CANNODE_0_Com2PduR
          ComTxIPdu: ComMinimumDelayTime=0.0, ComTxIPduUnusedAreasDefault=255
            ComTxModeFalse
              ComTxMode: ComTxModeNumberOfRepetitions=0, ComTxModeMode=PERIODIC, ComTxModeTimeOffset=0.0, ComTxModeTimePeriod=0.02, ComTxModeRepetitionPeriod=0
            ComTxModeTrue
              ComTxMode: ComTxModeNumberOfRepetitions=0, ComTxModeMode=PERIODIC, ComTxModeTimeOffset=0.0, ComTxModeTimePeriod=0.02, ComTxModeRepetitionPeriod=0
        BMS_3DBh_Can_Network_CANNODE_0: ComIPduDirection=SEND, ComTimeout=0.01, ComIPduHandleId=3, ComIPduType=NORMAL, ComFirstTimeout=0.01, ComIPduGroupRef=ComIPduGroup_Tx, ComIPduSignalRef=HVBDP_LngTrmDischrgPwr, ComIPduSignalRef=HVBDP_CrnkDischrgPwrV, ComIPduSignalRef=HVBDP_ShrtTrmDischrgPwr, ComIPduSignalRef=DischrgPeakTimeFactor, ComIPduSignalRef=BMSChecksum_3DBh, ComPduIdRef=BMS_3DBh_Can_Network_CANNODE_0_Com2PduR
          ComTxIPdu: ComMinimumDelayTime=0.0, ComTxIPduUnusedAreasDefault=255
            ComTxModeFalse
              ComTxMode: ComTxModeNumberOfRepetitions=0, ComTxModeMode=PERIODIC, ComTxModeTimeOffset=0.0, ComTxModeTimePeriod=0.01, ComTxModeRepetitionPeriod=0
            ComTxModeTrue
              ComTxMode: ComTxModeNumberOfRepetitions=0, ComTxModeMode=PERIODIC, ComTxModeTimeOffset=0.0, ComTxModeTimePeriod=0.01, ComTxModeRepetitionPeriod=0
        BMS_603h_Can_Network_CANNODE_0: ComIPduDirection=SEND, ComTimeout=0.0, ComIPduHandleId=17, ComIPduType=NORMAL, ComFirstTimeout=0.0, ComIPduGroupRef=ComIPduGroup_Tx, ComIPduSignalRef=ACChrgVoltRq, ComIPduSignalRef=ACChrgCurrRq, ComIPduSignalRef=ACChrgMode, ComIPduSignalRef=ACChrgFault, ComIPduSignalRef=CCVaule, ComIPduSignalRef=CPVaule, ComIPduSignalRef=S2_Status, ComPduIdRef=BMS_603h_Can_Network_CANNODE_0_Com2PduR
          ComTxIPdu: ComMinimumDelayTime=0.0, ComTxIPduUnusedAreasDefault=255
            ComTxModeFalse
              ComTxMode: ComTxModeNumberOfRepetitions=0, ComTxModeMode=DIRECT, ComTxModeTimeOffset=0, ComTxModeTimePeriod=0, ComTxModeRepetitionPeriod=0
            ComTxModeTrue
              ComTxMode: ComTxModeNumberOfRepetitions=0, ComTxModeMode=DIRECT, ComTxModeTimeOffset=0, ComTxModeTimePeriod=0, ComTxModeRepetitionPeriod=0
        BMS_594h_Can_Network_CANNODE_0: ComIPduDirection=SEND, ComTimeout=0.2, ComIPduHandleId=9, ComIPduType=NORMAL, ComFirstTimeout=0.2, ComIPduGroupRef=ComIPduGroup_Tx, ComIPduSignalRef=MaxClVlt, ComIPduSignalRef=MaxCellVoltNumb, ComIPduSignalRef=MinClVlt, ComIPduSignalRef=MinCellVoltNumb, ComIPduSignalRef=HVBatPackAccVltgV, ComIPduSignalRef=HVBatPackAccVltg, ComPduIdRef=BMS_594h_Can_Network_CANNODE_0_Com2PduR
          ComTxIPdu: ComMinimumDelayTime=0.0, ComTxIPduUnusedAreasDefault=255
            ComTxModeFalse
              ComTxMode: ComTxModeNumberOfRepetitions=0, ComTxModeMode=PERIODIC, ComTxModeTimeOffset=0.0, ComTxModeTimePeriod=0.2, ComTxModeRepetitionPeriod=0
            ComTxModeTrue
              ComTxMode: ComTxModeNumberOfRepetitions=0, ComTxModeMode=PERIODIC, ComTxModeTimeOffset=0.0, ComTxModeTimePeriod=0.2, ComTxModeRepetitionPeriod=0
        CTS_CHG_J1939_Network_CANNODE_0: ComIPduDirection=RECEIVE, ComTimeout=5.0, ComIPduHandleId=8, ComIPduErrorNotification=Com_RxTOCbk_CTS_CHG_J1939_Network_CANNODE_0, ComIpduNotificationCallback=Com_RxCbk_CTS_CHG_J1939_Network_CANNODE_0, ComIPduType=NORMAL, ComFirstTimeout=0.0, ComIPduGroupRef=ComIPduGroup_Rx, ComIPduSignalRef=CTS_SPN2823_SYNC_YearThousand, ComIPduSignalRef=CTS_SPN2823_SYNC_YearTen, ComIPduSignalRef=CTS_SPN2823_SYNC_YearHundred, ComIPduSignalRef=CTS_SPN2823_SYNC_Year, ComIPduSignalRef=CTS_SPN2823_SYNC_SecondTen, ComIPduSignalRef=CTS_SPN2823_SYNC_Second, ComIPduSignalRef=CTS_SPN2823_SYNC_MonthTen, ComIPduSignalRef=CTS_SPN2823_SYNC_Month, ComIPduSignalRef=CTS_SPN2823_SYNC_MinuteTen, ComIPduSignalRef=CTS_SPN2823_SYNC_Minute, ComIPduSignalRef=CTS_SPN2823_SYNC_HourTen, ComIPduSignalRef=CTS_SPN2823_SYNC_Hour, ComIPduSignalRef=CTS_SPN2823_SYNC_DayTen, ComIPduSignalRef=CTS_SPN2823_SYNC_Day, ComPduIdRef=CTS_CHG_J1939_Network_CANNODE_0_PduR2Com
        CSD_CHG_J1939_Network_CANNODE_0: ComIPduDirection=RECEIVE, ComTimeout=2.5, ComIPduHandleId=6, ComIPduErrorNotification=Com_RxTOCbk_CSD_CHG_J1939_Network_CANNODE_0, ComIpduNotificationCallback=Com_RxCbk_CSD_CHG_J1939_Network_CANNODE_0, ComIPduType=NORMAL, ComFirstTimeout=0.0, ComIPduGroupRef=ComIPduGroup_Rx, ComIPduSignalRef=CSD_SPN3613_CHG_Index, ComIPduSignalRef=CSD_SPN3612_E_Out, ComIPduSignalRef=CSD_SPN3611_Time_Charged, ComPduIdRef=CSD_CHG_J1939_Network_CANNODE_0_PduR2Com
        CST_CHG_J1939_Network_CANNODE_0: ComIPduDirection=RECEIVE, ComTimeout=0.1, ComIPduHandleId=7, ComIPduErrorNotification=Com_RxTOCbk_CST_CHG_J1939_Network_CANNODE_0, ComIpduNotificationCallback=Com_RxCbk_CST_CHG_J1939_Network_CANNODE_0, ComIPduType=NORMAL, ComFirstTimeout=0.0, ComIPduGroupRef=ComIPduGroup_Rx, ComIPduSignalRef=CST_SPN3521_Stop_Reason_BMSStop, ComIPduSignalRef=CST_SPN3523_Stop_Fault_U, ComIPduSignalRef=CST_SPN3523_Stop_Fault_Mismatch, ComIPduSignalRef=CST_SPN3522_Stop_Fault_T_Inter, ComIPduSignalRef=CST_SPN3522_Stop_Fault_T_CHG, ComIPduSignalRef=CST_SPN3522_Stop_Fault_Other, ComIPduSignalRef=CST_SPN3522_Stop_Fault_EmerStop, ComIPduSignalRef=CST_SPN3522_Stop_Fault_Deliver, ComIPduSignalRef=CST_SPN3522_Stop_Fault_CHGCnnt, ComIPduSignalRef=CST_SPN3521_Stop_Reason_Manual, ComIPduSignalRef=CST_SPN3521_Stop_Reason_Fault, ComIPduSignalRef=CST_SPN3521_Stop_Reason_Auto, ComPduIdRef=CST_CHG_J1939_Network_CANNODE_0_PduR2Com
        CHM_CHG_J1939_Network_CANNODE_0: ComIPduDirection=RECEIVE, ComTimeout=2.5, ComIPduHandleId=2, ComIPduErrorNotification=Com_RxTOCbk_CHM_CHG_J1939_Network_CANNODE_0, ComIpduNotificationCallback=Com_RxCbk_CHM_CHG_J1939_Network_CANNODE_0, ComIPduType=NORMAL, ComFirstTimeout=0.0, ComIPduGroupRef=ComIPduGroup_Rx, ComIPduSignalRef=CHM_SPN2600_Comm_Ver, ComPduIdRef=CHM_CHG_J1939_Network_CANNODE_0_PduR2Com
        CRO_CHG_J1939_Network_CANNODE_0: ComIPduDirection=RECEIVE, ComTimeout=2.5, ComIPduHandleId=5, ComIPduErrorNotification=Com_RxTOCbk_CRO_CHG_J1939_Network_CANNODE_0, ComIpduNotificationCallback=Com_RxCbk_CRO_CHG_J1939_Network_CANNODE_0, ComIPduType=NORMAL, ComFirstTimeout=0.0, ComIPduGroupRef=ComIPduGroup_Rx, ComIPduSignalRef=CRO_SPN2830_CHG_Ready, ComPduIdRef=CRO_CHG_J1939_Network_CANNODE_0_PduR2Com
        CEM_CHG_J1939_Network_CANNODE_0: ComIPduDirection=RECEIVE, ComTimeout=2.5, ComIPduHandleId=1, ComIPduErrorNotification=Com_RxTOCbk_CEM_CHG_J1939_Network_CANNODE_0, ComIpduNotificationCallback=Com_RxCbk_CEM_CHG_J1939_Network_CANNODE_0, ComIPduType=NORMAL, ComFirstTimeout=0.0, ComIPduGroupRef=ComIPduGroup_Rx, ComIPduSignalRef=CEM_other, ComIPduSignalRef=CEM_SPN3927_Timeout_BSD, ComIPduSignalRef=CEM_SPN3926_Timeout_BST, ComIPduSignalRef=CEM_SPN3925_Timeout_BCL, ComIPduSignalRef=CEM_SPN3924_Timeout_BCS, ComIPduSignalRef=CEM_SPN3923_Timeout_BRO, ComIPduSignalRef=CEM_SPN3922_Timeout_BCP, ComIPduSignalRef=CEM_SPN3921_Timeout_BRM, ComPduIdRef=CEM_CHG_J1939_Network_CANNODE_0_PduR2Com
        CML_CHG_J1939_Network_CANNODE_0: ComIPduDirection=RECEIVE, ComTimeout=2.5, ComIPduHandleId=3, ComIPduErrorNotification=Com_RxTOCbk_CML_CHG_J1939_Network_CANNODE_0, ComIpduNotificationCallback=Com_RxCbk_CML_CHG_J1939_Network_CANNODE_0, ComIPduType=NORMAL, ComFirstTimeout=0.0, ComIPduGroupRef=ComIPduGroup_Rx, ComIPduSignalRef=CML_SPN2827_I_Min_Out, ComIPduSignalRef=CML_SPN2826_I_Max_Out, ComIPduSignalRef=CML_SPN2825_U_Min_Out, ComIPduSignalRef=CML_SPN2824_U_Max_Out, ComPduIdRef=CML_CHG_J1939_Network_CANNODE_0_PduR2Com
        CCS_CHG_J1939_Network_CANNODE_0: ComIPduDirection=RECEIVE, ComTimeout=0.5, ComIPduHandleId=0, ComIPduErrorNotification=Com_RxTOCbk_CCS_CHG_J1939_Network_CANNODE_0, ComIpduNotificationCallback=Com_RxCbk_CCS_CHG_J1939_Network_CANNODE_0, ComIPduType=NORMAL, ComFirstTimeout=0.0, ComIPduGroupRef=ComIPduGroup_Rx, ComIPduSignalRef=CCS_SPN3081_U_Out, ComIPduSignalRef=CCS_SPN3082_I_Out, ComIPduSignalRef=CCS_SPN3083_Time_Charged, ComIPduSignalRef=CCS_SPN3929_Chg_enable, ComPduIdRef=CCS_CHG_J1939_Network_CANNODE_0_PduR2Com
        CRM_CHG_J1939_Network_CANNODE_0: ComIPduDirection=RECEIVE, ComTimeout=2.5, ComIPduHandleId=4, ComIPduErrorNotification=Com_RxTOCbk_CRM_CHG_J1939_Network_CANNODE_0, ComIpduNotificationCallback=Com_RxCbk_CRM_CHG_J1939_Network_CANNODE_0, ComIPduType=NORMAL, ComFirstTimeout=0.0, ComIPduGroupRef=ComIPduGroup_Rx, ComIPduSignalRef=CRM_SPN2562_CHG_Loc, ComIPduSignalRef=CRM_SPN2561_CHG_Index, ComIPduSignalRef=CRM_SPN2560_Ack, ComPduIdRef=CRM_CHG_J1939_Network_CANNODE_0_PduR2Com
        BHM_BCU_J1939_Network_CANNODE_0: ComIPduDirection=SEND, ComTimeout=0.0, ComIPduHandleId=16, ComIPduType=NORMAL, ComFirstTimeout=0.0, ComIPduGroupRef=ComIPduGroup_Tx, ComIPduSignalRef=BHM_SPN2601_Ubat_Max_Permit, ComPduIdRef=BHM_BCU_J1939_Network_CANNODE_0_Com2PduR
          ComTxIPdu: ComMinimumDelayTime=0.0, ComTxIPduUnusedAreasDefault=255
            ComTxModeFalse
              ComTxMode: ComTxModeNumberOfRepetitions=0, ComTxModeMode=DIRECT, ComTxModeTimeOffset=0, ComTxModeTimePeriod=0, ComTxModeRepetitionPeriod=0
            ComTxModeTrue
              ComTxMode: ComTxModeNumberOfRepetitions=0, ComTxModeMode=DIRECT, ComTxModeTimeOffset=0, ComTxModeTimePeriod=0, ComTxModeRepetitionPeriod=0
        BSM_BCU_J1939_Network_CANNODE_0: ComIPduDirection=SEND, ComTimeout=0.0, ComIPduHandleId=25, ComIPduType=NORMAL, ComFirstTimeout=0.0, ComIPduGroupRef=ComIPduGroup_Tx, ComIPduSignalRef=BSM_SPN3096_Chg_Enable, ComIPduSignalRef=BSM_SPN3095_OutConnector_State, ComIPduSignalRef=BSM_SPN3094_Iso_State, ComIPduSignalRef=BSM_SPN3093_T_Warn, ComIPduSignalRef=BSM_SPN3092_I_Warn, ComIPduSignalRef=BSM_SPN3091_SOC_Warn, ComIPduSignalRef=BSM_SPN3090_Ucell_Warn, ComIPduSignalRef=BSM_SPN3089_T_Min_Index, ComIPduSignalRef=BSM_SPN3088_T_Min, ComIPduSignalRef=BSM_SPN3087_T_Max_Index, ComIPduSignalRef=BSM_SPN3086_T_Max, ComIPduSignalRef=BSM_SPN3085_Ucell_Max_Index, ComPduIdRef=BSM_BCU_J1939_Network_CANNODE_0_Com2PduR
          ComTxIPdu: ComMinimumDelayTime=0.0, ComTxIPduUnusedAreasDefault=255
            ComTxModeFalse
              ComTxMode: ComTxModeNumberOfRepetitions=0, ComTxModeMode=DIRECT, ComTxModeTimeOffset=0, ComTxModeTimePeriod=0, ComTxModeRepetitionPeriod=0
            ComTxModeTrue
              ComTxMode: ComTxModeNumberOfRepetitions=0, ComTxModeMode=DIRECT, ComTxModeTimeOffset=0, ComTxModeTimePeriod=0, ComTxModeRepetitionPeriod=0
        BST_BCU_J1939_Network_CANNODE_0: ComIPduDirection=SEND, ComTimeout=0.0, ComIPduHandleId=26, ComIPduType=NORMAL, ComFirstTimeout=0.0, ComIPduGroupRef=ComIPduGroup_Tx, ComIPduSignalRef=BST_SPN3512_Stop_Fault_HVRelay, ComIPduSignalRef=BST_SPN3512_Stop_Fault_CC2, ComIPduSignalRef=BST_SPN3511_Stop_Reason_CHGStop, ComIPduSignalRef=BST_SPN3513_Stop_Fault_U, ComIPduSignalRef=BST_SPN3513_Stop_Fault_I, ComIPduSignalRef=BST_SPN3512_Stop_Fault_T, ComIPduSignalRef=BST_SPN3512_Stop_Fault_Other, ComIPduSignalRef=BST_SPN3512_Stop_Fault_Iso, ComIPduSignalRef=BST_SPN3512_Stop_Fault_OutCnnt, ComIPduSignalRef=BST_SPN3512_Stop_Fault_BCUcompo, ComIPduSignalRef=BST_SPN3512_Stop_Fault_ChgCnnt, ComIPduSignalRef=BST_SPN3511_Stop_Reason_Ucell, ComIPduSignalRef=BST_SPN3511_Stop_Reason_U, ComIPduSignalRef=BST_SPN3511_Stop_Reason_SOC, ComPduIdRef=BST_BCU_J1939_Network_CANNODE_0_Com2PduR
          ComTxIPdu: ComMinimumDelayTime=0.0, ComTxIPduUnusedAreasDefault=255
            ComTxModeFalse
              ComTxMode: ComTxModeNumberOfRepetitions=0, ComTxModeMode=DIRECT, ComTxModeTimeOffset=0, ComTxModeTimePeriod=0, ComTxModeRepetitionPeriod=0
            ComTxModeTrue
              ComTxMode: ComTxModeNumberOfRepetitions=0, ComTxModeMode=DIRECT, ComTxModeTimeOffset=0, ComTxModeTimePeriod=0, ComTxModeRepetitionPeriod=0
        BRO_BCU_J1939_Network_CANNODE_0: ComIPduDirection=SEND, ComTimeout=0.0, ComIPduHandleId=23, ComIPduType=NORMAL, ComFirstTimeout=0.0, ComIPduGroupRef=ComIPduGroup_Tx, ComIPduSignalRef=BRO_SPN2829_BCU_Ready, ComPduIdRef=BRO_BCU_J1939_Network_CANNODE_0_Com2PduR
          ComTxIPdu: ComMinimumDelayTime=0.0, ComTxIPduUnusedAreasDefault=255
            ComTxModeFalse
              ComTxMode: ComTxModeNumberOfRepetitions=0, ComTxModeMode=DIRECT, ComTxModeTimeOffset=0, ComTxModeTimePeriod=0, ComTxModeRepetitionPeriod=0
            ComTxModeTrue
              ComTxMode: ComTxModeNumberOfRepetitions=0, ComTxModeMode=DIRECT, ComTxModeTimeOffset=0, ComTxModeTimePeriod=0, ComTxModeRepetitionPeriod=0
        BEM_BCU_J1939_Network_CANNODE_0: ComIPduDirection=SEND, ComTimeout=0.0, ComIPduHandleId=15, ComIPduType=NORMAL, ComFirstTimeout=0.0, ComIPduGroupRef=ComIPduGroup_Tx, ComIPduSignalRef=BEM_other, ComIPduSignalRef=BEM_SPN3907_Timeout_CSD, ComIPduSignalRef=BEM_SPN3906_Timeout_CST, ComIPduSignalRef=BEM_SPN3905_Timeout_CCS, ComIPduSignalRef=BEM_SPN3904_Timeout_CRO, ComIPduSignalRef=BEM_SPN3903_Timeout_CTS_CML, ComIPduSignalRef=BEM_SPN3902_Timeout_SPN2560_0xAA, ComIPduSignalRef=BEM_SPN3901_Timeout_SPN2560_0x00, ComPduIdRef=BEM_BCU_J1939_Network_CANNODE_0_Com2PduR
          ComTxIPdu: ComMinimumDelayTime=0.0, ComTxIPduUnusedAreasDefault=255
            ComTxModeFalse
              ComTxMode: ComTxModeNumberOfRepetitions=0, ComTxModeMode=DIRECT, ComTxModeTimeOffset=0, ComTxModeTimePeriod=0, ComTxModeRepetitionPeriod=0
            ComTxModeTrue
              ComTxMode: ComTxModeNumberOfRepetitions=0, ComTxModeMode=DIRECT, ComTxModeTimeOffset=0, ComTxModeTimePeriod=0, ComTxModeRepetitionPeriod=0
        BCL_BCU_J1939_Network_CANNODE_0: ComIPduDirection=SEND, ComTimeout=0.0, ComIPduHandleId=12, ComIPduType=NORMAL, ComFirstTimeout=0.0, ComIPduGroupRef=ComIPduGroup_Tx, ComIPduSignalRef=BCL_SPN3074_ChgMode, ComIPduSignalRef=BCL_SPN3073_I_Req, ComIPduSignalRef=BCL_SPN3072_U_Req, ComPduIdRef=BCL_BCU_J1939_Network_CANNODE_0_Com2PduR
          ComTxIPdu: ComMinimumDelayTime=0.0, ComTxIPduUnusedAreasDefault=255
            ComTxModeFalse
              ComTxMode: ComTxModeNumberOfRepetitions=0, ComTxModeMode=DIRECT, ComTxModeTimeOffset=0, ComTxModeTimePeriod=0, ComTxModeRepetitionPeriod=0
            ComTxModeTrue
              ComTxMode: ComTxModeNumberOfRepetitions=0, ComTxModeMode=DIRECT, ComTxModeTimeOffset=0, ComTxModeTimePeriod=0, ComTxModeRepetitionPeriod=0
        BSD_BCU_J1939_Network_CANNODE_0: ComIPduDirection=SEND, ComTimeout=0.0, ComIPduHandleId=24, ComIPduType=NORMAL, ComFirstTimeout=0.0, ComIPduGroupRef=ComIPduGroup_Tx, ComIPduSignalRef=BSD_SPN3605_T_Max, ComIPduSignalRef=BSD_SPN3604_T_Min, ComIPduSignalRef=BSD_SPN3603_Ucell_Max, ComIPduSignalRef=BSD_SPN3602_Ucell_Min, ComIPduSignalRef=BSD_SPN3601_SOC_Final, ComPduIdRef=BSD_BCU_J1939_Network_CANNODE_0_Com2PduR
          ComTxIPdu: ComMinimumDelayTime=0.0, ComTxIPduUnusedAreasDefault=255
            ComTxModeFalse
              ComTxMode: ComTxModeNumberOfRepetitions=0, ComTxModeMode=DIRECT, ComTxModeTimeOffset=0, ComTxModeTimePeriod=0, ComTxModeRepetitionPeriod=0
            ComTxModeTrue
              ComTxMode: ComTxModeNumberOfRepetitions=0, ComTxModeMode=DIRECT, ComTxModeTimeOffset=0, ComTxModeTimePeriod=0, ComTxModeRepetitionPeriod=0
        BCP_BCU_J1939_Network_CANNODE_0: ComIPduDirection=SEND, ComIPduCancellationSupport=0, ComIPduHandleId=13, ComIPduType=TP, ComIPduGroupRef=ComIPduGroup_Tx, ComIPduSignalRef=BCP_SPN2816_Ucell_Max_Permit, ComIPduSignalRef=BCP_SPN2817_I_Max_Permit, ComIPduSignalRef=BCP_SPN2818_kWh_Nom, ComIPduSignalRef=BCP_SPN2819_U_Max_Permit, ComIPduSignalRef=BCP_SPN2820_T_Max_Permit, ComIPduSignalRef=BCP_SPN2821_SOC, ComIPduSignalRef=BCP_SPN2822_U, ComPduIdRef=BCP_BCU_J1939_Network_CANNODE_0_Com2PduR
          ComTxIPdu_0 (ComTxIPdu): ComTxIPduUnusedAreasDefault=255
            ComTxModeFalse_0 (ComTxModeFalse)
              ComTxMode_0 (ComTxMode): ComTxModeNumberOfRepetitions=0, ComTxModeMode=DIRECT, ComTxModeTimeOffset=0.0, ComTxModeRepetitionPeriod=0.0, ComTxModeTimePeriod=0.0
            ComTxModeTrue_0 (ComTxModeTrue)
              ComTxMode_0 (ComTxMode): ComTxModeNumberOfRepetitions=0, ComTxModeMode=DIRECT, ComTxModeTimeOffset=0.0, ComTxModeRepetitionPeriod=0.0, ComTxModeTimePeriod=0.0
        BCS_BCU_J1939_Network_CANNODE_0: ComIPduDirection=SEND, ComIPduCancellationSupport=0, ComIPduHandleId=14, ComIPduType=TP, ComIPduGroupRef=ComIPduGroup_Tx, ComIPduSignalRef=BCS_SPN3075_U_Mea, ComIPduSignalRef=BCS_SPN3076_I_Mea, ComIPduSignalRef=BCS_SPN3077_Ucell_Max, ComIPduSignalRef=BCS_SPN3077_Ucell_Max_Grp, ComIPduSignalRef=BCS_SPN3078_SOC, ComIPduSignalRef=BCS_SPN3079_Time_Remain, ComPduIdRef=BCS_BCU_J1939_Network_CANNODE_0_Com2PduR
          ComTxIPdu_0 (ComTxIPdu): ComTxIPduUnusedAreasDefault=255
            ComTxModeFalse_0 (ComTxModeFalse)
              ComTxMode_0 (ComTxMode): ComTxModeNumberOfRepetitions=0, ComTxModeMode=DIRECT, ComTxModeTimeOffset=0.0, ComTxModeRepetitionPeriod=0.0, ComTxModeTimePeriod=0.0
            ComTxModeTrue_0 (ComTxModeTrue)
              ComTxMode_0 (ComTxMode): ComTxModeNumberOfRepetitions=0, ComTxModeMode=DIRECT, ComTxModeTimeOffset=0.0, ComTxModeRepetitionPeriod=0.0, ComTxModeTimePeriod=0.0
        BRM_BCU_J1939_Network_CANNODE_0: ComIPduDirection=SEND, ComIPduCancellationSupport=0, ComIPduHandleId=22, ComIPduType=TP, ComIPduGroupRef=ComIPduGroup_Tx, ComIPduSignalRef=BRM_SPN2565_Ver, ComIPduSignalRef=BRM_SPN2566_Bat_Type, ComIPduSignalRef=BRM_SPN2567_Cap_Nom, ComIPduSignalRef=BRM_SPN2568_U_Nom, ComIPduSignalRef=BRM_SPN2569_BatFactory, ComIPduSignalRef=BRM_SPN2570_PackSN, ComIPduSignalRef=BRM_SPN2571_PackDay, ComIPduSignalRef=BRM_SPN2571_PackMonth, ComIPduSignalRef=BRM_SPN2571_PackYear, ComIPduSignalRef=BRM_SPN2572_PackChgCnt, ComIPduSignalRef=BRM_SPN2573_PackRight, ComIPduSignalRef=BRM_SPN2574_BMSSW_Reserved, ComIPduSignalRef=BRM_SPN2575_VIN1, ComIPduSignalRef=BRM_SPN2575_VIN10, ComIPduSignalRef=BRM_SPN2575_VIN11, ComIPduSignalRef=BRM_SPN2575_VIN12, ComIPduSignalRef=BRM_SPN2575_VIN13, ComIPduSignalRef=BRM_SPN2575_VIN14, ComIPduSignalRef=BRM_SPN2575_VIN15, ComIPduSignalRef=BRM_SPN2575_VIN16, ComIPduSignalRef=BRM_SPN2575_VIN17, ComIPduSignalRef=BRM_SPN2575_VIN2, ComIPduSignalRef=BRM_SPN2575_VIN3, ComIPduSignalRef=BRM_SPN2575_VIN4, ComIPduSignalRef=BRM_SPN2575_VIN5, ComIPduSignalRef=BRM_SPN2575_VIN6, ComIPduSignalRef=BRM_SPN2575_VIN7, ComIPduSignalRef=BRM_SPN2575_VIN8, ComIPduSignalRef=BRM_SPN2575_VIN9, ComIPduSignalRef=BRM_SPN2576_BMSVer_Day, ComIPduSignalRef=BRM_SPN2576_BMSVer_Month, ComIPduSignalRef=BRM_SPN2576_BMSVer_Reserver, ComIPduSignalRef=BRM_SPN2576_BMSVer_Version, ComIPduSignalRef=BRM_SPN2576_BMSVer_Year, ComPduIdRef=BRM_BCU_J1939_Network_CANNODE_0_Com2PduR
          ComTxIPdu_0 (ComTxIPdu): ComTxIPduUnusedAreasDefault=255
            ComTxModeFalse_0 (ComTxModeFalse)
              ComTxMode_0 (ComTxMode): ComTxModeNumberOfRepetitions=0, ComTxModeMode=DIRECT, ComTxModeTimeOffset=0.0, ComTxModeRepetitionPeriod=0.0, ComTxModeTimePeriod=0.0
            ComTxModeTrue_0 (ComTxModeTrue)
              ComTxMode_0 (ComTxMode): ComTxModeNumberOfRepetitions=0, ComTxModeMode=DIRECT, ComTxModeTimeOffset=0.0, ComTxModeRepetitionPeriod=0.0, ComTxModeTimePeriod=0.0
        Old_BRM_BCU_J1939_Network_CANNODE_0: ComIPduDirection=SEND, ComIPduCancellationSupport=0, ComIPduHandleId=27, ComIPduType=TP, ComIPduGroupRef=ComIPduGroup_Tx, ComIPduSignalRef=Old_BRM_SPN2571_PackMonth, ComIPduSignalRef=Old_BRM_SPN2567_Cap_Nom, ComIPduSignalRef=Old_BRM_SPN2569_BatFactory, ComIPduSignalRef=Old_BRM_SPN2566_Bat_Type, ComIPduSignalRef=Old_BRM_SPN2574_BMSSW_Reserved, ComIPduSignalRef=Old_BRM_SPN2572_PackChgCnt, ComIPduSignalRef=Old_BRM_SPN2575_VIN2, ComIPduSignalRef=Old_BRM_SPN2575_VIN3, ComIPduSignalRef=Old_BRM_SPN2571_PackYear, ComIPduSignalRef=Old_BRM_SPN2575_VIN1, ComIPduSignalRef=Old_BRM_SPN2575_VIN17, ComIPduSignalRef=Old_BRM_SPN2575_VIN15, ComIPduSignalRef=Old_BRM_SPN2575_VIN16, ComIPduSignalRef=Old_BRM_SPN2575_VIN13, ComIPduSignalRef=Old_BRM_SPN2575_VIN14, ComIPduSignalRef=Old_BRM_SPN2570_PackSN, ComIPduSignalRef=Old_BRM_SPN2575_VIN11, ComIPduSignalRef=Old_BRM_SPN2575_VIN12, ComIPduSignalRef=Old_BRM_SPN2575_VIN10, ComIPduSignalRef=Old_BRM_SPN2568_U_Nom, ComIPduSignalRef=Old_BRM_SPN2573_PackRight, ComIPduSignalRef=Old_BRM_SPN2575_VIN8, ComIPduSignalRef=Old_BRM_SPN2575_VIN9, ComIPduSignalRef=Old_BRM_SPN2575_VIN6, ComIPduSignalRef=Old_BRM_SPN2575_VIN7, ComIPduSignalRef=Old_BRM_SPN2575_VIN4, ComIPduSignalRef=Old_BRM_SPN2575_VIN5, ComIPduSignalRef=Old_BRM_SPN2571_PackDay, ComIPduSignalRef=Old_BRM_SPN2565_Ver, ComPduIdRef=Old_BRM_BCU_J1939_Network_CANNODE_0_Com2PduR
          ComTxIPdu_0 (ComTxIPdu): ComTxIPduUnusedAreasDefault=255
            ComTxModeFalse_0 (ComTxModeFalse)
              ComTxMode_0 (ComTxMode): ComTxModeNumberOfRepetitions=0, ComTxModeMode=DIRECT, ComTxModeTimeOffset=0.0, ComTxModeTimePeriod=0.0, ComTxModeRepetitionPeriod=0.0
            ComTxModeTrue_0 (ComTxModeTrue)
              ComTxMode_0 (ComTxMode): ComTxModeNumberOfRepetitions=0, ComTxModeMode=DIRECT, ComTxModeTimeOffset=0.0, ComTxModeRepetitionPeriod=0.0, ComTxModeTimePeriod=0.0
      ComIPduGroup_Rx (ComIPduGroup): ComIPduGroupHandleId=0
      ComIPduGroup_Tx (ComIPduGroup): ComIPduGroupHandleId=1
      346 x ComSignal, all with ComUpdateBitPosition=-1, ComTransferProperty=TRIGGERED:
        V_DC: ComNotification=Rte_COMCbk_V_DC, ComSignalType=UINT16, ComSignalEndianness=BIG_ENDIAN, ComBitSize=15, ComHandleId=59, ComSignalInitValue=0, ComBitPosition=54, ComTimeoutNotification=Rte_COMCbkTOut_V_DC, ComSystemTemplateSystemSignalRef=V_DC
        V_DCValidity: ComNotification=Rte_COMCbk_V_DCValidity, ComSignalType=BOOLEAN, ComSignalEndianness=BIG_ENDIAN, ComBitSize=1, ComHandleId=60, ComSignalInitValue=0, ComBitPosition=55, ComTimeoutNotification=Rte_COMCbkTOut_V_DCValidity, ComSystemTemplateSystemSignalRef=V_DCValidity
        PTHVCntctrReq: ComNotification=Rte_COMCbk_PTHVCntctrReq, ComSignalType=UINT8, ComSignalEndianness=BIG_ENDIAN, ComBitSize=2, ComHandleId=65, ComSignalInitValue=0, ComBitPosition=4, ComTimeoutNotification=Rte_COMCbkTOut_PTHVCntctrReq, ComSystemTemplateSystemSignalRef=PTHVCntctrReq
        ChrgrStatPTHVCntctrClsAlwd: ComNotification=Rte_COMCbk_ChrgrStatPTHVCntctrClsAlwd, ComSignalType=BOOLEAN, ComSignalEndianness=BIG_ENDIAN, ComBitSize=1, ComHandleId=66, ComSignalInitValue=0, ComBitPosition=0, ComTimeoutNotification=Rte_COMCbkTOut_ChrgrStatPTHVCntctrClsAlwd, ComSystemTemplateSystemSignalRef=ChrgrStatPTHVCntctrClsAlwd
        ChrgrStatPTHVCntctOpnrAlwd: ComNotification=Rte_COMCbk_ChrgrStatPTHVCntctOpnrAlwd, ComSignalType=BOOLEAN, ComSignalEndianness=BIG_ENDIAN, ComBitSize=1, ComHandleId=67, ComSignalInitValue=0, ComBitPosition=1, ComTimeoutNotification=Rte_COMCbkTOut_ChrgrStatPTHVCntctOpnrAlwd, ComSystemTemplateSystemSignalRef=ChrgrStatPTHVCntctOpnrAlwd
        RollingCounter_1E3h: ComNotification=Rte_COMCbk_RollingCounter_1E3h, ComSignalType=UINT8, ComSignalEndianness=BIG_ENDIAN, ComBitSize=4, ComHandleId=68, ComSignalInitValue=0, ComBitPosition=55, ComTimeoutNotification=Rte_COMCbkTOut_RollingCounter_1E3h, ComSystemTemplateSystemSignalRef=RollingCounter_1E3h
        CheckSum_1E3h: ComNotification=Rte_COMCbk_CheckSum_1E3h, ComSignalType=UINT8, ComSignalEndianness=BIG_ENDIAN, ComBitSize=8, ComHandleId=69, ComSignalInitValue=0, ComBitPosition=63, ComTimeoutNotification=Rte_COMCbkTOut_CheckSum_1E3h, ComSystemTemplateSystemSignalRef=CheckSum_1E3h
        InvADCCrntV: ComNotification=Rte_COMCbk_InvADCCrntV, ComSignalType=BOOLEAN, ComSignalEndianness=BIG_ENDIAN, ComBitSize=1, ComHandleId=61, ComSignalInitValue=0, ComBitPosition=55, ComTimeoutNotification=Rte_COMCbkTOut_InvADCCrntV, ComSystemTemplateSystemSignalRef=InvADCCrntV
        InvADCCrnt: ComNotification=Rte_COMCbk_InvADCCrnt, ComSignalType=UINT16, ComSignalEndianness=BIG_ENDIAN, ComBitSize=15, ComHandleId=62, ComSignalInitValue=0, ComBitPosition=54, ComTimeoutNotification=Rte_COMCbkTOut_InvADCCrnt, ComSystemTemplateSystemSignalRef=InvADCCrnt
        VehicleSpeedStatus: ComNotification=Rte_COMCbk_VehicleSpeedStatus, ComSignalType=BOOLEAN, ComSignalEndianness=BIG_ENDIAN, ComBitSize=1, ComHandleId=72, ComSignalInitValue=0, ComBitPosition=7, ComTimeoutNotification=Rte_COMCbkTOut_VehicleSpeedStatus, ComSystemTemplateSystemSignalRef=VehicleSpeedStatus
        VehicleSpeed: ComNotification=Rte_COMCbk_VehicleSpeed, ComSignalType=UINT16, ComSignalEndianness=BIG_ENDIAN, ComBitSize=15, ComHandleId=73, ComSignalInitValue=0, ComBitPosition=6, ComTimeoutNotification=Rte_COMCbkTOut_VehicleSpeed, ComSystemTemplateSystemSignalRef=VehicleSpeed
        MessageCounter_23Ch: ComNotification=Rte_COMCbk_MessageCounter_23Ch, ComSignalType=UINT8, ComSignalEndianness=BIG_ENDIAN, ComBitSize=4, ComHandleId=74, ComSignalInitValue=0, ComBitPosition=55, ComTimeoutNotification=Rte_COMCbkTOut_MessageCounter_23Ch, ComSystemTemplateSystemSignalRef=MessageCounter_23Ch
        CheckSum_23Ch: ComNotification=Rte_COMCbk_CheckSum_23Ch, ComSignalType=UINT8, ComSignalEndianness=BIG_ENDIAN, ComBitSize=8, ComHandleId=75, ComSignalInitValue=0, ComBitPosition=63, ComTimeoutNotification=Rte_COMCbkTOut_CheckSum_23Ch, ComSystemTemplateSystemSignalRef=CheckSum_23Ch
        I_LDC_In: ComNotification=Rte_COMCbk_I_LDC_In, ComSignalType=UINT16, ComSignalEndianness=BIG_ENDIAN, ComBitSize=12, ComHandleId=50, ComSignalInitValue=0, ComBitPosition=27, ComTimeoutNotification=Rte_COMCbkTOut_I_LDC_In, ComSystemTemplateSystemSignalRef=I_LDC_In
        CDU_HVILWarning: ComNotification=Rte_COMCbk_CDU_HVILWarning, ComSignalType=BOOLEAN, ComSignalEndianness=BIG_ENDIAN, ComBitSize=1, ComHandleId=51, ComSignalInitValue=0, ComBitPosition=7, ComTimeoutNotification=Rte_COMCbkTOut_CDU_HVILWarning, ComSystemTemplateSystemSignalRef=CDU_HVILWarning
        SysPwrMd: ComNotification=Rte_COMCbk_SysPwrMd, ComSignalType=UINT8, ComSignalEndianness=BIG_ENDIAN, ComBitSize=2, ComHandleId=76, ComSignalInitValue=0, ComBitPosition=1, ComTimeoutNotification=Rte_COMCbkTOut_SysPwrMd, ComSystemTemplateSystemSignalRef=SysPwrMd
        SysOpnlMd: ComNotification=Rte_COMCbk_SysOpnlMd, ComSignalType=UINT8, ComSignalEndianness=BIG_ENDIAN, ComBitSize=3, ComHandleId=77, ComSignalInitValue=0, ComBitPosition=6, ComTimeoutNotification=Rte_COMCbkTOut_SysOpnlMd, ComSystemTemplateSystemSignalRef=SysOpnlMd
        SysVolMdV: ComNotification=Rte_COMCbk_SysVolMdV, ComSignalType=BOOLEAN, ComSignalEndianness=BIG_ENDIAN, ComBitSize=1, ComHandleId=78, ComSignalInitValue=0, ComBitPosition=7, ComTimeoutNotification=Rte_COMCbkTOut_SysVolMdV, ComSystemTemplateSystemSignalRef=SysVolMdV
        SysVolV: ComNotification=Rte_COMCbk_SysVolV, ComSignalType=BOOLEAN, ComSignalEndianness=BIG_ENDIAN, ComBitSize=1, ComHandleId=79, ComSignalInitValue=0, ComBitPosition=32, ComTimeoutNotification=Rte_COMCbkTOut_SysVolV, ComSystemTemplateSystemSignalRef=SysVolV
        SysVol: ComNotification=Rte_COMCbk_SysVol, ComSignalType=UINT8, ComSignalEndianness=BIG_ENDIAN, ComBitSize=8, ComHandleId=80, ComSignalInitValue=0, ComBitPosition=47, ComTimeoutNotification=Rte_COMCbkTOut_SysVol, ComSystemTemplateSystemSignalRef=SysVol
        SysVolMd: ComNotification=Rte_COMCbk_SysVolMd, ComSignalType=UINT8, ComSignalEndianness=BIG_ENDIAN, ComBitSize=2, ComHandleId=81, ComSignalInitValue=0, ComBitPosition=58, ComTimeoutNotification=Rte_COMCbkTOut_SysVolMd, ComSystemTemplateSystemSignalRef=SysVolMd
        TesterDiagRequestData_BMS: ComSignalLength=8, ComSignalType=UINT8_N, ComSignalEndianness=opaque, ComBitSize=64, ComHandleId=63, ComSignalInitValue=0, ComBitPosition=0, ComSystemTemplateSystemSignalRef=TesterDiagRequestData_BMS
        SysBPM: ComNotification=Rte_COMCbk_SysBPM, ComSignalType=UINT8, ComSignalEndianness=BIG_ENDIAN, ComBitSize=2, ComHandleId=86, ComSignalInitValue=0, ComBitPosition=5, ComTimeoutNotification=Rte_COMCbkTOut_SysBPM, ComSystemTemplateSystemSignalRef=SysBPM
        SysBPMEnbd: ComNotification=Rte_COMCbk_SysBPMEnbd, ComSignalType=BOOLEAN, ComSignalEndianness=BIG_ENDIAN, ComBitSize=1, ComHandleId=87, ComSignalInitValue=0, ComBitPosition=6, ComTimeoutNotification=Rte_COMCbkTOut_SysBPMEnbd, ComSystemTemplateSystemSignalRef=SysBPMEnbd
        VehCrshTyp: ComNotification=Rte_COMCbk_VehCrshTyp, ComSignalType=UINT8, ComSignalEndianness=BIG_ENDIAN, ComBitSize=4, ComHandleId=90, ComSignalInitValue=0, ComBitPosition=4, ComTimeoutNotification=Rte_COMCbkTOut_VehCrshTyp, ComSystemTemplateSystemSignalRef=VehCrshTyp
        RollingCounter: ComNotification=Rte_COMCbk_RollingCounter, ComSignalType=UINT8, ComSignalEndianness=BIG_ENDIAN, ComBitSize=4, ComHandleId=91, ComSignalInitValue=0, ComBitPosition=55, ComTimeoutNotification=Rte_COMCbkTOut_RollingCounter, ComSystemTemplateSystemSignalRef=RollingCounter
        SRSCheckSum: ComNotification=Rte_COMCbk_SRSCheckSum, ComSignalType=UINT8, ComSignalEndianness=BIG_ENDIAN, ComBitSize=8, ComHandleId=92, ComSignalInitValue=0, ComBitPosition=63, ComTimeoutNotification=Rte_COMCbkTOut_SRSCheckSum, ComSystemTemplateSystemSignalRef=SRSCheckSum
        VehSpdAvgDrvnV: ComNotification=Rte_COMCbk_VehSpdAvgDrvnV, ComSignalType=BOOLEAN, ComSignalEndianness=BIG_ENDIAN, ComBitSize=1, ComHandleId=70, ComSignalInitValue=0, ComBitPosition=7, ComTimeoutNotification=Rte_COMCbkTOut_VehSpdAvgDrvnV, ComSystemTemplateSystemSignalRef=VehSpdAvgDrvnV
        VehSpdAvgDrvn: ComNotification=Rte_COMCbk_VehSpdAvgDrvn, ComSignalType=UINT16, ComSignalEndianness=BIG_ENDIAN, ComBitSize=15, ComHandleId=71, ComSignalInitValue=0, ComBitPosition=6, ComTimeoutNotification=Rte_COMCbkTOut_VehSpdAvgDrvn, ComSystemTemplateSystemSignalRef=VehSpdAvgDrvn
        TesterDiagRequestData_Fun: ComSignalLength=8, ComSignalType=UINT8_N, ComSignalEndianness=opaque, ComBitSize=64, ComHandleId=64, ComSignalInitValue=0, ComBitPosition=0, ComSystemTemplateSystemSignalRef=TesterDiagRequestData_Fun
        FrontCompStatFdbck: ComNotification=Rte_COMCbk_FrontCompStatFdbck, ComSignalType=UINT8, ComSignalEndianness=BIG_ENDIAN, ComBitSize=4, ComHandleId=82, ComSignalInitValue=0, ComBitPosition=6, ComTimeoutNotification=Rte_COMCbkTOut_FrontCompStatFdbck, ComSystemTemplateSystemSignalRef=FrontCompStatFdbck
        FrontCmprElctrCrnt: ComNotification=Rte_COMCbk_FrontCmprElctrCrnt, ComSignalType=UINT8, ComSignalEndianness=BIG_ENDIAN, ComBitSize=8, ComHandleId=83, ComSignalInitValue=0, ComBitPosition=39, ComTimeoutNotification=Rte_COMCbkTOut_FrontCmprElctrCrnt, ComSystemTemplateSystemSignalRef=FrontCmprElctrCrnt
        FrontPTCStatFdbck: ComNotification=Rte_COMCbk_FrontPTCStatFdbck, ComSignalType=UINT8, ComSignalEndianness=BIG_ENDIAN, ComBitSize=2, ComHandleId=84, ComSignalInitValue=0, ComBitPosition=41, ComTimeoutNotification=Rte_COMCbkTOut_FrontPTCStatFdbck, ComSystemTemplateSystemSignalRef=FrontPTCStatFdbck
        FrontPTCElctrCrnt: ComNotification=Rte_COMCbk_FrontPTCElctrCrnt, ComSignalType=UINT8, ComSignalEndianness=BIG_ENDIAN, ComBitSize=8, ComHandleId=85, ComSignalInitValue=0, ComBitPosition=31, ComTimeoutNotification=Rte_COMCbkTOut_FrontPTCElctrCrnt, ComSystemTemplateSystemSignalRef=FrontPTCElctrCrnt
        OBCChgVolt: ComNotification=Rte_COMCbk_OBCChgVolt, ComSignalType=UINT16, ComSignalEndianness=BIG_ENDIAN, ComBitSize=14, ComHandleId=52, ComSignalInitValue=0, ComBitPosition=7, ComTimeoutNotification=Rte_COMCbkTOut_OBCChgVolt, ComSystemTemplateSystemSignalRef=OBCChgVolt
        OBCChgCurrent: ComNotification=Rte_COMCbk_OBCChgCurrent, ComSignalType=UINT16, ComSignalEndianness=BIG_ENDIAN, ComBitSize=10, ComHandleId=53, ComSignalInitValue=0, ComBitPosition=9, ComTimeoutNotification=Rte_COMCbkTOut_OBCChgCurrent, ComSystemTemplateSystemSignalRef=OBCChgCurrent
        OBCMaxChrgVoltage: ComNotification=Rte_COMCbk_OBCMaxChrgVoltage, ComSignalType=UINT16, ComSignalEndianness=BIG_ENDIAN, ComBitSize=14, ComHandleId=54, ComSignalInitValue=0, ComBitPosition=31, ComTimeoutNotification=Rte_COMCbkTOut_OBCMaxChrgVoltage, ComSystemTemplateSystemSignalRef=OBCMaxChrgVoltage
        OBCMaxChrgCurrent: ComNotification=Rte_COMCbk_OBCMaxChrgCurrent, ComSignalType=UINT16, ComSignalEndianness=BIG_ENDIAN, ComBitSize=10, ComHandleId=55, ComSignalInitValue=0, ComBitPosition=33, ComTimeoutNotification=Rte_COMCbkTOut_OBCMaxChrgCurrent, ComSystemTemplateSystemSignalRef=OBCMaxChrgCurrent
        OBCStatus: ComNotification=Rte_COMCbk_OBCStatus, ComSignalType=UINT8, ComSignalEndianness=BIG_ENDIAN, ComBitSize=3, ComHandleId=56, ComSignalInitValue=0, ComBitPosition=50, ComTimeoutNotification=Rte_COMCbkTOut_OBCStatus, ComSystemTemplateSystemSignalRef=OBCStatus
        OBCCurrentFltCode: ComNotification=Rte_COMCbk_OBCCurrentFltCode, ComSignalType=UINT8, ComSignalEndianness=BIG_ENDIAN, ComBitSize=5, ComHandleId=57, ComSignalInitValue=0, ComBitPosition=55, ComTimeoutNotification=Rte_COMCbkTOut_OBCCurrentFltCode, ComSystemTemplateSystemSignalRef=OBCCurrentFltCode
        OBCHistoryFltCode: ComNotification=Rte_COMCbk_OBCHistoryFltCode, ComSignalType=UINT8, ComSignalEndianness=BIG_ENDIAN, ComBitSize=5, ComHandleId=58, ComSignalInitValue=0, ComBitPosition=61, ComTimeoutNotification=Rte_COMCbkTOut_OBCHistoryFltCode, ComSystemTemplateSystemSignalRef=OBCHistoryFltCode
        HighPreVehOdo: ComNotification=Rte_COMCbk_HighPreVehOdo, ComSignalType=UINT32, ComSignalEndianness=BIG_ENDIAN, ComBitSize=24, ComHandleId=88, ComSignalInitValue=0, ComBitPosition=7, ComTimeoutNotification=Rte_COMCbkTOut_HighPreVehOdo, ComSystemTemplateSystemSignalRef=HighPreVehOdo
        HighPreVehOdoV: ComNotification=Rte_COMCbk_HighPreVehOdoV, ComSignalType=BOOLEAN, ComSignalEndianness=BIG_ENDIAN, ComBitSize=1, ComHandleId=89, ComSignalInitValue=0, ComBitPosition=31, ComTimeoutNotification=Rte_COMCbkTOut_HighPreVehOdoV, ComSystemTemplateSystemSignalRef=HighPreVehOdoV
        MesCellTempNumIndex: ComSignalType=UINT8, ComSignalEndianness=BIG_ENDIAN, ComBitSize=8, ComHandleId=27, ComSignalInitValue=1, ComBitPosition=7, ComSystemTemplateSystemSignalRef=MesCellTempNumIndex
        CellTempMes1: ComSignalType=UINT8, ComSignalEndianness=BIG_ENDIAN, ComBitSize=8, ComHandleId=28, ComSignalInitValue=0, ComBitPosition=15, ComSystemTemplateSystemSignalRef=CellTempMes1
        CellTempMes2: ComSignalType=UINT8, ComSignalEndianness=BIG_ENDIAN, ComBitSize=8, ComHandleId=29, ComSignalInitValue=0, ComBitPosition=23, ComSystemTemplateSystemSignalRef=CellTempMes2
        CellTempMes3: ComSignalType=UINT8, ComSignalEndianness=BIG_ENDIAN, ComBitSize=8, ComHandleId=30, ComSignalInitValue=0, ComBitPosition=31, ComSystemTemplateSystemSignalRef=CellTempMes3
        CellTempMes4: ComSignalType=UINT8, ComSignalEndianness=BIG_ENDIAN, ComBitSize=8, ComHandleId=31, ComSignalInitValue=0, ComBitPosition=39, ComSystemTemplateSystemSignalRef=CellTempMes4
        CellTempMes5: ComSignalType=UINT8, ComSignalEndianness=BIG_ENDIAN, ComBitSize=8, ComHandleId=32, ComSignalInitValue=0, ComBitPosition=47, ComSystemTemplateSystemSignalRef=CellTempMes5
        CellTempMes6: ComSignalType=UINT8, ComSignalEndianness=BIG_ENDIAN, ComBitSize=8, ComHandleId=33, ComSignalInitValue=0, ComBitPosition=55, ComSystemTemplateSystemSignalRef=CellTempMes6
        CellTempMes7: ComSignalType=UINT8, ComSignalEndianness=BIG_ENDIAN, ComBitSize=8, ComHandleId=34, ComSignalInitValue=0, ComBitPosition=63, ComSystemTemplateSystemSignalRef=CellTempMes7
        BMSCellQuantity: ComSignalType=UINT8, ComSignalEndianness=BIG_ENDIAN, ComBitSize=8, ComHandleId=53, ComSignalInitValue=1, ComBitPosition=7, ComSystemTemplateSystemSignalRef=BMSCellQuantity
        BMSTempProbeQuantity: ComSignalType=UINT8, ComSignalEndianness=BIG_ENDIAN, ComBitSize=8, ComHandleId=54, ComSignalInitValue=1, ComBitPosition=31, ComSystemTemplateSystemSignalRef=BMSTempProbeQuantity
        RealSOC: ComSignalType=UINT16, ComSignalEndianness=BIG_ENDIAN, ComBitSize=16, ComHandleId=55, ComSignalInitValue=0, ComBitPosition=15, ComSystemTemplateSystemSignalRef=RealSOC
        HVIsoValue: ComSignalType=UINT16, ComSignalEndianness=BIG_ENDIAN, ComBitSize=13, ComHandleId=56, ComSignalInitValue=0, ComBitPosition=36, ComSystemTemplateSystemSignalRef=HVIsoValue
        HVIsoWarning: ComSignalType=UINT8, ComSignalEndianness=BIG_ENDIAN, ComBitSize=2, ComHandleId=35, ComSignalInitValue=0, ComBitPosition=1, ComSystemTemplateSystemSignalRef=HVIsoWarning
        HVILWarning: ComSignalType=BOOLEAN, ComSignalEndianness=BIG_ENDIAN, ComBitSize=1, ComHandleId=36, ComSignalInitValue=0, ComBitPosition=2, ComSystemTemplateSystemSignalRef=HVILWarning
        SOCLowWarning: ComSignalType=UINT8, ComSignalEndianness=BIG_ENDIAN, ComBitSize=2, ComHandleId=37, ComSignalInitValue=0, ComBitPosition=4, ComSystemTemplateSystemSignalRef=SOCLowWarning
        TempDiffWarning: ComSignalType=BOOLEAN, ComSignalEndianness=BIG_ENDIAN, ComBitSize=1, ComHandleId=38, ComSignalInitValue=0, ComBitPosition=5, ComSystemTemplateSystemSignalRef=TempDiffWarning
        TempHighWarning: ComSignalType=BOOLEAN, ComSignalEndianness=BIG_ENDIAN, ComBitSize=1, ComHandleId=39, ComSignalInitValue=0, ComBitPosition=6, ComSystemTemplateSystemSignalRef=TempHighWarning
        PackOvWarning: ComSignalType=BOOLEAN, ComSignalEndianness=BIG_ENDIAN, ComBitSize=1, ComHandleId=40, ComSignalInitValue=0, ComBitPosition=7, ComSystemTemplateSystemSignalRef=PackOvWarning
        PackUvWarning: ComSignalType=BOOLEAN, ComSignalEndianness=BIG_ENDIAN, ComBitSize=1, ComHandleId=41, ComSignalInitValue=0, ComBitPosition=8, ComSystemTemplateSystemSignalRef=PackUvWarning
        CellOvWarning: ComSignalType=BOOLEAN, ComSignalEndianness=BIG_ENDIAN, ComBitSize=1, ComHandleId=42, ComSignalInitValue=0, ComBitPosition=9, ComSystemTemplateSystemSignalRef=CellOvWarning
        CellUvWarning: ComSignalType=BOOLEAN, ComSignalEndianness=BIG_ENDIAN, ComBitSize=1, ComHandleId=43, ComSignalInitValue=0, ComBitPosition=10, ComSystemTemplateSystemSignalRef=CellUvWarning
        SOCHighWarning: ComSignalType=BOOLEAN, ComSignalEndianness=BIG_ENDIAN, ComBitSize=1, ComHandleId=44, ComSignalInitValue=0, ComBitPosition=11, ComSystemTemplateSystemSignalRef=SOCHighWarning
        SOCFastChgWarning: ComSignalType=BOOLEAN, ComSignalEndianness=BIG_ENDIAN, ComBitSize=1, ComHandleId=45, ComSignalInitValue=0, ComBitPosition=12, ComSystemTemplateSystemSignalRef=SOCFastChgWarning
        PwrBatPackMismatchWarning: ComSignalType=BOOLEAN, ComSignalEndianness=BIG_ENDIAN, ComBitSize=1, ComHandleId=46, ComSignalInitValue=0, ComBitPosition=13, ComSystemTemplateSystemSignalRef=PwrBatPackMismatchWarning
        BMSCelConsistencyWarning: ComSignalType=BOOLEAN, ComSignalEndianness=BIG_ENDIAN, ComBitSize=1, ComHandleId=47, ComSignalInitValue=0, ComBitPosition=14, ComSystemTemplateSystemSignalRef=BMSCelConsistencyWarning
        BMSVolHighWarning: ComSignalType=BOOLEAN, ComSignalEndianness=BIG_ENDIAN, ComBitSize=1, ComHandleId=48, ComSignalInitValue=0, ComBitPosition=15, ComSystemTemplateSystemSignalRef=BMSVolHighWarning
        EnergyConsumptionPer: ComSignalType=UINT16, ComSignalEndianness=BIG_ENDIAN, ComBitSize=16, ComHandleId=49, ComSignalInitValue=0, ComBitPosition=23, ComSystemTemplateSystemSignalRef=EnergyConsumptionPer
        RestEnergy: ComSignalType=UINT16, ComSignalEndianness=BIG_ENDIAN, ComBitSize=16, ComHandleId=50, ComSignalInitValue=0, ComBitPosition=39, ComSystemTemplateSystemSignalRef=RestEnergy
        ThermalAlarm: ComSignalType=BOOLEAN, ComSignalEndianness=BIG_ENDIAN, ComBitSize=1, ComHandleId=51, ComSignalInitValue=0, ComBitPosition=48, ComSystemTemplateSystemSignalRef=ThermalAlarm
        ThermalAlarmV: ComSignalType=BOOLEAN, ComSignalEndianness=BIG_ENDIAN, ComBitSize=1, ComHandleId=52, ComSignalInitValue=0, ComBitPosition=49, ComSystemTemplateSystemSignalRef=ThermalAlarmV
        HVCntctrStat: ComSignalType=UINT8, ComSignalEndianness=BIG_ENDIAN, ComBitSize=3, ComHandleId=0, ComSignalInitValue=0, ComBitPosition=2, ComSystemTemplateSystemSignalRef=HVCntctrStat
        HVBatFltSevrtyStat: ComSignalType=UINT8, ComSignalEndianness=BIG_ENDIAN, ComBitSize=3, ComHandleId=1, ComSignalInitValue=0, ComBitPosition=34, ComSystemTemplateSystemSignalRef=HVBatFltSevrtyStat
        HVCntctrStatARC: ComSignalType=UINT8, ComSignalEndianness=BIG_ENDIAN, ComBitSize=2, ComHandleId=2, ComSignalInitValue=0, ComBitPosition=37, ComSystemTemplateSystemSignalRef=HVCntctrStatARC
        ChrgrStatPTHVCntctrReq: ComSignalType=UINT8, ComSignalEndianness=BIG_ENDIAN, ComBitSize=2, ComHandleId=3, ComSignalInitValue=0, ComBitPosition=4, ComSystemTemplateSystemSignalRef=ChrgrStatPTHVCntctrReq
        HVBatPrcdCrntV: ComSignalType=BOOLEAN, ComSignalEndianness=BIG_ENDIAN, ComBitSize=1, ComHandleId=4, ComSignalInitValue=0, ComBitPosition=54, ComSystemTemplateSystemSignalRef=HVBatPrcdCrntV
        HVBatPrcdCrnt: ComSignalType=UINT16, ComSignalEndianness=BIG_ENDIAN, ComBitSize=14, ComHandleId=5, ComSignalInitValue=0, ComBitPosition=53, ComSystemTemplateSystemSignalRef=HVBatPrcdCrnt
        BMSlightReq: ComSignalType=BOOLEAN, ComSignalEndianness=BIG_ENDIAN, ComBitSize=1, ComHandleId=6, ComSignalInitValue=0, ComBitPosition=35, ComSystemTemplateSystemSignalRef=BMSlightReq
        BMSDTCSeriousLevel: ComSignalType=UINT8, ComSignalEndianness=BIG_ENDIAN, ComBitSize=4, ComHandleId=151, ComSignalInitValue=0, ComBitPosition=3, ComSystemTemplateSystemSignalRef=BMSDTCSeriousLevel
        BMSDTCHighByte: ComSignalType=UINT8, ComSignalEndianness=BIG_ENDIAN, ComBitSize=8, ComHandleId=152, ComSignalInitValue=0, ComBitPosition=15, ComSystemTemplateSystemSignalRef=BMSDTCHighByte
        BMSDTCLowByte: ComSignalType=UINT8, ComSignalEndianness=BIG_ENDIAN, ComBitSize=8, ComHandleId=153, ComSignalInitValue=0, ComBitPosition=23, ComSystemTemplateSystemSignalRef=BMSDTCLowByte
        BMSDTCFailureTypeByte: ComSignalType=UINT8, ComSignalEndianness=BIG_ENDIAN, ComBitSize=8, ComHandleId=154, ComSignalInitValue=0, ComBitPosition=31, ComSystemTemplateSystemSignalRef=BMSDTCFailureTypeByte
        BMSDTCStatus: ComSignalType=UINT8, ComSignalEndianness=BIG_ENDIAN, ComBitSize=8, ComHandleId=155, ComSignalInitValue=0, ComBitPosition=39, ComSystemTemplateSystemSignalRef=BMSDTCStatus
        BMSDTCType: ComSignalType=UINT8, ComSignalEndianness=BIG_ENDIAN, ComBitSize=8, ComHandleId=156, ComSignalInitValue=0, ComBitPosition=47, ComSystemTemplateSystemSignalRef=BMSDTCType
        HVBatPackPrcdVltgV: ComSignalType=BOOLEAN, ComSignalEndianness=BIG_ENDIAN, ComBitSize=1, ComHandleId=7, ComSignalInitValue=0, ComBitPosition=5, ComSystemTemplateSystemSignalRef=HVBatPackPrcdVltgV
        HVBatPackPrcdVltg: ComSignalType=UINT16, ComSignalEndianness=BIG_ENDIAN, ComBitSize=13, ComHandleId=8, ComSignalInitValue=0, ComBitPosition=4, ComSystemTemplateSystemSignalRef=HVBatPackPrcdVltg
        StopChargingReson: ComSignalType=UINT8, ComSignalEndianness=BIG_ENDIAN, ComBitSize=4, ComHandleId=118, ComSignalInitValue=0, ComBitPosition=7, ComSystemTemplateSystemSignalRef=StopChargingReson
        BEM_CRM00: ComSignalType=BOOLEAN, ComSignalEndianness=BIG_ENDIAN, ComBitSize=1, ComHandleId=119, ComSignalInitValue=0, ComBitPosition=3, ComSystemTemplateSystemSignalRef=BEM_CRM00
        BEM_CRMAA: ComSignalType=BOOLEAN, ComSignalEndianness=BIG_ENDIAN, ComBitSize=1, ComHandleId=120, ComSignalInitValue=0, ComBitPosition=2, ComSystemTemplateSystemSignalRef=BEM_CRMAA
        BEM_CML: ComSignalType=BOOLEAN, ComSignalEndianness=BIG_ENDIAN, ComBitSize=1, ComHandleId=121, ComSignalInitValue=0, ComBitPosition=1, ComSystemTemplateSystemSignalRef=BEM_CML
        BEM_CRO: ComSignalType=BOOLEAN, ComSignalEndianness=BIG_ENDIAN, ComBitSize=1, ComHandleId=122, ComSignalInitValue=0, ComBitPosition=0, ComSystemTemplateSystemSignalRef=BEM_CRO
        BEM_CCS: ComSignalType=BOOLEAN, ComSignalEndianness=BIG_ENDIAN, ComBitSize=1, ComHandleId=123, ComSignalInitValue=0, ComBitPosition=15, ComSystemTemplateSystemSignalRef=BEM_CCS
        BEM_CST: ComSignalType=BOOLEAN, ComSignalEndianness=BIG_ENDIAN, ComBitSize=1, ComHandleId=124, ComSignalInitValue=0, ComBitPosition=14, ComSystemTemplateSystemSignalRef=BEM_CST
        BEM_CSD: ComSignalType=BOOLEAN, ComSignalEndianness=BIG_ENDIAN, ComBitSize=1, ComHandleId=125, ComSignalInitValue=0, ComBitPosition=13, ComSystemTemplateSystemSignalRef=BEM_CSD
        BEM_Other: ComSignalType=BOOLEAN, ComSignalEndianness=BIG_ENDIAN, ComBitSize=1, ComHandleId=126, ComSignalInitValue=0, ComBitPosition=12, ComSystemTemplateSystemSignalRef=BEM_Other
        CEM_BRM: ComSignalType=BOOLEAN, ComSignalEndianness=BIG_ENDIAN, ComBitSize=1, ComHandleId=127, ComSignalInitValue=0, ComBitPosition=11, ComSystemTemplateSystemSignalRef=CEM_BRM
        CEM_BCP: ComSignalType=BOOLEAN, ComSignalEndianness=BIG_ENDIAN, ComBitSize=1, ComHandleId=128, ComSignalInitValue=0, ComBitPosition=10, ComSystemTemplateSystemSignalRef=CEM_BCP
        CEM_BRO: ComSignalType=BOOLEAN, ComSignalEndianness=BIG_ENDIAN, ComBitSize=1, ComHandleId=129, ComSignalInitValue=0, ComBitPosition=9, ComSystemTemplateSystemSignalRef=CEM_BRO
        CEM_BCS: ComSignalType=BOOLEAN, ComSignalEndianness=BIG_ENDIAN, ComBitSize=1, ComHandleId=130, ComSignalInitValue=0, ComBitPosition=8, ComSystemTemplateSystemSignalRef=CEM_BCS
        CEM_BCL: ComSignalType=BOOLEAN, ComSignalEndianness=BIG_ENDIAN, ComBitSize=1, ComHandleId=131, ComSignalInitValue=0, ComBitPosition=23, ComSystemTemplateSystemSignalRef=CEM_BCL
        CEM_BST: ComSignalType=BOOLEAN, ComSignalEndianness=BIG_ENDIAN, ComBitSize=1, ComHandleId=132, ComSignalInitValue=0, ComBitPosition=22, ComSystemTemplateSystemSignalRef=CEM_BST
        CEM_BSD: ComSignalType=BOOLEAN, ComSignalEndianness=BIG_ENDIAN, ComBitSize=1, ComHandleId=133, ComSignalInitValue=0, ComBitPosition=21, ComSystemTemplateSystemSignalRef=CEM_BSD
        CEM_Other: ComSignalType=BOOLEAN, ComSignalEndianness=BIG_ENDIAN, ComBitSize=1, ComHandleId=134, ComSignalInitValue=0, ComBitPosition=20, ComSystemTemplateSystemSignalRef=CEM_Other
        BMSStopChargeFaultCode1: ComSignalType=BOOLEAN, ComSignalEndianness=BIG_ENDIAN, ComBitSize=1, ComHandleId=135, ComSignalInitValue=0, ComBitPosition=19, ComSystemTemplateSystemSignalRef=BMSStopChargeFaultCode1
        BMSStopChargeFaultCode2: ComSignalType=BOOLEAN, ComSignalEndianness=BIG_ENDIAN, ComBitSize=1, ComHandleId=136, ComSignalInitValue=0, ComBitPosition=18, ComSystemTemplateSystemSignalRef=BMSStopChargeFaultCode2
        BMSStopChargeFaultCode3: ComSignalType=BOOLEAN, ComSignalEndianness=BIG_ENDIAN, ComBitSize=1, ComHandleId=137, ComSignalInitValue=0, ComBitPosition=17, ComSystemTemplateSystemSignalRef=BMSStopChargeFaultCode3
        BMSStopChargeFaultCode4: ComSignalType=BOOLEAN, ComSignalEndianness=BIG_ENDIAN, ComBitSize=1, ComHandleId=138, ComSignalInitValue=0, ComBitPosition=31, ComSystemTemplateSystemSignalRef=BMSStopChargeFaultCode4
        BMSStopChargeFaultCode5: ComSignalType=BOOLEAN, ComSignalEndianness=BIG_ENDIAN, ComBitSize=1, ComHandleId=139, ComSignalInitValue=0, ComBitPosition=30, ComSystemTemplateSystemSignalRef=BMSStopChargeFaultCode5
        BMSStopChargeFaultCode6: ComSignalType=BOOLEAN, ComSignalEndianness=BIG_ENDIAN, ComBitSize=1, ComHandleId=140, ComSignalInitValue=0, ComBitPosition=29, ComSystemTemplateSystemSignalRef=BMSStopChargeFaultCode6
        BMSStopChargeFaultCode7: ComSignalType=BOOLEAN, ComSignalEndianness=BIG_ENDIAN, ComBitSize=1, ComHandleId=141, ComSignalInitValue=0, ComBitPosition=28, ComSystemTemplateSystemSignalRef=BMSStopChargeFaultCode7
        BMSStopChargeFaultCode8: ComSignalType=BOOLEAN, ComSignalEndianness=BIG_ENDIAN, ComBitSize=1, ComHandleId=142, ComSignalInitValue=0, ComBitPosition=27, ComSystemTemplateSystemSignalRef=BMSStopChargeFaultCode8
        CHGStopChargeFaultCode1: ComSignalType=BOOLEAN, ComSignalEndianness=BIG_ENDIAN, ComBitSize=1, ComHandleId=143, ComSignalInitValue=0, ComBitPosition=26, ComSystemTemplateSystemSignalRef=CHGStopChargeFaultCode1
        CHGStopChargeFaultCode2: ComSignalType=BOOLEAN, ComSignalEndianness=BIG_ENDIAN, ComBitSize=1, ComHandleId=144, ComSignalInitValue=0, ComBitPosition=25, ComSystemTemplateSystemSignalRef=CHGStopChargeFaultCode2
        CHGStopChargeFaultCode3: ComSignalType=BOOLEAN, ComSignalEndianness=BIG_ENDIAN, ComBitSize=1, ComHandleId=145, ComSignalInitValue=0, ComBitPosition=24, ComSystemTemplateSystemSignalRef=CHGStopChargeFaultCode3
        CHGStopChargeFaultCode4: ComSignalType=BOOLEAN, ComSignalEndianness=BIG_ENDIAN, ComBitSize=1, ComHandleId=146, ComSignalInitValue=0, ComBitPosition=39, ComSystemTemplateSystemSignalRef=CHGStopChargeFaultCode4
        CHGStopChargeFaultCode5: ComSignalType=BOOLEAN, ComSignalEndianness=BIG_ENDIAN, ComBitSize=1, ComHandleId=147, ComSignalInitValue=0, ComBitPosition=38, ComSystemTemplateSystemSignalRef=CHGStopChargeFaultCode5
        CHGStopChargeFaultCode6: ComSignalType=BOOLEAN, ComSignalEndianness=BIG_ENDIAN, ComBitSize=1, ComHandleId=148, ComSignalInitValue=0, ComBitPosition=37, ComSystemTemplateSystemSignalRef=CHGStopChargeFaultCode6
        CHGStopChargeFaultCode7: ComSignalType=BOOLEAN, ComSignalEndianness=BIG_ENDIAN, ComBitSize=1, ComHandleId=149, ComSignalInitValue=0, ComBitPosition=36, ComSystemTemplateSystemSignalRef=CHGStopChargeFaultCode7
        CHGStopChargeFaultCode8: ComSignalType=BOOLEAN, ComSignalEndianness=BIG_ENDIAN, ComBitSize=1, ComHandleId=150, ComSignalInitValue=0, ComBitPosition=35, ComSystemTemplateSystemSignalRef=CHGStopChargeFaultCode8
        BatLf: ComSignalType=UINT8, ComSignalEndianness=BIG_ENDIAN, ComBitSize=8, ComHandleId=57, ComSignalInitValue=0, ComBitPosition=7, ComSystemTemplateSystemSignalRef=BatLf
        ChrgPlugStatus: ComSignalType=BOOLEAN, ComSignalEndianness=BIG_ENDIAN, ComBitSize=1, ComHandleId=58, ComSignalInitValue=0, ComBitPosition=8, ComSystemTemplateSystemSignalRef=ChrgPlugStatus
        PreChrgUnitRdy: ComSignalType=BOOLEAN, ComSignalEndianness=BIG_ENDIAN, ComBitSize=1, ComHandleId=59, ComSignalInitValue=0, ComBitPosition=10, ComSystemTemplateSystemSignalRef=PreChrgUnitRdy
        BMSChrgStatus: ComSignalType=UINT8, ComSignalEndianness=BIG_ENDIAN, ComBitSize=3, ComHandleId=60, ComSignalInitValue=0, ComBitPosition=13, ComSystemTemplateSystemSignalRef=BMSChrgStatus
        HVSystemStatus: ComSignalType=UINT8, ComSignalEndianness=BIG_ENDIAN, ComBitSize=4, ComHandleId=61, ComSignalInitValue=0, ComBitPosition=23, ComSystemTemplateSystemSignalRef=HVSystemStatus
        TotalBatteryCap: ComSignalType=UINT16, ComSignalEndianness=BIG_ENDIAN, ComBitSize=16, ComHandleId=62, ComSignalInitValue=0, ComBitPosition=31, ComSystemTemplateSystemSignalRef=TotalBatteryCap
        RechgEnergyStorSysNumb: ComSignalType=UINT8, ComSignalEndianness=BIG_ENDIAN, ComBitSize=4, ComHandleId=73, ComSignalInitValue=1, ComBitPosition=3, ComSystemTemplateSystemSignalRef=RechgEnergyStorSysNumb
        CurRechgEnergyStorSysIndex: ComSignalType=UINT8, ComSignalEndianness=BIG_ENDIAN, ComBitSize=4, ComHandleId=74, ComSignalInitValue=1, ComBitPosition=7, ComSystemTemplateSystemSignalRef=CurRechgEnergyStorSysIndex
        RechgEnergyStorSysCodeLength: ComSignalType=UINT8, ComSignalEndianness=BIG_ENDIAN, ComBitSize=5, ComHandleId=75, ComSignalInitValue=1, ComBitPosition=12, ComSystemTemplateSystemSignalRef=RechgEnergyStorSysCodeLength
        RechgEnergyStorSysCodeIndex: ComSignalType=UINT8, ComSignalEndianness=BIG_ENDIAN, ComBitSize=3, ComHandleId=76, ComSignalInitValue=1, ComBitPosition=15, ComSystemTemplateSystemSignalRef=RechgEnergyStorSysCodeIndex
        RechgEnergyStorSysCode1: ComSignalType=UINT8, ComSignalEndianness=BIG_ENDIAN, ComBitSize=8, ComHandleId=77, ComSignalInitValue=0, ComBitPosition=23, ComSystemTemplateSystemSignalRef=RechgEnergyStorSysCode1
        RechgEnergyStorSysCode2: ComSignalType=UINT8, ComSignalEndianness=BIG_ENDIAN, ComBitSize=8, ComHandleId=78, ComSignalInitValue=0, ComBitPosition=31, ComSystemTemplateSystemSignalRef=RechgEnergyStorSysCode2
        RechgEnergyStorSysCode3: ComSignalType=UINT8, ComSignalEndianness=BIG_ENDIAN, ComBitSize=8, ComHandleId=79, ComSignalInitValue=0, ComBitPosition=39, ComSystemTemplateSystemSignalRef=RechgEnergyStorSysCode3
        RechgEnergyStorSysCode4: ComSignalType=UINT8, ComSignalEndianness=BIG_ENDIAN, ComBitSize=8, ComHandleId=80, ComSignalInitValue=0, ComBitPosition=47, ComSystemTemplateSystemSignalRef=RechgEnergyStorSysCode4
        RechgEnergyStorSysCode5: ComSignalType=UINT8, ComSignalEndianness=BIG_ENDIAN, ComBitSize=8, ComHandleId=81, ComSignalInitValue=0, ComBitPosition=55, ComSystemTemplateSystemSignalRef=RechgEnergyStorSysCode5
        RechgEnergyStorSysCode6: ComSignalType=UINT8, ComSignalEndianness=BIG_ENDIAN, ComBitSize=8, ComHandleId=82, ComSignalInitValue=0, ComBitPosition=63, ComSystemTemplateSystemSignalRef=RechgEnergyStorSysCode6
        FullChargeRemainingTime: ComSignalType=UINT16, ComSignalEndianness=BIG_ENDIAN, ComBitSize=10, ComHandleId=115, ComSignalInitValue=0, ComBitPosition=7, ComSystemTemplateSystemSignalRef=FullChargeRemainingTime
        RequestChargeCurrent: ComSignalType=UINT16, ComSignalEndianness=BIG_ENDIAN, ComBitSize=9, ComHandleId=116, ComSignalInitValue=0, ComBitPosition=23, ComSystemTemplateSystemSignalRef=RequestChargeCurrent
        ChargingVoltage: ComSignalType=UINT16, ComSignalEndianness=BIG_ENDIAN, ComBitSize=14, ComHandleId=117, ComSignalInitValue=0, ComBitPosition=39, ComSystemTemplateSystemSignalRef=ChargingVoltage
        BMSDiagResponseData: ComSignalLength=8, ComSignalType=UINT8_N, ComSignalEndianness=opaque, ComBitSize=64, ComHandleId=157, ComSignalInitValue=0, ComBitPosition=0, ComSystemTemplateSystemSignalRef=BMSDiagResponseData
        MaxBatTmp: ComSignalType=UINT8, ComSignalEndianness=BIG_ENDIAN, ComBitSize=8, ComHandleId=69, ComSignalInitValue=0, ComBitPosition=7, ComSystemTemplateSystemSignalRef=MaxBatTmp
        MaxCellTempNumb: ComSignalType=UINT8, ComSignalEndianness=BIG_ENDIAN, ComBitSize=8, ComHandleId=70, ComSignalInitValue=1, ComBitPosition=15, ComSystemTemplateSystemSignalRef=MaxCellTempNumb
        MinBatTmp: ComSignalType=UINT8, ComSignalEndianness=BIG_ENDIAN, ComBitSize=8, ComHandleId=71, ComSignalInitValue=0, ComBitPosition=23, ComSystemTemplateSystemSignalRef=MinBatTmp
        MinCellTempNumb: ComSignalType=UINT8, ComSignalEndianness=BIG_ENDIAN, ComBitSize=8, ComHandleId=72, ComSignalInitValue=1, ComBitPosition=31, ComSystemTemplateSystemSignalRef=MinCellTempNumb
        HVBCP_LngTrmChrgPwr: ComSignalType=UINT16, ComSignalEndianness=BIG_ENDIAN, ComBitSize=11, ComHandleId=9, ComSignalInitValue=0, ComBitPosition=7, ComSystemTemplateSystemSignalRef=HVBCP_LngTrmChrgPwr
        HVBCP_CrnkChrgPwrV: ComSignalType=BOOLEAN, ComSignalEndianness=BIG_ENDIAN, ComBitSize=1, ComHandleId=10, ComSignalInitValue=0, ComBitPosition=11, ComSystemTemplateSystemSignalRef=HVBCP_CrnkChrgPwrV
        HVBCP_ShrtTrmChrgPwr: ComSignalType=UINT16, ComSignalEndianness=BIG_ENDIAN, ComBitSize=11, ComHandleId=11, ComSignalInitValue=0, ComBitPosition=10, ComSystemTemplateSystemSignalRef=HVBCP_ShrtTrmChrgPwr
        ChrgPeakTimeFactor: ComSignalType=UINT8, ComSignalEndianness=BIG_ENDIAN, ComBitSize=8, ComHandleId=12, ComSignalInitValue=0, ComBitPosition=31, ComSystemTemplateSystemSignalRef=ChrgPeakTimeFactor
        HVBatSOCHiRes: ComSignalType=UINT16, ComSignalEndianness=BIG_ENDIAN, ComBitSize=16, ComHandleId=13, ComSignalInitValue=0, ComBitPosition=39, ComSystemTemplateSystemSignalRef=HVBatSOCHiRes
        BMSChecksum_3DAh: ComSignalType=UINT8, ComSignalEndianness=BIG_ENDIAN, ComBitSize=8, ComHandleId=14, ComSignalInitValue=0, ComBitPosition=63, ComSystemTemplateSystemSignalRef=BMSChecksum_3DAh
        MesCellVoltNumIndex: ComSignalType=UINT8, ComSignalEndianness=BIG_ENDIAN, ComBitSize=8, ComHandleId=20, ComSignalInitValue=1, ComBitPosition=7, ComSystemTemplateSystemSignalRef=MesCellVoltNumIndex
        Mes1CellVolt: ComSignalType=UINT16, ComSignalEndianness=BIG_ENDIAN, ComBitSize=13, ComHandleId=21, ComSignalInitValue=8191, ComBitPosition=12, ComSystemTemplateSystemSignalRef=Mes1CellVolt
        Mes1CellBalState: ComSignalType=BOOLEAN, ComSignalEndianness=BIG_ENDIAN, ComBitSize=1, ComHandleId=22, ComSignalInitValue=0, ComBitPosition=13, ComSystemTemplateSystemSignalRef=Mes1CellBalState
        Mes2CellVolt: ComSignalType=UINT16, ComSignalEndianness=BIG_ENDIAN, ComBitSize=13, ComHandleId=23, ComSignalInitValue=8191, ComBitPosition=28, ComSystemTemplateSystemSignalRef=Mes2CellVolt
        Mes2CellBalState: ComSignalType=BOOLEAN, ComSignalEndianness=BIG_ENDIAN, ComBitSize=1, ComHandleId=24, ComSignalInitValue=0, ComBitPosition=29, ComSystemTemplateSystemSignalRef=Mes2CellBalState
        Mes3CellVolt: ComSignalType=UINT16, ComSignalEndianness=BIG_ENDIAN, ComBitSize=13, ComHandleId=25, ComSignalInitValue=8191, ComBitPosition=44, ComSystemTemplateSystemSignalRef=Mes3CellVolt
        Mes3CellBalState: ComSignalType=BOOLEAN, ComSignalEndianness=BIG_ENDIAN, ComBitSize=1, ComHandleId=26, ComSignalInitValue=0, ComBitPosition=45, ComSystemTemplateSystemSignalRef=Mes3CellBalState
        HVBDP_LngTrmDischrgPwr: ComSignalType=UINT16, ComSignalEndianness=BIG_ENDIAN, ComBitSize=11, ComHandleId=15, ComSignalInitValue=0, ComBitPosition=7, ComSystemTemplateSystemSignalRef=HVBDP_LngTrmDischrgPwr
        HVBDP_CrnkDischrgPwrV: ComSignalType=BOOLEAN, ComSignalEndianness=BIG_ENDIAN, ComBitSize=1, ComHandleId=16, ComSignalInitValue=0, ComBitPosition=11, ComSystemTemplateSystemSignalRef=HVBDP_CrnkDischrgPwrV
        HVBDP_ShrtTrmDischrgPwr: ComSignalType=UINT16, ComSignalEndianness=BIG_ENDIAN, ComBitSize=11, ComHandleId=17, ComSignalInitValue=0, ComBitPosition=10, ComSystemTemplateSystemSignalRef=HVBDP_ShrtTrmDischrgPwr
        DischrgPeakTimeFactor: ComSignalType=UINT8, ComSignalEndianness=BIG_ENDIAN, ComBitSize=8, ComHandleId=18, ComSignalInitValue=0, ComBitPosition=31, ComSystemTemplateSystemSignalRef=DischrgPeakTimeFactor
        BMSChecksum_3DBh: ComSignalType=UINT8, ComSignalEndianness=BIG_ENDIAN, ComBitSize=8, ComHandleId=19, ComSignalInitValue=0, ComBitPosition=63, ComSystemTemplateSystemSignalRef=BMSChecksum_3DBh
        ACChrgVoltRq: ComSignalType=UINT16, ComSignalEndianness=BIG_ENDIAN, ComBitSize=14, ComHandleId=108, ComSignalInitValue=0, ComBitPosition=13, ComSystemTemplateSystemSignalRef=ACChrgVoltRq
        ACChrgCurrRq: ComSignalType=UINT16, ComSignalEndianness=BIG_ENDIAN, ComBitSize=10, ComHandleId=109, ComSignalInitValue=0, ComBitPosition=25, ComSystemTemplateSystemSignalRef=ACChrgCurrRq
        ACChrgMode: ComSignalType=UINT8, ComSignalEndianness=BIG_ENDIAN, ComBitSize=4, ComHandleId=110, ComSignalInitValue=0, ComBitPosition=47, ComSystemTemplateSystemSignalRef=ACChrgMode
        ACChrgFault: ComSignalType=UINT8, ComSignalEndianness=BIG_ENDIAN, ComBitSize=4, ComHandleId=111, ComSignalInitValue=0, ComBitPosition=43, ComSystemTemplateSystemSignalRef=ACChrgFault
        CCVaule: ComSignalType=UINT8, ComSignalEndianness=BIG_ENDIAN, ComBitSize=8, ComHandleId=112, ComSignalInitValue=0, ComBitPosition=55, ComSystemTemplateSystemSignalRef=CCVaule
        CPVaule: ComSignalType=UINT8, ComSignalEndianness=BIG_ENDIAN, ComBitSize=8, ComHandleId=113, ComSignalInitValue=0, ComBitPosition=63, ComSystemTemplateSystemSignalRef=CPVaule
        S2_Status: ComSignalType=BOOLEAN, ComSignalEndianness=BIG_ENDIAN, ComBitSize=1, ComHandleId=114, ComSignalInitValue=0, ComBitPosition=14, ComSystemTemplateSystemSignalRef=S2_Status
        MaxClVlt: ComSignalType=UINT16, ComSignalEndianness=BIG_ENDIAN, ComBitSize=13, ComHandleId=63, ComSignalInitValue=0, ComBitPosition=4, ComSystemTemplateSystemSignalRef=MaxClVlt
        MaxCellVoltNumb: ComSignalType=UINT8, ComSignalEndianness=BIG_ENDIAN, ComBitSize=8, ComHandleId=64, ComSignalInitValue=1, ComBitPosition=23, ComSystemTemplateSystemSignalRef=MaxCellVoltNumb
        MinClVlt: ComSignalType=UINT16, ComSignalEndianness=BIG_ENDIAN, ComBitSize=13, ComHandleId=65, ComSignalInitValue=0, ComBitPosition=28, ComSystemTemplateSystemSignalRef=MinClVlt
        MinCellVoltNumb: ComSignalType=UINT8, ComSignalEndianness=BIG_ENDIAN, ComBitSize=8, ComHandleId=66, ComSignalInitValue=1, ComBitPosition=47, ComSystemTemplateSystemSignalRef=MinCellVoltNumb
        HVBatPackAccVltgV: ComSignalType=BOOLEAN, ComSignalEndianness=BIG_ENDIAN, ComBitSize=1, ComHandleId=67, ComSignalInitValue=0, ComBitPosition=53, ComSystemTemplateSystemSignalRef=HVBatPackAccVltgV
        HVBatPackAccVltg: ComSignalType=UINT16, ComSignalEndianness=BIG_ENDIAN, ComBitSize=13, ComHandleId=68, ComSignalInitValue=0, ComBitPosition=52, ComSystemTemplateSystemSignalRef=HVBatPackAccVltg
        CTS_SPN2823_SYNC_YearThousand: ComNotification=Rte_COMCbk_CTS_SPN2823_SYNC_YearThousand, ComSignalType=UINT8, ComSignalEndianness=LITTLE_ENDIAN, ComBitSize=4, ComHandleId=36, ComSignalInitValue=0, ComBitPosition=52, ComSystemTemplateSystemSignalRef=CTS_SPN2823_SYNC_YearThousand
        CTS_SPN2823_SYNC_YearTen: ComNotification=Rte_COMCbk_CTS_SPN2823_SYNC_YearTen, ComSignalType=UINT8, ComSignalEndianness=LITTLE_ENDIAN, ComBitSize=4, ComHandleId=37, ComSignalInitValue=0, ComBitPosition=44, ComSystemTemplateSystemSignalRef=CTS_SPN2823_SYNC_YearTen
        CTS_SPN2823_SYNC_YearHundred: ComNotification=Rte_COMCbk_CTS_SPN2823_SYNC_YearHundred, ComSignalType=UINT8, ComSignalEndianness=LITTLE_ENDIAN, ComBitSize=4, ComHandleId=38, ComSignalInitValue=0, ComBitPosition=48, ComSystemTemplateSystemSignalRef=CTS_SPN2823_SYNC_YearHundred
        CTS_SPN2823_SYNC_Year: ComNotification=Rte_COMCbk_CTS_SPN2823_SYNC_Year, ComSignalType=UINT8, ComSignalEndianness=LITTLE_ENDIAN, ComBitSize=4, ComHandleId=39, ComSignalInitValue=0, ComBitPosition=40, ComSystemTemplateSystemSignalRef=CTS_SPN2823_SYNC_Year
        CTS_SPN2823_SYNC_SecondTen: ComNotification=Rte_COMCbk_CTS_SPN2823_SYNC_SecondTen, ComSignalType=UINT8, ComSignalEndianness=LITTLE_ENDIAN, ComBitSize=4, ComHandleId=40, ComSignalInitValue=0, ComBitPosition=4, ComSystemTemplateSystemSignalRef=CTS_SPN2823_SYNC_SecondTen
        CTS_SPN2823_SYNC_Second: ComNotification=Rte_COMCbk_CTS_SPN2823_SYNC_Second, ComSignalType=UINT8, ComSignalEndianness=LITTLE_ENDIAN, ComBitSize=4, ComHandleId=41, ComSignalInitValue=0, ComBitPosition=0, ComSystemTemplateSystemSignalRef=CTS_SPN2823_SYNC_Second
        CTS_SPN2823_SYNC_MonthTen: ComNotification=Rte_COMCbk_CTS_SPN2823_SYNC_MonthTen, ComSignalType=UINT8, ComSignalEndianness=LITTLE_ENDIAN, ComBitSize=4, ComHandleId=42, ComSignalInitValue=0, ComBitPosition=36, ComSystemTemplateSystemSignalRef=CTS_SPN2823_SYNC_MonthTen
        CTS_SPN2823_SYNC_Month: ComNotification=Rte_COMCbk_CTS_SPN2823_SYNC_Month, ComSignalType=UINT8, ComSignalEndianness=LITTLE_ENDIAN, ComBitSize=4, ComHandleId=43, ComSignalInitValue=0, ComBitPosition=32, ComSystemTemplateSystemSignalRef=CTS_SPN2823_SYNC_Month
        CTS_SPN2823_SYNC_MinuteTen: ComNotification=Rte_COMCbk_CTS_SPN2823_SYNC_MinuteTen, ComSignalType=UINT8, ComSignalEndianness=LITTLE_ENDIAN, ComBitSize=4, ComHandleId=44, ComSignalInitValue=0, ComBitPosition=12, ComSystemTemplateSystemSignalRef=CTS_SPN2823_SYNC_MinuteTen
        CTS_SPN2823_SYNC_Minute: ComNotification=Rte_COMCbk_CTS_SPN2823_SYNC_Minute, ComSignalType=UINT8, ComSignalEndianness=LITTLE_ENDIAN, ComBitSize=4, ComHandleId=45, ComSignalInitValue=0, ComBitPosition=8, ComSystemTemplateSystemSignalRef=CTS_SPN2823_SYNC_Minute
        CTS_SPN2823_SYNC_HourTen: ComNotification=Rte_COMCbk_CTS_SPN2823_SYNC_HourTen, ComSignalType=UINT8, ComSignalEndianness=LITTLE_ENDIAN, ComBitSize=4, ComHandleId=46, ComSignalInitValue=0, ComBitPosition=20, ComSystemTemplateSystemSignalRef=CTS_SPN2823_SYNC_HourTen
        CTS_SPN2823_SYNC_Hour: ComNotification=Rte_COMCbk_CTS_SPN2823_SYNC_Hour, ComSignalType=UINT8, ComSignalEndianness=LITTLE_ENDIAN, ComBitSize=4, ComHandleId=47, ComSignalInitValue=0, ComBitPosition=16, ComSystemTemplateSystemSignalRef=CTS_SPN2823_SYNC_Hour
        CTS_SPN2823_SYNC_DayTen: ComNotification=Rte_COMCbk_CTS_SPN2823_SYNC_DayTen, ComSignalType=UINT8, ComSignalEndianness=LITTLE_ENDIAN, ComBitSize=4, ComHandleId=48, ComSignalInitValue=0, ComBitPosition=28, ComSystemTemplateSystemSignalRef=CTS_SPN2823_SYNC_DayTen
        CTS_SPN2823_SYNC_Day: ComNotification=Rte_COMCbk_CTS_SPN2823_SYNC_Day, ComSignalType=UINT8, ComSignalEndianness=LITTLE_ENDIAN, ComBitSize=4, ComHandleId=49, ComSignalInitValue=0, ComBitPosition=24, ComSystemTemplateSystemSignalRef=CTS_SPN2823_SYNC_Day
        CSD_SPN3613_CHG_Index: ComNotification=Rte_COMCbk_CSD_SPN3613_CHG_Index, ComSignalType=UINT32, ComSignalEndianness=LITTLE_ENDIAN, ComBitSize=32, ComHandleId=21, ComSignalInitValue=0, ComBitPosition=32, ComSystemTemplateSystemSignalRef=CSD_SPN3613_CHG_Index
        CSD_SPN3612_E_Out: ComNotification=Rte_COMCbk_CSD_SPN3612_E_Out, ComSignalType=UINT16, ComSignalEndianness=LITTLE_ENDIAN, ComBitSize=16, ComHandleId=22, ComSignalInitValue=0, ComBitPosition=16, ComSystemTemplateSystemSignalRef=CSD_SPN3612_E_Out
        CSD_SPN3611_Time_Charged: ComNotification=Rte_COMCbk_CSD_SPN3611_Time_Charged, ComSignalType=UINT16, ComSignalEndianness=LITTLE_ENDIAN, ComBitSize=16, ComHandleId=23, ComSignalInitValue=0, ComBitPosition=0, ComSystemTemplateSystemSignalRef=CSD_SPN3611_Time_Charged
        CST_SPN3521_Stop_Reason_BMSStop: ComNotification=Rte_COMCbk_CST_SPN3521_Stop_Reason_BMSStop, ComSignalType=UINT8, ComSignalEndianness=LITTLE_ENDIAN, ComBitSize=2, ComHandleId=24, ComSignalInitValue=0, ComBitPosition=6, ComSystemTemplateSystemSignalRef=CST_SPN3521_Stop_Reason_BMSStop
        CST_SPN3523_Stop_Fault_U: ComNotification=Rte_COMCbk_CST_SPN3523_Stop_Fault_U, ComSignalType=UINT8, ComSignalEndianness=LITTLE_ENDIAN, ComBitSize=2, ComHandleId=25, ComSignalInitValue=0, ComBitPosition=26, ComSystemTemplateSystemSignalRef=CST_SPN3523_Stop_Fault_U
        CST_SPN3523_Stop_Fault_Mismatch: ComNotification=Rte_COMCbk_CST_SPN3523_Stop_Fault_Mismatch, ComSignalType=UINT8, ComSignalEndianness=LITTLE_ENDIAN, ComBitSize=2, ComHandleId=26, ComSignalInitValue=0, ComBitPosition=24, ComSystemTemplateSystemSignalRef=CST_SPN3523_Stop_Fault_Mismatch
        CST_SPN3522_Stop_Fault_T_Inter: ComNotification=Rte_COMCbk_CST_SPN3522_Stop_Fault_T_Inter, ComSignalType=UINT8, ComSignalEndianness=LITTLE_ENDIAN, ComBitSize=2, ComHandleId=27, ComSignalInitValue=0, ComBitPosition=12, ComSystemTemplateSystemSignalRef=CST_SPN3522_Stop_Fault_T_Inter
        CST_SPN3522_Stop_Fault_T_CHG: ComNotification=Rte_COMCbk_CST_SPN3522_Stop_Fault_T_CHG, ComSignalType=UINT8, ComSignalEndianness=LITTLE_ENDIAN, ComBitSize=2, ComHandleId=28, ComSignalInitValue=0, ComBitPosition=8, ComSystemTemplateSystemSignalRef=CST_SPN3522_Stop_Fault_T_CHG
        CST_SPN3522_Stop_Fault_Other: ComNotification=Rte_COMCbk_CST_SPN3522_Stop_Fault_Other, ComSignalType=UINT8, ComSignalEndianness=LITTLE_ENDIAN, ComBitSize=2, ComHandleId=29, ComSignalInitValue=0, ComBitPosition=18, ComSystemTemplateSystemSignalRef=CST_SPN3522_Stop_Fault_Other
        CST_SPN3522_Stop_Fault_EmerStop: ComNotification=Rte_COMCbk_CST_SPN3522_Stop_Fault_EmerStop, ComSignalType=UINT8, ComSignalEndianness=LITTLE_ENDIAN, ComBitSize=2, ComHandleId=30, ComSignalInitValue=0, ComBitPosition=16, ComSystemTemplateSystemSignalRef=CST_SPN3522_Stop_Fault_EmerStop
        CST_SPN3522_Stop_Fault_Deliver: ComNotification=Rte_COMCbk_CST_SPN3522_Stop_Fault_Deliver, ComSignalType=UINT8, ComSignalEndianness=LITTLE_ENDIAN, ComBitSize=2, ComHandleId=31, ComSignalInitValue=0, ComBitPosition=14, ComSystemTemplateSystemSignalRef=CST_SPN3522_Stop_Fault_Deliver
        CST_SPN3522_Stop_Fault_CHGCnnt: ComNotification=Rte_COMCbk_CST_SPN3522_Stop_Fault_CHGCnnt, ComSignalType=UINT8, ComSignalEndianness=LITTLE_ENDIAN, ComBitSize=2, ComHandleId=32, ComSignalInitValue=0, ComBitPosition=10, ComSystemTemplateSystemSignalRef=CST_SPN3522_Stop_Fault_CHGCnnt
        CST_SPN3521_Stop_Reason_Manual: ComNotification=Rte_COMCbk_CST_SPN3521_Stop_Reason_Manual, ComSignalType=UINT8, ComSignalEndianness=LITTLE_ENDIAN, ComBitSize=2, ComHandleId=33, ComSignalInitValue=0, ComBitPosition=2, ComSystemTemplateSystemSignalRef=CST_SPN3521_Stop_Reason_Manual
        CST_SPN3521_Stop_Reason_Fault: ComNotification=Rte_COMCbk_CST_SPN3521_Stop_Reason_Fault, ComSignalType=UINT8, ComSignalEndianness=LITTLE_ENDIAN, ComBitSize=2, ComHandleId=34, ComSignalInitValue=0, ComBitPosition=4, ComSystemTemplateSystemSignalRef=CST_SPN3521_Stop_Reason_Fault
        CST_SPN3521_Stop_Reason_Auto: ComNotification=Rte_COMCbk_CST_SPN3521_Stop_Reason_Auto, ComSignalType=UINT8, ComSignalEndianness=LITTLE_ENDIAN, ComBitSize=2, ComHandleId=35, ComSignalInitValue=0, ComBitPosition=0, ComSystemTemplateSystemSignalRef=CST_SPN3521_Stop_Reason_Auto
        CHM_SPN2600_Comm_Ver: ComNotification=Rte_COMCbk_CHM_SPN2600_Comm_Ver, ComSignalType=UINT32, ComSignalEndianness=LITTLE_ENDIAN, ComBitSize=24, ComHandleId=12, ComSignalInitValue=0, ComBitPosition=0, ComSystemTemplateSystemSignalRef=CHM_SPN2600_Comm_Ver
        CRO_SPN2830_CHG_Ready: ComNotification=Rte_COMCbk_CRO_SPN2830_CHG_Ready, ComSignalType=UINT8, ComSignalEndianness=LITTLE_ENDIAN, ComBitSize=8, ComHandleId=20, ComSignalInitValue=0, ComBitPosition=0, ComSystemTemplateSystemSignalRef=CRO_SPN2830_CHG_Ready
        CEM_other: ComNotification=Rte_COMCbk_CEM_other, ComSignalType=UINT8, ComSignalEndianness=LITTLE_ENDIAN, ComBitSize=6, ComHandleId=4, ComSignalInitValue=0, ComBitPosition=26, ComSystemTemplateSystemSignalRef=CEM_other
        CEM_SPN3927_Timeout_BSD: ComNotification=Rte_COMCbk_CEM_SPN3927_Timeout_BSD, ComSignalType=UINT8, ComSignalEndianness=LITTLE_ENDIAN, ComBitSize=2, ComHandleId=5, ComSignalInitValue=0, ComBitPosition=24, ComSystemTemplateSystemSignalRef=CEM_SPN3927_Timeout_BSD
        CEM_SPN3926_Timeout_BST: ComNotification=Rte_COMCbk_CEM_SPN3926_Timeout_BST, ComSignalType=UINT8, ComSignalEndianness=LITTLE_ENDIAN, ComBitSize=2, ComHandleId=6, ComSignalInitValue=0, ComBitPosition=20, ComSystemTemplateSystemSignalRef=CEM_SPN3926_Timeout_BST
        CEM_SPN3925_Timeout_BCL: ComNotification=Rte_COMCbk_CEM_SPN3925_Timeout_BCL, ComSignalType=UINT8, ComSignalEndianness=LITTLE_ENDIAN, ComBitSize=2, ComHandleId=7, ComSignalInitValue=0, ComBitPosition=18, ComSystemTemplateSystemSignalRef=CEM_SPN3925_Timeout_BCL
        CEM_SPN3924_Timeout_BCS: ComNotification=Rte_COMCbk_CEM_SPN3924_Timeout_BCS, ComSignalType=UINT8, ComSignalEndianness=LITTLE_ENDIAN, ComBitSize=2, ComHandleId=8, ComSignalInitValue=0, ComBitPosition=16, ComSystemTemplateSystemSignalRef=CEM_SPN3924_Timeout_BCS
        CEM_SPN3923_Timeout_BRO: ComNotification=Rte_COMCbk_CEM_SPN3923_Timeout_BRO, ComSignalType=UINT8, ComSignalEndianness=LITTLE_ENDIAN, ComBitSize=2, ComHandleId=9, ComSignalInitValue=0, ComBitPosition=10, ComSystemTemplateSystemSignalRef=CEM_SPN3923_Timeout_BRO
        CEM_SPN3922_Timeout_BCP: ComNotification=Rte_COMCbk_CEM_SPN3922_Timeout_BCP, ComSignalType=UINT8, ComSignalEndianness=LITTLE_ENDIAN, ComBitSize=2, ComHandleId=10, ComSignalInitValue=0, ComBitPosition=8, ComSystemTemplateSystemSignalRef=CEM_SPN3922_Timeout_BCP
        CEM_SPN3921_Timeout_BRM: ComNotification=Rte_COMCbk_CEM_SPN3921_Timeout_BRM, ComSignalType=UINT8, ComSignalEndianness=LITTLE_ENDIAN, ComBitSize=2, ComHandleId=11, ComSignalInitValue=0, ComBitPosition=0, ComSystemTemplateSystemSignalRef=CEM_SPN3921_Timeout_BRM
        CML_SPN2827_I_Min_Out: ComNotification=Rte_COMCbk_CML_SPN2827_I_Min_Out, ComSignalType=UINT16, ComSignalEndianness=LITTLE_ENDIAN, ComBitSize=16, ComHandleId=13, ComSignalInitValue=4000, ComBitPosition=48, ComSystemTemplateSystemSignalRef=CML_SPN2827_I_Min_Out
        CML_SPN2826_I_Max_Out: ComNotification=Rte_COMCbk_CML_SPN2826_I_Max_Out, ComSignalType=UINT16, ComSignalEndianness=LITTLE_ENDIAN, ComBitSize=16, ComHandleId=14, ComSignalInitValue=4000, ComBitPosition=32, ComSystemTemplateSystemSignalRef=CML_SPN2826_I_Max_Out
        CML_SPN2825_U_Min_Out: ComNotification=Rte_COMCbk_CML_SPN2825_U_Min_Out, ComSignalType=UINT16, ComSignalEndianness=LITTLE_ENDIAN, ComBitSize=16, ComHandleId=15, ComSignalInitValue=0, ComBitPosition=16, ComSystemTemplateSystemSignalRef=CML_SPN2825_U_Min_Out
        CML_SPN2824_U_Max_Out: ComNotification=Rte_COMCbk_CML_SPN2824_U_Max_Out, ComSignalType=UINT16, ComSignalEndianness=LITTLE_ENDIAN, ComBitSize=16, ComHandleId=16, ComSignalInitValue=0, ComBitPosition=0, ComSystemTemplateSystemSignalRef=CML_SPN2824_U_Max_Out
        CCS_SPN3081_U_Out: ComNotification=Rte_COMCbk_CCS_SPN3081_U_Out, ComSignalType=UINT16, ComSignalEndianness=LITTLE_ENDIAN, ComBitSize=16, ComHandleId=0, ComSignalInitValue=0, ComBitPosition=0, ComSystemTemplateSystemSignalRef=CCS_SPN3081_U_Out
        CCS_SPN3082_I_Out: ComNotification=Rte_COMCbk_CCS_SPN3082_I_Out, ComSignalType=UINT16, ComSignalEndianness=LITTLE_ENDIAN, ComBitSize=16, ComHandleId=1, ComSignalInitValue=4000, ComBitPosition=16, ComSystemTemplateSystemSignalRef=CCS_SPN3082_I_Out
        CCS_SPN3083_Time_Charged: ComNotification=Rte_COMCbk_CCS_SPN3083_Time_Charged, ComSignalType=UINT16, ComSignalEndianness=LITTLE_ENDIAN, ComBitSize=16, ComHandleId=2, ComSignalInitValue=0, ComBitPosition=32, ComSystemTemplateSystemSignalRef=CCS_SPN3083_Time_Charged
        CCS_SPN3929_Chg_enable: ComNotification=Rte_COMCbk_CCS_SPN3929_Chg_enable, ComSignalType=UINT8, ComSignalEndianness=LITTLE_ENDIAN, ComBitSize=2, ComHandleId=3, ComSignalInitValue=0, ComBitPosition=48, ComSystemTemplateSystemSignalRef=CCS_SPN3929_Chg_enable
        CRM_SPN2562_CHG_Loc: ComNotification=Rte_COMCbk_CRM_SPN2562_CHG_Loc, ComSignalType=UINT32, ComSignalEndianness=LITTLE_ENDIAN, ComBitSize=24, ComHandleId=17, ComSignalInitValue=0, ComBitPosition=40, ComSystemTemplateSystemSignalRef=CRM_SPN2562_CHG_Loc
        CRM_SPN2561_CHG_Index: ComNotification=Rte_COMCbk_CRM_SPN2561_CHG_Index, ComSignalType=UINT32, ComSignalEndianness=LITTLE_ENDIAN, ComBitSize=32, ComHandleId=18, ComSignalInitValue=1, ComBitPosition=8, ComSystemTemplateSystemSignalRef=CRM_SPN2561_CHG_Index
        CRM_SPN2560_Ack: ComNotification=Rte_COMCbk_CRM_SPN2560_Ack, ComSignalType=UINT8, ComSignalEndianness=LITTLE_ENDIAN, ComBitSize=8, ComHandleId=19, ComSignalInitValue=0, ComBitPosition=0, ComSystemTemplateSystemSignalRef=CRM_SPN2560_Ack
        BHM_SPN2601_Ubat_Max_Permit: ComSignalType=UINT16, ComSignalEndianness=LITTLE_ENDIAN, ComBitSize=16, ComHandleId=107, ComSignalInitValue=0, ComBitPosition=0, ComSystemTemplateSystemSignalRef=BHM_SPN2601_Ubat_Max_Permit
        BSM_SPN3096_Chg_Enable: ComSignalType=UINT8, ComSignalEndianness=LITTLE_ENDIAN, ComBitSize=2, ComHandleId=198, ComSignalInitValue=0, ComBitPosition=52, ComSystemTemplateSystemSignalRef=BSM_SPN3096_Chg_Enable
        BSM_SPN3095_OutConnector_State: ComSignalType=UINT8, ComSignalEndianness=LITTLE_ENDIAN, ComBitSize=2, ComHandleId=199, ComSignalInitValue=0, ComBitPosition=50, ComSystemTemplateSystemSignalRef=BSM_SPN3095_OutConnector_State
        BSM_SPN3094_Iso_State: ComSignalType=UINT8, ComSignalEndianness=LITTLE_ENDIAN, ComBitSize=2, ComHandleId=200, ComSignalInitValue=0, ComBitPosition=48, ComSystemTemplateSystemSignalRef=BSM_SPN3094_Iso_State
        BSM_SPN3093_T_Warn: ComSignalType=UINT8, ComSignalEndianness=LITTLE_ENDIAN, ComBitSize=2, ComHandleId=201, ComSignalInitValue=0, ComBitPosition=46, ComSystemTemplateSystemSignalRef=BSM_SPN3093_T_Warn
        BSM_SPN3092_I_Warn: ComSignalType=UINT8, ComSignalEndianness=LITTLE_ENDIAN, ComBitSize=2, ComHandleId=202, ComSignalInitValue=0, ComBitPosition=44, ComSystemTemplateSystemSignalRef=BSM_SPN3092_I_Warn
        BSM_SPN3091_SOC_Warn: ComSignalType=UINT8, ComSignalEndianness=LITTLE_ENDIAN, ComBitSize=2, ComHandleId=203, ComSignalInitValue=0, ComBitPosition=42, ComSystemTemplateSystemSignalRef=BSM_SPN3091_SOC_Warn
        BSM_SPN3090_Ucell_Warn: ComSignalType=UINT8, ComSignalEndianness=LITTLE_ENDIAN, ComBitSize=2, ComHandleId=204, ComSignalInitValue=0, ComBitPosition=40, ComSystemTemplateSystemSignalRef=BSM_SPN3090_Ucell_Warn
        BSM_SPN3089_T_Min_Index: ComSignalType=UINT8, ComSignalEndianness=LITTLE_ENDIAN, ComBitSize=8, ComHandleId=205, ComSignalInitValue=0, ComBitPosition=32, ComSystemTemplateSystemSignalRef=BSM_SPN3089_T_Min_Index
        BSM_SPN3088_T_Min: ComSignalType=UINT8, ComSignalEndianness=LITTLE_ENDIAN, ComBitSize=8, ComHandleId=206, ComSignalInitValue=50, ComBitPosition=24, ComSystemTemplateSystemSignalRef=BSM_SPN3088_T_Min
        BSM_SPN3087_T_Max_Index: ComSignalType=UINT8, ComSignalEndianness=LITTLE_ENDIAN, ComBitSize=8, ComHandleId=207, ComSignalInitValue=0, ComBitPosition=16, ComSystemTemplateSystemSignalRef=BSM_SPN3087_T_Max_Index
        BSM_SPN3086_T_Max: ComSignalType=UINT8, ComSignalEndianness=LITTLE_ENDIAN, ComBitSize=8, ComHandleId=208, ComSignalInitValue=50, ComBitPosition=8, ComSystemTemplateSystemSignalRef=BSM_SPN3086_T_Max
        BSM_SPN3085_Ucell_Max_Index: ComSignalType=UINT8, ComSignalEndianness=LITTLE_ENDIAN, ComBitSize=8, ComHandleId=209, ComSignalInitValue=0, ComBitPosition=0, ComSystemTemplateSystemSignalRef=BSM_SPN3085_Ucell_Max_Index
        BST_SPN3512_Stop_Fault_HVRelay: ComSignalType=UINT8, ComSignalEndianness=LITTLE_ENDIAN, ComBitSize=2, ComHandleId=210, ComSignalInitValue=0, ComBitPosition=18, ComSystemTemplateSystemSignalRef=BST_SPN3512_Stop_Fault_HVRelay
        BST_SPN3512_Stop_Fault_CC2: ComSignalType=UINT8, ComSignalEndianness=LITTLE_ENDIAN, ComBitSize=2, ComHandleId=211, ComSignalInitValue=0, ComBitPosition=20, ComSystemTemplateSystemSignalRef=BST_SPN3512_Stop_Fault_CC2
        BST_SPN3511_Stop_Reason_CHGStop: ComSignalType=UINT8, ComSignalEndianness=LITTLE_ENDIAN, ComBitSize=2, ComHandleId=212, ComSignalInitValue=0, ComBitPosition=6, ComSystemTemplateSystemSignalRef=BST_SPN3511_Stop_Reason_CHGStop
        BST_SPN3513_Stop_Fault_U: ComSignalType=UINT8, ComSignalEndianness=LITTLE_ENDIAN, ComBitSize=2, ComHandleId=213, ComSignalInitValue=0, ComBitPosition=26, ComSystemTemplateSystemSignalRef=BST_SPN3513_Stop_Fault_U
        BST_SPN3513_Stop_Fault_I: ComSignalType=UINT8, ComSignalEndianness=LITTLE_ENDIAN, ComBitSize=2, ComHandleId=214, ComSignalInitValue=0, ComBitPosition=24, ComSystemTemplateSystemSignalRef=BST_SPN3513_Stop_Fault_I
        BST_SPN3512_Stop_Fault_T: ComSignalType=UINT8, ComSignalEndianness=LITTLE_ENDIAN, ComBitSize=2, ComHandleId=215, ComSignalInitValue=0, ComBitPosition=16, ComSystemTemplateSystemSignalRef=BST_SPN3512_Stop_Fault_T
        BST_SPN3512_Stop_Fault_Other: ComSignalType=UINT8, ComSignalEndianness=LITTLE_ENDIAN, ComBitSize=2, ComHandleId=216, ComSignalInitValue=0, ComBitPosition=22, ComSystemTemplateSystemSignalRef=BST_SPN3512_Stop_Fault_Other
        BST_SPN3512_Stop_Fault_Iso: ComSignalType=UINT8, ComSignalEndianness=LITTLE_ENDIAN, ComBitSize=2, ComHandleId=217, ComSignalInitValue=0, ComBitPosition=8, ComSystemTemplateSystemSignalRef=BST_SPN3512_Stop_Fault_Iso
        BST_SPN3512_Stop_Fault_OutCnnt: ComSignalType=UINT8, ComSignalEndianness=LITTLE_ENDIAN, ComBitSize=2, ComHandleId=218, ComSignalInitValue=0, ComBitPosition=10, ComSystemTemplateSystemSignalRef=BST_SPN3512_Stop_Fault_OutCnnt
        BST_SPN3512_Stop_Fault_BCUcompo: ComSignalType=UINT8, ComSignalEndianness=LITTLE_ENDIAN, ComBitSize=2, ComHandleId=219, ComSignalInitValue=0, ComBitPosition=12, ComSystemTemplateSystemSignalRef=BST_SPN3512_Stop_Fault_BCUcompo
        BST_SPN3512_Stop_Fault_ChgCnnt: ComSignalType=UINT8, ComSignalEndianness=LITTLE_ENDIAN, ComBitSize=2, ComHandleId=220, ComSignalInitValue=0, ComBitPosition=14, ComSystemTemplateSystemSignalRef=BST_SPN3512_Stop_Fault_ChgCnnt
        BST_SPN3511_Stop_Reason_Ucell: ComSignalType=UINT8, ComSignalEndianness=LITTLE_ENDIAN, ComBitSize=2, ComHandleId=221, ComSignalInitValue=0, ComBitPosition=4, ComSystemTemplateSystemSignalRef=BST_SPN3511_Stop_Reason_Ucell
        BST_SPN3511_Stop_Reason_U: ComSignalType=UINT8, ComSignalEndianness=LITTLE_ENDIAN, ComBitSize=2, ComHandleId=222, ComSignalInitValue=0, ComBitPosition=2, ComSystemTemplateSystemSignalRef=BST_SPN3511_Stop_Reason_U
        BST_SPN3511_Stop_Reason_SOC: ComSignalType=UINT8, ComSignalEndianness=LITTLE_ENDIAN, ComBitSize=2, ComHandleId=223, ComSignalInitValue=0, ComBitPosition=0, ComSystemTemplateSystemSignalRef=BST_SPN3511_Stop_Reason_SOC
        BRO_SPN2829_BCU_Ready: ComSignalType=UINT8, ComSignalEndianness=LITTLE_ENDIAN, ComBitSize=8, ComHandleId=192, ComSignalInitValue=0, ComBitPosition=0, ComSystemTemplateSystemSignalRef=BRO_SPN2829_BCU_Ready
        BEM_other: ComSignalType=UINT8, ComSignalEndianness=LITTLE_ENDIAN, ComBitSize=6, ComHandleId=99, ComSignalInitValue=0, ComBitPosition=26, ComSystemTemplateSystemSignalRef=BEM_other
        BEM_SPN3907_Timeout_CSD: ComSignalType=UINT8, ComSignalEndianness=LITTLE_ENDIAN, ComBitSize=2, ComHandleId=100, ComSignalInitValue=0, ComBitPosition=24, ComSystemTemplateSystemSignalRef=BEM_SPN3907_Timeout_CSD
        BEM_SPN3906_Timeout_CST: ComSignalType=UINT8, ComSignalEndianness=LITTLE_ENDIAN, ComBitSize=2, ComHandleId=101, ComSignalInitValue=0, ComBitPosition=18, ComSystemTemplateSystemSignalRef=BEM_SPN3906_Timeout_CST
        BEM_SPN3905_Timeout_CCS: ComSignalType=UINT8, ComSignalEndianness=LITTLE_ENDIAN, ComBitSize=2, ComHandleId=102, ComSignalInitValue=0, ComBitPosition=16, ComSystemTemplateSystemSignalRef=BEM_SPN3905_Timeout_CCS
        BEM_SPN3904_Timeout_CRO: ComSignalType=UINT8, ComSignalEndianness=LITTLE_ENDIAN, ComBitSize=2, ComHandleId=103, ComSignalInitValue=0, ComBitPosition=10, ComSystemTemplateSystemSignalRef=BEM_SPN3904_Timeout_CRO
        BEM_SPN3903_Timeout_CTS_CML: ComSignalType=UINT8, ComSignalEndianness=LITTLE_ENDIAN, ComBitSize=2, ComHandleId=104, ComSignalInitValue=0, ComBitPosition=8, ComSystemTemplateSystemSignalRef=BEM_SPN3903_Timeout_CTS_CML
        BEM_SPN3902_Timeout_SPN2560_0xAA: ComSignalType=UINT8, ComSignalEndianness=LITTLE_ENDIAN, ComBitSize=2, ComHandleId=105, ComSignalInitValue=0, ComBitPosition=2, ComSystemTemplateSystemSignalRef=BEM_SPN3902_Timeout_SPN2560_0xAA
        BEM_SPN3901_Timeout_SPN2560_0x00: ComSignalType=UINT8, ComSignalEndianness=LITTLE_ENDIAN, ComBitSize=2, ComHandleId=106, ComSignalInitValue=0, ComBitPosition=0, ComSystemTemplateSystemSignalRef=BEM_SPN3901_Timeout_SPN2560_0x00
        BCL_SPN3074_ChgMode: ComSignalType=UINT8, ComSignalEndianness=LITTLE_ENDIAN, ComBitSize=8, ComHandleId=83, ComSignalInitValue=0, ComBitPosition=32, ComSystemTemplateSystemSignalRef=BCL_SPN3074_ChgMode
        BCL_SPN3073_I_Req: ComSignalType=UINT16, ComSignalEndianness=LITTLE_ENDIAN, ComBitSize=16, ComHandleId=84, ComSignalInitValue=4000, ComBitPosition=16, ComSystemTemplateSystemSignalRef=BCL_SPN3073_I_Req
        BCL_SPN3072_U_Req: ComSignalType=UINT16, ComSignalEndianness=LITTLE_ENDIAN, ComBitSize=16, ComHandleId=85, ComSignalInitValue=0, ComBitPosition=0, ComSystemTemplateSystemSignalRef=BCL_SPN3072_U_Req
        BSD_SPN3605_T_Max: ComSignalType=UINT8, ComSignalEndianness=LITTLE_ENDIAN, ComBitSize=8, ComHandleId=193, ComSignalInitValue=50, ComBitPosition=48, ComSystemTemplateSystemSignalRef=BSD_SPN3605_T_Max
        BSD_SPN3604_T_Min: ComSignalType=UINT8, ComSignalEndianness=LITTLE_ENDIAN, ComBitSize=8, ComHandleId=194, ComSignalInitValue=50, ComBitPosition=40, ComSystemTemplateSystemSignalRef=BSD_SPN3604_T_Min
        BSD_SPN3603_Ucell_Max: ComSignalType=UINT16, ComSignalEndianness=LITTLE_ENDIAN, ComBitSize=16, ComHandleId=195, ComSignalInitValue=0, ComBitPosition=24, ComSystemTemplateSystemSignalRef=BSD_SPN3603_Ucell_Max
        BSD_SPN3602_Ucell_Min: ComSignalType=UINT16, ComSignalEndianness=LITTLE_ENDIAN, ComBitSize=16, ComHandleId=196, ComSignalInitValue=0, ComBitPosition=8, ComSystemTemplateSystemSignalRef=BSD_SPN3602_Ucell_Min
        BSD_SPN3601_SOC_Final: ComSignalType=UINT8, ComSignalEndianness=LITTLE_ENDIAN, ComBitSize=8, ComHandleId=197, ComSignalInitValue=0, ComBitPosition=0, ComSystemTemplateSystemSignalRef=BSD_SPN3601_SOC_Final
        BCP_SPN2822_U: ComSignalEndianness=LITTLE_ENDIAN, ComSignalType=UINT16, ComBitSize=16, ComHandleId=92, ComInitialValueOnly=0, ComSignalInitValue=0.0, ComBitPosition=88, ComSystemTemplateSystemSignalRef=BCP_SPN2822_U
        BCP_SPN2821_SOC: ComSignalEndianness=LITTLE_ENDIAN, ComSignalType=UINT16, ComBitSize=16, ComHandleId=91, ComInitialValueOnly=0, ComSignalInitValue=0.0, ComBitPosition=72, ComSystemTemplateSystemSignalRef=BCP_SPN2821_SOC
        BCP_SPN2820_T_Max_Permit: ComSignalEndianness=LITTLE_ENDIAN, ComSignalType=UINT8, ComBitSize=8, ComHandleId=90, ComInitialValueOnly=0, ComSignalInitValue=0.0, ComBitPosition=64, ComSystemTemplateSystemSignalRef=BCP_SPN2820_T_Max_Permit
        BCP_SPN2819_U_Max_Permit: ComSignalEndianness=LITTLE_ENDIAN, ComSignalType=UINT16, ComBitSize=16, ComHandleId=89, ComInitialValueOnly=0, ComSignalInitValue=0.0, ComBitPosition=48, ComSystemTemplateSystemSignalRef=BCP_SPN2819_U_Max_Permit
        BCP_SPN2818_kWh_Nom: ComSignalEndianness=LITTLE_ENDIAN, ComSignalType=UINT16, ComBitSize=16, ComHandleId=88, ComInitialValueOnly=0, ComSignalInitValue=0.0, ComBitPosition=31, ComSystemTemplateSystemSignalRef=BCP_SPN2818_kWh_Nom
        BCP_SPN2817_I_Max_Permit: ComSignalEndianness=LITTLE_ENDIAN, ComSignalType=UINT16, ComBitSize=16, ComHandleId=87, ComInitialValueOnly=0, ComSignalInitValue=0.0, ComBitPosition=16, ComSystemTemplateSystemSignalRef=BCP_SPN2817_I_Max_Permit
        BCP_SPN2816_Ucell_Max_Permit: ComSignalEndianness=LITTLE_ENDIAN, ComSignalType=UINT16, ComBitSize=16, ComHandleId=86, ComInitialValueOnly=0, ComSignalInitValue=0.0, ComBitPosition=0, ComSystemTemplateSystemSignalRef=BCP_SPN2816_Ucell_Max_Permit
        BCS_SPN3079_Time_Remain: ComSignalEndianness=LITTLE_ENDIAN, ComSignalType=UINT16, ComBitSize=16, ComHandleId=98, ComInitialValueOnly=0, ComSignalInitValue=0.0, ComBitPosition=56, ComSystemTemplateSystemSignalRef=BCS_SPN3079_Time_Remain
        BCS_SPN3078_SOC: ComSignalEndianness=LITTLE_ENDIAN, ComSignalType=UINT8, ComBitSize=8, ComHandleId=97, ComInitialValueOnly=0, ComSignalInitValue=0.0, ComBitPosition=48, ComSystemTemplateSystemSignalRef=BCS_SPN3078_SOC
        BCS_SPN3077_Ucell_Max_Grp: ComSignalEndianness=LITTLE_ENDIAN, ComSignalType=UINT8, ComBitSize=4, ComHandleId=96, ComInitialValueOnly=0, ComSignalInitValue=0.0, ComBitPosition=44, ComSystemTemplateSystemSignalRef=BCS_SPN3077_Ucell_Max_Grp
        BCS_SPN3077_Ucell_Max: ComSignalEndianness=LITTLE_ENDIAN, ComSignalType=UINT16, ComBitSize=12, ComHandleId=95, ComInitialValueOnly=0, ComSignalInitValue=0.0, ComBitPosition=32, ComSystemTemplateSystemSignalRef=BCS_SPN3077_Ucell_Max
        BCS_SPN3076_I_Mea: ComSignalType=UINT16, ComSignalEndianness=LITTLE_ENDIAN, ComBitSize=16, ComHandleId=94, ComInitialValueOnly=0, ComSignalInitValue=0.0, ComBitPosition=16, ComSystemTemplateSystemSignalRef=BCS_SPN3076_I_Mea
        BCS_SPN3075_U_Mea: ComSignalEndianness=LITTLE_ENDIAN, ComSignalType=UINT16, ComBitSize=16, ComHandleId=93, ComInitialValueOnly=0, ComSignalInitValue=0.0, ComBitPosition=0, ComSystemTemplateSystemSignalRef=BCS_SPN3075_U_Mea
        BRM_SPN2565_Ver: ComSignalEndianness=LITTLE_ENDIAN, ComSignalType=UINT32, ComBitSize=24, ComHandleId=158, ComInitialValueOnly=0, ComSignalInitValue=0.0, ComBitPosition=0, ComSystemTemplateSystemSignalRef=BRM_SPN2565_Ver
        BRM_SPN2566_Bat_Type: ComSignalEndianness=LITTLE_ENDIAN, ComSignalType=UINT8, ComBitSize=8, ComHandleId=159, ComInitialValueOnly=0, ComSignalInitValue=0.0, ComBitPosition=24, ComSystemTemplateSystemSignalRef=BRM_SPN2566_Bat_Type
        BRM_SPN2567_Cap_Nom: ComSignalEndianness=LITTLE_ENDIAN, ComSignalType=UINT16, ComBitSize=16, ComHandleId=160, ComInitialValueOnly=0, ComSignalInitValue=0.0, ComBitPosition=32, ComSystemTemplateSystemSignalRef=BRM_SPN2567_Cap_Nom
        BRM_SPN2568_U_Nom: ComSignalEndianness=LITTLE_ENDIAN, ComSignalType=UINT16, ComBitSize=16, ComHandleId=161, ComInitialValueOnly=0, ComSignalInitValue=0.0, ComBitPosition=48, ComSystemTemplateSystemSignalRef=BRM_SPN2568_U_Nom
        BRM_SPN2569_BatFactory: ComSignalEndianness=LITTLE_ENDIAN, ComSignalType=UINT32, ComBitSize=32, ComHandleId=162, ComInitialValueOnly=0, ComSignalInitValue=0.0, ComBitPosition=64, ComSystemTemplateSystemSignalRef=BRM_SPN2569_BatFactory
        BRM_SPN2570_PackSN: ComSignalEndianness=LITTLE_ENDIAN, ComSignalType=UINT32, ComBitSize=32, ComHandleId=163, ComInitialValueOnly=0, ComSignalInitValue=0.0, ComBitPosition=96, ComSystemTemplateSystemSignalRef=BRM_SPN2570_PackSN
        BRM_SPN2571_PackYear: ComSignalEndianness=LITTLE_ENDIAN, ComSignalType=UINT8, ComBitSize=8, ComHandleId=166, ComInitialValueOnly=0, ComSignalInitValue=0.0, ComBitPosition=128, ComSystemTemplateSystemSignalRef=BRM_SPN2571_PackYear
        BRM_SPN2571_PackMonth: ComSignalEndianness=LITTLE_ENDIAN, ComSignalType=UINT8, ComBitSize=8, ComHandleId=165, ComInitialValueOnly=0, ComSignalInitValue=0.0, ComBitPosition=136, ComSystemTemplateSystemSignalRef=BRM_SPN2571_PackMonth
        BRM_SPN2571_PackDay: ComSignalEndianness=LITTLE_ENDIAN, ComSignalType=UINT8, ComBitSize=8, ComHandleId=164, ComInitialValueOnly=0, ComSignalInitValue=0.0, ComBitPosition=144, ComSystemTemplateSystemSignalRef=BRM_SPN2571_PackDay
        BRM_SPN2573_PackRight: ComSignalEndianness=LITTLE_ENDIAN, ComSignalType=UINT8, ComBitSize=8, ComHandleId=168, ComInitialValueOnly=0, ComSignalInitValue=0.0, ComBitPosition=176, ComSystemTemplateSystemSignalRef=BRM_SPN2573_PackRight
        BRM_SPN2572_PackChgCnt: ComSignalEndianness=LITTLE_ENDIAN, ComSignalType=UINT32, ComBitSize=24, ComHandleId=167, ComInitialValueOnly=0, ComSignalInitValue=0.0, ComBitPosition=152, ComSystemTemplateSystemSignalRef=BRM_SPN2572_PackChgCnt
        BRM_SPN2574_BMSSW_Reserved: ComSignalEndianness=LITTLE_ENDIAN, ComSignalType=UINT8, ComBitSize=8, ComHandleId=169, ComInitialValueOnly=0, ComSignalInitValue=0.0, ComBitPosition=184, ComSystemTemplateSystemSignalRef=BRM_SPN2574_BMSSW_Reserved
        BRM_SPN2575_VIN1: ComSignalEndianness=LITTLE_ENDIAN, ComSignalType=UINT8, ComBitSize=8, ComHandleId=170, ComInitialValueOnly=0, ComSignalInitValue=0.0, ComBitPosition=192, ComSystemTemplateSystemSignalRef=BRM_SPN2575_VIN1
        BRM_SPN2575_VIN2: ComSignalEndianness=LITTLE_ENDIAN, ComSignalType=UINT8, ComBitSize=8, ComHandleId=179, ComInitialValueOnly=0, ComSignalInitValue=0.0, ComBitPosition=200, ComSystemTemplateSystemSignalRef=BRM_SPN2575_VIN2
        BRM_SPN2575_VIN3: ComSignalEndianness=LITTLE_ENDIAN, ComSignalType=UINT8, ComBitSize=8, ComHandleId=180, ComInitialValueOnly=0, ComSignalInitValue=0.0, ComBitPosition=208, ComSystemTemplateSystemSignalRef=BRM_SPN2575_VIN3
        BRM_SPN2575_VIN4: ComSignalEndianness=LITTLE_ENDIAN, ComSignalType=UINT8, ComBitSize=8, ComHandleId=181, ComInitialValueOnly=0, ComSignalInitValue=0.0, ComBitPosition=216, ComSystemTemplateSystemSignalRef=BRM_SPN2575_VIN4
        BRM_SPN2575_VIN5: ComSignalEndianness=LITTLE_ENDIAN, ComSignalType=UINT8, ComBitSize=8, ComHandleId=182, ComInitialValueOnly=0, ComSignalInitValue=0.0, ComBitPosition=224, ComSystemTemplateSystemSignalRef=BRM_SPN2575_VIN5
        BRM_SPN2575_VIN6: ComSignalEndianness=LITTLE_ENDIAN, ComSignalType=UINT8, ComBitSize=8, ComHandleId=183, ComInitialValueOnly=0, ComSignalInitValue=0.0, ComBitPosition=232, ComSystemTemplateSystemSignalRef=BRM_SPN2575_VIN6
        BRM_SPN2575_VIN7: ComSignalEndianness=LITTLE_ENDIAN, ComSignalType=UINT8, ComBitSize=8, ComHandleId=184, ComInitialValueOnly=0, ComSignalInitValue=0.0, ComBitPosition=240, ComSystemTemplateSystemSignalRef=BRM_SPN2575_VIN7
        BRM_SPN2575_VIN8: ComSignalEndianness=LITTLE_ENDIAN, ComSignalType=UINT8, ComBitSize=8, ComHandleId=185, ComInitialValueOnly=0, ComSignalInitValue=0.0, ComBitPosition=248, ComSystemTemplateSystemSignalRef=BRM_SPN2575_VIN8
        BRM_SPN2575_VIN9: ComSignalEndianness=LITTLE_ENDIAN, ComSignalType=UINT8, ComBitSize=8, ComHandleId=186, ComInitialValueOnly=0, ComSignalInitValue=0.0, ComBitPosition=256, ComSystemTemplateSystemSignalRef=BRM_SPN2575_VIN9
        BRM_SPN2575_VIN10: ComSignalEndianness=LITTLE_ENDIAN, ComSignalType=UINT8, ComBitSize=8, ComHandleId=171, ComInitialValueOnly=0, ComSignalInitValue=0.0, ComBitPosition=264, ComSystemTemplateSystemSignalRef=BRM_SPN2575_VIN10
        BRM_SPN2575_VIN11: ComSignalEndianness=LITTLE_ENDIAN, ComSignalType=UINT8, ComBitSize=8, ComHandleId=172, ComInitialValueOnly=0, ComSignalInitValue=0.0, ComBitPosition=272, ComSystemTemplateSystemSignalRef=BRM_SPN2575_VIN11
        BRM_SPN2575_VIN12: ComSignalEndianness=LITTLE_ENDIAN, ComSignalType=UINT8, ComBitSize=8, ComHandleId=173, ComInitialValueOnly=0, ComSignalInitValue=0.0, ComBitPosition=280, ComSystemTemplateSystemSignalRef=BRM_SPN2575_VIN12
        BRM_SPN2575_VIN13: ComSignalEndianness=LITTLE_ENDIAN, ComSignalType=UINT8, ComBitSize=8, ComHandleId=174, ComInitialValueOnly=0, ComSignalInitValue=0.0, ComBitPosition=288, ComSystemTemplateSystemSignalRef=BRM_SPN2575_VIN13
        BRM_SPN2575_VIN14: ComSignalEndianness=LITTLE_ENDIAN, ComSignalType=UINT8, ComBitSize=8, ComHandleId=175, ComInitialValueOnly=0, ComSignalInitValue=0.0, ComBitPosition=296, ComSystemTemplateSystemSignalRef=BRM_SPN2575_VIN14
        BRM_SPN2575_VIN15: ComSignalEndianness=LITTLE_ENDIAN, ComSignalType=UINT8, ComBitSize=8, ComHandleId=176, ComInitialValueOnly=0, ComSignalInitValue=0.0, ComBitPosition=304, ComSystemTemplateSystemSignalRef=BRM_SPN2575_VIN15
        BRM_SPN2575_VIN16: ComSignalEndianness=LITTLE_ENDIAN, ComSignalType=UINT8, ComBitSize=8, ComHandleId=177, ComInitialValueOnly=0, ComSignalInitValue=0.0, ComBitPosition=312, ComSystemTemplateSystemSignalRef=BRM_SPN2575_VIN16
        BRM_SPN2575_VIN17: ComSignalEndianness=LITTLE_ENDIAN, ComSignalType=UINT8, ComBitSize=8, ComHandleId=178, ComInitialValueOnly=0, ComSignalInitValue=0.0, ComBitPosition=320, ComSystemTemplateSystemSignalRef=BRM_SPN2575_VIN17
        BRM_SPN2576_BMSVer_Day: ComSignalEndianness=LITTLE_ENDIAN, ComSignalType=UINT8, ComBitSize=8, ComHandleId=187, ComInitialValueOnly=0, ComSignalInitValue=0.0, ComBitPosition=336, ComSystemTemplateSystemSignalRef=BRM_SPN2576_BMSVer_Day
        BRM_SPN2576_BMSVer_Month: ComSignalEndianness=LITTLE_ENDIAN, ComSignalType=UINT8, ComBitSize=8, ComHandleId=188, ComInitialValueOnly=0, ComSignalInitValue=0.0, ComBitPosition=344, ComSystemTemplateSystemSignalRef=BRM_SPN2576_BMSVer_Month
        BRM_SPN2576_BMSVer_Reserver: ComSignalEndianness=LITTLE_ENDIAN, ComSignalType=UINT32, ComBitSize=24, ComHandleId=189, ComInitialValueOnly=0, ComSignalInitValue=0.0, ComBitPosition=368, ComSystemTemplateSystemSignalRef=BRM_SPN2576_BMSVer_Reserver
        BRM_SPN2576_BMSVer_Version: ComSignalEndianness=LITTLE_ENDIAN, ComSignalType=UINT8, ComBitSize=8, ComHandleId=190, ComInitialValueOnly=0, ComSignalInitValue=0.0, ComBitPosition=328, ComSystemTemplateSystemSignalRef=BRM_SPN2576_BMSVer_Version
        BRM_SPN2576_BMSVer_Year: ComSignalEndianness=LITTLE_ENDIAN, ComSignalType=UINT16, ComBitSize=16, ComHandleId=191, ComInitialValueOnly=0, ComSignalInitValue=0.0, ComBitPosition=352, ComSystemTemplateSystemSignalRef=BRM_SPN2576_BMSVer_Year
        Old_BRM_SPN2565_Ver: ComSignalEndianness=LITTLE_ENDIAN, ComSignalType=UINT32, ComBitSize=24, ComHandleId=252, ComInitialValueOnly=0, ComSignalInitValue=0.0, ComBitPosition=0, ComSystemTemplateSystemSignalRef=BRM_SPN2565_Ver
        Old_BRM_SPN2566_Bat_Type: ComSignalEndianness=LITTLE_ENDIAN, ComSignalType=UINT8, ComBitSize=8, ComHandleId=227, ComInitialValueOnly=0, ComSignalInitValue=0.0, ComBitPosition=24, ComSystemTemplateSystemSignalRef=BRM_SPN2566_Bat_Type
        Old_BRM_SPN2567_Cap_Nom: ComSignalEndianness=LITTLE_ENDIAN, ComSignalType=UINT16, ComBitSize=16, ComHandleId=225, ComInitialValueOnly=0, ComSignalInitValue=0.0, ComBitPosition=32, ComSystemTemplateSystemSignalRef=BRM_SPN2567_Cap_Nom
        Old_BRM_SPN2568_U_Nom: ComSignalEndianness=LITTLE_ENDIAN, ComSignalType=UINT16, ComBitSize=16, ComHandleId=243, ComInitialValueOnly=0, ComSignalInitValue=0.0, ComBitPosition=48, ComSystemTemplateSystemSignalRef=BRM_SPN2568_U_Nom
        Old_BRM_SPN2569_BatFactory: ComSignalEndianness=LITTLE_ENDIAN, ComSignalType=UINT32, ComBitSize=32, ComHandleId=226, ComInitialValueOnly=0, ComSignalInitValue=0.0, ComBitPosition=64, ComSystemTemplateSystemSignalRef=BRM_SPN2569_BatFactory
        Old_BRM_SPN2570_PackSN: ComSignalEndianness=LITTLE_ENDIAN, ComSignalType=UINT32, ComBitSize=32, ComHandleId=239, ComInitialValueOnly=0, ComSignalInitValue=0.0, ComBitPosition=96, ComSystemTemplateSystemSignalRef=BRM_SPN2570_PackSN
        Old_BRM_SPN2571_PackYear: ComSignalEndianness=LITTLE_ENDIAN, ComSignalType=UINT8, ComBitSize=8, ComHandleId=232, ComInitialValueOnly=0, ComSignalInitValue=0.0, ComBitPosition=128, ComSystemTemplateSystemSignalRef=BRM_SPN2571_PackYear
        Old_BRM_SPN2571_PackMonth: ComSignalEndianness=LITTLE_ENDIAN, ComSignalType=UINT8, ComBitSize=8, ComHandleId=224, ComInitialValueOnly=0, ComSignalInitValue=0.0, ComBitPosition=136, ComSystemTemplateSystemSignalRef=BRM_SPN2571_PackMonth
        Old_BRM_SPN2571_PackDay: ComSignalEndianness=LITTLE_ENDIAN, ComSignalType=UINT8, ComBitSize=8, ComHandleId=251, ComInitialValueOnly=0, ComSignalInitValue=0.0, ComBitPosition=144, ComSystemTemplateSystemSignalRef=BRM_SPN2571_PackDay
        Old_BRM_SPN2573_PackRight: ComSignalEndianness=LITTLE_ENDIAN, ComSignalType=UINT8, ComBitSize=8, ComHandleId=244, ComInitialValueOnly=0, ComSignalInitValue=0.0, ComBitPosition=176, ComSystemTemplateSystemSignalRef=BRM_SPN2573_PackRight
        Old_BRM_SPN2572_PackChgCnt: ComSignalEndianness=LITTLE_ENDIAN, ComSignalType=UINT32, ComBitSize=24, ComHandleId=229, ComInitialValueOnly=0, ComSignalInitValue=0.0, ComBitPosition=152, ComSystemTemplateSystemSignalRef=BRM_SPN2572_PackChgCnt
        Old_BRM_SPN2574_BMSSW_Reserved: ComSignalEndianness=LITTLE_ENDIAN, ComSignalType=UINT8, ComBitSize=8, ComHandleId=228, ComInitialValueOnly=0, ComSignalInitValue=0.0, ComBitPosition=184, ComSystemTemplateSystemSignalRef=BRM_SPN2574_BMSSW_Reserved
        Old_BRM_SPN2575_VIN1: ComSignalEndianness=LITTLE_ENDIAN, ComSignalType=UINT8, ComBitSize=8, ComHandleId=233, ComInitialValueOnly=0, ComSignalInitValue=0.0, ComBitPosition=192, ComSystemTemplateSystemSignalRef=BRM_SPN2575_VIN1
        Old_BRM_SPN2575_VIN2: ComSignalEndianness=LITTLE_ENDIAN, ComSignalType=UINT8, ComBitSize=8, ComHandleId=230, ComInitialValueOnly=0, ComSignalInitValue=0.0, ComBitPosition=200, ComSystemTemplateSystemSignalRef=BRM_SPN2575_VIN2
        Old_BRM_SPN2575_VIN3: ComSignalEndianness=LITTLE_ENDIAN, ComSignalType=UINT8, ComBitSize=8, ComHandleId=231, ComInitialValueOnly=0, ComSignalInitValue=0.0, ComBitPosition=208, ComSystemTemplateSystemSignalRef=BRM_SPN2575_VIN3
        Old_BRM_SPN2575_VIN4: ComSignalEndianness=LITTLE_ENDIAN, ComSignalType=UINT8, ComBitSize=8, ComHandleId=249, ComInitialValueOnly=0, ComSignalInitValue=0.0, ComBitPosition=216, ComSystemTemplateSystemSignalRef=BRM_SPN2575_VIN4
        Old_BRM_SPN2575_VIN5: ComSignalEndianness=LITTLE_ENDIAN, ComSignalType=UINT8, ComBitSize=8, ComHandleId=250, ComInitialValueOnly=0, ComSignalInitValue=0.0, ComBitPosition=224, ComSystemTemplateSystemSignalRef=BRM_SPN2575_VIN5
        Old_BRM_SPN2575_VIN6: ComSignalEndianness=LITTLE_ENDIAN, ComSignalType=UINT8, ComBitSize=8, ComHandleId=247, ComInitialValueOnly=0, ComSignalInitValue=0.0, ComBitPosition=232, ComSystemTemplateSystemSignalRef=BRM_SPN2575_VIN6
        Old_BRM_SPN2575_VIN7: ComSignalEndianness=LITTLE_ENDIAN, ComSignalType=UINT8, ComBitSize=8, ComHandleId=248, ComInitialValueOnly=0, ComSignalInitValue=0.0, ComBitPosition=240, ComSystemTemplateSystemSignalRef=BRM_SPN2575_VIN7
        Old_BRM_SPN2575_VIN8: ComSignalEndianness=LITTLE_ENDIAN, ComSignalType=UINT8, ComBitSize=8, ComHandleId=245, ComInitialValueOnly=0, ComSignalInitValue=0.0, ComBitPosition=248, ComSystemTemplateSystemSignalRef=BRM_SPN2575_VIN8
        Old_BRM_SPN2575_VIN9: ComSignalEndianness=LITTLE_ENDIAN, ComSignalType=UINT8, ComBitSize=8, ComHandleId=246, ComInitialValueOnly=0, ComSignalInitValue=0.0, ComBitPosition=256, ComSystemTemplateSystemSignalRef=BRM_SPN2575_VIN9
        Old_BRM_SPN2575_VIN10: ComSignalEndianness=LITTLE_ENDIAN, ComSignalType=UINT8, ComBitSize=8, ComHandleId=242, ComInitialValueOnly=0, ComSignalInitValue=0.0, ComBitPosition=264, ComSystemTemplateSystemSignalRef=BRM_SPN2575_VIN10
        Old_BRM_SPN2575_VIN11: ComSignalEndianness=LITTLE_ENDIAN, ComSignalType=UINT8, ComBitSize=8, ComHandleId=240, ComInitialValueOnly=0, ComSignalInitValue=0.0, ComBitPosition=272, ComSystemTemplateSystemSignalRef=BRM_SPN2575_VIN11
        Old_BRM_SPN2575_VIN12: ComSignalEndianness=LITTLE_ENDIAN, ComSignalType=UINT8, ComBitSize=8, ComHandleId=241, ComInitialValueOnly=0, ComSignalInitValue=0.0, ComBitPosition=280, ComSystemTemplateSystemSignalRef=BRM_SPN2575_VIN12
        Old_BRM_SPN2575_VIN13: ComSignalEndianness=LITTLE_ENDIAN, ComSignalType=UINT8, ComBitSize=8, ComHandleId=237, ComInitialValueOnly=0, ComSignalInitValue=0.0, ComBitPosition=288, ComSystemTemplateSystemSignalRef=BRM_SPN2575_VIN13
        Old_BRM_SPN2575_VIN14: ComSignalEndianness=LITTLE_ENDIAN, ComSignalType=UINT8, ComBitSize=8, ComHandleId=238, ComInitialValueOnly=0, ComSignalInitValue=0.0, ComBitPosition=296, ComSystemTemplateSystemSignalRef=BRM_SPN2575_VIN14
        Old_BRM_SPN2575_VIN15: ComSignalEndianness=LITTLE_ENDIAN, ComSignalType=UINT8, ComBitSize=8, ComHandleId=235, ComInitialValueOnly=0, ComSignalInitValue=0.0, ComBitPosition=304, ComSystemTemplateSystemSignalRef=BRM_SPN2575_VIN15
        Old_BRM_SPN2575_VIN16: ComSignalEndianness=LITTLE_ENDIAN, ComSignalType=UINT8, ComBitSize=8, ComHandleId=236, ComInitialValueOnly=0, ComSignalInitValue=0.0, ComBitPosition=312, ComSystemTemplateSystemSignalRef=BRM_SPN2575_VIN16
        Old_BRM_SPN2575_VIN17: ComSignalEndianness=LITTLE_ENDIAN, ComSignalType=UINT8, ComBitSize=8, ComHandleId=234, ComInitialValueOnly=0, ComSignalInitValue=0.0, ComBitPosition=320, ComSystemTemplateSystemSignalRef=BRM_SPN2575_VIN17
      ComTimeBase: ComTxTimeBase=0.01, ComRxTimeBase=0.01, ComGwTimeBase=0.005
    ComGeneral:
      ComCancellationSupport = false
      ComSupportedIPduGroups = 2
      ComTxDoubleBuffer = false
      ComEnableJitterFilter = false
      ComCommonIPduTxPeriodFeature = false
      ComVersionInfoApi = false
      ComEnableSignalGroupArrayApi = false
      ComConfigurationUseDet = false
