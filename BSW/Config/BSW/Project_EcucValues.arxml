AUTOSAR XML (schema 4-2-2)
package /ETAS_Project/EcucModuleConfigurationValuess
  module config ComM: implementation-config-variant=VARIANT-PRE-COMPILE
    ComMGeneral:
      ComMEcuGroupClassification = 0
      ComMModeLimitationEnabled = false
      ComMTMinFullComModeDuration = 0.01
      ComMVersionInfoApi = false
      ComMWakeupInhibitionEnabled = false
      ComMPncGatewayEnabled = false
      ComMPncSupport = false
      ComMResetAfterForcingNoComm = false
      ComMSynchronousWakeUp = false
      ComMRteEnabled = false
      ComMDevErrorDetect = false
    ComMConfigSet
      ComMUser_Can_Network_0_Channel (ComMUser): ComMUserIdentifier=0
      ComMChannel_Can_Network_0_Channel (ComMChannel):
        ComMMainFunctionPeriod = 0.01
        ComMFullCommRequestNotificationEnabled = false
        ComMNoCom = true
        ComMNoWakeUpInhibitionNvmStorage = false
        ComMNoWakeup = true
        ComMChannelId = 0
        ComMBusType = COMM_BUS_TYPE_CAN
        ComMNetworkManagement: ComMNmLightTimeout=10, ComMNmVariant=NONE, ComMPncNmRequest=false
        ComMUserPerChannel_Can_Network_0_Channel (ComMUserPerChannel): ComMUserChannel=ComMUser_Can_Network_0_Channel
      ComMUser_J1939_Network_Channel (ComMUser): ComMUserIdentifier=1
      ComMChannel_J1939_Network_Channel (ComMChannel):
        ComMMainFunctionPeriod = 0.01
        ComMFullCommRequestNotificationEnabled = false
        ComMNoCom = true
        ComMNoWakeUpInhibitionNvmStorage = false
        ComMNoWakeup = true
        ComMChannelId = 1
        ComMBusType = COMM_BUS_TYPE_CAN
        ComMNetworkManagement: ComMNmLightTimeout=10, ComMNmVariant=NONE, ComMPncNmRequest=false
        ComMUserPerChannel_J1939_Network_Channel (ComMUserPerChannel): ComMUserChannel=ComMUser_J1939_Network_Channel
  module config CanIf: implementation-config-variant=VARIANT-PRE-COMPILE
    CanIfInitCfg: CanIfInitCfgSet=0
      CanIfInitHohCfg
        15 x CanIfHrhCfg, all with CanIfHrhSoftwareFilter=false, CanIfHrhCanCtrlIdRef=Can_Network_CANNODE_0:
          Can_Network_CANNODE_0_Rx_Std_MailBox_{1..15}: CanIfHrhIdSymRef=Can_Network_CANNODE_0_Rx_Std_MailBox_{1..15}
        18 x CanIfHthCfg, all with CanIfHthCanCtrlIdRef=Can_Network_CANNODE_0:
          Can_Network_CANNODE_0_Tx_Std_MailBox_{1..18}: CanIfHthIdSymRef=Can_Network_CANNODE_0_Tx_Std_MailBox_{1..18}
        9 x CanIfHrhCfg, all with CanIfHrhSoftwareFilter=false, CanIfHrhCanCtrlIdRef=J1939_Network_CANNODE_0:
          J1939_Network_CANNODE_0_Rx_Ext_MailBox_{1..9}: CanIfHrhIdSymRef=J1939_Network_CANNODE_0_Rx_Ext_MailBox_{1..9}
        7 x CanIfHthCfg, all with CanIfHthCanCtrlIdRef=J1939_Network_CANNODE_0:
          J1939_Network_CANNODE_0_Tx_Ext_MailBox_{1..7}: CanIfHthIdSymRef=J1939_Network_CANNODE_0_Tx_Ext_MailBox_{1..7}
        J1939_Network_CANNODE_0_Rx_Ext_MailBox_10 (CanIfHrhCfg): CanIfHrhSoftwareFilter=0, CanIfHrhIdSymRef=J1939_Network_CANNODE_0_Rx_Ext_MailBox_10, CanIfHrhCanCtrlIdRef=J1939_Network_CANNODE_0
        J1939_Network_CANNODE_0_Tx_Ext_MailBox_8 (CanIfHthCfg): CanIfHthIdSymRef=J1939_Network_CANNODE_0_Tx_Ext_MailBox_8, CanIfHthCanCtrlIdRef=J1939_Network_CANNODE_0
        J1939_Network_CANNODE_0_Tx_Ext_MailBox_9 (CanIfHthCfg): CanIfHthIdSymRef=J1939_Network_CANNODE_0_Tx_Ext_MailBox_9, CanIfHthCanCtrlIdRef=J1939_Network_CANNODE_0
      15 x CanIfRxPduCfg, all with CanIfRxPduReadData=false, CanIfRxPduReadNotifyStatus=true, CanIfRxPduControllerRef=Can_Network_CANNODE_0:
        PEU_0B4h_Can_Network_CANNODE_0: CanIfRxPduCanId=180, CanIfRxPduCanIdType=STANDARD_CAN, CanIfRxPduDlc=8, CanIfRxPduId=0, CanIfRxPduUserRxIndicationName=PduR_CanIfRxIndication, CanIfRxPduUserRxIndicationUL=PDUR, CanIfRxPduHrhIdRef=Can_Network_CANNODE_0_Rx_Std_MailBox_1, CanIfRxPduRef=PduCollection/PEU_0B4h_Can_Network_CANNODE_0_CanIf2PduR
        VCU_1E3h_Can_Network_CANNODE_0: CanIfRxPduCanId=483, CanIfRxPduCanIdType=STANDARD_CAN, CanIfRxPduDlc=8, CanIfRxPduId=1, CanIfRxPduUserRxIndicationName=PduR_CanIfRxIndication, CanIfRxPduUserRxIndicationUL=PDUR, CanIfRxPduHrhIdRef=Can_Network_CANNODE_0_Rx_Std_MailBox_2, CanIfRxPduRef=PduCollection/VCU_1E3h_Can_Network_CANNODE_0_CanIf2PduR
        PEU_18Bh_Can_Network_CANNODE_0: CanIfRxPduCanId=395, CanIfRxPduCanIdType=STANDARD_CAN, CanIfRxPduDlc=8, CanIfRxPduId=2, CanIfRxPduUserRxIndicationName=PduR_CanIfRxIndication, CanIfRxPduUserRxIndicationUL=PDUR, CanIfRxPduHrhIdRef=Can_Network_CANNODE_0_Rx_Std_MailBox_3, CanIfRxPduRef=PduCollection/PEU_18Bh_Can_Network_CANNODE_0_CanIf2PduR
        VCU_ABS_23Ch_Can_Network_CANNODE_0: CanIfRxPduCanId=572, CanIfRxPduCanIdType=STANDARD_CAN, CanIfRxPduDlc=8, CanIfRxPduId=3, CanIfRxPduUserRxIndicationName=PduR_CanIfRxIndication, CanIfRxPduUserRxIndicationUL=PDUR, CanIfRxPduHrhIdRef=Can_Network_CANNODE_0_Rx_Std_MailBox_4, CanIfRxPduRef=PduCollection/VCU_ABS_23Ch_Can_Network_CANNODE_0_CanIf2PduR
        DCDC_303h_Can_Network_CANNODE_0: CanIfRxPduCanId=771, CanIfRxPduCanIdType=STANDARD_CAN, CanIfRxPduDlc=8, CanIfRxPduId=4, CanIfRxPduUserRxIndicationName=PduR_CanIfRxIndication, CanIfRxPduUserRxIndicationUL=PDUR, CanIfRxPduHrhIdRef=Can_Network_CANNODE_0_Rx_Std_MailBox_5, CanIfRxPduRef=PduCollection/DCDC_303h_Can_Network_CANNODE_0_CanIf2PduR
        VCU_BCM_1F1h_Can_Network_CANNODE_0: CanIfRxPduCanId=497, CanIfRxPduCanIdType=STANDARD_CAN, CanIfRxPduDlc=8, CanIfRxPduId=5, CanIfRxPduUserRxIndicationName=PduR_CanIfRxIndication, CanIfRxPduUserRxIndicationUL=PDUR, CanIfRxPduHrhIdRef=Can_Network_CANNODE_0_Rx_Std_MailBox_6, CanIfRxPduRef=PduCollection/VCU_BCM_1F1h_Can_Network_CANNODE_0_CanIf2PduR
        Tester_748h_Can_Network_CANNODE_0: CanIfRxPduCanId=1864, CanIfRxPduCanIdType=STANDARD_CAN, CanIfRxPduDlc=8, CanIfRxPduId=6, CanIfRxPduUserRxIndicationName=PduR_CanIfRxIndication, CanIfRxPduUserRxIndicationUL=PDUR, CanIfRxPduHrhIdRef=Can_Network_CANNODE_0_Rx_Std_MailBox_7, CanIfRxPduRef=PduCollection/Tester_748h_Can_Network_CANNODE_0_CanIf2PduR
        VCU_IPK_1F2h_Can_Network_CANNODE_0: CanIfRxPduCanId=498, CanIfRxPduCanIdType=STANDARD_CAN, CanIfRxPduDlc=2, CanIfRxPduId=7, CanIfRxPduUserRxIndicationName=PduR_CanIfRxIndication, CanIfRxPduUserRxIndicationUL=PDUR, CanIfRxPduHrhIdRef=Can_Network_CANNODE_0_Rx_Std_MailBox_8, CanIfRxPduRef=PduCollection/VCU_IPK_1F2h_Can_Network_CANNODE_0_CanIf2PduR
        VCU_SRS_163h_Can_Network_CANNODE_0: CanIfRxPduCanId=355, CanIfRxPduCanIdType=STANDARD_CAN, CanIfRxPduDlc=8, CanIfRxPduId=8, CanIfRxPduUserRxIndicationName=PduR_CanIfRxIndication, CanIfRxPduUserRxIndicationUL=PDUR, CanIfRxPduHrhIdRef=Can_Network_CANNODE_0_Rx_Std_MailBox_9, CanIfRxPduRef=PduCollection/VCU_SRS_163h_Can_Network_CANNODE_0_CanIf2PduR
        VCU_353h_Can_Network_CANNODE_0: CanIfRxPduCanId=851, CanIfRxPduCanIdType=STANDARD_CAN, CanIfRxPduDlc=8, CanIfRxPduId=9, CanIfRxPduUserRxIndicationName=PduR_CanIfRxIndication, CanIfRxPduUserRxIndicationUL=PDUR, CanIfRxPduHrhIdRef=Can_Network_CANNODE_0_Rx_Std_MailBox_10, CanIfRxPduRef=PduCollection/VCU_353h_Can_Network_CANNODE_0_CanIf2PduR
        Tester_7DFh_Can_Network_CANNODE_0: CanIfRxPduCanId=2015, CanIfRxPduCanIdType=STANDARD_CAN, CanIfRxPduDlc=8, CanIfRxPduId=10, CanIfRxPduUserRxIndicationName=PduR_CanIfRxIndication, CanIfRxPduUserRxIndicationUL=PDUR, CanIfRxPduHrhIdRef=Can_Network_CANNODE_0_Rx_Std_MailBox_11, CanIfRxPduRef=PduCollection/Tester_7DFh_Can_Network_CANNODE_0_CanIf2PduR
        VCU_HCM_55Fh_Can_Network_CANNODE_0: CanIfRxPduCanId=1375, CanIfRxPduCanIdType=STANDARD_CAN, CanIfRxPduDlc=8, CanIfRxPduId=11, CanIfRxPduUserRxIndicationName=PduR_CanIfRxIndication, CanIfRxPduUserRxIndicationUL=PDUR, CanIfRxPduHrhIdRef=Can_Network_CANNODE_0_Rx_Std_MailBox_12, CanIfRxPduRef=PduCollection/VCU_HCM_55Fh_Can_Network_CANNODE_0_CanIf2PduR
        OBC_604h_Can_Network_CANNODE_0: CanIfRxPduCanId=1540, CanIfRxPduCanIdType=STANDARD_CAN, CanIfRxPduDlc=8, CanIfRxPduId=12, CanIfRxPduUserRxIndicationName=PduR_CanIfRxIndication, CanIfRxPduUserRxIndicationUL=PDUR, CanIfRxPduHrhIdRef=Can_Network_CANNODE_0_Rx_Std_MailBox_13, CanIfRxPduRef=PduCollection/OBC_604h_Can_Network_CANNODE_0_CanIf2PduR
        VCU_IPK_362h_Can_Network_CANNODE_0: CanIfRxPduCanId=866, CanIfRxPduCanIdType=STANDARD_CAN, CanIfRxPduDlc=8, CanIfRxPduId=13, CanIfRxPduUserRxIndicationName=PduR_CanIfRxIndication, CanIfRxPduUserRxIndicationUL=PDUR, CanIfRxPduHrhIdRef=Can_Network_CANNODE_0_Rx_Std_MailBox_14, CanIfRxPduRef=PduCollection/VCU_IPK_362h_Can_Network_CANNODE_0_CanIf2PduR
        XCP_CMD_Can_Network_CANNODE_0: CanIfRxPduCanId=1728, CanIfRxPduCanIdType=STANDARD_NO_FD_CAN, CanIfRxPduDlc=1, CanIfRxPduId=14, CanIfRxPduUserRxIndicationUL=XCP, CanIfRxPduHrhIdRef=Can_Network_CANNODE_0_Rx_Std_MailBox_15, CanIfRxPduRef=XCP_CMD_Can_Network_CANNODE_0_CanIf2Xcp
      Buffer_BMS_329h_Can_Network_CANNODE_0 (CanIfBufferCfg): CanIfBufferSize=1, CanIfBufferHthRef=Can_Network_CANNODE_0_Tx_Std_MailBox_1
      BMS_329h_Can_Network_CANNODE_0 (CanIfTxPduCfg):
        CanIfTxPduReadNotifyStatus = false
        CanIfTxPduType = STATIC
        CanIfTxPduCanIdType = STANDARD_CAN
        CanIfTxPduCanId = 809
        CanIfTxPduDlc = 8
        CanIfTxPduUserTxConfirmationUL = PDUR
        CanIfTxPduControllerRef = Can_Network_CANNODE_0
        CanIfTxPduBufferRef = Buffer_BMS_329h_Can_Network_CANNODE_0
        CanIfTxPduRef = PduCollection/BMS_329h_Can_Network_CANNODE_0_PduR2CanIf
      Buffer_BMS_503h_Can_Network_CANNODE_0 (CanIfBufferCfg): CanIfBufferSize=1, CanIfBufferHthRef=Can_Network_CANNODE_0_Tx_Std_MailBox_2
      BMS_503h_Can_Network_CANNODE_0 (CanIfTxPduCfg):
        CanIfTxPduReadNotifyStatus = false
        CanIfTxPduType = STATIC
        CanIfTxPduCanIdType = STANDARD_CAN
        CanIfTxPduCanId = 1283
        CanIfTxPduDlc = 8
        CanIfTxPduId = 1
        CanIfTxPduUserTxConfirmationUL = PDUR
        CanIfTxPduControllerRef = Can_Network_CANNODE_0
        CanIfTxPduBufferRef = Buffer_BMS_503h_Can_Network_CANNODE_0
        CanIfTxPduRef = PduCollection/BMS_503h_Can_Network_CANNODE_0_PduR2CanIf
      Buffer_BMS_501h_Can_Network_CANNODE_0 (CanIfBufferCfg): CanIfBufferSize=1, CanIfBufferHthRef=Can_Network_CANNODE_0_Tx_Std_MailBox_3
      BMS_501h_Can_Network_CANNODE_0 (CanIfTxPduCfg):
        CanIfTxPduReadNotifyStatus = false
        CanIfTxPduType = STATIC
        CanIfTxPduCanIdType = STANDARD_CAN
        CanIfTxPduCanId = 1281
        CanIfTxPduDlc = 8
        CanIfTxPduId = 2
        CanIfTxPduUserTxConfirmationUL = PDUR
        CanIfTxPduControllerRef = Can_Network_CANNODE_0
        CanIfTxPduBufferRef = Buffer_BMS_501h_Can_Network_CANNODE_0
        CanIfTxPduRef = PduCollection/BMS_501h_Can_Network_CANNODE_0_PduR2CanIf
      Buffer_BMS_1D8h_Can_Network_CANNODE_0 (CanIfBufferCfg): CanIfBufferSize=1, CanIfBufferHthRef=Can_Network_CANNODE_0_Tx_Std_MailBox_4
      BMS_1D8h_Can_Network_CANNODE_0 (CanIfTxPduCfg):
        CanIfTxPduReadNotifyStatus = false
        CanIfTxPduType = STATIC
        CanIfTxPduCanIdType = STANDARD_CAN
        CanIfTxPduCanId = 472
        CanIfTxPduDlc = 8
        CanIfTxPduId = 3
        CanIfTxPduUserTxConfirmationUL = PDUR
        CanIfTxPduControllerRef = Can_Network_CANNODE_0
        CanIfTxPduBufferRef = Buffer_BMS_1D8h_Can_Network_CANNODE_0
        CanIfTxPduRef = PduCollection/BMS_1D8h_Can_Network_CANNODE_0_PduR2CanIf
      Buffer_BMS_795h_Can_Network_CANNODE_0 (CanIfBufferCfg): CanIfBufferSize=1, CanIfBufferHthRef=Can_Network_CANNODE_0_Tx_Std_MailBox_5
      BMS_795h_Can_Network_CANNODE_0 (CanIfTxPduCfg):
        CanIfTxPduReadNotifyStatus = false
        CanIfTxPduType = STATIC
        CanIfTxPduCanIdType = STANDARD_CAN
        CanIfTxPduCanId = 1941
        CanIfTxPduDlc = 8
        CanIfTxPduId = 4
        CanIfTxPduUserTxConfirmationUL = PDUR
        CanIfTxPduControllerRef = Can_Network_CANNODE_0
        CanIfTxPduBufferRef = Buffer_BMS_795h_Can_Network_CANNODE_0
        CanIfTxPduRef = PduCollection/BMS_795h_Can_Network_CANNODE_0_PduR2CanIf
      Buffer_XCP_RES_DAQ_Can_Network_CANNODE_0 (CanIfBufferCfg): CanIfBufferSize=1, CanIfBufferHthRef=Can_Network_CANNODE_0_Tx_Std_MailBox_6
      XCP_RES_DAQ_Can_Network_CANNODE_0 (CanIfTxPduCfg):
        CanIfTxPduReadNotifyStatus = false
        CanIfTxPduType = STATIC
        CanIfTxPduCanIdType = STANDARD_CAN
        CanIfTxPduCanId = 1743
        CanIfTxPduDlc = 8
        CanIfTxPduId = 5
        CanIfTxPduUserTxConfirmationUL = XCP
        CanIfTxPduControllerRef = Can_Network_CANNODE_0
        CanIfTxPduBufferRef = Buffer_XCP_RES_DAQ_Can_Network_CANNODE_0
        CanIfTxPduRef = XCP_RES_DAQ_Can_Network_CANNODE_0_Xcp2CanIf
      Buffer_BMS_3D7h_Can_Network_CANNODE_0 (CanIfBufferCfg): CanIfBufferSize=1, CanIfBufferHthRef=Can_Network_CANNODE_0_Tx_Std_MailBox_7
      BMS_3D7h_Can_Network_CANNODE_0 (CanIfTxPduCfg):
        CanIfTxPduReadNotifyStatus = false
        CanIfTxPduType = STATIC
        CanIfTxPduCanIdType = STANDARD_CAN
        CanIfTxPduCanId = 983
        CanIfTxPduDlc = 8
        CanIfTxPduId = 6
        CanIfTxPduUserTxConfirmationUL = PDUR
        CanIfTxPduControllerRef = Can_Network_CANNODE_0
        CanIfTxPduBufferRef = Buffer_BMS_3D7h_Can_Network_CANNODE_0
        CanIfTxPduRef = PduCollection/BMS_3D7h_Can_Network_CANNODE_0_PduR2CanIf
      Buffer_BMS_606h_Can_Network_CANNODE_0 (CanIfBufferCfg): CanIfBufferSize=1, CanIfBufferHthRef=Can_Network_CANNODE_0_Tx_Std_MailBox_8
      BMS_606h_Can_Network_CANNODE_0 (CanIfTxPduCfg):
        CanIfTxPduReadNotifyStatus = false
        CanIfTxPduType = STATIC
        CanIfTxPduCanIdType = STANDARD_CAN
        CanIfTxPduCanId = 1542
        CanIfTxPduDlc = 8
        CanIfTxPduId = 7
        CanIfTxPduUserTxConfirmationUL = PDUR
        CanIfTxPduControllerRef = Can_Network_CANNODE_0
        CanIfTxPduBufferRef = Buffer_BMS_606h_Can_Network_CANNODE_0
        CanIfTxPduRef = PduCollection/BMS_606h_Can_Network_CANNODE_0_PduR2CanIf
      Buffer_BMS_598h_Can_Network_CANNODE_0 (CanIfBufferCfg): CanIfBufferSize=1, CanIfBufferHthRef=Can_Network_CANNODE_0_Tx_Std_MailBox_9
      BMS_598h_Can_Network_CANNODE_0 (CanIfTxPduCfg):
        CanIfTxPduReadNotifyStatus = false
        CanIfTxPduType = STATIC
        CanIfTxPduCanIdType = STANDARD_CAN
        CanIfTxPduCanId = 1432
        CanIfTxPduDlc = 8
        CanIfTxPduId = 8
        CanIfTxPduUserTxConfirmationUL = PDUR
        CanIfTxPduControllerRef = Can_Network_CANNODE_0
        CanIfTxPduBufferRef = Buffer_BMS_598h_Can_Network_CANNODE_0
        CanIfTxPduRef = PduCollection/BMS_598h_Can_Network_CANNODE_0_PduR2CanIf
      Buffer_BMS_509h_Can_Network_CANNODE_0 (CanIfBufferCfg): CanIfBufferSize=1, CanIfBufferHthRef=Can_Network_CANNODE_0_Tx_Std_MailBox_10
      BMS_509h_Can_Network_CANNODE_0 (CanIfTxPduCfg):
        CanIfTxPduReadNotifyStatus = false
        CanIfTxPduType = STATIC
        CanIfTxPduCanIdType = STANDARD_CAN
        CanIfTxPduCanId = 1289
        CanIfTxPduDlc = 8
        CanIfTxPduId = 9
        CanIfTxPduUserTxConfirmationUL = PDUR
        CanIfTxPduControllerRef = Can_Network_CANNODE_0
        CanIfTxPduBufferRef = Buffer_BMS_509h_Can_Network_CANNODE_0
        CanIfTxPduRef = PduCollection/BMS_509h_Can_Network_CANNODE_0_PduR2CanIf
      Buffer_BMS_605h_Can_Network_CANNODE_0 (CanIfBufferCfg): CanIfBufferSize=1, CanIfBufferHthRef=Can_Network_CANNODE_0_Tx_Std_MailBox_11
      BMS_605h_Can_Network_CANNODE_0 (CanIfTxPduCfg):
        CanIfTxPduReadNotifyStatus = false
        CanIfTxPduType = STATIC
        CanIfTxPduCanIdType = STANDARD_CAN
        CanIfTxPduCanId = 1541
        CanIfTxPduDlc = 8
        CanIfTxPduId = 10
        CanIfTxPduUserTxConfirmationUL = PDUR
        CanIfTxPduControllerRef = Can_Network_CANNODE_0
        CanIfTxPduBufferRef = Buffer_BMS_605h_Can_Network_CANNODE_0
        CanIfTxPduRef = PduCollection/BMS_605h_Can_Network_CANNODE_0_PduR2CanIf
      Buffer_BMS_7C8h_Can_Network_CANNODE_0 (CanIfBufferCfg): CanIfBufferSize=1, CanIfBufferHthRef=Can_Network_CANNODE_0_Tx_Std_MailBox_12
      BMS_7C8h_Can_Network_CANNODE_0 (CanIfTxPduCfg):
        CanIfTxPduReadNotifyStatus = false
        CanIfTxPduType = STATIC
        CanIfTxPduCanIdType = STANDARD_CAN
        CanIfTxPduCanId = 1992
        CanIfTxPduDlc = 8
        CanIfTxPduId = 11
        CanIfTxPduUserTxConfirmationUL = PDUR
        CanIfTxPduControllerRef = Can_Network_CANNODE_0
        CanIfTxPduBufferRef = Buffer_BMS_7C8h_Can_Network_CANNODE_0
        CanIfTxPduRef = PduCollection/BMS_7C8h_Can_Network_CANNODE_0_PduR2CanIf
      Buffer_BMS_596h_Can_Network_CANNODE_0 (CanIfBufferCfg): CanIfBufferSize=1, CanIfBufferHthRef=Can_Network_CANNODE_0_Tx_Std_MailBox_13
      BMS_596h_Can_Network_CANNODE_0 (CanIfTxPduCfg):
        CanIfTxPduReadNotifyStatus = false
        CanIfTxPduType = STATIC
        CanIfTxPduCanIdType = STANDARD_CAN
        CanIfTxPduCanId = 1430
        CanIfTxPduDlc = 8
        CanIfTxPduId = 12
        CanIfTxPduUserTxConfirmationUL = PDUR
        CanIfTxPduControllerRef = Can_Network_CANNODE_0
        CanIfTxPduBufferRef = Buffer_BMS_596h_Can_Network_CANNODE_0
        CanIfTxPduRef = PduCollection/BMS_596h_Can_Network_CANNODE_0_PduR2CanIf
      Buffer_BMS_3DAh_Can_Network_CANNODE_0 (CanIfBufferCfg): CanIfBufferSize=1, CanIfBufferHthRef=Can_Network_CANNODE_0_Tx_Std_MailBox_14
      BMS_3DAh_Can_Network_CANNODE_0 (CanIfTxPduCfg):
        CanIfTxPduReadNotifyStatus = false
        CanIfTxPduType = STATIC
        CanIfTxPduCanIdType = STANDARD_CAN
        CanIfTxPduCanId = 986
        CanIfTxPduDlc = 8
        CanIfTxPduId = 13
        CanIfTxPduUserTxConfirmationUL = PDUR
        CanIfTxPduControllerRef = Can_Network_CANNODE_0
        CanIfTxPduBufferRef = Buffer_BMS_3DAh_Can_Network_CANNODE_0
        CanIfTxPduRef = PduCollection/BMS_3DAh_Can_Network_CANNODE_0_PduR2CanIf
      Buffer_BMS_32Ah_Can_Network_CANNODE_0 (CanIfBufferCfg): CanIfBufferSize=1, CanIfBufferHthRef=Can_Network_CANNODE_0_Tx_Std_MailBox_15
      BMS_32Ah_Can_Network_CANNODE_0 (CanIfTxPduCfg):
        CanIfTxPduReadNotifyStatus = false
        CanIfTxPduType = STATIC
        CanIfTxPduCanIdType = STANDARD_CAN
        CanIfTxPduCanId = 810
        CanIfTxPduDlc = 8
        CanIfTxPduId = 14
        CanIfTxPduUserTxConfirmationUL = PDUR
        CanIfTxPduControllerRef = Can_Network_CANNODE_0
        CanIfTxPduBufferRef = Buffer_BMS_32Ah_Can_Network_CANNODE_0
        CanIfTxPduRef = PduCollection/BMS_32Ah_Can_Network_CANNODE_0_PduR2CanIf
      Buffer_BMS_3DBh_Can_Network_CANNODE_0 (CanIfBufferCfg): CanIfBufferSize=1, CanIfBufferHthRef=Can_Network_CANNODE_0_Tx_Std_MailBox_16
      BMS_3DBh_Can_Network_CANNODE_0 (CanIfTxPduCfg):
        CanIfTxPduReadNotifyStatus = false
        CanIfTxPduType = STATIC
        CanIfTxPduCanIdType = STANDARD_CAN
        CanIfTxPduCanId = 987
        CanIfTxPduDlc = 8
        CanIfTxPduId = 15
        CanIfTxPduUserTxConfirmationUL = PDUR
        CanIfTxPduControllerRef = Can_Network_CANNODE_0
        CanIfTxPduBufferRef = Buffer_BMS_3DBh_Can_Network_CANNODE_0
        CanIfTxPduRef = PduCollection/BMS_3DBh_Can_Network_CANNODE_0_PduR2CanIf
      Buffer_BMS_603h_Can_Network_CANNODE_0 (CanIfBufferCfg): CanIfBufferSize=1, CanIfBufferHthRef=Can_Network_CANNODE_0_Tx_Std_MailBox_17
      BMS_603h_Can_Network_CANNODE_0 (CanIfTxPduCfg):
        CanIfTxPduReadNotifyStatus = false
        CanIfTxPduType = STATIC
        CanIfTxPduCanIdType = STANDARD_CAN
        CanIfTxPduCanId = 1539
        CanIfTxPduDlc = 8
        CanIfTxPduId = 16
        CanIfTxPduUserTxConfirmationUL = PDUR
        CanIfTxPduControllerRef = Can_Network_CANNODE_0
        CanIfTxPduBufferRef = Buffer_BMS_603h_Can_Network_CANNODE_0
        CanIfTxPduRef = PduCollection/BMS_603h_Can_Network_CANNODE_0_PduR2CanIf
      Buffer_BMS_594h_Can_Network_CANNODE_0 (CanIfBufferCfg): CanIfBufferSize=1, CanIfBufferHthRef=Can_Network_CANNODE_0_Tx_Std_MailBox_18
      BMS_594h_Can_Network_CANNODE_0 (CanIfTxPduCfg):
        CanIfTxPduReadNotifyStatus = false
        CanIfTxPduType = STATIC
        CanIfTxPduCanIdType = STANDARD_CAN
        CanIfTxPduCanId = 1428
        CanIfTxPduDlc = 8
        CanIfTxPduId = 17
        CanIfTxPduUserTxConfirmationUL = PDUR
        CanIfTxPduControllerRef = Can_Network_CANNODE_0
        CanIfTxPduBufferRef = Buffer_BMS_594h_Can_Network_CANNODE_0
        CanIfTxPduRef = PduCollection/BMS_594h_Can_Network_CANNODE_0_PduR2CanIf
      9 x CanIfRxPduCfg, all with CanIfRxPduReadData=false, CanIfRxPduReadNotifyStatus=true, CanIfRxPduCanIdType=EXTENDED_CAN, CanIfRxPduUserRxIndicationName=PduR_CanIfRxIndication, CanIfRxPduUserRxIndicationUL=PDUR, CanIfRxPduControllerRef=J1939_Network_CANNODE_0:
        Frm_CTS_CHG_J1939_Network_CANNODE_0: CanIfRxPduCanId=403174486, CanIfRxPduDlc=7, CanIfRxPduId=15, CanIfRxPduHrhIdRef=J1939_Network_CANNODE_0_Rx_Ext_MailBox_1, CanIfRxPduRef=PduCollection/CTS_CHG_J1939_Network_CANNODE_0_CanIf2PduR
        Frm_CSD_CHG_J1939_Network_CANNODE_0: CanIfRxPduCanId=404616278, CanIfRxPduDlc=8, CanIfRxPduId=16, CanIfRxPduHrhIdRef=J1939_Network_CANNODE_0_Rx_Ext_MailBox_2, CanIfRxPduRef=PduCollection/CSD_CHG_J1939_Network_CANNODE_0_CanIf2PduR
        Frm_CST_CHG_J1939_Network_CANNODE_0: CanIfRxPduCanId=270201942, CanIfRxPduDlc=4, CanIfRxPduId=17, CanIfRxPduHrhIdRef=J1939_Network_CANNODE_0_Rx_Ext_MailBox_3, CanIfRxPduRef=PduCollection/CST_CHG_J1939_Network_CANNODE_0_CanIf2PduR
        Frm_CHM_CHG_J1939_Network_CANNODE_0: CanIfRxPduCanId=405206102, CanIfRxPduDlc=3, CanIfRxPduId=18, CanIfRxPduHrhIdRef=J1939_Network_CANNODE_0_Rx_Ext_MailBox_4, CanIfRxPduRef=PduCollection/CHM_CHG_J1939_Network_CANNODE_0_CanIf2PduR
        Frm_CRO_CHG_J1939_Network_CANNODE_0: CanIfRxPduCanId=269153366, CanIfRxPduDlc=1, CanIfRxPduId=19, CanIfRxPduHrhIdRef=J1939_Network_CANNODE_0_Rx_Ext_MailBox_5, CanIfRxPduRef=PduCollection/CRO_CHG_J1939_Network_CANNODE_0_CanIf2PduR
        Frm_CEM_CHG_J1939_Network_CANNODE_0: CanIfRxPduCanId=136311894, CanIfRxPduDlc=4, CanIfRxPduId=20, CanIfRxPduHrhIdRef=J1939_Network_CANNODE_0_Rx_Ext_MailBox_6, CanIfRxPduRef=PduCollection/CEM_CHG_J1939_Network_CANNODE_0_CanIf2PduR
        Frm_CML_CHG_J1939_Network_CANNODE_0: CanIfRxPduCanId=403240022, CanIfRxPduDlc=8, CanIfRxPduId=21, CanIfRxPduHrhIdRef=J1939_Network_CANNODE_0_Rx_Ext_MailBox_7, CanIfRxPduRef=PduCollection/CML_CHG_J1939_Network_CANNODE_0_CanIf2PduR
        Frm_CCS_CHG_J1939_Network_CANNODE_0: CanIfRxPduCanId=403895382, CanIfRxPduDlc=8, CanIfRxPduId=22, CanIfRxPduHrhIdRef=J1939_Network_CANNODE_0_Rx_Ext_MailBox_8, CanIfRxPduRef=PduCollection/CCS_CHG_J1939_Network_CANNODE_0_CanIf2PduR
        Frm_CRM_CHG_J1939_Network_CANNODE_0: CanIfRxPduCanId=402781270, CanIfRxPduDlc=8, CanIfRxPduId=23, CanIfRxPduHrhIdRef=J1939_Network_CANNODE_0_Rx_Ext_MailBox_9, CanIfRxPduRef=PduCollection/CRM_CHG_J1939_Network_CANNODE_0_CanIf2PduR
      Buffer_Frm_BHM_BCU_J1939_Network_CANNODE_0 (CanIfBufferCfg): CanIfBufferSize=1, CanIfBufferHthRef=J1939_Network_CANNODE_0_Tx_Ext_MailBox_1
      Frm_BHM_BCU_J1939_Network_CANNODE_0 (CanIfTxPduCfg):
        CanIfTxPduReadNotifyStatus = false
        CanIfTxPduType = STATIC
        CanIfTxPduCanIdType = EXTENDED_CAN
        CanIfTxPduCanId = 405231348
        CanIfTxPduDlc = 2
        CanIfTxPduId = 18
        CanIfTxPduUserTxConfirmationUL = PDUR
        CanIfTxPduControllerRef = J1939_Network_CANNODE_0
        CanIfTxPduBufferRef = Buffer_Frm_BHM_BCU_J1939_Network_CANNODE_0
        CanIfTxPduRef = PduCollection/BHM_BCU_J1939_Network_CANNODE_0_PduR2CanIf
      Buffer_Frm_BSM_BCU_J1939_Network_CANNODE_0 (CanIfBufferCfg): CanIfBufferSize=1, CanIfBufferHthRef=J1939_Network_CANNODE_0_Tx_Ext_MailBox_2
      Frm_BSM_BCU_J1939_Network_CANNODE_0 (CanIfTxPduCfg):
        CanIfTxPduReadNotifyStatus = false
        CanIfTxPduType = STATIC
        CanIfTxPduCanIdType = EXTENDED_CAN
        CanIfTxPduCanId = 403920628
        CanIfTxPduDlc = 7
        CanIfTxPduId = 19
        CanIfTxPduUserTxConfirmationUL = PDUR
        CanIfTxPduControllerRef = J1939_Network_CANNODE_0
        CanIfTxPduBufferRef = Buffer_Frm_BSM_BCU_J1939_Network_CANNODE_0
        CanIfTxPduRef = PduCollection/BSM_BCU_J1939_Network_CANNODE_0_PduR2CanIf
      Buffer_Frm_BST_BCU_J1939_Network_CANNODE_0 (CanIfBufferCfg): CanIfBufferSize=1, CanIfBufferHthRef=J1939_Network_CANNODE_0_Tx_Ext_MailBox_3
      Frm_BST_BCU_J1939_Network_CANNODE_0 (CanIfTxPduCfg):
        CanIfTxPduReadNotifyStatus = false
        CanIfTxPduType = STATIC
        CanIfTxPduCanIdType = EXTENDED_CAN
        CanIfTxPduCanId = 270096116
        CanIfTxPduDlc = 4
        CanIfTxPduId = 20
        CanIfTxPduUserTxConfirmationUL = PDUR
        CanIfTxPduControllerRef = J1939_Network_CANNODE_0
        CanIfTxPduBufferRef = Buffer_Frm_BST_BCU_J1939_Network_CANNODE_0
        CanIfTxPduRef = PduCollection/BST_BCU_J1939_Network_CANNODE_0_PduR2CanIf
      Buffer_Frm_BRO_BCU_J1939_Network_CANNODE_0 (CanIfBufferCfg): CanIfBufferSize=1, CanIfBufferHthRef=J1939_Network_CANNODE_0_Tx_Ext_MailBox_4
      Frm_BRO_BCU_J1939_Network_CANNODE_0 (CanIfTxPduCfg):
        CanIfTxPduReadNotifyStatus = false
        CanIfTxPduType = STATIC
        CanIfTxPduCanIdType = EXTENDED_CAN
        CanIfTxPduCanId = 269047540
        CanIfTxPduDlc = 1
        CanIfTxPduId = 21
        CanIfTxPduUserTxConfirmationUL = PDUR
        CanIfTxPduControllerRef = J1939_Network_CANNODE_0
        CanIfTxPduBufferRef = Buffer_Frm_BRO_BCU_J1939_Network_CANNODE_0
        CanIfTxPduRef = PduCollection/BRO_BCU_J1939_Network_CANNODE_0_PduR2CanIf
      Buffer_Frm_BEM_BCU_J1939_Network_CANNODE_0 (CanIfBufferCfg): CanIfBufferSize=1, CanIfBufferHthRef=J1939_Network_CANNODE_0_Tx_Ext_MailBox_5
      Frm_BEM_BCU_J1939_Network_CANNODE_0 (CanIfTxPduCfg):
        CanIfTxPduReadNotifyStatus = false
        CanIfTxPduType = STATIC
        CanIfTxPduCanIdType = EXTENDED_CAN
        CanIfTxPduCanId = 136206068
        CanIfTxPduDlc = 4
        CanIfTxPduId = 22
        CanIfTxPduUserTxConfirmationUL = PDUR
        CanIfTxPduControllerRef = J1939_Network_CANNODE_0
        CanIfTxPduBufferRef = Buffer_Frm_BEM_BCU_J1939_Network_CANNODE_0
        CanIfTxPduRef = PduCollection/BEM_BCU_J1939_Network_CANNODE_0_PduR2CanIf
      Buffer_Frm_BCL_BCU_J1939_Network_CANNODE_0 (CanIfBufferCfg): CanIfBufferSize=1, CanIfBufferHthRef=J1939_Network_CANNODE_0_Tx_Ext_MailBox_6
      Frm_BCL_BCU_J1939_Network_CANNODE_0 (CanIfTxPduCfg):
        CanIfTxPduReadNotifyStatus = false
        CanIfTxPduType = STATIC
        CanIfTxPduCanIdType = EXTENDED_CAN
        CanIfTxPduCanId = 403724020
        CanIfTxPduDlc = 5
        CanIfTxPduId = 23
        CanIfTxPduUserTxConfirmationUL = PDUR
        CanIfTxPduControllerRef = J1939_Network_CANNODE_0
        CanIfTxPduBufferRef = Buffer_Frm_BCL_BCU_J1939_Network_CANNODE_0
        CanIfTxPduRef = PduCollection/BCL_BCU_J1939_Network_CANNODE_0_PduR2CanIf
      Buffer_Frm_BSD_BCU_J1939_Network_CANNODE_0 (CanIfBufferCfg): CanIfBufferSize=1, CanIfBufferHthRef=J1939_Network_CANNODE_0_Tx_Ext_MailBox_7
      Frm_BSD_BCU_J1939_Network_CANNODE_0 (CanIfTxPduCfg):
        CanIfTxPduReadNotifyStatus = false
        CanIfTxPduType = STATIC
        CanIfTxPduCanIdType = EXTENDED_CAN
        CanIfTxPduCanId = 404510452
        CanIfTxPduDlc = 7
        CanIfTxPduId = 24
        CanIfTxPduUserTxConfirmationUL = PDUR
        CanIfTxPduControllerRef = J1939_Network_CANNODE_0
        CanIfTxPduBufferRef = Buffer_Frm_BSD_BCU_J1939_Network_CANNODE_0
        CanIfTxPduRef = PduCollection/BSD_BCU_J1939_Network_CANNODE_0_PduR2CanIf
      Frm_NPDU_RX_CM_CMDT_J1939_Network_CANNODE_0 (CanIfRxPduCfg):
        CanIfRxPduReadData = false
        CanIfRxPduReadNotifyStatus = true
        CanIfRxPduCanId = 485291094
        CanIfRxPduCanIdType = EXTENDED_CAN
        CanIfRxPduDlc = 8
        CanIfRxPduId = 24
        CanIfRxPduUserRxIndicationUL = J1939TP
        CanIfRxPduUserRxIndicationName = J1939Tp_RxIndication
        CanIfRxPduHrhIdRef = J1939_Network_CANNODE_0_Rx_Ext_MailBox_10
        CanIfRxPduControllerRef = J1939_Network_CANNODE_0
        CanIfRxPduRef = NPDU_RX_CM_CMDT_J1939_Network_CANNODE_0_CanIf2J1939Tp
      Buffer_Frm_NPDU_TX_DT_J1939_Network_CANNODE_0 (CanIfBufferCfg): CanIfBufferSize=1, CanIfBufferHthRef=J1939_Network_CANNODE_0_Tx_Ext_MailBox_8
      Frm_NPDU_TX_DT_J1939_Network_CANNODE_0 (CanIfTxPduCfg):
        CanIfTxPduReadNotifyStatus = false
        CanIfTxPduType = STATIC
        CanIfTxPduCanIdType = EXTENDED_CAN
        CanIfTxPduCanId = 15400960
        CanIfTxPduDlc = 8
        CanIfTxPduId = 25
        CanIfTxPduCanIdMask = 16711680
        CanIfTxPduUserTxConfirmationUL = J1939TP
        CanIfTxPduUserTxConfirmationName = J1939Tp_TxConfirmation
        CanIfTxPduControllerRef = J1939_Network_CANNODE_0
        CanIfTxPduBufferRef = Buffer_Frm_NPDU_TX_DT_J1939_Network_CANNODE_0
        CanIfTxPduRef = NPDU_TX_DT_J1939_Network_CANNODE_0_J1939Tp2CanIf
      Buffer_Frm_NPDU_TX_CM_J1939_Network_CANNODE_0 (CanIfBufferCfg): CanIfBufferSize=1, CanIfBufferHthRef=J1939_Network_CANNODE_0_Tx_Ext_MailBox_9
      Frm_NPDU_TX_CM_J1939_Network_CANNODE_0 (CanIfTxPduCfg):
        CanIfTxPduReadNotifyStatus = false
        CanIfTxPduType = STATIC
        CanIfTxPduCanIdType = EXTENDED_CAN
        CanIfTxPduCanId = 15466496
        CanIfTxPduDlc = 8
        CanIfTxPduId = 26
        CanIfTxPduCanIdMask = 16711680
        CanIfTxPduUserTxConfirmationUL = J1939TP
        CanIfTxPduUserTxConfirmationName = J1939Tp_TxConfirmation
        CanIfTxPduControllerRef = J1939_Network_CANNODE_0
        CanIfTxPduBufferRef = Buffer_Frm_NPDU_TX_CM_J1939_Network_CANNODE_0
        CanIfTxPduRef = NPDU_TX_CM_J1939_Network_CANNODE_0_J1939Tp2CanIf
    CanIfCtrlDrvCfg:
      CanIfCtrlDrvBusOffNotification = true
      CanIfCtrlDrvWakeUpNotification = false
      CanIfCtrlDrvNameRef = CanGeneral
      CanIfCtrlDrvInitHohConfigRef = CanIfInitHohCfg
      Can_Network_CANNODE_0 (CanIfCtrlCfg): CanIfCtrlId=0, CanIfCtrlWakeupSupport=false, CanIfCtrlCanCtrlRef=Can_Network_CANNODE_0
      J1939_Network_CANNODE_0 (CanIfCtrlCfg): CanIfCtrlId=1, CanIfCtrlWakeupSupport=false, CanIfCtrlCanCtrlRef=J1939_Network_CANNODE_0
    CanIfDispatchCfg: CanIfDispatchUserCtrlBusOffUL=CAN_SM, CanIfDispatchUserCtrlModeIndicationUL=CAN_SM, CanIfDispatchUserTrcvModeIndicationName=CAN_SM
    CanIfPrivateCfg: CanIfPrivateDlcCheck=false
    CanIfPublicCfg:
      CanIfPublicReadRxPduDataApi = false
      CanIfPublicReadRxPduNotifyStatusApi = true
      CanIfPublicReadTxPduNotifyStatusApi = true
      CanIfPublicSetDynamicTxIdApi = false
      CanIfPublicTxBuffering = 0
      CanIfPublicTxConfirmPollingSupport = false
      CanIfPublicVersionInfoApi = false
      CanIfPublicMultipleDrvSupport = false
      CanIfPublicChangeBaudrateSupport = false
      CanIfPublicCancelTransmitSupport = false
      CanIfPublicRxBuffering = false
      CanIfPublicErrorPassiveSupport = false
      CanIfPublicDynamicTxIdSupport = false
      CanIfPublicCanIfLiteConfiguration = false
      CanIfPublicUserTpTxInOfflineMode = false
      CanIfPublicWakeupCheckValidSupport = false
      CanIfPublicPnSupport = false
      CanIfPublicHandleTypeEnum = UINT16
      CanIfPublicBusoffRecoveryfromRxIndication = false
      CanIfPublicInstanceId = 1
      CanIfHwObjectPrefix = CanConf_CanHardwareObject
      CanIfMetaDataSupport = 1
      CanIfPublicDevErrorDetect = false
      CanIfCalibrationSupport: CanIfCalibration=false
  module config CanSm: definition=CanSM, implementation-config-variant=VARIANT-PRE-COMPILE
    CanSMConfiguration: CanSMModeRequestRepetitionMax=5, CanSMModeRequestRepetitionTime=0.07
      CanSMManagerNetwork_Can_Network_0 (CanSMManagerNetwork):
        CanSMBorTxConfirmationPolling = false
        CanSMBorCounterL1ToL2 = 0
        CanSMBorTimeL1 = 0.04
        CanSMBorTimeL2 = 0.1
        CanSMBorTimeTxEnsured = 0.02
        CanSMNetworkIndex = 0
        CanSMComMNetworkHandleRef = ComMChannel_Can_Network_0_Channel
        CanSMDemEventParameterRefs: CanSMRbDynCreate_CANSM_E_BUS_OFF=Standard
        CanSMController_Can_Network_CANNODE_0 (CanSMController): CanSMControllerId=Can_Network_CANNODE_0
      CanSMManagerNetwork_J1939_Network (CanSMManagerNetwork):
        CanSMBorTxConfirmationPolling = false
        CanSMBorCounterL1ToL2 = 0
        CanSMBorTimeL1 = 0.04
        CanSMBorTimeL2 = 0.1
        CanSMBorTimeTxEnsured = 0.02
        CanSMNetworkIndex = 1
        CanSMComMNetworkHandleRef = ComMChannel_J1939_Network_Channel
        CanSMDemEventParameterRefs: CanSMRbDynCreate_CANSM_E_BUS_OFF=Standard
        CanSMController_J1939_Network_CANNODE_0 (CanSMController): CanSMControllerId=J1939_Network_CANNODE_0
    CanSMGeneral: CanSMMainFunctionTimePeriod=0.01, CanSMVersionInfoApi=false, CanSMChangeBaudrateApi=false, CanSMDevErrorDetect=false
  module config Com: implementation-config-variant=VARIANT-PRE-COMPILE
    ComConfig_0 (ComConfig): ComConfigurationId=0
      ComTimeBase: ComGwTimeBase=0.005, ComRxTimeBase=0.01, ComTxTimeBase=0.01
      ComIPduGroup_Rx (ComIPduGroup): ComIPduGroupHandleId=0
      PEU_0B4h_Can_Network_CANNODE_0 (ComIPdu):
        ComIPduSignalProcessing = IMMEDIATE
        ComIPduType = NORMAL
        ComIPduDirection = RECEIVE
        ComFirstTimeout = 0.0
        ComTimeout = 0.1
        ComIpduNotificationCallback = Com_RxCbk_PEU_0B4h_Can_Network_CANNODE_0
        ComIPduErrorNotification = Com_RxTOCbk_PEU_0B4h_Can_Network_CANNODE_0
        ComIPduGroupRef = ComIPduGroup_Rx
        ComPduIdRef = PduCollection/PEU_0B4h_Can_Network_CANNODE_0_PduR2Com
        ComIPduSignalRef = V_DC
        ComIPduSignalRef = V_DCValidity
      V_DC (ComSignal):
        ComSignalInitValue = 0
        ComSignalType = UINT16
        ComSignalEndianness = BIG_ENDIAN
        ComBitSize = 15
        ComBitPosition = 54
        ComUpdateBitPosition = -1
        ComTransferProperty = TRIGGERED
        ComHandleId = 0
        ComNotification = Rte_COMCbk_V_DC
        ComTimeoutNotification = Rte_COMCbkTOut_V_DC
        ComSystemTemplateSystemSignalRef = V_DC
      V_DCValidity (ComSignal):
        ComSignalInitValue = 0
        ComSignalType = BOOLEAN
        ComSignalEndianness = BIG_ENDIAN
        ComBitSize = 1
        ComBitPosition = 55
        ComUpdateBitPosition = -1
        ComTransferProperty = TRIGGERED
        ComHandleId = 1
        ComNotification = Rte_COMCbk_V_DCValidity
        ComTimeoutNotification = Rte_COMCbkTOut_V_DCValidity
        ComSystemTemplateSystemSignalRef = V_DCValidity
      VCU_1E3h_Can_Network_CANNODE_0 (ComIPdu):
        ComIPduSignalProcessing = IMMEDIATE
        ComIPduType = NORMAL
        ComIPduDirection = RECEIVE
        ComFirstTimeout = 0.0
        ComTimeout = 0.2
        ComIpduNotificationCallback = Com_RxCbk_VCU_1E3h_Can_Network_CANNODE_0
        ComIPduErrorNotification = Com_RxTOCbk_VCU_1E3h_Can_Network_CANNODE_0
        ComIPduGroupRef = ComIPduGroup_Rx
        ComPduIdRef = PduCollection/VCU_1E3h_Can_Network_CANNODE_0_PduR2Com
        ComIPduSignalRef = PTHVCntctrReq
        ComIPduSignalRef = ChrgrStatPTHVCntctrClsAlwd
        ComIPduSignalRef = ChrgrStatPTHVCntctOpnrAlwd
        ComIPduSignalRef = RollingCounter_1E3h
        ComIPduSignalRef = CheckSum_1E3h
      5 x ComSignal, all with ComSignalInitValue=0, ComSignalEndianness=BIG_ENDIAN, ComUpdateBitPosition=-1, ComTransferProperty=TRIGGERED:
        PTHVCntctrReq: ComSignalType=UINT8, ComBitSize=2, ComBitPosition=4, ComHandleId=2, ComNotification=Rte_COMCbk_PTHVCntctrReq, ComTimeoutNotification=Rte_COMCbkTOut_PTHVCntctrReq, ComSystemTemplateSystemSignalRef=PTHVCntctrReq
        ChrgrStatPTHVCntctrClsAlwd: ComSignalType=BOOLEAN, ComBitSize=1, ComBitPosition=0, ComHandleId=3, ComNotification=Rte_COMCbk_ChrgrStatPTHVCntctrClsAlwd, ComTimeoutNotification=Rte_COMCbkTOut_ChrgrStatPTHVCntctrClsAlwd, ComSystemTemplateSystemSignalRef=ChrgrStatPTHVCntctrClsAlwd
        ChrgrStatPTHVCntctOpnrAlwd: ComSignalType=BOOLEAN, ComBitSize=1, ComBitPosition=1, ComHandleId=4, ComNotification=Rte_COMCbk_ChrgrStatPTHVCntctOpnrAlwd, ComTimeoutNotification=Rte_COMCbkTOut_ChrgrStatPTHVCntctOpnrAlwd, ComSystemTemplateSystemSignalRef=ChrgrStatPTHVCntctOpnrAlwd
        RollingCounter_1E3h: ComSignalType=UINT8, ComBitSize=4, ComBitPosition=55, ComHandleId=5, ComNotification=Rte_COMCbk_RollingCounter_1E3h, ComTimeoutNotification=Rte_COMCbkTOut_RollingCounter_1E3h, ComSystemTemplateSystemSignalRef=RollingCounter_1E3h
        CheckSum_1E3h: ComSignalType=UINT8, ComBitSize=8, ComBitPosition=63, ComHandleId=6, ComNotification=Rte_COMCbk_CheckSum_1E3h, ComTimeoutNotification=Rte_COMCbkTOut_CheckSum_1E3h, ComSystemTemplateSystemSignalRef=CheckSum_1E3h
      PEU_18Bh_Can_Network_CANNODE_0 (ComIPdu):
        ComIPduSignalProcessing = IMMEDIATE
        ComIPduType = NORMAL
        ComIPduDirection = RECEIVE
        ComFirstTimeout = 0.0
        ComTimeout = 0.1
        ComIpduNotificationCallback = Com_RxCbk_PEU_18Bh_Can_Network_CANNODE_0
        ComIPduErrorNotification = Com_RxTOCbk_PEU_18Bh_Can_Network_CANNODE_0
        ComIPduGroupRef = ComIPduGroup_Rx
        ComPduIdRef = PduCollection/PEU_18Bh_Can_Network_CANNODE_0_PduR2Com
        ComIPduSignalRef = InvADCCrntV
        ComIPduSignalRef = InvADCCrnt
      InvADCCrntV (ComSignal):
        ComSignalInitValue = 0
        ComSignalType = BOOLEAN
        ComSignalEndianness = BIG_ENDIAN
        ComBitSize = 1
        ComBitPosition = 55
        ComUpdateBitPosition = -1
        ComTransferProperty = TRIGGERED
        ComHandleId = 7
        ComNotification = Rte_COMCbk_InvADCCrntV
        ComTimeoutNotification = Rte_COMCbkTOut_InvADCCrntV
        ComSystemTemplateSystemSignalRef = InvADCCrntV
      InvADCCrnt (ComSignal):
        ComSignalInitValue = 0
        ComSignalType = UINT16
        ComSignalEndianness = BIG_ENDIAN
        ComBitSize = 15
        ComBitPosition = 54
        ComUpdateBitPosition = -1
        ComTransferProperty = TRIGGERED
        ComHandleId = 8
        ComNotification = Rte_COMCbk_InvADCCrnt
        ComTimeoutNotification = Rte_COMCbkTOut_InvADCCrnt
        ComSystemTemplateSystemSignalRef = InvADCCrnt
      VCU_ABS_23Ch_Can_Network_CANNODE_0 (ComIPdu):
        ComIPduSignalProcessing = IMMEDIATE
        ComIPduType = NORMAL
        ComIPduDirection = RECEIVE
        ComFirstTimeout = 0.0
        ComTimeout = 0.2
        ComIpduNotificationCallback = Com_RxCbk_VCU_ABS_23Ch_Can_Network_CANNODE_0
        ComIPduErrorNotification = Com_RxTOCbk_VCU_ABS_23Ch_Can_Network_CANNODE_0
        ComIPduGroupRef = ComIPduGroup_Rx
        ComPduIdRef = PduCollection/VCU_ABS_23Ch_Can_Network_CANNODE_0_PduR2Com
        ComIPduSignalRef = VehicleSpeedStatus
        ComIPduSignalRef = VehicleSpeed
        ComIPduSignalRef = MessageCounter_23Ch
        ComIPduSignalRef = CheckSum_23Ch
      4 x ComSignal, all with ComSignalInitValue=0, ComSignalEndianness=BIG_ENDIAN, ComUpdateBitPosition=-1, ComTransferProperty=TRIGGERED:
        VehicleSpeedStatus: ComSignalType=BOOLEAN, ComBitSize=1, ComBitPosition=7, ComHandleId=9, ComNotification=Rte_COMCbk_VehicleSpeedStatus, ComTimeoutNotification=Rte_COMCbkTOut_VehicleSpeedStatus, ComSystemTemplateSystemSignalRef=VehicleSpeedStatus
        VehicleSpeed: ComSignalType=UINT16, ComBitSize=15, ComBitPosition=6, ComHandleId=10, ComNotification=Rte_COMCbk_VehicleSpeed, ComTimeoutNotification=Rte_COMCbkTOut_VehicleSpeed, ComSystemTemplateSystemSignalRef=VehicleSpeed
        MessageCounter_23Ch: ComSignalType=UINT8, ComBitSize=4, ComBitPosition=55, ComHandleId=11, ComNotification=Rte_COMCbk_MessageCounter_23Ch, ComTimeoutNotification=Rte_COMCbkTOut_MessageCounter_23Ch, ComSystemTemplateSystemSignalRef=MessageCounter_23Ch
        CheckSum_23Ch: ComSignalType=UINT8, ComBitSize=8, ComBitPosition=63, ComHandleId=12, ComNotification=Rte_COMCbk_CheckSum_23Ch, ComTimeoutNotification=Rte_COMCbkTOut_CheckSum_23Ch, ComSystemTemplateSystemSignalRef=CheckSum_23Ch
      DCDC_303h_Can_Network_CANNODE_0 (ComIPdu):
        ComIPduSignalProcessing = IMMEDIATE
        ComIPduType = NORMAL
        ComIPduDirection = RECEIVE
        ComFirstTimeout = 0.0
        ComTimeout = 1.0
        ComIpduNotificationCallback = Com_RxCbk_DCDC_303h_Can_Network_CANNODE_0
        ComIPduErrorNotification = Com_RxTOCbk_DCDC_303h_Can_Network_CANNODE_0
        ComIPduGroupRef = ComIPduGroup_Rx
        ComPduIdRef = PduCollection/DCDC_303h_Can_Network_CANNODE_0_PduR2Com
        ComIPduSignalRef = I_LDC_In
        ComIPduSignalRef = CDU_HVILWarning
      I_LDC_In (ComSignal):
        ComSignalInitValue = 0
        ComSignalType = UINT16
        ComSignalEndianness = BIG_ENDIAN
        ComBitSize = 12
        ComBitPosition = 27
        ComUpdateBitPosition = -1
        ComTransferProperty = TRIGGERED
        ComHandleId = 13
        ComNotification = Rte_COMCbk_I_LDC_In
        ComTimeoutNotification = Rte_COMCbkTOut_I_LDC_In
        ComSystemTemplateSystemSignalRef = I_LDC_In
      CDU_HVILWarning (ComSignal):
        ComSignalInitValue = 0
        ComSignalType = BOOLEAN
        ComSignalEndianness = BIG_ENDIAN
        ComBitSize = 1
        ComBitPosition = 7
        ComUpdateBitPosition = -1
        ComTransferProperty = TRIGGERED
        ComHandleId = 14
        ComNotification = Rte_COMCbk_CDU_HVILWarning
        ComTimeoutNotification = Rte_COMCbkTOut_CDU_HVILWarning
        ComSystemTemplateSystemSignalRef = CDU_HVILWarning
      VCU_BCM_1F1h_Can_Network_CANNODE_0 (ComIPdu):
        ComIPduSignalProcessing = IMMEDIATE
        ComIPduType = NORMAL
        ComIPduDirection = RECEIVE
        ComFirstTimeout = 0.0
        ComTimeout = 0.2
        ComIpduNotificationCallback = Com_RxCbk_VCU_BCM_1F1h_Can_Network_CANNODE_0
        ComIPduErrorNotification = Com_RxTOCbk_VCU_BCM_1F1h_Can_Network_CANNODE_0
        ComIPduGroupRef = ComIPduGroup_Rx
        ComPduIdRef = PduCollection/VCU_BCM_1F1h_Can_Network_CANNODE_0_PduR2Com
        ComIPduSignalRef = SysPwrMd
        ComIPduSignalRef = SysOpnlMd
        ComIPduSignalRef = SysVolMdV
        ComIPduSignalRef = SysVolV
        ComIPduSignalRef = SysVol
        ComIPduSignalRef = SysVolMd
      6 x ComSignal, all with ComSignalInitValue=0, ComSignalEndianness=BIG_ENDIAN, ComUpdateBitPosition=-1, ComTransferProperty=TRIGGERED:
        SysPwrMd: ComSignalType=UINT8, ComBitSize=2, ComBitPosition=1, ComHandleId=15, ComNotification=Rte_COMCbk_SysPwrMd, ComTimeoutNotification=Rte_COMCbkTOut_SysPwrMd, ComSystemTemplateSystemSignalRef=SysPwrMd
        SysOpnlMd: ComSignalType=UINT8, ComBitSize=3, ComBitPosition=6, ComHandleId=16, ComNotification=Rte_COMCbk_SysOpnlMd, ComTimeoutNotification=Rte_COMCbkTOut_SysOpnlMd, ComSystemTemplateSystemSignalRef=SysOpnlMd
        SysVolMdV: ComSignalType=BOOLEAN, ComBitSize=1, ComBitPosition=7, ComHandleId=17, ComNotification=Rte_COMCbk_SysVolMdV, ComTimeoutNotification=Rte_COMCbkTOut_SysVolMdV, ComSystemTemplateSystemSignalRef=SysVolMdV
        SysVolV: ComSignalType=BOOLEAN, ComBitSize=1, ComBitPosition=32, ComHandleId=18, ComNotification=Rte_COMCbk_SysVolV, ComTimeoutNotification=Rte_COMCbkTOut_SysVolV, ComSystemTemplateSystemSignalRef=SysVolV
        SysVol: ComSignalType=UINT8, ComBitSize=8, ComBitPosition=47, ComHandleId=19, ComNotification=Rte_COMCbk_SysVol, ComTimeoutNotification=Rte_COMCbkTOut_SysVol, ComSystemTemplateSystemSignalRef=SysVol
        SysVolMd: ComSignalType=UINT8, ComBitSize=2, ComBitPosition=58, ComHandleId=20, ComNotification=Rte_COMCbk_SysVolMd, ComTimeoutNotification=Rte_COMCbkTOut_SysVolMd, ComSystemTemplateSystemSignalRef=SysVolMd
      Tester_748h_Can_Network_CANNODE_0 (ComIPdu):
        ComIPduSignalProcessing = IMMEDIATE
        ComIPduType = NORMAL
        ComIPduDirection = RECEIVE
        ComIPduGroupRef = ComIPduGroup_Rx
        ComPduIdRef = PduCollection/Tester_748h_Can_Network_CANNODE_0_PduR2Com
        ComIPduSignalRef = TesterDiagRequestData_BMS
      TesterDiagRequestData_BMS (ComSignal):
        ComSignalInitValue = 0
        ComSignalType = UINT8_N
        ComSignalEndianness = opaque
        ComSignalLength = 8
        ComBitSize = 64
        ComBitPosition = 0
        ComUpdateBitPosition = -1
        ComTransferProperty = TRIGGERED
        ComHandleId = 21
        ComSystemTemplateSystemSignalRef = TesterDiagRequestData_BMS
      VCU_IPK_1F2h_Can_Network_CANNODE_0 (ComIPdu):
        ComIPduSignalProcessing = IMMEDIATE
        ComIPduType = NORMAL
        ComIPduDirection = RECEIVE
        ComFirstTimeout = 0.0
        ComTimeout = 0.2
        ComIpduNotificationCallback = Com_RxCbk_VCU_IPK_1F2h_Can_Network_CANNODE_0
        ComIPduErrorNotification = Com_RxTOCbk_VCU_IPK_1F2h_Can_Network_CANNODE_0
        ComIPduGroupRef = ComIPduGroup_Rx
        ComPduIdRef = PduCollection/VCU_IPK_1F2h_Can_Network_CANNODE_0_PduR2Com
        ComIPduSignalRef = SysBPM
        ComIPduSignalRef = SysBPMEnbd
      SysBPM (ComSignal):
        ComSignalInitValue = 0
        ComSignalType = UINT8
        ComSignalEndianness = BIG_ENDIAN
        ComBitSize = 2
        ComBitPosition = 5
        ComUpdateBitPosition = -1
        ComTransferProperty = TRIGGERED
        ComHandleId = 22
        ComNotification = Rte_COMCbk_SysBPM
        ComTimeoutNotification = Rte_COMCbkTOut_SysBPM
        ComSystemTemplateSystemSignalRef = SysBPM
      SysBPMEnbd (ComSignal):
        ComSignalInitValue = 0
        ComSignalType = BOOLEAN
        ComSignalEndianness = BIG_ENDIAN
        ComBitSize = 1
        ComBitPosition = 6
        ComUpdateBitPosition = -1
        ComTransferProperty = TRIGGERED
        ComHandleId = 23
        ComNotification = Rte_COMCbk_SysBPMEnbd
        ComTimeoutNotification = Rte_COMCbkTOut_SysBPMEnbd
        ComSystemTemplateSystemSignalRef = SysBPMEnbd
      VCU_SRS_163h_Can_Network_CANNODE_0 (ComIPdu):
        ComIPduSignalProcessing = IMMEDIATE
        ComIPduType = NORMAL
        ComIPduDirection = RECEIVE
        ComFirstTimeout = 0.0
        ComTimeout = 0.2
        ComIpduNotificationCallback = Com_RxCbk_VCU_SRS_163h_Can_Network_CANNODE_0
        ComIPduErrorNotification = Com_RxTOCbk_VCU_SRS_163h_Can_Network_CANNODE_0
        ComIPduGroupRef = ComIPduGroup_Rx
        ComPduIdRef = PduCollection/VCU_SRS_163h_Can_Network_CANNODE_0_PduR2Com
        ComIPduSignalRef = VehCrshTyp
        ComIPduSignalRef = RollingCounter
        ComIPduSignalRef = SRSCheckSum
      3 x ComSignal, all with ComSignalInitValue=0, ComSignalType=UINT8, ComSignalEndianness=BIG_ENDIAN, ComUpdateBitPosition=-1, ComTransferProperty=TRIGGERED:
        VehCrshTyp: ComBitSize=4, ComBitPosition=4, ComHandleId=24, ComNotification=Rte_COMCbk_VehCrshTyp, ComTimeoutNotification=Rte_COMCbkTOut_VehCrshTyp, ComSystemTemplateSystemSignalRef=VehCrshTyp
        RollingCounter: ComBitSize=4, ComBitPosition=55, ComHandleId=25, ComNotification=Rte_COMCbk_RollingCounter, ComTimeoutNotification=Rte_COMCbkTOut_RollingCounter, ComSystemTemplateSystemSignalRef=RollingCounter
        SRSCheckSum: ComBitSize=8, ComBitPosition=63, ComHandleId=26, ComNotification=Rte_COMCbk_SRSCheckSum, ComTimeoutNotification=Rte_COMCbkTOut_SRSCheckSum, ComSystemTemplateSystemSignalRef=SRSCheckSum
      VCU_353h_Can_Network_CANNODE_0 (ComIPdu):
        ComIPduSignalProcessing = IMMEDIATE
        ComIPduType = NORMAL
        ComIPduDirection = RECEIVE
        ComFirstTimeout = 0.0
        ComTimeout = 1.0
        ComIpduNotificationCallback = Com_RxCbk_VCU_353h_Can_Network_CANNODE_0
        ComIPduErrorNotification = Com_RxTOCbk_VCU_353h_Can_Network_CANNODE_0
        ComIPduGroupRef = ComIPduGroup_Rx
        ComPduIdRef = PduCollection/VCU_353h_Can_Network_CANNODE_0_PduR2Com
        ComIPduSignalRef = VehSpdAvgDrvnV
        ComIPduSignalRef = VehSpdAvgDrvn
      VehSpdAvgDrvnV (ComSignal):
        ComSignalInitValue = 0
        ComSignalType = BOOLEAN
        ComSignalEndianness = BIG_ENDIAN
        ComBitSize = 1
        ComBitPosition = 7
        ComUpdateBitPosition = -1
        ComTransferProperty = TRIGGERED
        ComHandleId = 27
        ComNotification = Rte_COMCbk_VehSpdAvgDrvnV
        ComTimeoutNotification = Rte_COMCbkTOut_VehSpdAvgDrvnV
        ComSystemTemplateSystemSignalRef = VehSpdAvgDrvnV
      VehSpdAvgDrvn (ComSignal):
        ComSignalInitValue = 0
        ComSignalType = UINT16
        ComSignalEndianness = BIG_ENDIAN
        ComBitSize = 15
        ComBitPosition = 6
        ComUpdateBitPosition = -1
        ComTransferProperty = TRIGGERED
        ComHandleId = 28
        ComNotification = Rte_COMCbk_VehSpdAvgDrvn
        ComTimeoutNotification = Rte_COMCbkTOut_VehSpdAvgDrvn
        ComSystemTemplateSystemSignalRef = VehSpdAvgDrvn
      Tester_7DFh_Can_Network_CANNODE_0 (ComIPdu):
        ComIPduSignalProcessing = IMMEDIATE
        ComIPduType = NORMAL
        ComIPduDirection = RECEIVE
        ComIPduGroupRef = ComIPduGroup_Rx
        ComPduIdRef = PduCollection/Tester_7DFh_Can_Network_CANNODE_0_PduR2Com
        ComIPduSignalRef = TesterDiagRequestData_Fun
      TesterDiagRequestData_Fun (ComSignal):
        ComSignalInitValue = 0
        ComSignalType = UINT8_N
        ComSignalEndianness = opaque
        ComSignalLength = 8
        ComBitSize = 64
        ComBitPosition = 0
        ComUpdateBitPosition = -1
        ComTransferProperty = TRIGGERED
        ComHandleId = 29
        ComSystemTemplateSystemSignalRef = TesterDiagRequestData_Fun
      VCU_HCM_55Fh_Can_Network_CANNODE_0 (ComIPdu):
        ComIPduSignalProcessing = IMMEDIATE
        ComIPduType = NORMAL
        ComIPduDirection = RECEIVE
        ComFirstTimeout = 0.0
        ComTimeout = 2.0
        ComIpduNotificationCallback = Com_RxCbk_VCU_HCM_55Fh_Can_Network_CANNODE_0
        ComIPduErrorNotification = Com_RxTOCbk_VCU_HCM_55Fh_Can_Network_CANNODE_0
        ComIPduGroupRef = ComIPduGroup_Rx
        ComPduIdRef = PduCollection/VCU_HCM_55Fh_Can_Network_CANNODE_0_PduR2Com
        ComIPduSignalRef = FrontCompStatFdbck
        ComIPduSignalRef = FrontCmprElctrCrnt
        ComIPduSignalRef = FrontPTCStatFdbck
        ComIPduSignalRef = FrontPTCElctrCrnt
      4 x ComSignal, all with ComSignalInitValue=0, ComSignalType=UINT8, ComSignalEndianness=BIG_ENDIAN, ComUpdateBitPosition=-1, ComTransferProperty=TRIGGERED:
        FrontCompStatFdbck: ComBitSize=4, ComBitPosition=6, ComHandleId=30, ComNotification=Rte_COMCbk_FrontCompStatFdbck, ComTimeoutNotification=Rte_COMCbkTOut_FrontCompStatFdbck, ComSystemTemplateSystemSignalRef=FrontCompStatFdbck
        FrontCmprElctrCrnt: ComBitSize=8, ComBitPosition=39, ComHandleId=31, ComNotification=Rte_COMCbk_FrontCmprElctrCrnt, ComTimeoutNotification=Rte_COMCbkTOut_FrontCmprElctrCrnt, ComSystemTemplateSystemSignalRef=FrontCmprElctrCrnt
        FrontPTCStatFdbck: ComBitSize=2, ComBitPosition=41, ComHandleId=32, ComNotification=Rte_COMCbk_FrontPTCStatFdbck, ComTimeoutNotification=Rte_COMCbkTOut_FrontPTCStatFdbck, ComSystemTemplateSystemSignalRef=FrontPTCStatFdbck
        FrontPTCElctrCrnt: ComBitSize=8, ComBitPosition=31, ComHandleId=33, ComNotification=Rte_COMCbk_FrontPTCElctrCrnt, ComTimeoutNotification=Rte_COMCbkTOut_FrontPTCElctrCrnt, ComSystemTemplateSystemSignalRef=FrontPTCElctrCrnt
      OBC_604h_Can_Network_CANNODE_0 (ComIPdu):
        ComIPduSignalProcessing = IMMEDIATE
        ComIPduType = NORMAL
        ComIPduDirection = RECEIVE
        ComFirstTimeout = 0.0
        ComTimeout = 1.0
        ComIpduNotificationCallback = Com_RxCbk_OBC_604h_Can_Network_CANNODE_0
        ComIPduErrorNotification = Com_RxTOCbk_OBC_604h_Can_Network_CANNODE_0
        ComIPduGroupRef = ComIPduGroup_Rx
        ComPduIdRef = PduCollection/OBC_604h_Can_Network_CANNODE_0_PduR2Com
        ComIPduSignalRef = OBCChgVolt
        ComIPduSignalRef = OBCChgCurrent
        ComIPduSignalRef = OBCMaxChrgVoltage
        ComIPduSignalRef = OBCMaxChrgCurrent
        ComIPduSignalRef = OBCStatus
        ComIPduSignalRef = OBCCurrentFltCode
        ComIPduSignalRef = OBCHistoryFltCode
      7 x ComSignal, all with ComSignalInitValue=0, ComSignalEndianness=BIG_ENDIAN, ComUpdateBitPosition=-1, ComTransferProperty=TRIGGERED:
        OBCChgVolt: ComSignalType=UINT16, ComBitSize=14, ComBitPosition=7, ComHandleId=34, ComNotification=Rte_COMCbk_OBCChgVolt, ComTimeoutNotification=Rte_COMCbkTOut_OBCChgVolt, ComSystemTemplateSystemSignalRef=OBCChgVolt
        OBCChgCurrent: ComSignalType=UINT16, ComBitSize=10, ComBitPosition=9, ComHandleId=35, ComNotification=Rte_COMCbk_OBCChgCurrent, ComTimeoutNotification=Rte_COMCbkTOut_OBCChgCurrent, ComSystemTemplateSystemSignalRef=OBCChgCurrent
        OBCMaxChrgVoltage: ComSignalType=UINT16, ComBitSize=14, ComBitPosition=31, ComHandleId=36, ComNotification=Rte_COMCbk_OBCMaxChrgVoltage, ComTimeoutNotification=Rte_COMCbkTOut_OBCMaxChrgVoltage, ComSystemTemplateSystemSignalRef=OBCMaxChrgVoltage
        OBCMaxChrgCurrent: ComSignalType=UINT16, ComBitSize=10, ComBitPosition=33, ComHandleId=37, ComNotification=Rte_COMCbk_OBCMaxChrgCurrent, ComTimeoutNotification=Rte_COMCbkTOut_OBCMaxChrgCurrent, ComSystemTemplateSystemSignalRef=OBCMaxChrgCurrent
        OBCStatus: ComSignalType=UINT8, ComBitSize=3, ComBitPosition=50, ComHandleId=38, ComNotification=Rte_COMCbk_OBCStatus, ComTimeoutNotification=Rte_COMCbkTOut_OBCStatus, ComSystemTemplateSystemSignalRef=OBCStatus
        OBCCurrentFltCode: ComSignalType=UINT8, ComBitSize=5, ComBitPosition=55, ComHandleId=39, ComNotification=Rte_COMCbk_OBCCurrentFltCode, ComTimeoutNotification=Rte_COMCbkTOut_OBCCurrentFltCode, ComSystemTemplateSystemSignalRef=OBCCurrentFltCode
        OBCHistoryFltCode: ComSignalType=UINT8, ComBitSize=5, ComBitPosition=61, ComHandleId=40, ComNotification=Rte_COMCbk_OBCHistoryFltCode, ComTimeoutNotification=Rte_COMCbkTOut_OBCHistoryFltCode, ComSystemTemplateSystemSignalRef=OBCHistoryFltCode
      VCU_IPK_362h_Can_Network_CANNODE_0 (ComIPdu):
        ComIPduSignalProcessing = IMMEDIATE
        ComIPduType = NORMAL
        ComIPduDirection = RECEIVE
        ComFirstTimeout = 0.0
        ComTimeout = 10.0
        ComIpduNotificationCallback = Com_RxCbk_VCU_IPK_362h_Can_Network_CANNODE_0
        ComIPduErrorNotification = Com_RxTOCbk_VCU_IPK_362h_Can_Network_CANNODE_0
        ComIPduGroupRef = ComIPduGroup_Rx
        ComPduIdRef = PduCollection/VCU_IPK_362h_Can_Network_CANNODE_0_PduR2Com
        ComIPduSignalRef = HighPreVehOdo
        ComIPduSignalRef = HighPreVehOdoV
      HighPreVehOdo (ComSignal):
        ComSignalInitValue = 0
        ComSignalType = UINT32
        ComSignalEndianness = BIG_ENDIAN
        ComBitSize = 24
        ComBitPosition = 7
        ComUpdateBitPosition = -1
        ComTransferProperty = TRIGGERED
        ComHandleId = 41
        ComNotification = Rte_COMCbk_HighPreVehOdo
        ComTimeoutNotification = Rte_COMCbkTOut_HighPreVehOdo
        ComSystemTemplateSystemSignalRef = HighPreVehOdo
      HighPreVehOdoV (ComSignal):
        ComSignalInitValue = 0
        ComSignalType = BOOLEAN
        ComSignalEndianness = BIG_ENDIAN
        ComBitSize = 1
        ComBitPosition = 31
        ComUpdateBitPosition = -1
        ComTransferProperty = TRIGGERED
        ComHandleId = 42
        ComNotification = Rte_COMCbk_HighPreVehOdoV
        ComTimeoutNotification = Rte_COMCbkTOut_HighPreVehOdoV
        ComSystemTemplateSystemSignalRef = HighPreVehOdoV
      ComIPduGroup_Tx (ComIPduGroup): ComIPduGroupHandleId=1
      BMS_329h_Can_Network_CANNODE_0 (ComIPdu):
        ComIPduSignalProcessing = IMMEDIATE
        ComIPduType = NORMAL
        ComIPduDirection = SEND
        ComFirstTimeout = 0.1
        ComTimeout = 0.1
        ComIPduGroupRef = ComIPduGroup_Tx
        ComPduIdRef = PduCollection/BMS_329h_Can_Network_CANNODE_0_Com2PduR
        ComIPduSignalRef = MesCellTempNumIndex
        ComIPduSignalRef = CellTempMes{1..7}
        ComTxIPdu: ComMinimumDelayTime=0.0, ComTxIPduUnusedAreasDefault=255
          ComTxModeTrue
            ComTxMode: ComTxModeTimePeriod=0.1, ComTxModeMode=PERIODIC, ComTxModeNumberOfRepetitions=0, ComTxModeRepetitionPeriod=0, ComTxModeTimeOffset=0.0
          ComTxModeFalse
            ComTxMode: ComTxModeTimePeriod=0.1, ComTxModeMode=PERIODIC, ComTxModeNumberOfRepetitions=0, ComTxModeRepetitionPeriod=0, ComTxModeTimeOffset=0.0
      8 x ComSignal, all with ComSignalType=UINT8, ComSignalEndianness=BIG_ENDIAN, ComBitSize=8, ComUpdateBitPosition=-1, ComTransferProperty=TRIGGERED:
        MesCellTempNumIndex: ComSignalInitValue=1, ComBitPosition=7, ComHandleId=0, ComSystemTemplateSystemSignalRef=MesCellTempNumIndex
        CellTempMes1: ComSignalInitValue=0, ComBitPosition=15, ComHandleId=1, ComSystemTemplateSystemSignalRef=CellTempMes1
        CellTempMes2: ComSignalInitValue=0, ComBitPosition=23, ComHandleId=2, ComSystemTemplateSystemSignalRef=CellTempMes2
        CellTempMes3: ComSignalInitValue=0, ComBitPosition=31, ComHandleId=3, ComSystemTemplateSystemSignalRef=CellTempMes3
        CellTempMes4: ComSignalInitValue=0, ComBitPosition=39, ComHandleId=4, ComSystemTemplateSystemSignalRef=CellTempMes4
        CellTempMes5: ComSignalInitValue=0, ComBitPosition=47, ComHandleId=5, ComSystemTemplateSystemSignalRef=CellTempMes5
        CellTempMes6: ComSignalInitValue=0, ComBitPosition=55, ComHandleId=6, ComSystemTemplateSystemSignalRef=CellTempMes6
        CellTempMes7: ComSignalInitValue=0, ComBitPosition=63, ComHandleId=7, ComSystemTemplateSystemSignalRef=CellTempMes7
      BMS_503h_Can_Network_CANNODE_0 (ComIPdu):
        ComIPduSignalProcessing = IMMEDIATE
        ComIPduType = NORMAL
        ComIPduDirection = SEND
        ComFirstTimeout = 0.1
        ComTimeout = 0.1
        ComIPduGroupRef = ComIPduGroup_Tx
        ComPduIdRef = PduCollection/BMS_503h_Can_Network_CANNODE_0_Com2PduR
        ComIPduSignalRef = BMSCellQuantity
        ComIPduSignalRef = BMSTempProbeQuantity
        ComIPduSignalRef = RealSOC
        ComIPduSignalRef = HVIsoValue
        ComTxIPdu: ComMinimumDelayTime=0.0, ComTxIPduUnusedAreasDefault=255
          ComTxModeTrue
            ComTxMode: ComTxModeTimePeriod=0.1, ComTxModeMode=PERIODIC, ComTxModeNumberOfRepetitions=0, ComTxModeRepetitionPeriod=0, ComTxModeTimeOffset=0.0
          ComTxModeFalse
            ComTxMode: ComTxModeTimePeriod=0.1, ComTxModeMode=PERIODIC, ComTxModeNumberOfRepetitions=0, ComTxModeRepetitionPeriod=0, ComTxModeTimeOffset=0.0
      4 x ComSignal, all with ComSignalEndianness=BIG_ENDIAN, ComUpdateBitPosition=-1, ComTransferProperty=TRIGGERED:
        BMSCellQuantity: ComSignalInitValue=1, ComSignalType=UINT8, ComBitSize=8, ComBitPosition=7, ComHandleId=8, ComSystemTemplateSystemSignalRef=BMSCellQuantity
        BMSTempProbeQuantity: ComSignalInitValue=1, ComSignalType=UINT8, ComBitSize=8, ComBitPosition=31, ComHandleId=9, ComSystemTemplateSystemSignalRef=BMSTempProbeQuantity
        RealSOC: ComSignalInitValue=0, ComSignalType=UINT16, ComBitSize=16, ComBitPosition=15, ComHandleId=10, ComSystemTemplateSystemSignalRef=RealSOC
        HVIsoValue: ComSignalInitValue=0, ComSignalType=UINT16, ComBitSize=13, ComBitPosition=36, ComHandleId=11, ComSystemTemplateSystemSignalRef=HVIsoValue
      BMS_501h_Can_Network_CANNODE_0 (ComIPdu):
        ComIPduSignalProcessing = IMMEDIATE
        ComIPduType = NORMAL
        ComIPduDirection = SEND
        ComFirstTimeout = 0.1
        ComTimeout = 0.1
        ComIPduGroupRef = ComIPduGroup_Tx
        ComPduIdRef = PduCollection/BMS_501h_Can_Network_CANNODE_0_Com2PduR
        ComIPduSignalRef = HVIsoWarning
        ComIPduSignalRef = HVILWarning
        ComIPduSignalRef = SOCLowWarning
        ComIPduSignalRef = TempDiffWarning
        ComIPduSignalRef = TempHighWarning
        ComIPduSignalRef = PackOvWarning
        ComIPduSignalRef = PackUvWarning
        ComIPduSignalRef = CellOvWarning
        ComIPduSignalRef = CellUvWarning
        ComIPduSignalRef = SOCHighWarning
        ComIPduSignalRef = SOCFastChgWarning
        ComIPduSignalRef = PwrBatPackMismatchWarning
        ComIPduSignalRef = BMSCelConsistencyWarning
        ComIPduSignalRef = BMSVolHighWarning
        ComIPduSignalRef = EnergyConsumptionPer
        ComIPduSignalRef = RestEnergy
        ComIPduSignalRef = ThermalAlarm
        ComIPduSignalRef = ThermalAlarmV
        ComTxIPdu: ComMinimumDelayTime=0.0, ComTxIPduUnusedAreasDefault=255
          ComTxModeTrue
            ComTxMode: ComTxModeTimePeriod=0.1, ComTxModeMode=PERIODIC, ComTxModeNumberOfRepetitions=0, ComTxModeRepetitionPeriod=0, ComTxModeTimeOffset=0.0
          ComTxModeFalse
            ComTxMode: ComTxModeTimePeriod=0.1, ComTxModeMode=PERIODIC, ComTxModeNumberOfRepetitions=0, ComTxModeRepetitionPeriod=0, ComTxModeTimeOffset=0.0
      18 x ComSignal, all with ComSignalInitValue=0, ComSignalEndianness=BIG_ENDIAN, ComUpdateBitPosition=-1, ComTransferProperty=TRIGGERED:
        HVIsoWarning: ComSignalType=UINT8, ComBitSize=2, ComBitPosition=1, ComHandleId=12, ComSystemTemplateSystemSignalRef=HVIsoWarning
        HVILWarning: ComSignalType=BOOLEAN, ComBitSize=1, ComBitPosition=2, ComHandleId=13, ComSystemTemplateSystemSignalRef=HVILWarning
        SOCLowWarning: ComSignalType=UINT8, ComBitSize=2, ComBitPosition=4, ComHandleId=14, ComSystemTemplateSystemSignalRef=SOCLowWarning
        TempDiffWarning: ComSignalType=BOOLEAN, ComBitSize=1, ComBitPosition=5, ComHandleId=15, ComSystemTemplateSystemSignalRef=TempDiffWarning
        TempHighWarning: ComSignalType=BOOLEAN, ComBitSize=1, ComBitPosition=6, ComHandleId=16, ComSystemTemplateSystemSignalRef=TempHighWarning
        PackOvWarning: ComSignalType=BOOLEAN, ComBitSize=1, ComBitPosition=7, ComHandleId=17, ComSystemTemplateSystemSignalRef=PackOvWarning
        PackUvWarning: ComSignalType=BOOLEAN, ComBitSize=1, ComBitPosition=8, ComHandleId=18, ComSystemTemplateSystemSignalRef=PackUvWarning
        CellOvWarning: ComSignalType=BOOLEAN, ComBitSize=1, ComBitPosition=9, ComHandleId=19, ComSystemTemplateSystemSignalRef=CellOvWarning
        CellUvWarning: ComSignalType=BOOLEAN, ComBitSize=1, ComBitPosition=10, ComHandleId=20, ComSystemTemplateSystemSignalRef=CellUvWarning
        SOCHighWarning: ComSignalType=BOOLEAN, ComBitSize=1, ComBitPosition=11, ComHandleId=21, ComSystemTemplateSystemSignalRef=SOCHighWarning
        SOCFastChgWarning: ComSignalType=BOOLEAN, ComBitSize=1, ComBitPosition=12, ComHandleId=22, ComSystemTemplateSystemSignalRef=SOCFastChgWarning
        PwrBatPackMismatchWarning: ComSignalType=BOOLEAN, ComBitSize=1, ComBitPosition=13, ComHandleId=23, ComSystemTemplateSystemSignalRef=PwrBatPackMismatchWarning
        BMSCelConsistencyWarning: ComSignalType=BOOLEAN, ComBitSize=1, ComBitPosition=14, ComHandleId=24, ComSystemTemplateSystemSignalRef=BMSCelConsistencyWarning
        BMSVolHighWarning: ComSignalType=BOOLEAN, ComBitSize=1, ComBitPosition=15, ComHandleId=25, ComSystemTemplateSystemSignalRef=BMSVolHighWarning
        EnergyConsumptionPer: ComSignalType=UINT16, ComBitSize=16, ComBitPosition=23, ComHandleId=26, ComSystemTemplateSystemSignalRef=EnergyConsumptionPer
        RestEnergy: ComSignalType=UINT16, ComBitSize=16, ComBitPosition=39, ComHandleId=27, ComSystemTemplateSystemSignalRef=RestEnergy
        ThermalAlarm: ComSignalType=BOOLEAN, ComBitSize=1, ComBitPosition=48, ComHandleId=28, ComSystemTemplateSystemSignalRef=ThermalAlarm
        ThermalAlarmV: ComSignalType=BOOLEAN, ComBitSize=1, ComBitPosition=49, ComHandleId=29, ComSystemTemplateSystemSignalRef=ThermalAlarmV
      BMS_1D8h_Can_Network_CANNODE_0 (ComIPdu):
        ComIPduSignalProcessing = IMMEDIATE
        ComIPduType = NORMAL
        ComIPduDirection = SEND
        ComFirstTimeout = 0.01
        ComTimeout = 0.01
        ComIPduGroupRef = ComIPduGroup_Tx
        ComPduIdRef = PduCollection/BMS_1D8h_Can_Network_CANNODE_0_Com2PduR
        ComIPduSignalRef = HVCntctrStat
        ComIPduSignalRef = HVBatFltSevrtyStat
        ComIPduSignalRef = HVCntctrStatARC
        ComIPduSignalRef = ChrgrStatPTHVCntctrReq
        ComIPduSignalRef = HVBatPrcdCrntV
        ComIPduSignalRef = HVBatPrcdCrnt
        ComIPduSignalRef = BMSlightReq
        ComTxIPdu: ComMinimumDelayTime=0.0, ComTxIPduUnusedAreasDefault=255
          ComTxModeTrue
            ComTxMode: ComTxModeTimePeriod=0.01, ComTxModeMode=PERIODIC, ComTxModeNumberOfRepetitions=0, ComTxModeRepetitionPeriod=0, ComTxModeTimeOffset=0.0
          ComTxModeFalse
            ComTxMode: ComTxModeTimePeriod=0.01, ComTxModeMode=PERIODIC, ComTxModeNumberOfRepetitions=0, ComTxModeRepetitionPeriod=0, ComTxModeTimeOffset=0.0
      7 x ComSignal, all with ComSignalInitValue=0, ComSignalEndianness=BIG_ENDIAN, ComUpdateBitPosition=-1, ComTransferProperty=TRIGGERED:
        HVCntctrStat: ComSignalType=UINT8, ComBitSize=3, ComBitPosition=2, ComHandleId=30, ComSystemTemplateSystemSignalRef=HVCntctrStat
        HVBatFltSevrtyStat: ComSignalType=UINT8, ComBitSize=3, ComBitPosition=34, ComHandleId=31, ComSystemTemplateSystemSignalRef=HVBatFltSevrtyStat
        HVCntctrStatARC: ComSignalType=UINT8, ComBitSize=2, ComBitPosition=37, ComHandleId=32, ComSystemTemplateSystemSignalRef=HVCntctrStatARC
        ChrgrStatPTHVCntctrReq: ComSignalType=UINT8, ComBitSize=2, ComBitPosition=4, ComHandleId=33, ComSystemTemplateSystemSignalRef=ChrgrStatPTHVCntctrReq
        HVBatPrcdCrntV: ComSignalType=BOOLEAN, ComBitSize=1, ComBitPosition=54, ComHandleId=34, ComSystemTemplateSystemSignalRef=HVBatPrcdCrntV
        HVBatPrcdCrnt: ComSignalType=UINT16, ComBitSize=14, ComBitPosition=53, ComHandleId=35, ComSystemTemplateSystemSignalRef=HVBatPrcdCrnt
        BMSlightReq: ComSignalType=BOOLEAN, ComBitSize=1, ComBitPosition=35, ComHandleId=36, ComSystemTemplateSystemSignalRef=BMSlightReq
      BMS_795h_Can_Network_CANNODE_0 (ComIPdu):
        ComIPduSignalProcessing = IMMEDIATE
        ComIPduType = NORMAL
        ComIPduDirection = SEND
        ComFirstTimeout = 0.0
        ComTimeout = 0.0
        ComIPduGroupRef = ComIPduGroup_Tx
        ComPduIdRef = PduCollection/BMS_795h_Can_Network_CANNODE_0_Com2PduR
        ComIPduSignalRef = BMSDTCSeriousLevel
        ComIPduSignalRef = BMSDTCHighByte
        ComIPduSignalRef = BMSDTCLowByte
        ComIPduSignalRef = BMSDTCFailureTypeByte
        ComIPduSignalRef = BMSDTCStatus
        ComIPduSignalRef = BMSDTCType
        ComTxIPdu: ComMinimumDelayTime=0.0, ComTxIPduUnusedAreasDefault=255
          ComTxModeTrue
            ComTxMode: ComTxModeTimePeriod=0, ComTxModeMode=DIRECT, ComTxModeNumberOfRepetitions=0, ComTxModeRepetitionPeriod=0, ComTxModeTimeOffset=0
          ComTxModeFalse
            ComTxMode: ComTxModeTimePeriod=0, ComTxModeMode=DIRECT, ComTxModeNumberOfRepetitions=0, ComTxModeRepetitionPeriod=0, ComTxModeTimeOffset=0
      6 x ComSignal, all with ComSignalInitValue=0, ComSignalType=UINT8, ComSignalEndianness=BIG_ENDIAN, ComUpdateBitPosition=-1, ComTransferProperty=TRIGGERED:
        BMSDTCSeriousLevel: ComBitSize=4, ComBitPosition=3, ComHandleId=37, ComSystemTemplateSystemSignalRef=BMSDTCSeriousLevel
        BMSDTCHighByte: ComBitSize=8, ComBitPosition=15, ComHandleId=38, ComSystemTemplateSystemSignalRef=BMSDTCHighByte
        BMSDTCLowByte: ComBitSize=8, ComBitPosition=23, ComHandleId=39, ComSystemTemplateSystemSignalRef=BMSDTCLowByte
        BMSDTCFailureTypeByte: ComBitSize=8, ComBitPosition=31, ComHandleId=40, ComSystemTemplateSystemSignalRef=BMSDTCFailureTypeByte
        BMSDTCStatus: ComBitSize=8, ComBitPosition=39, ComHandleId=41, ComSystemTemplateSystemSignalRef=BMSDTCStatus
        BMSDTCType: ComBitSize=8, ComBitPosition=47, ComHandleId=42, ComSystemTemplateSystemSignalRef=BMSDTCType
      BMS_3D7h_Can_Network_CANNODE_0 (ComIPdu):
        ComIPduSignalProcessing = IMMEDIATE
        ComIPduType = NORMAL
        ComIPduDirection = SEND
        ComFirstTimeout = 0.01
        ComTimeout = 0.01
        ComIPduGroupRef = ComIPduGroup_Tx
        ComPduIdRef = PduCollection/BMS_3D7h_Can_Network_CANNODE_0_Com2PduR
        ComIPduSignalRef = HVBatPackPrcdVltgV
        ComIPduSignalRef = HVBatPackPrcdVltg
        ComTxIPdu: ComMinimumDelayTime=0.0, ComTxIPduUnusedAreasDefault=255
          ComTxModeTrue
            ComTxMode: ComTxModeTimePeriod=0.01, ComTxModeMode=PERIODIC, ComTxModeNumberOfRepetitions=0, ComTxModeRepetitionPeriod=0, ComTxModeTimeOffset=0.0
          ComTxModeFalse
            ComTxMode: ComTxModeTimePeriod=0.01, ComTxModeMode=PERIODIC, ComTxModeNumberOfRepetitions=0, ComTxModeRepetitionPeriod=0, ComTxModeTimeOffset=0.0
      HVBatPackPrcdVltgV (ComSignal):
        ComSignalInitValue = 0
        ComSignalType = BOOLEAN
        ComSignalEndianness = BIG_ENDIAN
        ComBitSize = 1
        ComBitPosition = 5
        ComUpdateBitPosition = -1
        ComTransferProperty = TRIGGERED
        ComHandleId = 43
        ComSystemTemplateSystemSignalRef = HVBatPackPrcdVltgV
      HVBatPackPrcdVltg (ComSignal):
        ComSignalInitValue = 0
        ComSignalType = UINT16
        ComSignalEndianness = BIG_ENDIAN
        ComBitSize = 13
        ComBitPosition = 4
        ComUpdateBitPosition = -1
        ComTransferProperty = TRIGGERED
        ComHandleId = 44
        ComSystemTemplateSystemSignalRef = HVBatPackPrcdVltg
      BMS_606h_Can_Network_CANNODE_0 (ComIPdu):
        ComIPduSignalProcessing = IMMEDIATE
        ComIPduType = NORMAL
        ComIPduDirection = SEND
        ComFirstTimeout = 0.0
        ComTimeout = 0.0
        ComIPduGroupRef = ComIPduGroup_Tx
        ComPduIdRef = PduCollection/BMS_606h_Can_Network_CANNODE_0_Com2PduR
        ComIPduSignalRef = StopChargingReson
        ComIPduSignalRef = BEM_CRM00
        ComIPduSignalRef = BEM_CRMAA
        ComIPduSignalRef = BEM_CML
        ComIPduSignalRef = BEM_CRO
        ComIPduSignalRef = BEM_CCS
        ComIPduSignalRef = BEM_CST
        ComIPduSignalRef = BEM_CSD
        ComIPduSignalRef = BEM_Other
        ComIPduSignalRef = CEM_BRM
        ComIPduSignalRef = CEM_BCP
        ComIPduSignalRef = CEM_BRO
        ComIPduSignalRef = CEM_BCS
        ComIPduSignalRef = CEM_BCL
        ComIPduSignalRef = CEM_BST
        ComIPduSignalRef = CEM_BSD
        ComIPduSignalRef = CEM_Other
        ComIPduSignalRef = BMSStopChargeFaultCode{1..8}
        ComIPduSignalRef = CHGStopChargeFaultCode{1..8}
        ComTxIPdu: ComMinimumDelayTime=0.0, ComTxIPduUnusedAreasDefault=255
          ComTxModeTrue
            ComTxMode: ComTxModeTimePeriod=0, ComTxModeMode=DIRECT, ComTxModeNumberOfRepetitions=0, ComTxModeRepetitionPeriod=0, ComTxModeTimeOffset=0
          ComTxModeFalse
            ComTxMode: ComTxModeTimePeriod=0, ComTxModeMode=DIRECT, ComTxModeNumberOfRepetitions=0, ComTxModeRepetitionPeriod=0, ComTxModeTimeOffset=0
      33 x ComSignal, all with ComSignalInitValue=0, ComSignalEndianness=BIG_ENDIAN, ComUpdateBitPosition=-1, ComTransferProperty=TRIGGERED:
        StopChargingReson: ComSignalType=UINT8, ComBitSize=4, ComBitPosition=7, ComHandleId=45, ComSystemTemplateSystemSignalRef=StopChargingReson
        BEM_CRM00: ComSignalType=BOOLEAN, ComBitSize=1, ComBitPosition=3, ComHandleId=46, ComSystemTemplateSystemSignalRef=BEM_CRM00
        BEM_CRMAA: ComSignalType=BOOLEAN, ComBitSize=1, ComBitPosition=2, ComHandleId=47, ComSystemTemplateSystemSignalRef=BEM_CRMAA
        BEM_CML: ComSignalType=BOOLEAN, ComBitSize=1, ComBitPosition=1, ComHandleId=48, ComSystemTemplateSystemSignalRef=BEM_CML
        BEM_CRO: ComSignalType=BOOLEAN, ComBitSize=1, ComBitPosition=0, ComHandleId=49, ComSystemTemplateSystemSignalRef=BEM_CRO
        BEM_CCS: ComSignalType=BOOLEAN, ComBitSize=1, ComBitPosition=15, ComHandleId=50, ComSystemTemplateSystemSignalRef=BEM_CCS
        BEM_CST: ComSignalType=BOOLEAN, ComBitSize=1, ComBitPosition=14, ComHandleId=51, ComSystemTemplateSystemSignalRef=BEM_CST
        BEM_CSD: ComSignalType=BOOLEAN, ComBitSize=1, ComBitPosition=13, ComHandleId=52, ComSystemTemplateSystemSignalRef=BEM_CSD
        BEM_Other: ComSignalType=BOOLEAN, ComBitSize=1, ComBitPosition=12, ComHandleId=53, ComSystemTemplateSystemSignalRef=BEM_Other
        CEM_BRM: ComSignalType=BOOLEAN, ComBitSize=1, ComBitPosition=11, ComHandleId=54, ComSystemTemplateSystemSignalRef=CEM_BRM
        CEM_BCP: ComSignalType=BOOLEAN, ComBitSize=1, ComBitPosition=10, ComHandleId=55, ComSystemTemplateSystemSignalRef=CEM_BCP
        CEM_BRO: ComSignalType=BOOLEAN, ComBitSize=1, ComBitPosition=9, ComHandleId=56, ComSystemTemplateSystemSignalRef=CEM_BRO
        CEM_BCS: ComSignalType=BOOLEAN, ComBitSize=1, ComBitPosition=8, ComHandleId=57, ComSystemTemplateSystemSignalRef=CEM_BCS
        CEM_BCL: ComSignalType=BOOLEAN, ComBitSize=1, ComBitPosition=23, ComHandleId=58, ComSystemTemplateSystemSignalRef=CEM_BCL
        CEM_BST: ComSignalType=BOOLEAN, ComBitSize=1, ComBitPosition=22, ComHandleId=59, ComSystemTemplateSystemSignalRef=CEM_BST
        CEM_BSD: ComSignalType=BOOLEAN, ComBitSize=1, ComBitPosition=21, ComHandleId=60, ComSystemTemplateSystemSignalRef=CEM_BSD
        CEM_Other: ComSignalType=BOOLEAN, ComBitSize=1, ComBitPosition=20, ComHandleId=61, ComSystemTemplateSystemSignalRef=CEM_Other
        BMSStopChargeFaultCode1: ComSignalType=BOOLEAN, ComBitSize=1, ComBitPosition=19, ComHandleId=62, ComSystemTemplateSystemSignalRef=BMSStopChargeFaultCode1
        BMSStopChargeFaultCode2: ComSignalType=BOOLEAN, ComBitSize=1, ComBitPosition=18, ComHandleId=63, ComSystemTemplateSystemSignalRef=BMSStopChargeFaultCode2
        BMSStopChargeFaultCode3: ComSignalType=BOOLEAN, ComBitSize=1, ComBitPosition=17, ComHandleId=64, ComSystemTemplateSystemSignalRef=BMSStopChargeFaultCode3
        BMSStopChargeFaultCode4: ComSignalType=BOOLEAN, ComBitSize=1, ComBitPosition=31, ComHandleId=65, ComSystemTemplateSystemSignalRef=BMSStopChargeFaultCode4
        BMSStopChargeFaultCode5: ComSignalType=BOOLEAN, ComBitSize=1, ComBitPosition=30, ComHandleId=66, ComSystemTemplateSystemSignalRef=BMSStopChargeFaultCode5
        BMSStopChargeFaultCode6: ComSignalType=BOOLEAN, ComBitSize=1, ComBitPosition=29, ComHandleId=67, ComSystemTemplateSystemSignalRef=BMSStopChargeFaultCode6
        BMSStopChargeFaultCode7: ComSignalType=BOOLEAN, ComBitSize=1, ComBitPosition=28, ComHandleId=68, ComSystemTemplateSystemSignalRef=BMSStopChargeFaultCode7
        BMSStopChargeFaultCode8: ComSignalType=BOOLEAN, ComBitSize=1, ComBitPosition=27, ComHandleId=69, ComSystemTemplateSystemSignalRef=BMSStopChargeFaultCode8
        CHGStopChargeFaultCode1: ComSignalType=BOOLEAN, ComBitSize=1, ComBitPosition=26, ComHandleId=70, ComSystemTemplateSystemSignalRef=CHGStopChargeFaultCode1
        CHGStopChargeFaultCode2: ComSignalType=BOOLEAN, ComBitSize=1, ComBitPosition=25, ComHandleId=71, ComSystemTemplateSystemSignalRef=CHGStopChargeFaultCode2
        CHGStopChargeFaultCode3: ComSignalType=BOOLEAN, ComBitSize=1, ComBitPosition=24, ComHandleId=72, ComSystemTemplateSystemSignalRef=CHGStopChargeFaultCode3
        CHGStopChargeFaultCode4: ComSignalType=BOOLEAN, ComBitSize=1, ComBitPosition=39, ComHandleId=73, ComSystemTemplateSystemSignalRef=CHGStopChargeFaultCode4
        CHGStopChargeFaultCode5: ComSignalType=BOOLEAN, ComBitSize=1, ComBitPosition=38, ComHandleId=74, ComSystemTemplateSystemSignalRef=CHGStopChargeFaultCode5
        CHGStopChargeFaultCode6: ComSignalType=BOOLEAN, ComBitSize=1, ComBitPosition=37, ComHandleId=75, ComSystemTemplateSystemSignalRef=CHGStopChargeFaultCode6
        CHGStopChargeFaultCode7: ComSignalType=BOOLEAN, ComBitSize=1, ComBitPosition=36, ComHandleId=76, ComSystemTemplateSystemSignalRef=CHGStopChargeFaultCode7
        CHGStopChargeFaultCode8: ComSignalType=BOOLEAN, ComBitSize=1, ComBitPosition=35, ComHandleId=77, ComSystemTemplateSystemSignalRef=CHGStopChargeFaultCode8
      BMS_598h_Can_Network_CANNODE_0 (ComIPdu):
        ComIPduSignalProcessing = IMMEDIATE
        ComIPduType = NORMAL
        ComIPduDirection = SEND
        ComFirstTimeout = 0.1
        ComTimeout = 0.1
        ComIPduGroupRef = ComIPduGroup_Tx
        ComPduIdRef = PduCollection/BMS_598h_Can_Network_CANNODE_0_Com2PduR
        ComIPduSignalRef = BatLf
        ComIPduSignalRef = ChrgPlugStatus
        ComIPduSignalRef = PreChrgUnitRdy
        ComIPduSignalRef = BMSChrgStatus
        ComIPduSignalRef = HVSystemStatus
        ComIPduSignalRef = TotalBatteryCap
        ComTxIPdu: ComMinimumDelayTime=0.0, ComTxIPduUnusedAreasDefault=255
          ComTxModeTrue
            ComTxMode: ComTxModeTimePeriod=0.1, ComTxModeMode=PERIODIC, ComTxModeNumberOfRepetitions=0, ComTxModeRepetitionPeriod=0, ComTxModeTimeOffset=0.0
          ComTxModeFalse
            ComTxMode: ComTxModeTimePeriod=0.1, ComTxModeMode=PERIODIC, ComTxModeNumberOfRepetitions=0, ComTxModeRepetitionPeriod=0, ComTxModeTimeOffset=0.0
      6 x ComSignal, all with ComSignalInitValue=0, ComSignalEndianness=BIG_ENDIAN, ComUpdateBitPosition=-1, ComTransferProperty=TRIGGERED:
        BatLf: ComSignalType=UINT8, ComBitSize=8, ComBitPosition=7, ComHandleId=78, ComSystemTemplateSystemSignalRef=BatLf
        ChrgPlugStatus: ComSignalType=BOOLEAN, ComBitSize=1, ComBitPosition=8, ComHandleId=79, ComSystemTemplateSystemSignalRef=ChrgPlugStatus
        PreChrgUnitRdy: ComSignalType=BOOLEAN, ComBitSize=1, ComBitPosition=10, ComHandleId=80, ComSystemTemplateSystemSignalRef=PreChrgUnitRdy
        BMSChrgStatus: ComSignalType=UINT8, ComBitSize=3, ComBitPosition=13, ComHandleId=81, ComSystemTemplateSystemSignalRef=BMSChrgStatus
        HVSystemStatus: ComSignalType=UINT8, ComBitSize=4, ComBitPosition=23, ComHandleId=82, ComSystemTemplateSystemSignalRef=HVSystemStatus
        TotalBatteryCap: ComSignalType=UINT16, ComBitSize=16, ComBitPosition=31, ComHandleId=83, ComSystemTemplateSystemSignalRef=TotalBatteryCap
      BMS_509h_Can_Network_CANNODE_0 (ComIPdu):
        ComIPduSignalProcessing = IMMEDIATE
        ComIPduType = NORMAL
        ComIPduDirection = SEND
        ComFirstTimeout = 0.5
        ComTimeout = 0.5
        ComIPduGroupRef = ComIPduGroup_Tx
        ComPduIdRef = PduCollection/BMS_509h_Can_Network_CANNODE_0_Com2PduR
        ComIPduSignalRef = RechgEnergyStorSysNumb
        ComIPduSignalRef = CurRechgEnergyStorSysIndex
        ComIPduSignalRef = RechgEnergyStorSysCodeLength
        ComIPduSignalRef = RechgEnergyStorSysCodeIndex
        ComIPduSignalRef = RechgEnergyStorSysCode{1..6}
        ComTxIPdu: ComMinimumDelayTime=0.0, ComTxIPduUnusedAreasDefault=255
          ComTxModeTrue
            ComTxMode: ComTxModeTimePeriod=0.5, ComTxModeMode=PERIODIC, ComTxModeNumberOfRepetitions=0, ComTxModeRepetitionPeriod=0, ComTxModeTimeOffset=0.0
          ComTxModeFalse
            ComTxMode: ComTxModeTimePeriod=0.5, ComTxModeMode=PERIODIC, ComTxModeNumberOfRepetitions=0, ComTxModeRepetitionPeriod=0, ComTxModeTimeOffset=0.0
      10 x ComSignal, all with ComSignalType=UINT8, ComSignalEndianness=BIG_ENDIAN, ComUpdateBitPosition=-1, ComTransferProperty=TRIGGERED:
        RechgEnergyStorSysNumb: ComSignalInitValue=1, ComBitSize=4, ComBitPosition=3, ComHandleId=84, ComSystemTemplateSystemSignalRef=RechgEnergyStorSysNumb
        CurRechgEnergyStorSysIndex: ComSignalInitValue=1, ComBitSize=4, ComBitPosition=7, ComHandleId=85, ComSystemTemplateSystemSignalRef=CurRechgEnergyStorSysIndex
        RechgEnergyStorSysCodeLength: ComSignalInitValue=1, ComBitSize=5, ComBitPosition=12, ComHandleId=86, ComSystemTemplateSystemSignalRef=RechgEnergyStorSysCodeLength
        RechgEnergyStorSysCodeIndex: ComSignalInitValue=1, ComBitSize=3, ComBitPosition=15, ComHandleId=87, ComSystemTemplateSystemSignalRef=RechgEnergyStorSysCodeIndex
        RechgEnergyStorSysCode1: ComSignalInitValue=0, ComBitSize=8, ComBitPosition=23, ComHandleId=88, ComSystemTemplateSystemSignalRef=RechgEnergyStorSysCode1
        RechgEnergyStorSysCode2: ComSignalInitValue=0, ComBitSize=8, ComBitPosition=31, ComHandleId=89, ComSystemTemplateSystemSignalRef=RechgEnergyStorSysCode2
        RechgEnergyStorSysCode3: ComSignalInitValue=0, ComBitSize=8, ComBitPosition=39, ComHandleId=90, ComSystemTemplateSystemSignalRef=RechgEnergyStorSysCode3
        RechgEnergyStorSysCode4: ComSignalInitValue=0, ComBitSize=8, ComBitPosition=47, ComHandleId=91, ComSystemTemplateSystemSignalRef=RechgEnergyStorSysCode4
        RechgEnergyStorSysCode5: ComSignalInitValue=0, ComBitSize=8, ComBitPosition=55, ComHandleId=92, ComSystemTemplateSystemSignalRef=RechgEnergyStorSysCode5
        RechgEnergyStorSysCode6: ComSignalInitValue=0, ComBitSize=8, ComBitPosition=63, ComHandleId=93, ComSystemTemplateSystemSignalRef=RechgEnergyStorSysCode6
      BMS_605h_Can_Network_CANNODE_0 (ComIPdu):
        ComIPduSignalProcessing = IMMEDIATE
        ComIPduType = NORMAL
        ComIPduDirection = SEND
        ComFirstTimeout = 0.0
        ComTimeout = 0.0
        ComIPduGroupRef = ComIPduGroup_Tx
        ComPduIdRef = PduCollection/BMS_605h_Can_Network_CANNODE_0_Com2PduR
        ComIPduSignalRef = FullChargeRemainingTime
        ComIPduSignalRef = RequestChargeCurrent
        ComIPduSignalRef = ChargingVoltage
        ComTxIPdu: ComMinimumDelayTime=0.0, ComTxIPduUnusedAreasDefault=255
          ComTxModeTrue
            ComTxMode: ComTxModeTimePeriod=0, ComTxModeMode=DIRECT, ComTxModeNumberOfRepetitions=0, ComTxModeRepetitionPeriod=0, ComTxModeTimeOffset=0
          ComTxModeFalse
            ComTxMode: ComTxModeTimePeriod=0, ComTxModeMode=DIRECT, ComTxModeNumberOfRepetitions=0, ComTxModeRepetitionPeriod=0, ComTxModeTimeOffset=0
      3 x ComSignal, all with ComSignalInitValue=0, ComSignalType=UINT16, ComSignalEndianness=BIG_ENDIAN, ComUpdateBitPosition=-1, ComTransferProperty=TRIGGERED:
        FullChargeRemainingTime: ComBitSize=10, ComBitPosition=7, ComHandleId=94, ComSystemTemplateSystemSignalRef=FullChargeRemainingTime
        RequestChargeCurrent: ComBitSize=9, ComBitPosition=23, ComHandleId=95, ComSystemTemplateSystemSignalRef=RequestChargeCurrent
        ChargingVoltage: ComBitSize=14, ComBitPosition=39, ComHandleId=96, ComSystemTemplateSystemSignalRef=ChargingVoltage
      BMS_7C8h_Can_Network_CANNODE_0 (ComIPdu):
        ComIPduSignalProcessing = IMMEDIATE
        ComIPduType = NORMAL
        ComIPduDirection = SEND
        ComFirstTimeout = 0.0
        ComTimeout = 0.0
        ComIPduGroupRef = ComIPduGroup_Tx
        ComPduIdRef = PduCollection/BMS_7C8h_Can_Network_CANNODE_0_Com2PduR
        ComIPduSignalRef = BMSDiagResponseData
        ComTxIPdu: ComMinimumDelayTime=0.0, ComTxIPduUnusedAreasDefault=255
          ComTxModeTrue
            ComTxMode: ComTxModeTimePeriod=0, ComTxModeMode=DIRECT, ComTxModeNumberOfRepetitions=0, ComTxModeRepetitionPeriod=0, ComTxModeTimeOffset=0
          ComTxModeFalse
            ComTxMode: ComTxModeTimePeriod=0, ComTxModeMode=DIRECT, ComTxModeNumberOfRepetitions=0, ComTxModeRepetitionPeriod=0, ComTxModeTimeOffset=0
      BMSDiagResponseData (ComSignal):
        ComSignalInitValue = 0
        ComSignalType = UINT8_N
        ComSignalEndianness = opaque
        ComSignalLength = 8
        ComBitSize = 64
        ComBitPosition = 0
        ComUpdateBitPosition = -1
        ComTransferProperty = TRIGGERED
        ComHandleId = 97
        ComSystemTemplateSystemSignalRef = BMSDiagResponseData
      BMS_596h_Can_Network_CANNODE_0 (ComIPdu):
        ComIPduSignalProcessing = IMMEDIATE
        ComIPduType = NORMAL
        ComIPduDirection = SEND
        ComFirstTimeout = 0.2
        ComTimeout = 0.2
        ComIPduGroupRef = ComIPduGroup_Tx
        ComPduIdRef = PduCollection/BMS_596h_Can_Network_CANNODE_0_Com2PduR
        ComIPduSignalRef = MaxBatTmp
        ComIPduSignalRef = MaxCellTempNumb
        ComIPduSignalRef = MinBatTmp
        ComIPduSignalRef = MinCellTempNumb
        ComTxIPdu: ComMinimumDelayTime=0.0, ComTxIPduUnusedAreasDefault=255
          ComTxModeTrue
            ComTxMode: ComTxModeTimePeriod=0.2, ComTxModeMode=PERIODIC, ComTxModeNumberOfRepetitions=0, ComTxModeRepetitionPeriod=0, ComTxModeTimeOffset=0.0
          ComTxModeFalse
            ComTxMode: ComTxModeTimePeriod=0.2, ComTxModeMode=PERIODIC, ComTxModeNumberOfRepetitions=0, ComTxModeRepetitionPeriod=0, ComTxModeTimeOffset=0.0
      4 x ComSignal, all with ComSignalType=UINT8, ComSignalEndianness=BIG_ENDIAN, ComBitSize=8, ComUpdateBitPosition=-1, ComTransferProperty=TRIGGERED:
        MaxBatTmp: ComSignalInitValue=0, ComBitPosition=7, ComHandleId=98, ComSystemTemplateSystemSignalRef=MaxBatTmp
        MaxCellTempNumb: ComSignalInitValue=1, ComBitPosition=15, ComHandleId=99, ComSystemTemplateSystemSignalRef=MaxCellTempNumb
        MinBatTmp: ComSignalInitValue=0, ComBitPosition=23, ComHandleId=100, ComSystemTemplateSystemSignalRef=MinBatTmp
        MinCellTempNumb: ComSignalInitValue=1, ComBitPosition=31, ComHandleId=101, ComSystemTemplateSystemSignalRef=MinCellTempNumb
      BMS_3DAh_Can_Network_CANNODE_0 (ComIPdu):
        ComIPduSignalProcessing = IMMEDIATE
        ComIPduType = NORMAL
        ComIPduDirection = SEND
        ComFirstTimeout = 0.01
        ComTimeout = 0.01
        ComIPduGroupRef = ComIPduGroup_Tx
        ComPduIdRef = PduCollection/BMS_3DAh_Can_Network_CANNODE_0_Com2PduR
        ComIPduSignalRef = HVBCP_LngTrmChrgPwr
        ComIPduSignalRef = HVBCP_CrnkChrgPwrV
        ComIPduSignalRef = HVBCP_ShrtTrmChrgPwr
        ComIPduSignalRef = ChrgPeakTimeFactor
        ComIPduSignalRef = HVBatSOCHiRes
        ComIPduSignalRef = BMSChecksum_3DAh
        ComTxIPdu: ComMinimumDelayTime=0.0, ComTxIPduUnusedAreasDefault=255
          ComTxModeTrue
            ComTxMode: ComTxModeTimePeriod=0.01, ComTxModeMode=PERIODIC, ComTxModeNumberOfRepetitions=0, ComTxModeRepetitionPeriod=0, ComTxModeTimeOffset=0.0
          ComTxModeFalse
            ComTxMode: ComTxModeTimePeriod=0.01, ComTxModeMode=PERIODIC, ComTxModeNumberOfRepetitions=0, ComTxModeRepetitionPeriod=0, ComTxModeTimeOffset=0.0
      6 x ComSignal, all with ComSignalInitValue=0, ComSignalEndianness=BIG_ENDIAN, ComUpdateBitPosition=-1, ComTransferProperty=TRIGGERED:
        HVBCP_LngTrmChrgPwr: ComSignalType=UINT16, ComBitSize=11, ComBitPosition=7, ComHandleId=102, ComSystemTemplateSystemSignalRef=HVBCP_LngTrmChrgPwr
        HVBCP_CrnkChrgPwrV: ComSignalType=BOOLEAN, ComBitSize=1, ComBitPosition=11, ComHandleId=103, ComSystemTemplateSystemSignalRef=HVBCP_CrnkChrgPwrV
        HVBCP_ShrtTrmChrgPwr: ComSignalType=UINT16, ComBitSize=11, ComBitPosition=10, ComHandleId=104, ComSystemTemplateSystemSignalRef=HVBCP_ShrtTrmChrgPwr
        ChrgPeakTimeFactor: ComSignalType=UINT8, ComBitSize=8, ComBitPosition=31, ComHandleId=105, ComSystemTemplateSystemSignalRef=ChrgPeakTimeFactor
        HVBatSOCHiRes: ComSignalType=UINT16, ComBitSize=16, ComBitPosition=39, ComHandleId=106, ComSystemTemplateSystemSignalRef=HVBatSOCHiRes
        BMSChecksum_3DAh: ComSignalType=UINT8, ComBitSize=8, ComBitPosition=63, ComHandleId=107, ComSystemTemplateSystemSignalRef=BMSChecksum_3DAh
      BMS_32Ah_Can_Network_CANNODE_0 (ComIPdu):
        ComIPduSignalProcessing = IMMEDIATE
        ComIPduType = NORMAL
        ComIPduDirection = SEND
        ComFirstTimeout = 0.02
        ComTimeout = 0.02
        ComIPduGroupRef = ComIPduGroup_Tx
        ComPduIdRef = PduCollection/BMS_32Ah_Can_Network_CANNODE_0_Com2PduR
        ComIPduSignalRef = MesCellVoltNumIndex
        ComIPduSignalRef = Mes1CellVolt
        ComIPduSignalRef = Mes1CellBalState
        ComIPduSignalRef = Mes2CellVolt
        ComIPduSignalRef = Mes2CellBalState
        ComIPduSignalRef = Mes3CellVolt
        ComIPduSignalRef = Mes3CellBalState
        ComTxIPdu: ComMinimumDelayTime=0.0, ComTxIPduUnusedAreasDefault=255
          ComTxModeTrue
            ComTxMode: ComTxModeTimePeriod=0.02, ComTxModeMode=PERIODIC, ComTxModeNumberOfRepetitions=0, ComTxModeRepetitionPeriod=0, ComTxModeTimeOffset=0.0
          ComTxModeFalse
            ComTxMode: ComTxModeTimePeriod=0.02, ComTxModeMode=PERIODIC, ComTxModeNumberOfRepetitions=0, ComTxModeRepetitionPeriod=0, ComTxModeTimeOffset=0.0
      7 x ComSignal, all with ComSignalEndianness=BIG_ENDIAN, ComUpdateBitPosition=-1, ComTransferProperty=TRIGGERED:
        MesCellVoltNumIndex: ComSignalInitValue=1, ComSignalType=UINT8, ComBitSize=8, ComBitPosition=7, ComHandleId=108, ComSystemTemplateSystemSignalRef=MesCellVoltNumIndex
        Mes1CellVolt: ComSignalInitValue=8191, ComSignalType=UINT16, ComBitSize=13, ComBitPosition=12, ComHandleId=109, ComSystemTemplateSystemSignalRef=Mes1CellVolt
        Mes1CellBalState: ComSignalInitValue=0, ComSignalType=BOOLEAN, ComBitSize=1, ComBitPosition=13, ComHandleId=110, ComSystemTemplateSystemSignalRef=Mes1CellBalState
        Mes2CellVolt: ComSignalInitValue=8191, ComSignalType=UINT16, ComBitSize=13, ComBitPosition=28, ComHandleId=111, ComSystemTemplateSystemSignalRef=Mes2CellVolt
        Mes2CellBalState: ComSignalInitValue=0, ComSignalType=BOOLEAN, ComBitSize=1, ComBitPosition=29, ComHandleId=112, ComSystemTemplateSystemSignalRef=Mes2CellBalState
        Mes3CellVolt: ComSignalInitValue=8191, ComSignalType=UINT16, ComBitSize=13, ComBitPosition=44, ComHandleId=113, ComSystemTemplateSystemSignalRef=Mes3CellVolt
        Mes3CellBalState: ComSignalInitValue=0, ComSignalType=BOOLEAN, ComBitSize=1, ComBitPosition=45, ComHandleId=114, ComSystemTemplateSystemSignalRef=Mes3CellBalState
      BMS_3DBh_Can_Network_CANNODE_0 (ComIPdu):
        ComIPduSignalProcessing = IMMEDIATE
        ComIPduType = NORMAL
        ComIPduDirection = SEND
        ComFirstTimeout = 0.01
        ComTimeout = 0.01
        ComIPduGroupRef = ComIPduGroup_Tx
        ComPduIdRef = PduCollection/BMS_3DBh_Can_Network_CANNODE_0_Com2PduR
        ComIPduSignalRef = HVBDP_LngTrmDischrgPwr
        ComIPduSignalRef = HVBDP_CrnkDischrgPwrV
        ComIPduSignalRef = HVBDP_ShrtTrmDischrgPwr
        ComIPduSignalRef = DischrgPeakTimeFactor
        ComIPduSignalRef = BMSChecksum_3DBh
        ComTxIPdu: ComMinimumDelayTime=0.0, ComTxIPduUnusedAreasDefault=255
          ComTxModeTrue
            ComTxMode: ComTxModeTimePeriod=0.01, ComTxModeMode=PERIODIC, ComTxModeNumberOfRepetitions=0, ComTxModeRepetitionPeriod=0, ComTxModeTimeOffset=0.0
          ComTxModeFalse
            ComTxMode: ComTxModeTimePeriod=0.01, ComTxModeMode=PERIODIC, ComTxModeNumberOfRepetitions=0, ComTxModeRepetitionPeriod=0, ComTxModeTimeOffset=0.0
      5 x ComSignal, all with ComSignalInitValue=0, ComSignalEndianness=BIG_ENDIAN, ComUpdateBitPosition=-1, ComTransferProperty=TRIGGERED:
        HVBDP_LngTrmDischrgPwr: ComSignalType=UINT16, ComBitSize=11, ComBitPosition=7, ComHandleId=115, ComSystemTemplateSystemSignalRef=HVBDP_LngTrmDischrgPwr
        HVBDP_CrnkDischrgPwrV: ComSignalType=BOOLEAN, ComBitSize=1, ComBitPosition=11, ComHandleId=116, ComSystemTemplateSystemSignalRef=HVBDP_CrnkDischrgPwrV
        HVBDP_ShrtTrmDischrgPwr: ComSignalType=UINT16, ComBitSize=11, ComBitPosition=10, ComHandleId=117, ComSystemTemplateSystemSignalRef=HVBDP_ShrtTrmDischrgPwr
        DischrgPeakTimeFactor: ComSignalType=UINT8, ComBitSize=8, ComBitPosition=31, ComHandleId=118, ComSystemTemplateSystemSignalRef=DischrgPeakTimeFactor
        BMSChecksum_3DBh: ComSignalType=UINT8, ComBitSize=8, ComBitPosition=63, ComHandleId=119, ComSystemTemplateSystemSignalRef=BMSChecksum_3DBh
      BMS_603h_Can_Network_CANNODE_0 (ComIPdu):
        ComIPduSignalProcessing = IMMEDIATE
        ComIPduType = NORMAL
        ComIPduDirection = SEND
        ComFirstTimeout = 0.0
        ComTimeout = 0.0
        ComIPduGroupRef = ComIPduGroup_Tx
        ComPduIdRef = PduCollection/BMS_603h_Can_Network_CANNODE_0_Com2PduR
        ComIPduSignalRef = ACChrgVoltRq
        ComIPduSignalRef = ACChrgCurrRq
        ComIPduSignalRef = ACChrgMode
        ComIPduSignalRef = ACChrgFault
        ComIPduSignalRef = CCVaule
        ComIPduSignalRef = CPVaule
        ComIPduSignalRef = S2_Status
        ComTxIPdu: ComMinimumDelayTime=0.0, ComTxIPduUnusedAreasDefault=255
          ComTxModeTrue
            ComTxMode: ComTxModeTimePeriod=0, ComTxModeMode=DIRECT, ComTxModeNumberOfRepetitions=0, ComTxModeRepetitionPeriod=0, ComTxModeTimeOffset=0
          ComTxModeFalse
            ComTxMode: ComTxModeTimePeriod=0, ComTxModeMode=DIRECT, ComTxModeNumberOfRepetitions=0, ComTxModeRepetitionPeriod=0, ComTxModeTimeOffset=0
      7 x ComSignal, all with ComSignalInitValue=0, ComSignalEndianness=BIG_ENDIAN, ComUpdateBitPosition=-1, ComTransferProperty=TRIGGERED:
        ACChrgVoltRq: ComSignalType=UINT16, ComBitSize=14, ComBitPosition=13, ComHandleId=120, ComSystemTemplateSystemSignalRef=ACChrgVoltRq
        ACChrgCurrRq: ComSignalType=UINT16, ComBitSize=10, ComBitPosition=25, ComHandleId=121, ComSystemTemplateSystemSignalRef=ACChrgCurrRq
        ACChrgMode: ComSignalType=UINT8, ComBitSize=4, ComBitPosition=47, ComHandleId=122, ComSystemTemplateSystemSignalRef=ACChrgMode
        ACChrgFault: ComSignalType=UINT8, ComBitSize=4, ComBitPosition=43, ComHandleId=123, ComSystemTemplateSystemSignalRef=ACChrgFault
        CCVaule: ComSignalType=UINT8, ComBitSize=8, ComBitPosition=55, ComHandleId=124, ComSystemTemplateSystemSignalRef=CCVaule
        CPVaule: ComSignalType=UINT8, ComBitSize=8, ComBitPosition=63, ComHandleId=125, ComSystemTemplateSystemSignalRef=CPVaule
        S2_Status: ComSignalType=BOOLEAN, ComBitSize=1, ComBitPosition=14, ComHandleId=126, ComSystemTemplateSystemSignalRef=S2_Status
      BMS_594h_Can_Network_CANNODE_0 (ComIPdu):
        ComIPduSignalProcessing = IMMEDIATE
        ComIPduType = NORMAL
        ComIPduDirection = SEND
        ComFirstTimeout = 0.2
        ComTimeout = 0.2
        ComIPduGroupRef = ComIPduGroup_Tx
        ComPduIdRef = PduCollection/BMS_594h_Can_Network_CANNODE_0_Com2PduR
        ComIPduSignalRef = MaxClVlt
        ComIPduSignalRef = MaxCellVoltNumb
        ComIPduSignalRef = MinClVlt
        ComIPduSignalRef = MinCellVoltNumb
        ComIPduSignalRef = HVBatPackAccVltgV
        ComIPduSignalRef = HVBatPackAccVltg
        ComTxIPdu: ComMinimumDelayTime=0.0, ComTxIPduUnusedAreasDefault=255
          ComTxModeTrue
            ComTxMode: ComTxModeTimePeriod=0.2, ComTxModeMode=PERIODIC, ComTxModeNumberOfRepetitions=0, ComTxModeRepetitionPeriod=0, ComTxModeTimeOffset=0.0
          ComTxModeFalse
            ComTxMode: ComTxModeTimePeriod=0.2, ComTxModeMode=PERIODIC, ComTxModeNumberOfRepetitions=0, ComTxModeRepetitionPeriod=0, ComTxModeTimeOffset=0.0
      6 x ComSignal, all with ComSignalEndianness=BIG_ENDIAN, ComUpdateBitPosition=-1, ComTransferProperty=TRIGGERED:
        MaxClVlt: ComSignalInitValue=0, ComSignalType=UINT16, ComBitSize=13, ComBitPosition=4, ComHandleId=127, ComSystemTemplateSystemSignalRef=MaxClVlt
        MaxCellVoltNumb: ComSignalInitValue=1, ComSignalType=UINT8, ComBitSize=8, ComBitPosition=23, ComHandleId=128, ComSystemTemplateSystemSignalRef=MaxCellVoltNumb
        MinClVlt: ComSignalInitValue=0, ComSignalType=UINT16, ComBitSize=13, ComBitPosition=28, ComHandleId=129, ComSystemTemplateSystemSignalRef=MinClVlt
        MinCellVoltNumb: ComSignalInitValue=1, ComSignalType=UINT8, ComBitSize=8, ComBitPosition=47, ComHandleId=130, ComSystemTemplateSystemSignalRef=MinCellVoltNumb
        HVBatPackAccVltgV: ComSignalInitValue=0, ComSignalType=BOOLEAN, ComBitSize=1, ComBitPosition=53, ComHandleId=131, ComSystemTemplateSystemSignalRef=HVBatPackAccVltgV
        HVBatPackAccVltg: ComSignalInitValue=0, ComSignalType=UINT16, ComBitSize=13, ComBitPosition=52, ComHandleId=132, ComSystemTemplateSystemSignalRef=HVBatPackAccVltg
      CTS_CHG_J1939_Network_CANNODE_0 (ComIPdu):
        ComIPduSignalProcessing = IMMEDIATE
        ComIPduType = NORMAL
        ComIPduDirection = RECEIVE
        ComFirstTimeout = 0.0
        ComTimeout = 5.0
        ComIpduNotificationCallback = Com_RxCbk_CTS_CHG_J1939_Network_CANNODE_0
        ComIPduErrorNotification = Com_RxTOCbk_CTS_CHG_J1939_Network_CANNODE_0
        ComIPduGroupRef = ComIPduGroup_Rx
        ComPduIdRef = PduCollection/CTS_CHG_J1939_Network_CANNODE_0_PduR2Com
        ComIPduSignalRef = CTS_SPN2823_SYNC_YearThousand
        ComIPduSignalRef = CTS_SPN2823_SYNC_YearTen
        ComIPduSignalRef = CTS_SPN2823_SYNC_YearHundred
        ComIPduSignalRef = CTS_SPN2823_SYNC_Year
        ComIPduSignalRef = CTS_SPN2823_SYNC_SecondTen
        ComIPduSignalRef = CTS_SPN2823_SYNC_Second
        ComIPduSignalRef = CTS_SPN2823_SYNC_MonthTen
        ComIPduSignalRef = CTS_SPN2823_SYNC_Month
        ComIPduSignalRef = CTS_SPN2823_SYNC_MinuteTen
        ComIPduSignalRef = CTS_SPN2823_SYNC_Minute
        ComIPduSignalRef = CTS_SPN2823_SYNC_HourTen
        ComIPduSignalRef = CTS_SPN2823_SYNC_Hour
        ComIPduSignalRef = CTS_SPN2823_SYNC_DayTen
        ComIPduSignalRef = CTS_SPN2823_SYNC_Day
      14 x ComSignal, all with ComSignalInitValue=0, ComSignalType=UINT8, ComSignalEndianness=LITTLE_ENDIAN, ComBitSize=4, ComUpdateBitPosition=-1, ComTransferProperty=TRIGGERED:
        CTS_SPN2823_SYNC_YearThousand: ComBitPosition=52, ComHandleId=43, ComNotification=Rte_COMCbk_CTS_SPN2823_SYNC_YearThousand, ComSystemTemplateSystemSignalRef=CTS_SPN2823_SYNC_YearThousand
        CTS_SPN2823_SYNC_YearTen: ComBitPosition=44, ComHandleId=44, ComNotification=Rte_COMCbk_CTS_SPN2823_SYNC_YearTen, ComSystemTemplateSystemSignalRef=CTS_SPN2823_SYNC_YearTen
        CTS_SPN2823_SYNC_YearHundred: ComBitPosition=48, ComHandleId=45, ComNotification=Rte_COMCbk_CTS_SPN2823_SYNC_YearHundred, ComSystemTemplateSystemSignalRef=CTS_SPN2823_SYNC_YearHundred
        CTS_SPN2823_SYNC_Year: ComBitPosition=40, ComHandleId=46, ComNotification=Rte_COMCbk_CTS_SPN2823_SYNC_Year, ComSystemTemplateSystemSignalRef=CTS_SPN2823_SYNC_Year
        CTS_SPN2823_SYNC_SecondTen: ComBitPosition=4, ComHandleId=47, ComNotification=Rte_COMCbk_CTS_SPN2823_SYNC_SecondTen, ComSystemTemplateSystemSignalRef=CTS_SPN2823_SYNC_SecondTen
        CTS_SPN2823_SYNC_Second: ComBitPosition=0, ComHandleId=48, ComNotification=Rte_COMCbk_CTS_SPN2823_SYNC_Second, ComSystemTemplateSystemSignalRef=CTS_SPN2823_SYNC_Second
        CTS_SPN2823_SYNC_MonthTen: ComBitPosition=36, ComHandleId=49, ComNotification=Rte_COMCbk_CTS_SPN2823_SYNC_MonthTen, ComSystemTemplateSystemSignalRef=CTS_SPN2823_SYNC_MonthTen
        CTS_SPN2823_SYNC_Month: ComBitPosition=32, ComHandleId=50, ComNotification=Rte_COMCbk_CTS_SPN2823_SYNC_Month, ComSystemTemplateSystemSignalRef=CTS_SPN2823_SYNC_Month
        CTS_SPN2823_SYNC_MinuteTen: ComBitPosition=12, ComHandleId=51, ComNotification=Rte_COMCbk_CTS_SPN2823_SYNC_MinuteTen, ComSystemTemplateSystemSignalRef=CTS_SPN2823_SYNC_MinuteTen
        CTS_SPN2823_SYNC_Minute: ComBitPosition=8, ComHandleId=52, ComNotification=Rte_COMCbk_CTS_SPN2823_SYNC_Minute, ComSystemTemplateSystemSignalRef=CTS_SPN2823_SYNC_Minute
        CTS_SPN2823_SYNC_HourTen: ComBitPosition=20, ComHandleId=53, ComNotification=Rte_COMCbk_CTS_SPN2823_SYNC_HourTen, ComSystemTemplateSystemSignalRef=CTS_SPN2823_SYNC_HourTen
        CTS_SPN2823_SYNC_Hour: ComBitPosition=16, ComHandleId=54, ComNotification=Rte_COMCbk_CTS_SPN2823_SYNC_Hour, ComSystemTemplateSystemSignalRef=CTS_SPN2823_SYNC_Hour
        CTS_SPN2823_SYNC_DayTen: ComBitPosition=28, ComHandleId=55, ComNotification=Rte_COMCbk_CTS_SPN2823_SYNC_DayTen, ComSystemTemplateSystemSignalRef=CTS_SPN2823_SYNC_DayTen
        CTS_SPN2823_SYNC_Day: ComBitPosition=24, ComHandleId=56, ComNotification=Rte_COMCbk_CTS_SPN2823_SYNC_Day, ComSystemTemplateSystemSignalRef=CTS_SPN2823_SYNC_Day
      CSD_CHG_J1939_Network_CANNODE_0 (ComIPdu):
        ComIPduSignalProcessing = IMMEDIATE
        ComIPduType = NORMAL
        ComIPduDirection = RECEIVE
        ComIpduNotificationCallback = Com_RxCbk_CSD_CHG_J1939_Network_CANNODE_0
        ComIPduErrorNotification = Com_RxTOCbk_CSD_CHG_J1939_Network_CANNODE_0
        ComFirstTimeout = 0.0
        ComTimeout = 2.5
        ComIPduGroupRef = ComIPduGroup_Rx
        ComPduIdRef = PduCollection/CSD_CHG_J1939_Network_CANNODE_0_PduR2Com
        ComIPduSignalRef = CSD_SPN3613_CHG_Index
        ComIPduSignalRef = CSD_SPN3612_E_Out
        ComIPduSignalRef = CSD_SPN3611_Time_Charged
      3 x ComSignal, all with ComSignalInitValue=0, ComSignalEndianness=LITTLE_ENDIAN, ComUpdateBitPosition=-1, ComTransferProperty=TRIGGERED:
        CSD_SPN3613_CHG_Index: ComSignalType=UINT32, ComBitSize=32, ComBitPosition=32, ComHandleId=57, ComNotification=Rte_COMCbk_CSD_SPN3613_CHG_Index, ComSystemTemplateSystemSignalRef=CSD_SPN3613_CHG_Index
        CSD_SPN3612_E_Out: ComSignalType=UINT16, ComBitSize=16, ComBitPosition=16, ComHandleId=58, ComNotification=Rte_COMCbk_CSD_SPN3612_E_Out, ComSystemTemplateSystemSignalRef=CSD_SPN3612_E_Out
        CSD_SPN3611_Time_Charged: ComSignalType=UINT16, ComBitSize=16, ComBitPosition=0, ComHandleId=59, ComNotification=Rte_COMCbk_CSD_SPN3611_Time_Charged, ComSystemTemplateSystemSignalRef=CSD_SPN3611_Time_Charged
      CST_CHG_J1939_Network_CANNODE_0 (ComIPdu):
        ComIPduSignalProcessing = IMMEDIATE
        ComIPduType = NORMAL
        ComIPduDirection = RECEIVE
        ComIpduNotificationCallback = Com_RxCbk_CST_CHG_J1939_Network_CANNODE_0
        ComIPduErrorNotification = Com_RxTOCbk_CST_CHG_J1939_Network_CANNODE_0
        ComFirstTimeout = 0.0
        ComTimeout = 0.1
        ComIPduGroupRef = ComIPduGroup_Rx
        ComPduIdRef = PduCollection/CST_CHG_J1939_Network_CANNODE_0_PduR2Com
        ComIPduSignalRef = CST_SPN3521_Stop_Reason_BMSStop
        ComIPduSignalRef = CST_SPN3523_Stop_Fault_U
        ComIPduSignalRef = CST_SPN3523_Stop_Fault_Mismatch
        ComIPduSignalRef = CST_SPN3522_Stop_Fault_T_Inter
        ComIPduSignalRef = CST_SPN3522_Stop_Fault_T_CHG
        ComIPduSignalRef = CST_SPN3522_Stop_Fault_Other
        ComIPduSignalRef = CST_SPN3522_Stop_Fault_EmerStop
        ComIPduSignalRef = CST_SPN3522_Stop_Fault_Deliver
        ComIPduSignalRef = CST_SPN3522_Stop_Fault_CHGCnnt
        ComIPduSignalRef = CST_SPN3521_Stop_Reason_Manual
        ComIPduSignalRef = CST_SPN3521_Stop_Reason_Fault
        ComIPduSignalRef = CST_SPN3521_Stop_Reason_Auto
      12 x ComSignal, all with ComSignalInitValue=0, ComSignalType=UINT8, ComSignalEndianness=LITTLE_ENDIAN, ComBitSize=2, ComUpdateBitPosition=-1, ComTransferProperty=TRIGGERED:
        CST_SPN3521_Stop_Reason_BMSStop: ComBitPosition=6, ComHandleId=60, ComNotification=Rte_COMCbk_CST_SPN3521_Stop_Reason_BMSStop, ComSystemTemplateSystemSignalRef=CST_SPN3521_Stop_Reason_BMSStop
        CST_SPN3523_Stop_Fault_U: ComBitPosition=26, ComHandleId=61, ComNotification=Rte_COMCbk_CST_SPN3523_Stop_Fault_U, ComSystemTemplateSystemSignalRef=CST_SPN3523_Stop_Fault_U
        CST_SPN3523_Stop_Fault_Mismatch: ComBitPosition=24, ComHandleId=62, ComNotification=Rte_COMCbk_CST_SPN3523_Stop_Fault_Mismatch, ComSystemTemplateSystemSignalRef=CST_SPN3523_Stop_Fault_Mismatch
        CST_SPN3522_Stop_Fault_T_Inter: ComBitPosition=12, ComHandleId=63, ComNotification=Rte_COMCbk_CST_SPN3522_Stop_Fault_T_Inter, ComSystemTemplateSystemSignalRef=CST_SPN3522_Stop_Fault_T_Inter
        CST_SPN3522_Stop_Fault_T_CHG: ComBitPosition=8, ComHandleId=64, ComNotification=Rte_COMCbk_CST_SPN3522_Stop_Fault_T_CHG, ComSystemTemplateSystemSignalRef=CST_SPN3522_Stop_Fault_T_CHG
        CST_SPN3522_Stop_Fault_Other: ComBitPosition=18, ComHandleId=65, ComNotification=Rte_COMCbk_CST_SPN3522_Stop_Fault_Other, ComSystemTemplateSystemSignalRef=CST_SPN3522_Stop_Fault_Other
        CST_SPN3522_Stop_Fault_EmerStop: ComBitPosition=16, ComHandleId=66, ComNotification=Rte_COMCbk_CST_SPN3522_Stop_Fault_EmerStop, ComSystemTemplateSystemSignalRef=CST_SPN3522_Stop_Fault_EmerStop
        CST_SPN3522_Stop_Fault_Deliver: ComBitPosition=14, ComHandleId=67, ComNotification=Rte_COMCbk_CST_SPN3522_Stop_Fault_Deliver, ComSystemTemplateSystemSignalRef=CST_SPN3522_Stop_Fault_Deliver
        CST_SPN3522_Stop_Fault_CHGCnnt: ComBitPosition=10, ComHandleId=68, ComNotification=Rte_COMCbk_CST_SPN3522_Stop_Fault_CHGCnnt, ComSystemTemplateSystemSignalRef=CST_SPN3522_Stop_Fault_CHGCnnt
        CST_SPN3521_Stop_Reason_Manual: ComBitPosition=2, ComHandleId=69, ComNotification=Rte_COMCbk_CST_SPN3521_Stop_Reason_Manual, ComSystemTemplateSystemSignalRef=CST_SPN3521_Stop_Reason_Manual
        CST_SPN3521_Stop_Reason_Fault: ComBitPosition=4, ComHandleId=70, ComNotification=Rte_COMCbk_CST_SPN3521_Stop_Reason_Fault, ComSystemTemplateSystemSignalRef=CST_SPN3521_Stop_Reason_Fault
        CST_SPN3521_Stop_Reason_Auto: ComBitPosition=0, ComHandleId=71, ComNotification=Rte_COMCbk_CST_SPN3521_Stop_Reason_Auto, ComSystemTemplateSystemSignalRef=CST_SPN3521_Stop_Reason_Auto
      CHM_CHG_J1939_Network_CANNODE_0 (ComIPdu):
        ComIPduSignalProcessing = IMMEDIATE
        ComIPduType = NORMAL
        ComIPduDirection = RECEIVE
        ComIpduNotificationCallback = Com_RxCbk_CHM_CHG_J1939_Network_CANNODE_0
        ComIPduErrorNotification = Com_RxTOCbk_CHM_CHG_J1939_Network_CANNODE_0
        ComFirstTimeout = 0.0
        ComTimeout = 2.5
        ComIPduGroupRef = ComIPduGroup_Rx
        ComPduIdRef = PduCollection/CHM_CHG_J1939_Network_CANNODE_0_PduR2Com
        ComIPduSignalRef = CHM_SPN2600_Comm_Ver
      CHM_SPN2600_Comm_Ver (ComSignal):
        ComSignalInitValue = 0
        ComSignalType = UINT32
        ComSignalEndianness = LITTLE_ENDIAN
        ComBitSize = 24
        ComBitPosition = 0
        ComUpdateBitPosition = -1
        ComTransferProperty = TRIGGERED
        ComHandleId = 72
        ComNotification = Rte_COMCbk_CHM_SPN2600_Comm_Ver
        ComSystemTemplateSystemSignalRef = CHM_SPN2600_Comm_Ver
      CRO_CHG_J1939_Network_CANNODE_0 (ComIPdu):
        ComIPduSignalProcessing = IMMEDIATE
        ComIPduType = NORMAL
        ComIPduDirection = RECEIVE
        ComIpduNotificationCallback = Com_RxCbk_CRO_CHG_J1939_Network_CANNODE_0
        ComIPduErrorNotification = Com_RxTOCbk_CRO_CHG_J1939_Network_CANNODE_0
        ComFirstTimeout = 0.0
        ComTimeout = 2.5
        ComIPduGroupRef = ComIPduGroup_Rx
        ComPduIdRef = PduCollection/CRO_CHG_J1939_Network_CANNODE_0_PduR2Com
        ComIPduSignalRef = CRO_SPN2830_CHG_Ready
      CRO_SPN2830_CHG_Ready (ComSignal):
        ComSignalInitValue = 0
        ComSignalType = UINT8
        ComSignalEndianness = LITTLE_ENDIAN
        ComBitSize = 8
        ComBitPosition = 0
        ComUpdateBitPosition = -1
        ComTransferProperty = TRIGGERED
        ComHandleId = 73
        ComNotification = Rte_COMCbk_CRO_SPN2830_CHG_Ready
        ComSystemTemplateSystemSignalRef = CRO_SPN2830_CHG_Ready
      CEM_CHG_J1939_Network_CANNODE_0 (ComIPdu):
        ComIPduSignalProcessing = IMMEDIATE
        ComIPduType = NORMAL
        ComIPduDirection = RECEIVE
        ComIpduNotificationCallback = Com_RxCbk_CEM_CHG_J1939_Network_CANNODE_0
        ComIPduErrorNotification = Com_RxTOCbk_CEM_CHG_J1939_Network_CANNODE_0
        ComFirstTimeout = 0.0
        ComTimeout = 2.5
        ComIPduGroupRef = ComIPduGroup_Rx
        ComPduIdRef = PduCollection/CEM_CHG_J1939_Network_CANNODE_0_PduR2Com
        ComIPduSignalRef = CEM_other
        ComIPduSignalRef = CEM_SPN3927_Timeout_BSD
        ComIPduSignalRef = CEM_SPN3926_Timeout_BST
        ComIPduSignalRef = CEM_SPN3925_Timeout_BCL
        ComIPduSignalRef = CEM_SPN3924_Timeout_BCS
        ComIPduSignalRef = CEM_SPN3923_Timeout_BRO
        ComIPduSignalRef = CEM_SPN3922_Timeout_BCP
        ComIPduSignalRef = CEM_SPN3921_Timeout_BRM
      8 x ComSignal, all with ComSignalInitValue=0, ComSignalType=UINT8, ComSignalEndianness=LITTLE_ENDIAN, ComUpdateBitPosition=-1, ComTransferProperty=TRIGGERED:
        CEM_other: ComBitSize=6, ComBitPosition=26, ComHandleId=74, ComNotification=Rte_COMCbk_CEM_other, ComSystemTemplateSystemSignalRef=CEM_other
        CEM_SPN3927_Timeout_BSD: ComBitSize=2, ComBitPosition=24, ComHandleId=75, ComNotification=Rte_COMCbk_CEM_SPN3927_Timeout_BSD, ComSystemTemplateSystemSignalRef=CEM_SPN3927_Timeout_BSD
        CEM_SPN3926_Timeout_BST: ComBitSize=2, ComBitPosition=20, ComHandleId=76, ComNotification=Rte_COMCbk_CEM_SPN3926_Timeout_BST, ComSystemTemplateSystemSignalRef=CEM_SPN3926_Timeout_BST
        CEM_SPN3925_Timeout_BCL: ComBitSize=2, ComBitPosition=18, ComHandleId=77, ComNotification=Rte_COMCbk_CEM_SPN3925_Timeout_BCL, ComSystemTemplateSystemSignalRef=CEM_SPN3925_Timeout_BCL
        CEM_SPN3924_Timeout_BCS: ComBitSize=2, ComBitPosition=16, ComHandleId=78, ComNotification=Rte_COMCbk_CEM_SPN3924_Timeout_BCS, ComSystemTemplateSystemSignalRef=CEM_SPN3924_Timeout_BCS
        CEM_SPN3923_Timeout_BRO: ComBitSize=2, ComBitPosition=10, ComHandleId=79, ComNotification=Rte_COMCbk_CEM_SPN3923_Timeout_BRO, ComSystemTemplateSystemSignalRef=CEM_SPN3923_Timeout_BRO
        CEM_SPN3922_Timeout_BCP: ComBitSize=2, ComBitPosition=8, ComHandleId=80, ComNotification=Rte_COMCbk_CEM_SPN3922_Timeout_BCP, ComSystemTemplateSystemSignalRef=CEM_SPN3922_Timeout_BCP
        CEM_SPN3921_Timeout_BRM: ComBitSize=2, ComBitPosition=0, ComHandleId=81, ComNotification=Rte_COMCbk_CEM_SPN3921_Timeout_BRM, ComSystemTemplateSystemSignalRef=CEM_SPN3921_Timeout_BRM
      CML_CHG_J1939_Network_CANNODE_0 (ComIPdu):
        ComIPduSignalProcessing = IMMEDIATE
        ComIPduType = NORMAL
        ComIPduDirection = RECEIVE
        ComIpduNotificationCallback = Com_RxCbk_CML_CHG_J1939_Network_CANNODE_0
        ComIPduErrorNotification = Com_RxTOCbk_CML_CHG_J1939_Network_CANNODE_0
        ComFirstTimeout = 0.0
        ComTimeout = 2.5
        ComIPduGroupRef = ComIPduGroup_Rx
        ComPduIdRef = PduCollection/CML_CHG_J1939_Network_CANNODE_0_PduR2Com
        ComIPduSignalRef = CML_SPN2827_I_Min_Out
        ComIPduSignalRef = CML_SPN2826_I_Max_Out
        ComIPduSignalRef = CML_SPN2825_U_Min_Out
        ComIPduSignalRef = CML_SPN2824_U_Max_Out
      4 x ComSignal, all with ComSignalType=UINT16, ComSignalEndianness=LITTLE_ENDIAN, ComBitSize=16, ComUpdateBitPosition=-1, ComTransferProperty=TRIGGERED:
        CML_SPN2827_I_Min_Out: ComSignalInitValue=4000, ComBitPosition=48, ComHandleId=82, ComNotification=Rte_COMCbk_CML_SPN2827_I_Min_Out, ComSystemTemplateSystemSignalRef=CML_SPN2827_I_Min_Out
        CML_SPN2826_I_Max_Out: ComSignalInitValue=4000, ComBitPosition=32, ComHandleId=83, ComNotification=Rte_COMCbk_CML_SPN2826_I_Max_Out, ComSystemTemplateSystemSignalRef=CML_SPN2826_I_Max_Out
        CML_SPN2825_U_Min_Out: ComSignalInitValue=0, ComBitPosition=16, ComHandleId=84, ComNotification=Rte_COMCbk_CML_SPN2825_U_Min_Out, ComSystemTemplateSystemSignalRef=CML_SPN2825_U_Min_Out
        CML_SPN2824_U_Max_Out: ComSignalInitValue=0, ComBitPosition=0, ComHandleId=85, ComNotification=Rte_COMCbk_CML_SPN2824_U_Max_Out, ComSystemTemplateSystemSignalRef=CML_SPN2824_U_Max_Out
      CCS_CHG_J1939_Network_CANNODE_0 (ComIPdu):
        ComIPduSignalProcessing = IMMEDIATE
        ComIPduType = NORMAL
        ComIPduDirection = RECEIVE
        ComIpduNotificationCallback = Com_RxCbk_CCS_CHG_J1939_Network_CANNODE_0
        ComIPduErrorNotification = Com_RxTOCbk_CCS_CHG_J1939_Network_CANNODE_0
        ComFirstTimeout = 0.0
        ComTimeout = 0.5
        ComIPduGroupRef = ComIPduGroup_Rx
        ComPduIdRef = PduCollection/CCS_CHG_J1939_Network_CANNODE_0_PduR2Com
        ComIPduSignalRef = CCS_SPN3081_U_Out
        ComIPduSignalRef = CCS_SPN3082_I_Out
        ComIPduSignalRef = CCS_SPN3083_Time_Charged
        ComIPduSignalRef = CCS_SPN3929_Chg_enable
      4 x ComSignal, all with ComSignalEndianness=LITTLE_ENDIAN, ComUpdateBitPosition=-1, ComTransferProperty=TRIGGERED:
        CCS_SPN3081_U_Out: ComSignalInitValue=0, ComSignalType=UINT16, ComBitSize=16, ComBitPosition=0, ComHandleId=86, ComNotification=Rte_COMCbk_CCS_SPN3081_U_Out, ComSystemTemplateSystemSignalRef=CCS_SPN3081_U_Out
        CCS_SPN3082_I_Out: ComSignalInitValue=4000, ComSignalType=UINT16, ComBitSize=16, ComBitPosition=16, ComHandleId=87, ComNotification=Rte_COMCbk_CCS_SPN3082_I_Out, ComSystemTemplateSystemSignalRef=CCS_SPN3082_I_Out
        CCS_SPN3083_Time_Charged: ComSignalInitValue=0, ComSignalType=UINT16, ComBitSize=16, ComBitPosition=32, ComHandleId=88, ComNotification=Rte_COMCbk_CCS_SPN3083_Time_Charged, ComSystemTemplateSystemSignalRef=CCS_SPN3083_Time_Charged
        CCS_SPN3929_Chg_enable: ComSignalInitValue=0, ComSignalType=UINT8, ComBitSize=2, ComBitPosition=48, ComHandleId=89, ComNotification=Rte_COMCbk_CCS_SPN3929_Chg_enable, ComSystemTemplateSystemSignalRef=CCS_SPN3929_Chg_enable
      CRM_CHG_J1939_Network_CANNODE_0 (ComIPdu):
        ComIPduSignalProcessing = IMMEDIATE
        ComIPduType = NORMAL
        ComIPduDirection = RECEIVE
        ComIpduNotificationCallback = Com_RxCbk_CRM_CHG_J1939_Network_CANNODE_0
        ComIPduErrorNotification = Com_RxTOCbk_CRM_CHG_J1939_Network_CANNODE_0
        ComFirstTimeout = 0.0
        ComTimeout = 2.5
        ComIPduGroupRef = ComIPduGroup_Rx
        ComPduIdRef = PduCollection/CRM_CHG_J1939_Network_CANNODE_0_PduR2Com
        ComIPduSignalRef = CRM_SPN2562_CHG_Loc
        ComIPduSignalRef = CRM_SPN2561_CHG_Index
        ComIPduSignalRef = CRM_SPN2560_Ack
      3 x ComSignal, all with ComSignalEndianness=LITTLE_ENDIAN, ComUpdateBitPosition=-1, ComTransferProperty=TRIGGERED:
        CRM_SPN2562_CHG_Loc: ComSignalInitValue=0, ComSignalType=UINT32, ComBitSize=24, ComBitPosition=40, ComHandleId=90, ComNotification=Rte_COMCbk_CRM_SPN2562_CHG_Loc, ComSystemTemplateSystemSignalRef=CRM_SPN2562_CHG_Loc
        CRM_SPN2561_CHG_Index: ComSignalInitValue=1, ComSignalType=UINT32, ComBitSize=32, ComBitPosition=8, ComHandleId=91, ComNotification=Rte_COMCbk_CRM_SPN2561_CHG_Index, ComSystemTemplateSystemSignalRef=CRM_SPN2561_CHG_Index
        CRM_SPN2560_Ack: ComSignalInitValue=0, ComSignalType=UINT8, ComBitSize=8, ComBitPosition=0, ComHandleId=92, ComNotification=Rte_COMCbk_CRM_SPN2560_Ack, ComSystemTemplateSystemSignalRef=CRM_SPN2560_Ack
      BHM_BCU_J1939_Network_CANNODE_0 (ComIPdu):
        ComIPduSignalProcessing = IMMEDIATE
        ComIPduType = NORMAL
        ComIPduDirection = SEND
        ComFirstTimeout = 0.0
        ComTimeout = 0.0
        ComIPduGroupRef = ComIPduGroup_Tx
        ComPduIdRef = PduCollection/BHM_BCU_J1939_Network_CANNODE_0_Com2PduR
        ComIPduSignalRef = BHM_SPN2601_Ubat_Max_Permit
        ComTxIPdu: ComMinimumDelayTime=0.0, ComTxIPduUnusedAreasDefault=255
          ComTxModeTrue
            ComTxMode: ComTxModeTimePeriod=0, ComTxModeMode=DIRECT, ComTxModeNumberOfRepetitions=0, ComTxModeRepetitionPeriod=0, ComTxModeTimeOffset=0
          ComTxModeFalse
            ComTxMode: ComTxModeTimePeriod=0, ComTxModeMode=DIRECT, ComTxModeNumberOfRepetitions=0, ComTxModeRepetitionPeriod=0, ComTxModeTimeOffset=0
      BHM_SPN2601_Ubat_Max_Permit (ComSignal):
        ComSignalInitValue = 0
        ComSignalType = UINT16
        ComSignalEndianness = LITTLE_ENDIAN
        ComBitSize = 16
        ComBitPosition = 0
        ComUpdateBitPosition = -1
        ComTransferProperty = TRIGGERED
        ComHandleId = 133
        ComSystemTemplateSystemSignalRef = BHM_SPN2601_Ubat_Max_Permit
      BSM_BCU_J1939_Network_CANNODE_0 (ComIPdu):
        ComIPduSignalProcessing = IMMEDIATE
        ComIPduType = NORMAL
        ComIPduDirection = SEND
        ComFirstTimeout = 0.0
        ComTimeout = 0.0
        ComIPduGroupRef = ComIPduGroup_Tx
        ComPduIdRef = PduCollection/BSM_BCU_J1939_Network_CANNODE_0_Com2PduR
        ComIPduSignalRef = BSM_SPN3096_Chg_Enable
        ComIPduSignalRef = BSM_SPN3095_OutConnector_State
        ComIPduSignalRef = BSM_SPN3094_Iso_State
        ComIPduSignalRef = BSM_SPN3093_T_Warn
        ComIPduSignalRef = BSM_SPN3092_I_Warn
        ComIPduSignalRef = BSM_SPN3091_SOC_Warn
        ComIPduSignalRef = BSM_SPN3090_Ucell_Warn
        ComIPduSignalRef = BSM_SPN3089_T_Min_Index
        ComIPduSignalRef = BSM_SPN3088_T_Min
        ComIPduSignalRef = BSM_SPN3087_T_Max_Index
        ComIPduSignalRef = BSM_SPN3086_T_Max
        ComIPduSignalRef = BSM_SPN3085_Ucell_Max_Index
        ComTxIPdu: ComMinimumDelayTime=0.0, ComTxIPduUnusedAreasDefault=255
          ComTxModeTrue
            ComTxMode: ComTxModeTimePeriod=0, ComTxModeMode=DIRECT, ComTxModeNumberOfRepetitions=0, ComTxModeRepetitionPeriod=0, ComTxModeTimeOffset=0
          ComTxModeFalse
            ComTxMode: ComTxModeTimePeriod=0, ComTxModeMode=DIRECT, ComTxModeNumberOfRepetitions=0, ComTxModeRepetitionPeriod=0, ComTxModeTimeOffset=0
      12 x ComSignal, all with ComSignalType=UINT8, ComSignalEndianness=LITTLE_ENDIAN, ComUpdateBitPosition=-1, ComTransferProperty=TRIGGERED:
        BSM_SPN3096_Chg_Enable: ComSignalInitValue=0, ComBitSize=2, ComBitPosition=52, ComHandleId=134, ComSystemTemplateSystemSignalRef=BSM_SPN3096_Chg_Enable
        BSM_SPN3095_OutConnector_State: ComSignalInitValue=0, ComBitSize=2, ComBitPosition=50, ComHandleId=135, ComSystemTemplateSystemSignalRef=BSM_SPN3095_OutConnector_State
        BSM_SPN3094_Iso_State: ComSignalInitValue=0, ComBitSize=2, ComBitPosition=48, ComHandleId=136, ComSystemTemplateSystemSignalRef=BSM_SPN3094_Iso_State
        BSM_SPN3093_T_Warn: ComSignalInitValue=0, ComBitSize=2, ComBitPosition=46, ComHandleId=137, ComSystemTemplateSystemSignalRef=BSM_SPN3093_T_Warn
        BSM_SPN3092_I_Warn: ComSignalInitValue=0, ComBitSize=2, ComBitPosition=44, ComHandleId=138, ComSystemTemplateSystemSignalRef=BSM_SPN3092_I_Warn
        BSM_SPN3091_SOC_Warn: ComSignalInitValue=0, ComBitSize=2, ComBitPosition=42, ComHandleId=139, ComSystemTemplateSystemSignalRef=BSM_SPN3091_SOC_Warn
        BSM_SPN3090_Ucell_Warn: ComSignalInitValue=0, ComBitSize=2, ComBitPosition=40, ComHandleId=140, ComSystemTemplateSystemSignalRef=BSM_SPN3090_Ucell_Warn
        BSM_SPN3089_T_Min_Index: ComSignalInitValue=0, ComBitSize=8, ComBitPosition=32, ComHandleId=141, ComSystemTemplateSystemSignalRef=BSM_SPN3089_T_Min_Index
        BSM_SPN3088_T_Min: ComSignalInitValue=50, ComBitSize=8, ComBitPosition=24, ComHandleId=142, ComSystemTemplateSystemSignalRef=BSM_SPN3088_T_Min
        BSM_SPN3087_T_Max_Index: ComSignalInitValue=0, ComBitSize=8, ComBitPosition=16, ComHandleId=143, ComSystemTemplateSystemSignalRef=BSM_SPN3087_T_Max_Index
        BSM_SPN3086_T_Max: ComSignalInitValue=50, ComBitSize=8, ComBitPosition=8, ComHandleId=144, ComSystemTemplateSystemSignalRef=BSM_SPN3086_T_Max
        BSM_SPN3085_Ucell_Max_Index: ComSignalInitValue=0, ComBitSize=8, ComBitPosition=0, ComHandleId=145, ComSystemTemplateSystemSignalRef=BSM_SPN3085_Ucell_Max_Index
      BST_BCU_J1939_Network_CANNODE_0 (ComIPdu):
        ComIPduSignalProcessing = IMMEDIATE
        ComIPduType = NORMAL
        ComIPduDirection = SEND
        ComFirstTimeout = 0.0
        ComTimeout = 0.0
        ComIPduGroupRef = ComIPduGroup_Tx
        ComPduIdRef = PduCollection/BST_BCU_J1939_Network_CANNODE_0_Com2PduR
        ComIPduSignalRef = BST_SPN3512_Stop_Fault_HVRelay
        ComIPduSignalRef = BST_SPN3512_Stop_Fault_CC2
        ComIPduSignalRef = BST_SPN3511_Stop_Reason_CHGStop
        ComIPduSignalRef = BST_SPN3513_Stop_Fault_U
        ComIPduSignalRef = BST_SPN3513_Stop_Fault_I
        ComIPduSignalRef = BST_SPN3512_Stop_Fault_T
        ComIPduSignalRef = BST_SPN3512_Stop_Fault_Other
        ComIPduSignalRef = BST_SPN3512_Stop_Fault_Iso
        ComIPduSignalRef = BST_SPN3512_Stop_Fault_OutCnnt
        ComIPduSignalRef = BST_SPN3512_Stop_Fault_BCUcompo
        ComIPduSignalRef = BST_SPN3512_Stop_Fault_ChgCnnt
        ComIPduSignalRef = BST_SPN3511_Stop_Reason_Ucell
        ComIPduSignalRef = BST_SPN3511_Stop_Reason_U
        ComIPduSignalRef = BST_SPN3511_Stop_Reason_SOC
        ComTxIPdu: ComMinimumDelayTime=0.0, ComTxIPduUnusedAreasDefault=255
          ComTxModeTrue
            ComTxMode: ComTxModeTimePeriod=0, ComTxModeMode=DIRECT, ComTxModeNumberOfRepetitions=0, ComTxModeRepetitionPeriod=0, ComTxModeTimeOffset=0
          ComTxModeFalse
            ComTxMode: ComTxModeTimePeriod=0, ComTxModeMode=DIRECT, ComTxModeNumberOfRepetitions=0, ComTxModeRepetitionPeriod=0, ComTxModeTimeOffset=0
      14 x ComSignal, all with ComSignalInitValue=0, ComSignalType=UINT8, ComSignalEndianness=LITTLE_ENDIAN, ComBitSize=2, ComUpdateBitPosition=-1, ComTransferProperty=TRIGGERED:
        BST_SPN3512_Stop_Fault_HVRelay: ComBitPosition=18, ComHandleId=146, ComSystemTemplateSystemSignalRef=BST_SPN3512_Stop_Fault_HVRelay
        BST_SPN3512_Stop_Fault_CC2: ComBitPosition=20, ComHandleId=147, ComSystemTemplateSystemSignalRef=BST_SPN3512_Stop_Fault_CC2
        BST_SPN3511_Stop_Reason_CHGStop: ComBitPosition=6, ComHandleId=148, ComSystemTemplateSystemSignalRef=BST_SPN3511_Stop_Reason_CHGStop
        BST_SPN3513_Stop_Fault_U: ComBitPosition=26, ComHandleId=149, ComSystemTemplateSystemSignalRef=BST_SPN3513_Stop_Fault_U
        BST_SPN3513_Stop_Fault_I: ComBitPosition=24, ComHandleId=150, ComSystemTemplateSystemSignalRef=BST_SPN3513_Stop_Fault_I
        BST_SPN3512_Stop_Fault_T: ComBitPosition=16, ComHandleId=151, ComSystemTemplateSystemSignalRef=BST_SPN3512_Stop_Fault_T
        BST_SPN3512_Stop_Fault_Other: ComBitPosition=22, ComHandleId=152, ComSystemTemplateSystemSignalRef=BST_SPN3512_Stop_Fault_Other
        BST_SPN3512_Stop_Fault_Iso: ComBitPosition=8, ComHandleId=153, ComSystemTemplateSystemSignalRef=BST_SPN3512_Stop_Fault_Iso
        BST_SPN3512_Stop_Fault_OutCnnt: ComBitPosition=10, ComHandleId=154, ComSystemTemplateSystemSignalRef=BST_SPN3512_Stop_Fault_OutCnnt
        BST_SPN3512_Stop_Fault_BCUcompo: ComBitPosition=12, ComHandleId=155, ComSystemTemplateSystemSignalRef=BST_SPN3512_Stop_Fault_BCUcompo
        BST_SPN3512_Stop_Fault_ChgCnnt: ComBitPosition=14, ComHandleId=156, ComSystemTemplateSystemSignalRef=BST_SPN3512_Stop_Fault_ChgCnnt
        BST_SPN3511_Stop_Reason_Ucell: ComBitPosition=4, ComHandleId=157, ComSystemTemplateSystemSignalRef=BST_SPN3511_Stop_Reason_Ucell
        BST_SPN3511_Stop_Reason_U: ComBitPosition=2, ComHandleId=158, ComSystemTemplateSystemSignalRef=BST_SPN3511_Stop_Reason_U
        BST_SPN3511_Stop_Reason_SOC: ComBitPosition=0, ComHandleId=159, ComSystemTemplateSystemSignalRef=BST_SPN3511_Stop_Reason_SOC
      BRO_BCU_J1939_Network_CANNODE_0 (ComIPdu):
        ComIPduSignalProcessing = IMMEDIATE
        ComIPduType = NORMAL
        ComIPduDirection = SEND
        ComFirstTimeout = 0.0
        ComTimeout = 0.0
        ComIPduGroupRef = ComIPduGroup_Tx
        ComPduIdRef = PduCollection/BRO_BCU_J1939_Network_CANNODE_0_Com2PduR
        ComIPduSignalRef = BRO_SPN2829_BCU_Ready
        ComTxIPdu: ComMinimumDelayTime=0.0, ComTxIPduUnusedAreasDefault=255
          ComTxModeTrue
            ComTxMode: ComTxModeTimePeriod=0, ComTxModeMode=DIRECT, ComTxModeNumberOfRepetitions=0, ComTxModeRepetitionPeriod=0, ComTxModeTimeOffset=0
          ComTxModeFalse
            ComTxMode: ComTxModeTimePeriod=0, ComTxModeMode=DIRECT, ComTxModeNumberOfRepetitions=0, ComTxModeRepetitionPeriod=0, ComTxModeTimeOffset=0
      BRO_SPN2829_BCU_Ready (ComSignal):
        ComSignalInitValue = 0
        ComSignalType = UINT8
        ComSignalEndianness = LITTLE_ENDIAN
        ComBitSize = 8
        ComBitPosition = 0
        ComUpdateBitPosition = -1
        ComTransferProperty = TRIGGERED
        ComHandleId = 160
        ComSystemTemplateSystemSignalRef = BRO_SPN2829_BCU_Ready
      BEM_BCU_J1939_Network_CANNODE_0 (ComIPdu):
        ComIPduSignalProcessing = IMMEDIATE
        ComIPduType = NORMAL
        ComIPduDirection = SEND
        ComFirstTimeout = 0.0
        ComTimeout = 0.0
        ComIPduGroupRef = ComIPduGroup_Tx
        ComPduIdRef = PduCollection/BEM_BCU_J1939_Network_CANNODE_0_Com2PduR
        ComIPduSignalRef = BEM_other
        ComIPduSignalRef = BEM_SPN3907_Timeout_CSD
        ComIPduSignalRef = BEM_SPN3906_Timeout_CST
        ComIPduSignalRef = BEM_SPN3905_Timeout_CCS
        ComIPduSignalRef = BEM_SPN3904_Timeout_CRO
        ComIPduSignalRef = BEM_SPN3903_Timeout_CTS_CML
        ComIPduSignalRef = BEM_SPN3902_Timeout_SPN2560_0xAA
        ComIPduSignalRef = BEM_SPN3901_Timeout_SPN2560_0x00
        ComTxIPdu: ComMinimumDelayTime=0.0, ComTxIPduUnusedAreasDefault=255
          ComTxModeTrue
            ComTxMode: ComTxModeTimePeriod=0, ComTxModeMode=DIRECT, ComTxModeNumberOfRepetitions=0, ComTxModeRepetitionPeriod=0, ComTxModeTimeOffset=0
          ComTxModeFalse
            ComTxMode: ComTxModeTimePeriod=0, ComTxModeMode=DIRECT, ComTxModeNumberOfRepetitions=0, ComTxModeRepetitionPeriod=0, ComTxModeTimeOffset=0
      8 x ComSignal, all with ComSignalInitValue=0, ComSignalType=UINT8, ComSignalEndianness=LITTLE_ENDIAN, ComUpdateBitPosition=-1, ComTransferProperty=TRIGGERED:
        BEM_other: ComBitSize=6, ComBitPosition=26, ComHandleId=161, ComSystemTemplateSystemSignalRef=BEM_other
        BEM_SPN3907_Timeout_CSD: ComBitSize=2, ComBitPosition=24, ComHandleId=162, ComSystemTemplateSystemSignalRef=BEM_SPN3907_Timeout_CSD
        BEM_SPN3906_Timeout_CST: ComBitSize=2, ComBitPosition=18, ComHandleId=163, ComSystemTemplateSystemSignalRef=BEM_SPN3906_Timeout_CST
        BEM_SPN3905_Timeout_CCS: ComBitSize=2, ComBitPosition=16, ComHandleId=164, ComSystemTemplateSystemSignalRef=BEM_SPN3905_Timeout_CCS
        BEM_SPN3904_Timeout_CRO: ComBitSize=2, ComBitPosition=10, ComHandleId=165, ComSystemTemplateSystemSignalRef=BEM_SPN3904_Timeout_CRO
        BEM_SPN3903_Timeout_CTS_CML: ComBitSize=2, ComBitPosition=8, ComHandleId=166, ComSystemTemplateSystemSignalRef=BEM_SPN3903_Timeout_CTS_CML
        BEM_SPN3902_Timeout_SPN2560_0xAA: ComBitSize=2, ComBitPosition=2, ComHandleId=167, ComSystemTemplateSystemSignalRef=BEM_SPN3902_Timeout_SPN2560_0xAA
        BEM_SPN3901_Timeout_SPN2560_0x00: ComBitSize=2, ComBitPosition=0, ComHandleId=168, ComSystemTemplateSystemSignalRef=BEM_SPN3901_Timeout_SPN2560_0x00
      BCL_BCU_J1939_Network_CANNODE_0 (ComIPdu):
        ComIPduSignalProcessing = IMMEDIATE
        ComIPduType = NORMAL
        ComIPduDirection = SEND
        ComFirstTimeout = 0.0
        ComTimeout = 0.0
        ComIPduGroupRef = ComIPduGroup_Tx
        ComPduIdRef = PduCollection/BCL_BCU_J1939_Network_CANNODE_0_Com2PduR
        ComIPduSignalRef = BCL_SPN3074_ChgMode
        ComIPduSignalRef = BCL_SPN3073_I_Req
        ComIPduSignalRef = BCL_SPN3072_U_Req
        ComTxIPdu: ComMinimumDelayTime=0.0, ComTxIPduUnusedAreasDefault=255
          ComTxModeTrue
            ComTxMode: ComTxModeTimePeriod=0, ComTxModeMode=DIRECT, ComTxModeNumberOfRepetitions=0, ComTxModeRepetitionPeriod=0, ComTxModeTimeOffset=0
          ComTxModeFalse
            ComTxMode: ComTxModeTimePeriod=0, ComTxModeMode=DIRECT, ComTxModeNumberOfRepetitions=0, ComTxModeRepetitionPeriod=0, ComTxModeTimeOffset=0
      3 x ComSignal, all with ComSignalEndianness=LITTLE_ENDIAN, ComUpdateBitPosition=-1, ComTransferProperty=TRIGGERED:
        BCL_SPN3074_ChgMode: ComSignalInitValue=0, ComSignalType=UINT8, ComBitSize=8, ComBitPosition=32, ComHandleId=169, ComSystemTemplateSystemSignalRef=BCL_SPN3074_ChgMode
        BCL_SPN3073_I_Req: ComSignalInitValue=4000, ComSignalType=UINT16, ComBitSize=16, ComBitPosition=16, ComHandleId=170, ComSystemTemplateSystemSignalRef=BCL_SPN3073_I_Req
        BCL_SPN3072_U_Req: ComSignalInitValue=0, ComSignalType=UINT16, ComBitSize=16, ComBitPosition=0, ComHandleId=171, ComSystemTemplateSystemSignalRef=BCL_SPN3072_U_Req
      BSD_BCU_J1939_Network_CANNODE_0 (ComIPdu):
        ComIPduSignalProcessing = IMMEDIATE
        ComIPduType = NORMAL
        ComIPduDirection = SEND
        ComFirstTimeout = 0.0
        ComTimeout = 0.0
        ComIPduGroupRef = ComIPduGroup_Tx
        ComPduIdRef = PduCollection/BSD_BCU_J1939_Network_CANNODE_0_Com2PduR
        ComIPduSignalRef = BSD_SPN3605_T_Max
        ComIPduSignalRef = BSD_SPN3604_T_Min
        ComIPduSignalRef = BSD_SPN3603_Ucell_Max
        ComIPduSignalRef = BSD_SPN3602_Ucell_Min
        ComIPduSignalRef = BSD_SPN3601_SOC_Final
        ComTxIPdu: ComMinimumDelayTime=0.0, ComTxIPduUnusedAreasDefault=255
          ComTxModeTrue
            ComTxMode: ComTxModeTimePeriod=0, ComTxModeMode=DIRECT, ComTxModeNumberOfRepetitions=0, ComTxModeRepetitionPeriod=0, ComTxModeTimeOffset=0
          ComTxModeFalse
            ComTxMode: ComTxModeTimePeriod=0, ComTxModeMode=DIRECT, ComTxModeNumberOfRepetitions=0, ComTxModeRepetitionPeriod=0, ComTxModeTimeOffset=0
      5 x ComSignal, all with ComSignalEndianness=LITTLE_ENDIAN, ComUpdateBitPosition=-1, ComTransferProperty=TRIGGERED:
        BSD_SPN3605_T_Max: ComSignalInitValue=50, ComSignalType=UINT8, ComBitSize=8, ComBitPosition=48, ComHandleId=172, ComSystemTemplateSystemSignalRef=BSD_SPN3605_T_Max
        BSD_SPN3604_T_Min: ComSignalInitValue=50, ComSignalType=UINT8, ComBitSize=8, ComBitPosition=40, ComHandleId=173, ComSystemTemplateSystemSignalRef=BSD_SPN3604_T_Min
        BSD_SPN3603_Ucell_Max: ComSignalInitValue=0, ComSignalType=UINT16, ComBitSize=16, ComBitPosition=24, ComHandleId=174, ComSystemTemplateSystemSignalRef=BSD_SPN3603_Ucell_Max
        BSD_SPN3602_Ucell_Min: ComSignalInitValue=0, ComSignalType=UINT16, ComBitSize=16, ComBitPosition=8, ComHandleId=175, ComSystemTemplateSystemSignalRef=BSD_SPN3602_Ucell_Min
        BSD_SPN3601_SOC_Final: ComSignalInitValue=0, ComSignalType=UINT8, ComBitSize=8, ComBitPosition=0, ComHandleId=176, ComSystemTemplateSystemSignalRef=BSD_SPN3601_SOC_Final
      3 x ComIPdu, all with ComIPduCancellationSupport=0, ComIPduType=TP, ComIPduDirection=SEND, ComIPduSignalProcessing=IMMEDIATE, ComIPduGroupRef=ComIPduGroup_Tx:
        BCP_BCU_J1939_Network_CANNODE_0: ComPduIdRef=PduCollection/BCP_BCU_J1939_Network_CANNODE_0_Com2PduR, ComIPduSignalRef=BCP_SPN2816_Ucell_Max_Permit, ComIPduSignalRef=BCP_SPN2817_I_Max_Permit, ComIPduSignalRef=BCP_SPN2818_kWh_Nom, ComIPduSignalRef=BCP_SPN2819_U_Max_Permit, ComIPduSignalRef=BCP_SPN2820_T_Max_Permit, ComIPduSignalRef=BCP_SPN2821_SOC, ComIPduSignalRef=BCP_SPN2822_U
          ComTxIPdu_0 (ComTxIPdu): ComTxIPduUnusedAreasDefault=255
            ComTxModeTrue_0 (ComTxModeTrue)
              ComTxMode_0 (ComTxMode): ComTxModeMode=DIRECT, ComTxModeNumberOfRepetitions=0, ComTxModeRepetitionPeriod=0.0, ComTxModeTimeOffset=0.0, ComTxModeTimePeriod=0.0
            ComTxModeFalse_0 (ComTxModeFalse)
              ComTxMode_0 (ComTxMode): ComTxModeMode=DIRECT, ComTxModeNumberOfRepetitions=0, ComTxModeRepetitionPeriod=0.0, ComTxModeTimeOffset=0.0, ComTxModeTimePeriod=0.0
        BCS_BCU_J1939_Network_CANNODE_0: ComPduIdRef=PduCollection/BCS_BCU_J1939_Network_CANNODE_0_Com2PduR, ComIPduSignalRef=BCS_SPN3075_U_Mea, ComIPduSignalRef=BCS_SPN3076_I_Mea, ComIPduSignalRef=BCS_SPN3077_Ucell_Max, ComIPduSignalRef=BCS_SPN3077_Ucell_Max_Grp, ComIPduSignalRef=BCS_SPN3078_SOC, ComIPduSignalRef=BCS_SPN3079_Time_Remain
          ComTxIPdu_0 (ComTxIPdu): ComTxIPduUnusedAreasDefault=255
            ComTxModeFalse_0 (ComTxModeFalse)
              ComTxMode_0 (ComTxMode): ComTxModeMode=DIRECT, ComTxModeNumberOfRepetitions=0, ComTxModeTimeOffset=0.0, ComTxModeRepetitionPeriod=0.0, ComTxModeTimePeriod=0.0
            ComTxModeTrue_0 (ComTxModeTrue)
              ComTxMode_0 (ComTxMode): ComTxModeMode=DIRECT, ComTxModeNumberOfRepetitions=0, ComTxModeRepetitionPeriod=0.0, ComTxModeTimeOffset=0.0, ComTxModeTimePeriod=0.0
        BRM_BCU_J1939_Network_CANNODE_0: ComPduIdRef=PduCollection/BRM_BCU_J1939_Network_CANNODE_0_Com2PduR, ComIPduSignalRef=BRM_SPN2565_Ver, ComIPduSignalRef=BRM_SPN2566_Bat_Type, ComIPduSignalRef=BRM_SPN2567_Cap_Nom, ComIPduSignalRef=BRM_SPN2568_U_Nom, ComIPduSignalRef=BRM_SPN2569_BatFactory, ComIPduSignalRef=BRM_SPN2570_PackSN, ComIPduSignalRef=BRM_SPN2571_PackDay, ComIPduSignalRef=BRM_SPN2571_PackMonth, ComIPduSignalRef=BRM_SPN2571_PackYear, ComIPduSignalRef=BRM_SPN2572_PackChgCnt, ComIPduSignalRef=BRM_SPN2573_PackRight, ComIPduSignalRef=BRM_SPN2574_BMSSW_Reserved, ComIPduSignalRef=BRM_SPN2575_VIN1, ComIPduSignalRef=BRM_SPN2575_VIN10, ComIPduSignalRef=BRM_SPN2575_VIN11, ComIPduSignalRef=BRM_SPN2575_VIN12, ComIPduSignalRef=BRM_SPN2575_VIN13, ComIPduSignalRef=BRM_SPN2575_VIN14, ComIPduSignalRef=BRM_SPN2575_VIN15, ComIPduSignalRef=BRM_SPN2575_VIN16, ComIPduSignalRef=BRM_SPN2575_VIN17, ComIPduSignalRef=BRM_SPN2575_VIN2, ComIPduSignalRef=BRM_SPN2575_VIN3, ComIPduSignalRef=BRM_SPN2575_VIN4, ComIPduSignalRef=BRM_SPN2575_VIN5, ComIPduSignalRef=BRM_SPN2575_VIN6, ComIPduSignalRef=BRM_SPN2575_VIN7, ComIPduSignalRef=BRM_SPN2575_VIN8, ComIPduSignalRef=BRM_SPN2575_VIN9, ComIPduSignalRef=BRM_SPN2576_BMSVer_Day, ComIPduSignalRef=BRM_SPN2576_BMSVer_Month, ComIPduSignalRef=BRM_SPN2576_BMSVer_Reserver, ComIPduSignalRef=BRM_SPN2576_BMSVer_Version, ComIPduSignalRef=BRM_SPN2576_BMSVer_Year
          ComTxIPdu_0 (ComTxIPdu): ComTxIPduUnusedAreasDefault=255
            ComTxModeFalse_0 (ComTxModeFalse)
              ComTxMode_0 (ComTxMode): ComTxModeMode=DIRECT, ComTxModeNumberOfRepetitions=0, ComTxModeRepetitionPeriod=0.0, ComTxModeTimeOffset=0.0, ComTxModeTimePeriod=0.0
            ComTxModeTrue_0 (ComTxModeTrue)
              ComTxMode_0 (ComTxMode): ComTxModeMode=DIRECT, ComTxModeNumberOfRepetitions=0, ComTxModeRepetitionPeriod=0.0, ComTxModeTimeOffset=0.0, ComTxModeTimePeriod=0.0
      76 x ComSignal, all with ComInitialValueOnly=0, ComSignalInitValue=0.0, ComUpdateBitPosition=-1, ComSignalEndianness=LITTLE_ENDIAN, ComTransferProperty=TRIGGERED:
        BCP_SPN2822_U: ComBitPosition=88, ComBitSize=16, ComSignalType=UINT16, ComSystemTemplateSystemSignalRef=BCP_SPN2822_U
        BCP_SPN2821_SOC: ComBitPosition=72, ComBitSize=16, ComSignalType=UINT16, ComSystemTemplateSystemSignalRef=BCP_SPN2821_SOC
        BCP_SPN2820_T_Max_Permit: ComBitPosition=64, ComBitSize=8, ComSignalType=UINT8, ComSystemTemplateSystemSignalRef=BCP_SPN2820_T_Max_Permit
        BCP_SPN2819_U_Max_Permit: ComBitPosition=48, ComBitSize=16, ComSignalType=UINT16, ComSystemTemplateSystemSignalRef=BCP_SPN2819_U_Max_Permit
        BCP_SPN2818_kWh_Nom: ComBitPosition=31, ComBitSize=16, ComSignalType=UINT16, ComSystemTemplateSystemSignalRef=BCP_SPN2818_kWh_Nom
        BCP_SPN2817_I_Max_Permit: ComBitPosition=16, ComBitSize=16, ComSignalType=UINT16, ComSystemTemplateSystemSignalRef=BCP_SPN2817_I_Max_Permit
        BCP_SPN2816_Ucell_Max_Permit: ComBitPosition=0, ComBitSize=16, ComSignalType=UINT16, ComSystemTemplateSystemSignalRef=BCP_SPN2816_Ucell_Max_Permit
        BCS_SPN3079_Time_Remain: ComBitPosition=56, ComBitSize=16, ComSignalType=UINT16, ComSystemTemplateSystemSignalRef=BCS_SPN3079_Time_Remain
        BCS_SPN3078_SOC: ComBitPosition=48, ComBitSize=8, ComSignalType=UINT8, ComSystemTemplateSystemSignalRef=BCS_SPN3078_SOC
        BCS_SPN3077_Ucell_Max_Grp: ComBitPosition=44, ComBitSize=4, ComSignalType=UINT8, ComSystemTemplateSystemSignalRef=BCS_SPN3077_Ucell_Max_Grp
        BCS_SPN3077_Ucell_Max: ComBitPosition=32, ComBitSize=12, ComSignalType=UINT16, ComSystemTemplateSystemSignalRef=BCS_SPN3077_Ucell_Max
        BCS_SPN3076_I_Mea: ComBitPosition=16, ComBitSize=16, ComSignalType=UINT16, ComSystemTemplateSystemSignalRef=BCS_SPN3076_I_Mea
        BCS_SPN3075_U_Mea: ComBitPosition=0, ComBitSize=16, ComSignalType=UINT16, ComSystemTemplateSystemSignalRef=BCS_SPN3075_U_Mea
        BRM_SPN2565_Ver: ComBitPosition=0, ComBitSize=24, ComSignalType=UINT32, ComSystemTemplateSystemSignalRef=BRM_SPN2565_Ver
        BRM_SPN2566_Bat_Type: ComBitPosition=24, ComBitSize=8, ComSignalType=UINT8, ComSystemTemplateSystemSignalRef=BRM_SPN2566_Bat_Type
        BRM_SPN2567_Cap_Nom: ComBitPosition=32, ComBitSize=16, ComSignalType=UINT16, ComSystemTemplateSystemSignalRef=BRM_SPN2567_Cap_Nom
        BRM_SPN2568_U_Nom: ComBitPosition=48, ComBitSize=16, ComSignalType=UINT16, ComSystemTemplateSystemSignalRef=BRM_SPN2568_U_Nom
        BRM_SPN2569_BatFactory: ComBitPosition=64, ComBitSize=32, ComSignalType=UINT32, ComSystemTemplateSystemSignalRef=BRM_SPN2569_BatFactory
        BRM_SPN2570_PackSN: ComBitPosition=96, ComBitSize=32, ComSignalType=UINT32, ComSystemTemplateSystemSignalRef=BRM_SPN2570_PackSN
        BRM_SPN2571_PackYear: ComBitPosition=128, ComBitSize=8, ComSignalType=UINT8, ComSystemTemplateSystemSignalRef=BRM_SPN2571_PackYear
        BRM_SPN2571_PackMonth: ComBitPosition=136, ComBitSize=8, ComSignalType=UINT8, ComSystemTemplateSystemSignalRef=BRM_SPN2571_PackMonth
        BRM_SPN2571_PackDay: ComBitPosition=144, ComBitSize=8, ComSignalType=UINT8, ComSystemTemplateSystemSignalRef=BRM_SPN2571_PackDay
        BRM_SPN2573_PackRight: ComBitPosition=176, ComBitSize=8, ComSignalType=UINT8, ComSystemTemplateSystemSignalRef=BRM_SPN2573_PackRight
        BRM_SPN2572_PackChgCnt: ComBitPosition=152, ComBitSize=24, ComSignalType=UINT32, ComSystemTemplateSystemSignalRef=BRM_SPN2572_PackChgCnt
        BRM_SPN2574_BMSSW_Reserved: ComBitPosition=184, ComBitSize=8, ComSignalType=UINT8, ComSystemTemplateSystemSignalRef=BRM_SPN2574_BMSSW_Reserved
        BRM_SPN2575_VIN1: ComBitPosition=192, ComBitSize=8, ComSignalType=UINT8, ComSystemTemplateSystemSignalRef=BRM_SPN2575_VIN1
        BRM_SPN2575_VIN2: ComBitPosition=200, ComBitSize=8, ComSignalType=UINT8, ComSystemTemplateSystemSignalRef=BRM_SPN2575_VIN2
        BRM_SPN2575_VIN3: ComBitPosition=208, ComBitSize=8, ComSignalType=UINT8, ComSystemTemplateSystemSignalRef=BRM_SPN2575_VIN3
        BRM_SPN2575_VIN4: ComBitPosition=216, ComBitSize=8, ComSignalType=UINT8, ComSystemTemplateSystemSignalRef=BRM_SPN2575_VIN4
        BRM_SPN2575_VIN5: ComBitPosition=224, ComBitSize=8, ComSignalType=UINT8, ComSystemTemplateSystemSignalRef=BRM_SPN2575_VIN5
        BRM_SPN2575_VIN6: ComBitPosition=232, ComBitSize=8, ComSignalType=UINT8, ComSystemTemplateSystemSignalRef=BRM_SPN2575_VIN6
        BRM_SPN2575_VIN7: ComBitPosition=240, ComBitSize=8, ComSignalType=UINT8, ComSystemTemplateSystemSignalRef=BRM_SPN2575_VIN7
        BRM_SPN2575_VIN8: ComBitPosition=248, ComBitSize=8, ComSignalType=UINT8, ComSystemTemplateSystemSignalRef=BRM_SPN2575_VIN8
        BRM_SPN2575_VIN9: ComBitPosition=256, ComBitSize=8, ComSignalType=UINT8, ComSystemTemplateSystemSignalRef=BRM_SPN2575_VIN9
        BRM_SPN2575_VIN10: ComBitPosition=264, ComBitSize=8, ComSignalType=UINT8, ComSystemTemplateSystemSignalRef=BRM_SPN2575_VIN10
        BRM_SPN2575_VIN11: ComBitPosition=272, ComBitSize=8, ComSignalType=UINT8, ComSystemTemplateSystemSignalRef=BRM_SPN2575_VIN11
        BRM_SPN2575_VIN12: ComBitPosition=280, ComBitSize=8, ComSignalType=UINT8, ComSystemTemplateSystemSignalRef=BRM_SPN2575_VIN12
        BRM_SPN2575_VIN13: ComBitPosition=288, ComBitSize=8, ComSignalType=UINT8, ComSystemTemplateSystemSignalRef=BRM_SPN2575_VIN13
        BRM_SPN2575_VIN14: ComBitPosition=296, ComBitSize=8, ComSignalType=UINT8, ComSystemTemplateSystemSignalRef=BRM_SPN2575_VIN14
        BRM_SPN2575_VIN15: ComBitPosition=304, ComBitSize=8, ComSignalType=UINT8, ComSystemTemplateSystemSignalRef=BRM_SPN2575_VIN15
        BRM_SPN2575_VIN16: ComBitPosition=312, ComBitSize=8, ComSignalType=UINT8, ComSystemTemplateSystemSignalRef=BRM_SPN2575_VIN16
        BRM_SPN2575_VIN17: ComBitPosition=320, ComBitSize=8, ComSignalType=UINT8, ComSystemTemplateSystemSignalRef=BRM_SPN2575_VIN17
        BRM_SPN2576_BMSVer_Day: ComBitPosition=336, ComBitSize=8, ComSignalType=UINT8, ComSystemTemplateSystemSignalRef=BRM_SPN2576_BMSVer_Day
        BRM_SPN2576_BMSVer_Month: ComBitPosition=344, ComBitSize=8, ComSignalType=UINT8, ComSystemTemplateSystemSignalRef=BRM_SPN2576_BMSVer_Month
        BRM_SPN2576_BMSVer_Reserver: ComBitPosition=368, ComBitSize=24, ComSignalType=UINT32, ComSystemTemplateSystemSignalRef=BRM_SPN2576_BMSVer_Reserver
        BRM_SPN2576_BMSVer_Version: ComBitPosition=328, ComBitSize=8, ComSignalType=UINT8, ComSystemTemplateSystemSignalRef=BRM_SPN2576_BMSVer_Version
        BRM_SPN2576_BMSVer_Year: ComBitPosition=352, ComBitSize=16, ComSignalType=UINT16, ComSystemTemplateSystemSignalRef=BRM_SPN2576_BMSVer_Year
        Old_BRM_SPN2565_Ver: ComBitPosition=0, ComBitSize=24, ComSignalType=UINT32, ComSystemTemplateSystemSignalRef=BRM_SPN2565_Ver
        Old_BRM_SPN2566_Bat_Type: ComBitPosition=24, ComBitSize=8, ComSignalType=UINT8, ComSystemTemplateSystemSignalRef=BRM_SPN2566_Bat_Type
        Old_BRM_SPN2567_Cap_Nom: ComBitPosition=32, ComBitSize=16, ComSignalType=UINT16, ComSystemTemplateSystemSignalRef=BRM_SPN2567_Cap_Nom
        Old_BRM_SPN2568_U_Nom: ComBitPosition=48, ComBitSize=16, ComSignalType=UINT16, ComSystemTemplateSystemSignalRef=BRM_SPN2568_U_Nom
        Old_BRM_SPN2569_BatFactory: ComBitPosition=64, ComBitSize=32, ComSignalType=UINT32, ComSystemTemplateSystemSignalRef=BRM_SPN2569_BatFactory
        Old_BRM_SPN2570_PackSN: ComBitPosition=96, ComBitSize=32, ComSignalType=UINT32, ComSystemTemplateSystemSignalRef=BRM_SPN2570_PackSN
        Old_BRM_SPN2571_PackYear: ComBitPosition=128, ComBitSize=8, ComSignalType=UINT8, ComSystemTemplateSystemSignalRef=BRM_SPN2571_PackYear
        Old_BRM_SPN2571_PackMonth: ComBitPosition=136, ComBitSize=8, ComSignalType=UINT8, ComSystemTemplateSystemSignalRef=BRM_SPN2571_PackMonth
        Old_BRM_SPN2571_PackDay: ComBitPosition=144, ComBitSize=8, ComSignalType=UINT8, ComSystemTemplateSystemSignalRef=BRM_SPN2571_PackDay
        Old_BRM_SPN2573_PackRight: ComBitPosition=176, ComBitSize=8, ComSignalType=UINT8, ComSystemTemplateSystemSignalRef=BRM_SPN2573_PackRight
        Old_BRM_SPN2572_PackChgCnt: ComBitPosition=152, ComBitSize=24, ComSignalType=UINT32, ComSystemTemplateSystemSignalRef=BRM_SPN2572_PackChgCnt
        Old_BRM_SPN2574_BMSSW_Reserved: ComBitPosition=184, ComBitSize=8, ComSignalType=UINT8, ComSystemTemplateSystemSignalRef=BRM_SPN2574_BMSSW_Reserved
        Old_BRM_SPN2575_VIN1: ComBitPosition=192, ComBitSize=8, ComSignalType=UINT8, ComSystemTemplateSystemSignalRef=BRM_SPN2575_VIN1
        Old_BRM_SPN2575_VIN2: ComBitPosition=200, ComBitSize=8, ComSignalType=UINT8, ComSystemTemplateSystemSignalRef=BRM_SPN2575_VIN2
        Old_BRM_SPN2575_VIN3: ComBitPosition=208, ComBitSize=8, ComSignalType=UINT8, ComSystemTemplateSystemSignalRef=BRM_SPN2575_VIN3
        Old_BRM_SPN2575_VIN4: ComBitPosition=216, ComBitSize=8, ComSignalType=UINT8, ComSystemTemplateSystemSignalRef=BRM_SPN2575_VIN4
        Old_BRM_SPN2575_VIN5: ComBitPosition=224, ComBitSize=8, ComSignalType=UINT8, ComSystemTemplateSystemSignalRef=BRM_SPN2575_VIN5
        Old_BRM_SPN2575_VIN6: ComBitPosition=232, ComBitSize=8, ComSignalType=UINT8, ComSystemTemplateSystemSignalRef=BRM_SPN2575_VIN6
        Old_BRM_SPN2575_VIN7: ComBitPosition=240, ComBitSize=8, ComSignalType=UINT8, ComSystemTemplateSystemSignalRef=BRM_SPN2575_VIN7
        Old_BRM_SPN2575_VIN8: ComBitPosition=248, ComBitSize=8, ComSignalType=UINT8, ComSystemTemplateSystemSignalRef=BRM_SPN2575_VIN8
        Old_BRM_SPN2575_VIN9: ComBitPosition=256, ComBitSize=8, ComSignalType=UINT8, ComSystemTemplateSystemSignalRef=BRM_SPN2575_VIN9
        Old_BRM_SPN2575_VIN10: ComBitPosition=264, ComBitSize=8, ComSignalType=UINT8, ComSystemTemplateSystemSignalRef=BRM_SPN2575_VIN10
        Old_BRM_SPN2575_VIN11: ComBitPosition=272, ComBitSize=8, ComSignalType=UINT8, ComSystemTemplateSystemSignalRef=BRM_SPN2575_VIN11
        Old_BRM_SPN2575_VIN12: ComBitPosition=280, ComBitSize=8, ComSignalType=UINT8, ComSystemTemplateSystemSignalRef=BRM_SPN2575_VIN12
        Old_BRM_SPN2575_VIN13: ComBitPosition=288, ComBitSize=8, ComSignalType=UINT8, ComSystemTemplateSystemSignalRef=BRM_SPN2575_VIN13
        Old_BRM_SPN2575_VIN14: ComBitPosition=296, ComBitSize=8, ComSignalType=UINT8, ComSystemTemplateSystemSignalRef=BRM_SPN2575_VIN14
        Old_BRM_SPN2575_VIN15: ComBitPosition=304, ComBitSize=8, ComSignalType=UINT8, ComSystemTemplateSystemSignalRef=BRM_SPN2575_VIN15
        Old_BRM_SPN2575_VIN16: ComBitPosition=312, ComBitSize=8, ComSignalType=UINT8, ComSystemTemplateSystemSignalRef=BRM_SPN2575_VIN16
        Old_BRM_SPN2575_VIN17: ComBitPosition=320, ComBitSize=8, ComSignalType=UINT8, ComSystemTemplateSystemSignalRef=BRM_SPN2575_VIN17
      Old_BRM_BCU_J1939_Network_CANNODE_0 (ComIPdu):
        ComIPduCancellationSupport = 0
        ComIPduDirection = SEND
        ComIPduSignalProcessing = IMMEDIATE
        ComIPduType = TP
        ComPduIdRef = PduCollection/Old_BRM_BCU_J1939_Network_CANNODE_0_Com2PduR
        ComIPduGroupRef = ComIPduGroup_Tx
        ComIPduSignalRef = Old_BRM_SPN2571_PackMonth
        ComIPduSignalRef = Old_BRM_SPN2567_Cap_Nom
        ComIPduSignalRef = Old_BRM_SPN2569_BatFactory
        ComIPduSignalRef = Old_BRM_SPN2566_Bat_Type
        ComIPduSignalRef = Old_BRM_SPN2574_BMSSW_Reserved
        ComIPduSignalRef = Old_BRM_SPN2572_PackChgCnt
        ComIPduSignalRef = Old_BRM_SPN2575_VIN2
        ComIPduSignalRef = Old_BRM_SPN2575_VIN3
        ComIPduSignalRef = Old_BRM_SPN2571_PackYear
        ComIPduSignalRef = Old_BRM_SPN2575_VIN1
        ComIPduSignalRef = Old_BRM_SPN2575_VIN17
        ComIPduSignalRef = Old_BRM_SPN2575_VIN15
        ComIPduSignalRef = Old_BRM_SPN2575_VIN16
        ComIPduSignalRef = Old_BRM_SPN2575_VIN13
        ComIPduSignalRef = Old_BRM_SPN2575_VIN14
        ComIPduSignalRef = Old_BRM_SPN2570_PackSN
        ComIPduSignalRef = Old_BRM_SPN2575_VIN11
        ComIPduSignalRef = Old_BRM_SPN2575_VIN12
        ComIPduSignalRef = Old_BRM_SPN2575_VIN10
        ComIPduSignalRef = Old_BRM_SPN2568_U_Nom
        ComIPduSignalRef = Old_BRM_SPN2573_PackRight
        ComIPduSignalRef = Old_BRM_SPN2575_VIN8
        ComIPduSignalRef = Old_BRM_SPN2575_VIN9
        ComIPduSignalRef = Old_BRM_SPN2575_VIN6
        ComIPduSignalRef = Old_BRM_SPN2575_VIN7
        ComIPduSignalRef = Old_BRM_SPN2575_VIN4
        ComIPduSignalRef = Old_BRM_SPN2575_VIN5
        ComIPduSignalRef = Old_BRM_SPN2571_PackDay
        ComIPduSignalRef = Old_BRM_SPN2565_Ver
        ComTxIPdu_0 (ComTxIPdu): ComTxIPduUnusedAreasDefault=255
          ComTxModeFalse_0 (ComTxModeFalse)
            ComTxMode_0 (ComTxMode): ComTxModeMode=DIRECT, ComTxModeNumberOfRepetitions=0, ComTxModeTimeOffset=0.0, ComTxModeTimePeriod=0.0, ComTxModeRepetitionPeriod=0.0
          ComTxModeTrue_0 (ComTxModeTrue)
            ComTxMode_0 (ComTxMode): ComTxModeMode=DIRECT, ComTxModeNumberOfRepetitions=0, ComTxModeRepetitionPeriod=0.0, ComTxModeTimeOffset=0.0, ComTxModeTimePeriod=0.0
    ComGeneral:
      ComSupportedIPduGroups = 100
      ComTxDoubleBuffer = false
      ComVersionInfoApi = false
      ComCommonIPduTxPeriodFeature = false
      ComEnableJitterFilter = false
      ComEnableSignalGroupArrayApi = false
      ComCancellationSupport = false
      ComConfigurationUseDet = false
  module config PduR: implementation-config-variant=VARIANT-PRE-COMPILE
    PduRGeneral:
      PduRVersionInfoApi = false
      PduRZeroCostOperation = false
      PduRFifoTxBufferSupport = false
      PduRIFGatewayOperation = false
      PduRTPGatewayOperation = false
      PduRMemorySize = 0
      PduRMinimumRoutingLoRxPduId = 0
      PduRMinimumRoutingLoTxPduId = 0
      PduRMinimumRoutingUpRxPduId = 0
      PduRMinimumRoutingUpTxPduId = 0
      PduRMulticastFromIfSupport = false
      PduRMulticastFromTpSupport = false
      PduRMulticastToIfSupport = false
      PduRMulticastToTpSupport = false
      PduRSbTxBufferSupport = false
      PduRQueueingSupport = false
      PduRCanTpChangeParameterRequestApi = false
      PduRFrTpChangeParameterRequestApi = false
      PduRDevErrorDetect = false
    PduRRoutingTables: PduRConfigurationId=0
      PduRRoutingTable
        51 x PduRRoutingPath:
          PEU_0B4h_Can_Network_CANNODE_0_CanIf2Com
            PEU_0B4h_Can_Network_CANNODE_0_CanIf2PduR (PduRSrcPdu): PduRSrcPduRef=PduCollection/PEU_0B4h_Can_Network_CANNODE_0_CanIf2PduR
            PEU_0B4h_Can_Network_CANNODE_0_PduR2Com (PduRDestPdu): PduRTransmissionConfirmation=false, PduRDestPduRef=PduCollection/PEU_0B4h_Can_Network_CANNODE_0_PduR2Com
          VCU_1E3h_Can_Network_CANNODE_0_CanIf2Com
            VCU_1E3h_Can_Network_CANNODE_0_CanIf2PduR (PduRSrcPdu): PduRSrcPduRef=PduCollection/VCU_1E3h_Can_Network_CANNODE_0_CanIf2PduR
            VCU_1E3h_Can_Network_CANNODE_0_PduR2Com (PduRDestPdu): PduRTransmissionConfirmation=false, PduRDestPduRef=PduCollection/VCU_1E3h_Can_Network_CANNODE_0_PduR2Com
          PEU_18Bh_Can_Network_CANNODE_0_CanIf2Com
            PEU_18Bh_Can_Network_CANNODE_0_CanIf2PduR (PduRSrcPdu): PduRSrcPduRef=PduCollection/PEU_18Bh_Can_Network_CANNODE_0_CanIf2PduR
            PEU_18Bh_Can_Network_CANNODE_0_PduR2Com (PduRDestPdu): PduRTransmissionConfirmation=false, PduRDestPduRef=PduCollection/PEU_18Bh_Can_Network_CANNODE_0_PduR2Com
          VCU_ABS_23Ch_Can_Network_CANNODE_0_CanIf2Com
            VCU_ABS_23Ch_Can_Network_CANNODE_0_CanIf2PduR (PduRSrcPdu): PduRSrcPduRef=PduCollection/VCU_ABS_23Ch_Can_Network_CANNODE_0_CanIf2PduR
            VCU_ABS_23Ch_Can_Network_CANNODE_0_PduR2Com (PduRDestPdu): PduRTransmissionConfirmation=false, PduRDestPduRef=PduCollection/VCU_ABS_23Ch_Can_Network_CANNODE_0_PduR2Com
          DCDC_303h_Can_Network_CANNODE_0_CanIf2Com
            DCDC_303h_Can_Network_CANNODE_0_CanIf2PduR (PduRSrcPdu): PduRSrcPduRef=PduCollection/DCDC_303h_Can_Network_CANNODE_0_CanIf2PduR
            DCDC_303h_Can_Network_CANNODE_0_PduR2Com (PduRDestPdu): PduRTransmissionConfirmation=false, PduRDestPduRef=PduCollection/DCDC_303h_Can_Network_CANNODE_0_PduR2Com
          VCU_BCM_1F1h_Can_Network_CANNODE_0_CanIf2Com
            VCU_BCM_1F1h_Can_Network_CANNODE_0_CanIf2PduR (PduRSrcPdu): PduRSrcPduRef=PduCollection/VCU_BCM_1F1h_Can_Network_CANNODE_0_CanIf2PduR
            VCU_BCM_1F1h_Can_Network_CANNODE_0_PduR2Com (PduRDestPdu): PduRTransmissionConfirmation=false, PduRDestPduRef=PduCollection/VCU_BCM_1F1h_Can_Network_CANNODE_0_PduR2Com
          Tester_748h_Can_Network_CANNODE_0_CanIf2Com
            Tester_748h_Can_Network_CANNODE_0_CanIf2PduR (PduRSrcPdu): PduRSrcPduRef=PduCollection/Tester_748h_Can_Network_CANNODE_0_CanIf2PduR
            Tester_748h_Can_Network_CANNODE_0_PduR2Com (PduRDestPdu): PduRTransmissionConfirmation=false, PduRDestPduRef=PduCollection/Tester_748h_Can_Network_CANNODE_0_PduR2Com
          VCU_IPK_1F2h_Can_Network_CANNODE_0_CanIf2Com
            VCU_IPK_1F2h_Can_Network_CANNODE_0_CanIf2PduR (PduRSrcPdu): PduRSrcPduRef=PduCollection/VCU_IPK_1F2h_Can_Network_CANNODE_0_CanIf2PduR
            VCU_IPK_1F2h_Can_Network_CANNODE_0_PduR2Com (PduRDestPdu): PduRTransmissionConfirmation=false, PduRDestPduRef=PduCollection/VCU_IPK_1F2h_Can_Network_CANNODE_0_PduR2Com
          VCU_SRS_163h_Can_Network_CANNODE_0_CanIf2Com
            VCU_SRS_163h_Can_Network_CANNODE_0_CanIf2PduR (PduRSrcPdu): PduRSrcPduRef=PduCollection/VCU_SRS_163h_Can_Network_CANNODE_0_CanIf2PduR
            VCU_SRS_163h_Can_Network_CANNODE_0_PduR2Com (PduRDestPdu): PduRTransmissionConfirmation=false, PduRDestPduRef=PduCollection/VCU_SRS_163h_Can_Network_CANNODE_0_PduR2Com
          VCU_353h_Can_Network_CANNODE_0_CanIf2Com
            VCU_353h_Can_Network_CANNODE_0_CanIf2PduR (PduRSrcPdu): PduRSrcPduRef=PduCollection/VCU_353h_Can_Network_CANNODE_0_CanIf2PduR
            VCU_353h_Can_Network_CANNODE_0_PduR2Com (PduRDestPdu): PduRTransmissionConfirmation=false, PduRDestPduRef=PduCollection/VCU_353h_Can_Network_CANNODE_0_PduR2Com
          Tester_7DFh_Can_Network_CANNODE_0_CanIf2Com
            Tester_7DFh_Can_Network_CANNODE_0_CanIf2PduR (PduRSrcPdu): PduRSrcPduRef=PduCollection/Tester_7DFh_Can_Network_CANNODE_0_CanIf2PduR
            Tester_7DFh_Can_Network_CANNODE_0_PduR2Com (PduRDestPdu): PduRTransmissionConfirmation=false, PduRDestPduRef=PduCollection/Tester_7DFh_Can_Network_CANNODE_0_PduR2Com
          VCU_HCM_55Fh_Can_Network_CANNODE_0_CanIf2Com
            VCU_HCM_55Fh_Can_Network_CANNODE_0_CanIf2PduR (PduRSrcPdu): PduRSrcPduRef=PduCollection/VCU_HCM_55Fh_Can_Network_CANNODE_0_CanIf2PduR
            VCU_HCM_55Fh_Can_Network_CANNODE_0_PduR2Com (PduRDestPdu): PduRTransmissionConfirmation=false, PduRDestPduRef=PduCollection/VCU_HCM_55Fh_Can_Network_CANNODE_0_PduR2Com
          OBC_604h_Can_Network_CANNODE_0_CanIf2Com
            OBC_604h_Can_Network_CANNODE_0_CanIf2PduR (PduRSrcPdu): PduRSrcPduRef=PduCollection/OBC_604h_Can_Network_CANNODE_0_CanIf2PduR
            OBC_604h_Can_Network_CANNODE_0_PduR2Com (PduRDestPdu): PduRTransmissionConfirmation=false, PduRDestPduRef=PduCollection/OBC_604h_Can_Network_CANNODE_0_PduR2Com
          VCU_IPK_362h_Can_Network_CANNODE_0_CanIf2Com
            VCU_IPK_362h_Can_Network_CANNODE_0_CanIf2PduR (PduRSrcPdu): PduRSrcPduRef=PduCollection/VCU_IPK_362h_Can_Network_CANNODE_0_CanIf2PduR
            VCU_IPK_362h_Can_Network_CANNODE_0_PduR2Com (PduRDestPdu): PduRTransmissionConfirmation=false, PduRDestPduRef=PduCollection/VCU_IPK_362h_Can_Network_CANNODE_0_PduR2Com
          BMS_329h_Can_Network_CANNODE_0_Com2CanIf
            BMS_329h_Can_Network_CANNODE_0_Com2PduR (PduRSrcPdu): PduRSrcPduRef=PduCollection/BMS_329h_Can_Network_CANNODE_0_Com2PduR
            BMS_329h_Can_Network_CANNODE_0_PduR2CanIf (PduRDestPdu): PduRTransmissionConfirmation=false, PduRDestPduRef=PduCollection/BMS_329h_Can_Network_CANNODE_0_PduR2CanIf
          BMS_503h_Can_Network_CANNODE_0_Com2CanIf
            BMS_503h_Can_Network_CANNODE_0_Com2PduR (PduRSrcPdu): PduRSrcPduRef=PduCollection/BMS_503h_Can_Network_CANNODE_0_Com2PduR
            BMS_503h_Can_Network_CANNODE_0_PduR2CanIf (PduRDestPdu): PduRTransmissionConfirmation=false, PduRDestPduRef=PduCollection/BMS_503h_Can_Network_CANNODE_0_PduR2CanIf
          BMS_501h_Can_Network_CANNODE_0_Com2CanIf
            BMS_501h_Can_Network_CANNODE_0_Com2PduR (PduRSrcPdu): PduRSrcPduRef=PduCollection/BMS_501h_Can_Network_CANNODE_0_Com2PduR
            BMS_501h_Can_Network_CANNODE_0_PduR2CanIf (PduRDestPdu): PduRTransmissionConfirmation=false, PduRDestPduRef=PduCollection/BMS_501h_Can_Network_CANNODE_0_PduR2CanIf
          BMS_1D8h_Can_Network_CANNODE_0_Com2CanIf
            BMS_1D8h_Can_Network_CANNODE_0_Com2PduR (PduRSrcPdu): PduRSrcPduRef=PduCollection/BMS_1D8h_Can_Network_CANNODE_0_Com2PduR
            BMS_1D8h_Can_Network_CANNODE_0_PduR2CanIf (PduRDestPdu): PduRTransmissionConfirmation=false, PduRDestPduRef=PduCollection/BMS_1D8h_Can_Network_CANNODE_0_PduR2CanIf
          BMS_795h_Can_Network_CANNODE_0_Com2CanIf
            BMS_795h_Can_Network_CANNODE_0_Com2PduR (PduRSrcPdu): PduRSrcPduRef=PduCollection/BMS_795h_Can_Network_CANNODE_0_Com2PduR
            BMS_795h_Can_Network_CANNODE_0_PduR2CanIf (PduRDestPdu): PduRTransmissionConfirmation=false, PduRDestPduRef=PduCollection/BMS_795h_Can_Network_CANNODE_0_PduR2CanIf
          BMS_3D7h_Can_Network_CANNODE_0_Com2CanIf
            BMS_3D7h_Can_Network_CANNODE_0_Com2PduR (PduRSrcPdu): PduRSrcPduRef=PduCollection/BMS_3D7h_Can_Network_CANNODE_0_Com2PduR
            BMS_3D7h_Can_Network_CANNODE_0_PduR2CanIf (PduRDestPdu): PduRTransmissionConfirmation=false, PduRDestPduRef=PduCollection/BMS_3D7h_Can_Network_CANNODE_0_PduR2CanIf
          BMS_606h_Can_Network_CANNODE_0_Com2CanIf
            BMS_606h_Can_Network_CANNODE_0_Com2PduR (PduRSrcPdu): PduRSrcPduRef=PduCollection/BMS_606h_Can_Network_CANNODE_0_Com2PduR
            BMS_606h_Can_Network_CANNODE_0_PduR2CanIf (PduRDestPdu): PduRTransmissionConfirmation=false, PduRDestPduRef=PduCollection/BMS_606h_Can_Network_CANNODE_0_PduR2CanIf
          BMS_598h_Can_Network_CANNODE_0_Com2CanIf
            BMS_598h_Can_Network_CANNODE_0_Com2PduR (PduRSrcPdu): PduRSrcPduRef=PduCollection/BMS_598h_Can_Network_CANNODE_0_Com2PduR
            BMS_598h_Can_Network_CANNODE_0_PduR2CanIf (PduRDestPdu): PduRTransmissionConfirmation=false, PduRDestPduRef=PduCollection/BMS_598h_Can_Network_CANNODE_0_PduR2CanIf
          BMS_509h_Can_Network_CANNODE_0_Com2CanIf
            BMS_509h_Can_Network_CANNODE_0_Com2PduR (PduRSrcPdu): PduRSrcPduRef=PduCollection/BMS_509h_Can_Network_CANNODE_0_Com2PduR
            BMS_509h_Can_Network_CANNODE_0_PduR2CanIf (PduRDestPdu): PduRTransmissionConfirmation=false, PduRDestPduRef=PduCollection/BMS_509h_Can_Network_CANNODE_0_PduR2CanIf
          BMS_605h_Can_Network_CANNODE_0_Com2CanIf
            BMS_605h_Can_Network_CANNODE_0_Com2PduR (PduRSrcPdu): PduRSrcPduRef=PduCollection/BMS_605h_Can_Network_CANNODE_0_Com2PduR
            BMS_605h_Can_Network_CANNODE_0_PduR2CanIf (PduRDestPdu): PduRTransmissionConfirmation=false, PduRDestPduRef=PduCollection/BMS_605h_Can_Network_CANNODE_0_PduR2CanIf
          BMS_7C8h_Can_Network_CANNODE_0_Com2CanIf
            BMS_7C8h_Can_Network_CANNODE_0_Com2PduR (PduRSrcPdu): PduRSrcPduRef=PduCollection/BMS_7C8h_Can_Network_CANNODE_0_Com2PduR
            BMS_7C8h_Can_Network_CANNODE_0_PduR2CanIf (PduRDestPdu): PduRTransmissionConfirmation=false, PduRDestPduRef=PduCollection/BMS_7C8h_Can_Network_CANNODE_0_PduR2CanIf
          BMS_596h_Can_Network_CANNODE_0_Com2CanIf
            BMS_596h_Can_Network_CANNODE_0_Com2PduR (PduRSrcPdu): PduRSrcPduRef=PduCollection/BMS_596h_Can_Network_CANNODE_0_Com2PduR
            BMS_596h_Can_Network_CANNODE_0_PduR2CanIf (PduRDestPdu): PduRTransmissionConfirmation=false, PduRDestPduRef=PduCollection/BMS_596h_Can_Network_CANNODE_0_PduR2CanIf
          BMS_3DAh_Can_Network_CANNODE_0_Com2CanIf
            BMS_3DAh_Can_Network_CANNODE_0_Com2PduR (PduRSrcPdu): PduRSrcPduRef=PduCollection/BMS_3DAh_Can_Network_CANNODE_0_Com2PduR
            BMS_3DAh_Can_Network_CANNODE_0_PduR2CanIf (PduRDestPdu): PduRTransmissionConfirmation=false, PduRDestPduRef=PduCollection/BMS_3DAh_Can_Network_CANNODE_0_PduR2CanIf
          BMS_32Ah_Can_Network_CANNODE_0_Com2CanIf
            BMS_32Ah_Can_Network_CANNODE_0_Com2PduR (PduRSrcPdu): PduRSrcPduRef=PduCollection/BMS_32Ah_Can_Network_CANNODE_0_Com2PduR
            BMS_32Ah_Can_Network_CANNODE_0_PduR2CanIf (PduRDestPdu): PduRTransmissionConfirmation=false, PduRDestPduRef=PduCollection/BMS_32Ah_Can_Network_CANNODE_0_PduR2CanIf
          BMS_3DBh_Can_Network_CANNODE_0_Com2CanIf
            BMS_3DBh_Can_Network_CANNODE_0_Com2PduR (PduRSrcPdu): PduRSrcPduRef=PduCollection/BMS_3DBh_Can_Network_CANNODE_0_Com2PduR
            BMS_3DBh_Can_Network_CANNODE_0_PduR2CanIf (PduRDestPdu): PduRTransmissionConfirmation=false, PduRDestPduRef=PduCollection/BMS_3DBh_Can_Network_CANNODE_0_PduR2CanIf
          BMS_603h_Can_Network_CANNODE_0_Com2CanIf
            BMS_603h_Can_Network_CANNODE_0_Com2PduR (PduRSrcPdu): PduRSrcPduRef=PduCollection/BMS_603h_Can_Network_CANNODE_0_Com2PduR
            BMS_603h_Can_Network_CANNODE_0_PduR2CanIf (PduRDestPdu): PduRTransmissionConfirmation=false, PduRDestPduRef=PduCollection/BMS_603h_Can_Network_CANNODE_0_PduR2CanIf
          BMS_594h_Can_Network_CANNODE_0_Com2CanIf
            BMS_594h_Can_Network_CANNODE_0_Com2PduR (PduRSrcPdu): PduRSrcPduRef=PduCollection/BMS_594h_Can_Network_CANNODE_0_Com2PduR
            BMS_594h_Can_Network_CANNODE_0_PduR2CanIf (PduRDestPdu): PduRTransmissionConfirmation=false, PduRDestPduRef=PduCollection/BMS_594h_Can_Network_CANNODE_0_PduR2CanIf
          CTS_CHG_J1939_Network_CANNODE_0_CanIf2Com
            CTS_CHG_J1939_Network_CANNODE_0_CanIf2PduR (PduRSrcPdu): PduRSrcPduRef=PduCollection/CTS_CHG_J1939_Network_CANNODE_0_CanIf2PduR
            CTS_CHG_J1939_Network_CANNODE_0_PduR2Com (PduRDestPdu): PduRTransmissionConfirmation=false, PduRDestPduRef=PduCollection/CTS_CHG_J1939_Network_CANNODE_0_PduR2Com
          CSD_CHG_J1939_Network_CANNODE_0_CanIf2Com
            CSD_CHG_J1939_Network_CANNODE_0_CanIf2PduR (PduRSrcPdu): PduRSrcPduRef=PduCollection/CSD_CHG_J1939_Network_CANNODE_0_CanIf2PduR
            CSD_CHG_J1939_Network_CANNODE_0_PduR2Com (PduRDestPdu): PduRTransmissionConfirmation=false, PduRDestPduRef=PduCollection/CSD_CHG_J1939_Network_CANNODE_0_PduR2Com
          CST_CHG_J1939_Network_CANNODE_0_CanIf2Com
            CST_CHG_J1939_Network_CANNODE_0_CanIf2PduR (PduRSrcPdu): PduRSrcPduRef=PduCollection/CST_CHG_J1939_Network_CANNODE_0_CanIf2PduR
            CST_CHG_J1939_Network_CANNODE_0_PduR2Com (PduRDestPdu): PduRTransmissionConfirmation=false, PduRDestPduRef=PduCollection/CST_CHG_J1939_Network_CANNODE_0_PduR2Com
          CHM_CHG_J1939_Network_CANNODE_0_CanIf2Com
            CHM_CHG_J1939_Network_CANNODE_0_CanIf2PduR (PduRSrcPdu): PduRSrcPduRef=PduCollection/CHM_CHG_J1939_Network_CANNODE_0_CanIf2PduR
            CHM_CHG_J1939_Network_CANNODE_0_PduR2Com (PduRDestPdu): PduRTransmissionConfirmation=false, PduRDestPduRef=PduCollection/CHM_CHG_J1939_Network_CANNODE_0_PduR2Com
          CRO_CHG_J1939_Network_CANNODE_0_CanIf2Com
            CRO_CHG_J1939_Network_CANNODE_0_CanIf2PduR (PduRSrcPdu): PduRSrcPduRef=PduCollection/CRO_CHG_J1939_Network_CANNODE_0_CanIf2PduR
            CRO_CHG_J1939_Network_CANNODE_0_PduR2Com (PduRDestPdu): PduRTransmissionConfirmation=false, PduRDestPduRef=PduCollection/CRO_CHG_J1939_Network_CANNODE_0_PduR2Com
          CEM_CHG_J1939_Network_CANNODE_0_CanIf2Com
            CEM_CHG_J1939_Network_CANNODE_0_CanIf2PduR (PduRSrcPdu): PduRSrcPduRef=PduCollection/CEM_CHG_J1939_Network_CANNODE_0_CanIf2PduR
            CEM_CHG_J1939_Network_CANNODE_0_PduR2Com (PduRDestPdu): PduRTransmissionConfirmation=false, PduRDestPduRef=PduCollection/CEM_CHG_J1939_Network_CANNODE_0_PduR2Com
          CML_CHG_J1939_Network_CANNODE_0_CanIf2Com
            CML_CHG_J1939_Network_CANNODE_0_CanIf2PduR (PduRSrcPdu): PduRSrcPduRef=PduCollection/CML_CHG_J1939_Network_CANNODE_0_CanIf2PduR
            CML_CHG_J1939_Network_CANNODE_0_PduR2Com (PduRDestPdu): PduRTransmissionConfirmation=false, PduRDestPduRef=PduCollection/CML_CHG_J1939_Network_CANNODE_0_PduR2Com
          CCS_CHG_J1939_Network_CANNODE_0_CanIf2Com
            CCS_CHG_J1939_Network_CANNODE_0_CanIf2PduR (PduRSrcPdu): PduRSrcPduRef=PduCollection/CCS_CHG_J1939_Network_CANNODE_0_CanIf2PduR
            CCS_CHG_J1939_Network_CANNODE_0_PduR2Com (PduRDestPdu): PduRTransmissionConfirmation=false, PduRDestPduRef=PduCollection/CCS_CHG_J1939_Network_CANNODE_0_PduR2Com
          CRM_CHG_J1939_Network_CANNODE_0_CanIf2Com
            CRM_CHG_J1939_Network_CANNODE_0_CanIf2PduR (PduRSrcPdu): PduRSrcPduRef=PduCollection/CRM_CHG_J1939_Network_CANNODE_0_CanIf2PduR
            CRM_CHG_J1939_Network_CANNODE_0_PduR2Com (PduRDestPdu): PduRTransmissionConfirmation=false, PduRDestPduRef=PduCollection/CRM_CHG_J1939_Network_CANNODE_0_PduR2Com
          BHM_BCU_J1939_Network_CANNODE_0_Com2CanIf
            BHM_BCU_J1939_Network_CANNODE_0_Com2PduR (PduRSrcPdu): PduRSrcPduRef=PduCollection/BHM_BCU_J1939_Network_CANNODE_0_Com2PduR
            BHM_BCU_J1939_Network_CANNODE_0_PduR2CanIf (PduRDestPdu): PduRTransmissionConfirmation=false, PduRDestPduRef=PduCollection/BHM_BCU_J1939_Network_CANNODE_0_PduR2CanIf
          BSM_BCU_J1939_Network_CANNODE_0_Com2CanIf
            BSM_BCU_J1939_Network_CANNODE_0_Com2PduR (PduRSrcPdu): PduRSrcPduRef=PduCollection/BSM_BCU_J1939_Network_CANNODE_0_Com2PduR
            BSM_BCU_J1939_Network_CANNODE_0_PduR2CanIf (PduRDestPdu): PduRTransmissionConfirmation=false, PduRDestPduRef=PduCollection/BSM_BCU_J1939_Network_CANNODE_0_PduR2CanIf
          BST_BCU_J1939_Network_CANNODE_0_Com2CanIf
            BST_BCU_J1939_Network_CANNODE_0_Com2PduR (PduRSrcPdu): PduRSrcPduRef=PduCollection/BST_BCU_J1939_Network_CANNODE_0_Com2PduR
            BST_BCU_J1939_Network_CANNODE_0_PduR2CanIf (PduRDestPdu): PduRTransmissionConfirmation=false, PduRDestPduRef=PduCollection/BST_BCU_J1939_Network_CANNODE_0_PduR2CanIf
          BRO_BCU_J1939_Network_CANNODE_0_Com2CanIf
            BRO_BCU_J1939_Network_CANNODE_0_Com2PduR (PduRSrcPdu): PduRSrcPduRef=PduCollection/BRO_BCU_J1939_Network_CANNODE_0_Com2PduR
            BRO_BCU_J1939_Network_CANNODE_0_PduR2CanIf (PduRDestPdu): PduRTransmissionConfirmation=false, PduRDestPduRef=PduCollection/BRO_BCU_J1939_Network_CANNODE_0_PduR2CanIf
          BEM_BCU_J1939_Network_CANNODE_0_Com2CanIf
            BEM_BCU_J1939_Network_CANNODE_0_Com2PduR (PduRSrcPdu): PduRSrcPduRef=PduCollection/BEM_BCU_J1939_Network_CANNODE_0_Com2PduR
            BEM_BCU_J1939_Network_CANNODE_0_PduR2CanIf (PduRDestPdu): PduRTransmissionConfirmation=false, PduRDestPduRef=PduCollection/BEM_BCU_J1939_Network_CANNODE_0_PduR2CanIf
          BCL_BCU_J1939_Network_CANNODE_0_Com2CanIf
            BCL_BCU_J1939_Network_CANNODE_0_Com2PduR (PduRSrcPdu): PduRSrcPduRef=PduCollection/BCL_BCU_J1939_Network_CANNODE_0_Com2PduR
            BCL_BCU_J1939_Network_CANNODE_0_PduR2CanIf (PduRDestPdu): PduRTransmissionConfirmation=false, PduRDestPduRef=PduCollection/BCL_BCU_J1939_Network_CANNODE_0_PduR2CanIf
          BSD_BCU_J1939_Network_CANNODE_0_Com2CanIf
            BSD_BCU_J1939_Network_CANNODE_0_Com2PduR (PduRSrcPdu): PduRSrcPduRef=PduCollection/BSD_BCU_J1939_Network_CANNODE_0_Com2PduR
            BSD_BCU_J1939_Network_CANNODE_0_PduR2CanIf (PduRDestPdu): PduRTransmissionConfirmation=false, PduRDestPduRef=PduCollection/BSD_BCU_J1939_Network_CANNODE_0_PduR2CanIf
          BCP_BCU_J1939_Network_CANNODE_0_Com2J1939Tp
            BCP_BCU_J1939_Network_CANNODE_0_PduR2J1939Tp (PduRDestPdu): PduRTransmissionConfirmation=0, PduRDestPduRef=PduCollection/BCP_BCU_J1939_Network_CANNODE_0_PduR2J1939Tp
            BCP_BCU_J1939_Network_CANNODE_0_Com2PduR (PduRSrcPdu): PduRSrcPduRef=PduCollection/BCP_BCU_J1939_Network_CANNODE_0_Com2PduR
          BCS_BCU_J1939_Network_CANNODE_0_Com2J1939Tp
            BCS_BCU_J1939_Network_CANNODE_0_PduR21939Tp (PduRDestPdu): PduRTransmissionConfirmation=0, PduRDestPduRef=BCS_BCU_J1939_Network_CANNODE_0_PduR2J1939Tp
            BCS_BCU_J1939_Network_CANNODE_0_Com2PduR (PduRSrcPdu): PduRSrcPduRef=PduCollection/BCS_BCU_J1939_Network_CANNODE_0_Com2PduR
          BRM_BCU_J1939_Network_CANNODE_0_Com2J1939Tp
            BRM_BCU_J1939_Network_CANNODE_0_PduR2J1939Tp (PduRDestPdu): PduRTransmissionConfirmation=0, PduRDestPduRef=PduCollection/BRM_BCU_J1939_Network_CANNODE_0_PduR2J1939Tp
            BRM_BCU_J1939_Network_CANNODE_0_Com2PduR (PduRSrcPdu): PduRSrcPduRef=PduCollection/BRM_BCU_J1939_Network_CANNODE_0_Com2PduR
          Old_BRM_BCU_J1939_Network_CANNODE_0_Com2J1939Tp
            Old_BRM_BCU_J1939_Network_CANNODE_0_PduR2J1939Tp (PduRDestPdu): PduRTransmissionConfirmation=1, PduRDestPduRef=PduCollection/Old_BRM_BCU_J1939_Network_CANNODE_0_PduR2J1939Tp
            Old_BRM_BCU_J1939_Network_CANNODE_0_Com2PduR (PduRSrcPdu): PduRSrcPduRef=PduCollection/Old_BRM_BCU_J1939_Network_CANNODE_0_Com2PduR
    4 x PduRBswModules, all with PduRCancelReceive=0, PduRCancelTransmit=0, PduRChangeParameterApi=0, PduRRetransmission=0, PduRUseTag=0:
      Com: PduRCommunicationInterface=1, PduRLowerModule=0, PduRTransportProtocol=1, PduRTriggertransmit=1, PduRTxConfirmation=0, PduRUpperModule=1, PduRBswModuleRef=Com
      CanIf: PduRCommunicationInterface=1, PduRLowerModule=1, PduRTransportProtocol=0, PduRTriggertransmit=0, PduRTxConfirmation=1, PduRUpperModule=0, PduRBswModuleRef=CanIf
      J1939Rm: PduRCommunicationInterface=1, PduRLowerModule=0, PduRTransportProtocol=0, PduRTriggertransmit=0, PduRTxConfirmation=1, PduRUpperModule=1
      J1939Tp: PduRCommunicationInterface=0, PduRLowerModule=1, PduRTransportProtocol=1, PduRTriggertransmit=1, PduRTxConfirmation=1, PduRUpperModule=0, PduRBswModuleRef=J1939Tp
  module config EcuC: implementation-config-variant=VARIANT-PRE-COMPILE
    EcucConfigSet
      PduCollection (EcucPduCollection): PduIdTypeEnum=uint16, PduLengthTypeEnum=uint16
        107 x Pdu:
          PEU_0B4h_Can_Network_CANNODE_0_CanIf2PduR: PduLength=8
          PEU_0B4h_Can_Network_CANNODE_0_PduR2Com: PduLength=8
          VCU_1E3h_Can_Network_CANNODE_0_CanIf2PduR: PduLength=8
          VCU_1E3h_Can_Network_CANNODE_0_PduR2Com: PduLength=8
          PEU_18Bh_Can_Network_CANNODE_0_CanIf2PduR: PduLength=8
          PEU_18Bh_Can_Network_CANNODE_0_PduR2Com: PduLength=8
          VCU_ABS_23Ch_Can_Network_CANNODE_0_CanIf2PduR: PduLength=8
          VCU_ABS_23Ch_Can_Network_CANNODE_0_PduR2Com: PduLength=8
          DCDC_303h_Can_Network_CANNODE_0_CanIf2PduR: PduLength=8
          DCDC_303h_Can_Network_CANNODE_0_PduR2Com: PduLength=8
          VCU_BCM_1F1h_Can_Network_CANNODE_0_CanIf2PduR: PduLength=8
          VCU_BCM_1F1h_Can_Network_CANNODE_0_PduR2Com: PduLength=8
          Tester_748h_Can_Network_CANNODE_0_CanIf2PduR: PduLength=8
          Tester_748h_Can_Network_CANNODE_0_PduR2Com: PduLength=8
          VCU_IPK_1F2h_Can_Network_CANNODE_0_CanIf2PduR: PduLength=2
          VCU_IPK_1F2h_Can_Network_CANNODE_0_PduR2Com: PduLength=2
          VCU_SRS_163h_Can_Network_CANNODE_0_CanIf2PduR: PduLength=8
          VCU_SRS_163h_Can_Network_CANNODE_0_PduR2Com: PduLength=8
          VCU_353h_Can_Network_CANNODE_0_CanIf2PduR: PduLength=8
          VCU_353h_Can_Network_CANNODE_0_PduR2Com: PduLength=8
          Tester_7DFh_Can_Network_CANNODE_0_CanIf2PduR: PduLength=8
          Tester_7DFh_Can_Network_CANNODE_0_PduR2Com: PduLength=8
          VCU_HCM_55Fh_Can_Network_CANNODE_0_CanIf2PduR: PduLength=8
          VCU_HCM_55Fh_Can_Network_CANNODE_0_PduR2Com: PduLength=8
          OBC_604h_Can_Network_CANNODE_0_CanIf2PduR: PduLength=8
          OBC_604h_Can_Network_CANNODE_0_PduR2Com: PduLength=8
          VCU_IPK_362h_Can_Network_CANNODE_0_CanIf2PduR: PduLength=8
          VCU_IPK_362h_Can_Network_CANNODE_0_PduR2Com: PduLength=8
          XCP_CMD_Can_Network_CANNODE_0_CanIf2Xcp: PduLength=8
          BMS_329h_Can_Network_CANNODE_0_Com2PduR: PduLength=8
          BMS_329h_Can_Network_CANNODE_0_PduR2CanIf: PduLength=8
          BMS_503h_Can_Network_CANNODE_0_Com2PduR: PduLength=8
          BMS_503h_Can_Network_CANNODE_0_PduR2CanIf: PduLength=8
          BMS_501h_Can_Network_CANNODE_0_Com2PduR: PduLength=8
          BMS_501h_Can_Network_CANNODE_0_PduR2CanIf: PduLength=8
          BMS_1D8h_Can_Network_CANNODE_0_Com2PduR: PduLength=8
          BMS_1D8h_Can_Network_CANNODE_0_PduR2CanIf: PduLength=8
          BMS_795h_Can_Network_CANNODE_0_Com2PduR: PduLength=8
          BMS_795h_Can_Network_CANNODE_0_PduR2CanIf: PduLength=8
          XCP_RES_DAQ_Can_Network_CANNODE_0_Xcp2CanIf: PduLength=8
          BMS_3D7h_Can_Network_CANNODE_0_Com2PduR: PduLength=8
          BMS_3D7h_Can_Network_CANNODE_0_PduR2CanIf: PduLength=8
          BMS_606h_Can_Network_CANNODE_0_Com2PduR: PduLength=8
          BMS_606h_Can_Network_CANNODE_0_PduR2CanIf: PduLength=8
          BMS_598h_Can_Network_CANNODE_0_Com2PduR: PduLength=8
          BMS_598h_Can_Network_CANNODE_0_PduR2CanIf: PduLength=8
          BMS_509h_Can_Network_CANNODE_0_Com2PduR: PduLength=8
          BMS_509h_Can_Network_CANNODE_0_PduR2CanIf: PduLength=8
          BMS_605h_Can_Network_CANNODE_0_Com2PduR: PduLength=8
          BMS_605h_Can_Network_CANNODE_0_PduR2CanIf: PduLength=8
          BMS_7C8h_Can_Network_CANNODE_0_Com2PduR: PduLength=8
          BMS_7C8h_Can_Network_CANNODE_0_PduR2CanIf: PduLength=8
          BMS_596h_Can_Network_CANNODE_0_Com2PduR: PduLength=8
          BMS_596h_Can_Network_CANNODE_0_PduR2CanIf: PduLength=8
          BMS_3DAh_Can_Network_CANNODE_0_Com2PduR: PduLength=8
          BMS_3DAh_Can_Network_CANNODE_0_PduR2CanIf: PduLength=8
          BMS_32Ah_Can_Network_CANNODE_0_Com2PduR: PduLength=8
          BMS_32Ah_Can_Network_CANNODE_0_PduR2CanIf: PduLength=8
          BMS_3DBh_Can_Network_CANNODE_0_Com2PduR: PduLength=8
          BMS_3DBh_Can_Network_CANNODE_0_PduR2CanIf: PduLength=8
          BMS_603h_Can_Network_CANNODE_0_Com2PduR: PduLength=8
          BMS_603h_Can_Network_CANNODE_0_PduR2CanIf: PduLength=8
          BMS_594h_Can_Network_CANNODE_0_Com2PduR: PduLength=8
          BMS_594h_Can_Network_CANNODE_0_PduR2CanIf: PduLength=8
          CTS_CHG_J1939_Network_CANNODE_0_CanIf2PduR: PduLength=7
          CTS_CHG_J1939_Network_CANNODE_0_PduR2Com: PduLength=7
          CSD_CHG_J1939_Network_CANNODE_0_CanIf2PduR: PduLength=8
          CSD_CHG_J1939_Network_CANNODE_0_PduR2Com: PduLength=8
          CST_CHG_J1939_Network_CANNODE_0_CanIf2PduR: PduLength=4
          CST_CHG_J1939_Network_CANNODE_0_PduR2Com: PduLength=4
          CHM_CHG_J1939_Network_CANNODE_0_CanIf2PduR: PduLength=3
          CHM_CHG_J1939_Network_CANNODE_0_PduR2Com: PduLength=3
          CRO_CHG_J1939_Network_CANNODE_0_CanIf2PduR: PduLength=1
          CRO_CHG_J1939_Network_CANNODE_0_PduR2Com: PduLength=1
          CEM_CHG_J1939_Network_CANNODE_0_CanIf2PduR: PduLength=4
          CEM_CHG_J1939_Network_CANNODE_0_PduR2Com: PduLength=4
          CML_CHG_J1939_Network_CANNODE_0_CanIf2PduR: PduLength=8
          CML_CHG_J1939_Network_CANNODE_0_PduR2Com: PduLength=8
          CCS_CHG_J1939_Network_CANNODE_0_CanIf2PduR: PduLength=8
          CCS_CHG_J1939_Network_CANNODE_0_PduR2Com: PduLength=8
          CRM_CHG_J1939_Network_CANNODE_0_CanIf2PduR: PduLength=8
          CRM_CHG_J1939_Network_CANNODE_0_PduR2Com: PduLength=8
          BHM_BCU_J1939_Network_CANNODE_0_Com2PduR: PduLength=2
          BHM_BCU_J1939_Network_CANNODE_0_PduR2CanIf: PduLength=2
          BSM_BCU_J1939_Network_CANNODE_0_Com2PduR: PduLength=7
          BSM_BCU_J1939_Network_CANNODE_0_PduR2CanIf: PduLength=7
          BST_BCU_J1939_Network_CANNODE_0_Com2PduR: PduLength=4
          BST_BCU_J1939_Network_CANNODE_0_PduR2CanIf: PduLength=4
          BRO_BCU_J1939_Network_CANNODE_0_Com2PduR: PduLength=1
          BRO_BCU_J1939_Network_CANNODE_0_PduR2CanIf: PduLength=1
          BEM_BCU_J1939_Network_CANNODE_0_Com2PduR: PduLength=4
          BEM_BCU_J1939_Network_CANNODE_0_PduR2CanIf: PduLength=4
          BCL_BCU_J1939_Network_CANNODE_0_Com2PduR: PduLength=5
          BCL_BCU_J1939_Network_CANNODE_0_PduR2CanIf: PduLength=5
          BSD_BCU_J1939_Network_CANNODE_0_Com2PduR: PduLength=7
          BSD_BCU_J1939_Network_CANNODE_0_PduR2CanIf: PduLength=7
          NPDU_RX_CM_CMDT_J1939_Network_CANNODE_0_CanIf2J1939Tp: PduLength=8
          NPDU_TX_DT_J1939_Network_CANNODE_0_J1939Tp2CanIf: PduLength=8
          NPDU_TX_CM_J1939_Network_CANNODE_0_J1939Tp2CanIf: PduLength=8
          BCP_BCU_J1939_Network_CANNODE_0_Com2PduR: PduLength=13
          BCP_BCU_J1939_Network_CANNODE_0_PduR2J1939Tp: PduLength=13
          BCS_BCU_J1939_Network_CANNODE_0_Com2PduR: PduLength=9
          BCS_BCU_J1939_Network_CANNODE_0_PduR2J1939Tp: PduLength=9
          BRM_BCU_J1939_Network_CANNODE_0_Com2PduR: PduLength=49
          BRM_BCU_J1939_Network_CANNODE_0_PduR2J1939Tp: PduLength=49
          Old_BRM_BCU_J1939_Network_CANNODE_0_Com2PduR: PduLength=41
          Old_BRM_BCU_J1939_Network_CANNODE_0_PduR2J1939Tp: PduLength=41
    EcuCRbSettings: EcuCRbArRelease=AR42_Rev2, EcuCRbRteInUse=true
