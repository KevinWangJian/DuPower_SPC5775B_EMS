AUTOSAR XML (schema 4-0-3)
standard types defined: Std_ReturnType
package /AUTOSAR_Std/ImplementationDataTypes  # AUTOSAR Standard types
  impl type Std_VersionInfoType: category=STRUCTURE, type-emitter=HEADER_FILE  # Standard Version Info Type | This type shall be used to request the version of a BSW module using the <Module name>_GetVersionInfo()function.
    5 x element, all with category=TYPE_REFERENCE:
      vendorID: implementation-data-type=uint16
      moduleID: implementation-data-type=uint16
      sw_major_version: implementation-data-type=uint8
      sw_minor_version: implementation-data-type=uint8
      sw_patch_version: implementation-data-type=uint8
package /AUTOSAR_Std/CompuMethods
  compu method Std_High_Low: 0=STD_LOW (no error occurred), 1=STD_HIGH (generic indication that an error occurred)
  compu method Std_Active_Idle: 0=STD_IDLE (no error occurred), 1=STD_ACTIVE (generic indication that an error occurred)
  compu method Std_On_Off: 0=STD_OFF (no error occurred), 1=STD_ON (generic indication that an error occurred)
