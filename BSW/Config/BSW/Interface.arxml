AUTOSAR XML (schema 4-2-2)
package /Interfaces
  11 x sender receiver interface:
    SenderReceiverInterface_boolean
      data VDP_boolean: type=boolean
    SenderReceiverInterface_float32
      data VDP_float32: type=float32
    SenderReceiverInterface_float64
      data VDP_float64: type=float64
    SenderReceiverInterface_sint16
      data VDP_sint16: type=sint16
    SenderReceiverInterface_sint32
      data VDP_sint32: type=sint32
    SenderReceiverInterface_sint8
      data VDP_sint8: type=sint8
    SenderReceiverInterface_uint16
      data VDP_uint16: type=uint16
    SenderReceiverInterface_uint32
      data VDP_uint32: type=uint32
    SenderReceiverInterface_uint8
      data VDP_uint8: type=uint8
    SenderReceiverInterface_uint64
      data VDP_uint64: type=uint64
    SenderReceiverInterface_sint64
      data VDP_sint64: type=sint64
