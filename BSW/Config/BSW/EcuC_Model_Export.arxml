AUTOSAR XML (schema 4-2-2)
package /ETAS_Project/EcucModuleConfigurationValuess
  module config EcuC
    EcucConfigSet
      PduCollection (EcucPduCollection): PduIdTypeEnum=uint16, PduLengthTypeEnum=uint16
        107 x Pdu:
          PEU_0B4h_Can_Network_CANNODE_0_CanIf2PduR: PduLength=8
          PEU_0B4h_Can_Network_CANNODE_0_PduR2Com: PduLength=8
          VCU_1E3h_Can_Network_CANNODE_0_CanIf2PduR: PduLength=8
          VCU_1E3h_Can_Network_CANNODE_0_PduR2Com: PduLength=8
          PEU_18Bh_Can_Network_CANNODE_0_CanIf2PduR: PduLength=8
          PEU_18Bh_Can_Network_CANNODE_0_PduR2Com: PduLength=8
          VCU_ABS_23Ch_Can_Network_CANNODE_0_CanIf2PduR: PduLength=8
          VCU_ABS_23Ch_Can_Network_CANNODE_0_PduR2Com: PduLength=8
          DCDC_303h_Can_Network_CANNODE_0_CanIf2PduR: PduLength=8
          DCDC_303h_Can_Network_CANNODE_0_PduR2Com: PduLength=8
          VCU_BCM_1F1h_Can_Network_CANNODE_0_CanIf2PduR: PduLength=8
          VCU_BCM_1F1h_Can_Network_CANNODE_0_PduR2Com: PduLength=8
          Tester_748h_Can_Network_CANNODE_0_CanIf2PduR: PduLength=8
          Tester_748h_Can_Network_CANNODE_0_PduR2Com: PduLength=8
          VCU_IPK_1F2h_Can_Network_CANNODE_0_CanIf2PduR: PduLength=2
          VCU_IPK_1F2h_Can_Network_CANNODE_0_PduR2Com: PduLength=2
          VCU_SRS_163h_Can_Network_CANNODE_0_CanIf2PduR: PduLength=8
          VCU_SRS_163h_Can_Network_CANNODE_0_PduR2Com: PduLength=8
          VCU_353h_Can_Network_CANNODE_0_CanIf2PduR: PduLength=8
          VCU_353h_Can_Network_CANNODE_0_PduR2Com: PduLength=8
          Tester_7DFh_Can_Network_CANNODE_0_CanIf2PduR: PduLength=8
          Tester_7DFh_Can_Network_CANNODE_0_PduR2Com: PduLength=8
          VCU_HCM_55Fh_Can_Network_CANNODE_0_CanIf2PduR: PduLength=8
          VCU_HCM_55Fh_Can_Network_CANNODE_0_PduR2Com: PduLength=8
          OBC_604h_Can_Network_CANNODE_0_CanIf2PduR: PduLength=8
          OBC_604h_Can_Network_CANNODE_0_PduR2Com: PduLength=8
          VCU_IPK_362h_Can_Network_CANNODE_0_CanIf2PduR: PduLength=8
          VCU_IPK_362h_Can_Network_CANNODE_0_PduR2Com: PduLength=8
          XCP_CMD_Can_Network_CANNODE_0_CanIf2Xcp: PduLength=8
          BMS_329h_Can_Network_CANNODE_0_Com2PduR: PduLength=8
          BMS_329h_Can_Network_CANNODE_0_PduR2CanIf: PduLength=8
          BMS_503h_Can_Network_CANNODE_0_Com2PduR: PduLength=8
          BMS_503h_Can_Network_CANNODE_0_PduR2CanIf: PduLength=8
          BMS_501h_Can_Network_CANNODE_0_Com2PduR: PduLength=8
          BMS_501h_Can_Network_CANNODE_0_PduR2CanIf: PduLength=8
          BMS_1D8h_Can_Network_CANNODE_0_Com2PduR: PduLength=8
          BMS_1D8h_Can_Network_CANNODE_0_PduR2CanIf: PduLength=8
          BMS_795h_Can_Network_CANNODE_0_Com2PduR: PduLength=8
          BMS_795h_Can_Network_CANNODE_0_PduR2CanIf: PduLength=8
          XCP_RES_DAQ_Can_Network_CANNODE_0_Xcp2CanIf: PduLength=8
          BMS_3D7h_Can_Network_CANNODE_0_Com2PduR: PduLength=8
          BMS_3D7h_Can_Network_CANNODE_0_PduR2CanIf: PduLength=8
          BMS_606h_Can_Network_CANNODE_0_Com2PduR: PduLength=8
          BMS_606h_Can_Network_CANNODE_0_PduR2CanIf: PduLength=8
          BMS_598h_Can_Network_CANNODE_0_Com2PduR: PduLength=8
          BMS_598h_Can_Network_CANNODE_0_PduR2CanIf: PduLength=8
          BMS_509h_Can_Network_CANNODE_0_Com2PduR: PduLength=8
          BMS_509h_Can_Network_CANNODE_0_PduR2CanIf: PduLength=8
          BMS_605h_Can_Network_CANNODE_0_Com2PduR: PduLength=8
          BMS_605h_Can_Network_CANNODE_0_PduR2CanIf: PduLength=8
          BMS_7C8h_Can_Network_CANNODE_0_Com2PduR: PduLength=8
          BMS_7C8h_Can_Network_CANNODE_0_PduR2CanIf: PduLength=8
          BMS_596h_Can_Network_CANNODE_0_Com2PduR: PduLength=8
          BMS_596h_Can_Network_CANNODE_0_PduR2CanIf: PduLength=8
          BMS_3DAh_Can_Network_CANNODE_0_Com2PduR: PduLength=8
          BMS_3DAh_Can_Network_CANNODE_0_PduR2CanIf: PduLength=8
          BMS_32Ah_Can_Network_CANNODE_0_Com2PduR: PduLength=8
          BMS_32Ah_Can_Network_CANNODE_0_PduR2CanIf: PduLength=8
          BMS_3DBh_Can_Network_CANNODE_0_Com2PduR: PduLength=8
          BMS_3DBh_Can_Network_CANNODE_0_PduR2CanIf: PduLength=8
          BMS_603h_Can_Network_CANNODE_0_Com2PduR: PduLength=8
          BMS_603h_Can_Network_CANNODE_0_PduR2CanIf: PduLength=8
          BMS_594h_Can_Network_CANNODE_0_Com2PduR: PduLength=8
          BMS_594h_Can_Network_CANNODE_0_PduR2CanIf: PduLength=8
          CTS_CHG_J1939_Network_CANNODE_0_CanIf2PduR: PduLength=7
          CTS_CHG_J1939_Network_CANNODE_0_PduR2Com: PduLength=7
          CSD_CHG_J1939_Network_CANNODE_0_CanIf2PduR: PduLength=8
          CSD_CHG_J1939_Network_CANNODE_0_PduR2Com: PduLength=8
          CST_CHG_J1939_Network_CANNODE_0_CanIf2PduR: PduLength=4
          CST_CHG_J1939_Network_CANNODE_0_PduR2Com: PduLength=4
          CHM_CHG_J1939_Network_CANNODE_0_CanIf2PduR: PduLength=3
          CHM_CHG_J1939_Network_CANNODE_0_PduR2Com: PduLength=3
          CRO_CHG_J1939_Network_CANNODE_0_CanIf2PduR: PduLength=1
          CRO_CHG_J1939_Network_CANNODE_0_PduR2Com: PduLength=1
          CEM_CHG_J1939_Network_CANNODE_0_CanIf2PduR: PduLength=4
          CEM_CHG_J1939_Network_CANNODE_0_PduR2Com: PduLength=4
          CML_CHG_J1939_Network_CANNODE_0_CanIf2PduR: PduLength=8
          CML_CHG_J1939_Network_CANNODE_0_PduR2Com: PduLength=8
          CCS_CHG_J1939_Network_CANNODE_0_CanIf2PduR: PduLength=8
          CCS_CHG_J1939_Network_CANNODE_0_PduR2Com: PduLength=8
          CRM_CHG_J1939_Network_CANNODE_0_CanIf2PduR: PduLength=8
          CRM_CHG_J1939_Network_CANNODE_0_PduR2Com: PduLength=8
          BHM_BCU_J1939_Network_CANNODE_0_Com2PduR: PduLength=2
          BHM_BCU_J1939_Network_CANNODE_0_PduR2CanIf: PduLength=2
          BSM_BCU_J1939_Network_CANNODE_0_Com2PduR: PduLength=7
          BSM_BCU_J1939_Network_CANNODE_0_PduR2CanIf: PduLength=7
          BST_BCU_J1939_Network_CANNODE_0_Com2PduR: PduLength=4
          BST_BCU_J1939_Network_CANNODE_0_PduR2CanIf: PduLength=4
          BRO_BCU_J1939_Network_CANNODE_0_Com2PduR: PduLength=1
          BRO_BCU_J1939_Network_CANNODE_0_PduR2CanIf: PduLength=1
          BEM_BCU_J1939_Network_CANNODE_0_Com2PduR: PduLength=4
          BEM_BCU_J1939_Network_CANNODE_0_PduR2CanIf: PduLength=4
          BCL_BCU_J1939_Network_CANNODE_0_Com2PduR: PduLength=5
          BCL_BCU_J1939_Network_CANNODE_0_PduR2CanIf: PduLength=5
          BSD_BCU_J1939_Network_CANNODE_0_Com2PduR: PduLength=7
          BSD_BCU_J1939_Network_CANNODE_0_PduR2CanIf: PduLength=7
          NPDU_RX_CM_CMDT_J1939_Network_CANNODE_0_CanIf2J1939Tp: PduLength=8
          NPDU_TX_DT_J1939_Network_CANNODE_0_J1939Tp2CanIf: PduLength=8
          NPDU_TX_CM_J1939_Network_CANNODE_0_J1939Tp2CanIf: PduLength=8
          BCP_BCU_J1939_Network_CANNODE_0_Com2PduR: PduLength=13
          BCP_BCU_J1939_Network_CANNODE_0_PduR2J1939Tp: PduLength=13
          BCS_BCU_J1939_Network_CANNODE_0_Com2PduR: PduLength=9
          BCS_BCU_J1939_Network_CANNODE_0_PduR2J1939Tp: PduLength=9
          BRM_BCU_J1939_Network_CANNODE_0_Com2PduR: PduLength=49
          BRM_BCU_J1939_Network_CANNODE_0_PduR2J1939Tp: PduLength=49
          Old_BRM_BCU_J1939_Network_CANNODE_0_Com2PduR: PduLength=41
          Old_BRM_BCU_J1939_Network_CANNODE_0_PduR2J1939Tp: PduLength=41
