AUTOSAR XML (schema 4-2-2)
package /Can
  module config Can: implementation-config-variant=VARIANT-PRE-COMPILE
    CanGeneral:
      CanMainFunctionBusoffPeriod = 0.0010
      CanMainFunctionModePeriod = 0.0010
      CanMultiplexedTransmission = false
      CanVersionInfoApi = false
      CanIndex = 0
      CanPublicIcomSupport = false
      CanTimeoutDuration = 1
      CanDevErrorDetection = false
    CanConfigSet
      Can_Network_CANNODE_0 (CanController):
        CanBusoffProcessing = POLLING
        CanControllerActivation = true
        CanControllerBaseAddress = 0
        CanTxProcessing = POLLING
        CanWakeupFunctionalityAPI = false
        CanWakeupProcessing = POLLING
        CanWakeupSupport = false
        CanControllerId = 0
        CanRxProcessing = POLLING
        CanControllerDefaultBaudrate = Can_Network_CANNODE_0/Can_Network_CANNODE_0
        Can_Network_CANNODE_0 (CanControllerBaudrateConfig):
          CanControllerBaudRate = 500
          CanControllerBaudRateConfigID = 1
          CanControllerPropSeg = 0
          CanControllerSeg1 = 10
          CanControllerSeg2 = 0
          CanControllerSyncJumpWidth = 0
      J1939_Network_CANNODE_0 (CanController):
        CanBusoffProcessing = POLLING
        CanControllerActivation = true
        CanControllerBaseAddress = 0
        CanTxProcessing = POLLING
        CanWakeupFunctionalityAPI = false
        CanWakeupProcessing = POLLING
        CanWakeupSupport = false
        CanControllerId = 1
        CanRxProcessing = POLLING
        CanControllerDefaultBaudrate = J1939_Network_CANNODE_0/J1939_Network_CANNODE_0
        J1939_Network_CANNODE_0 (CanControllerBaudrateConfig):
          CanControllerBaudRate = 500
          CanControllerBaudRateConfigID = 1
          CanControllerPropSeg = 0
          CanControllerSeg1 = 10
          CanControllerSeg2 = 0
          CanControllerSyncJumpWidth = 0
      52 x CanHardwareObject, all with CanHwObjectCount=1, CanHandleType=FULL:
        Can_Network_CANNODE_0_Rx_Std_MailBox_1: CanObjectType=RECEIVE, CanObjectId=0, CanIdType=STANDARD, CanControllerRef=CanConfigSet/Can_Network_CANNODE_0
          CanHwFilter: CanHwFilterCode=180, CanHwFilterMask=2047
        Can_Network_CANNODE_0_Rx_Std_MailBox_2: CanObjectType=RECEIVE, CanObjectId=1, CanIdType=STANDARD, CanControllerRef=CanConfigSet/Can_Network_CANNODE_0
          CanHwFilter: CanHwFilterCode=483, CanHwFilterMask=2047
        Can_Network_CANNODE_0_Rx_Std_MailBox_3: CanObjectType=RECEIVE, CanObjectId=2, CanIdType=STANDARD, CanControllerRef=CanConfigSet/Can_Network_CANNODE_0
          CanHwFilter: CanHwFilterCode=395, CanHwFilterMask=2047
        Can_Network_CANNODE_0_Rx_Std_MailBox_4: CanObjectType=RECEIVE, CanObjectId=3, CanIdType=STANDARD, CanControllerRef=CanConfigSet/Can_Network_CANNODE_0
          CanHwFilter: CanHwFilterCode=572, CanHwFilterMask=2047
        Can_Network_CANNODE_0_Rx_Std_MailBox_5: CanObjectType=RECEIVE, CanObjectId=4, CanIdType=STANDARD, CanControllerRef=CanConfigSet/Can_Network_CANNODE_0
          CanHwFilter: CanHwFilterCode=771, CanHwFilterMask=2047
        Can_Network_CANNODE_0_Rx_Std_MailBox_6: CanObjectType=RECEIVE, CanObjectId=5, CanIdType=STANDARD, CanControllerRef=CanConfigSet/Can_Network_CANNODE_0
          CanHwFilter: CanHwFilterCode=497, CanHwFilterMask=2047
        Can_Network_CANNODE_0_Rx_Std_MailBox_7: CanObjectType=RECEIVE, CanObjectId=6, CanIdType=STANDARD, CanControllerRef=CanConfigSet/Can_Network_CANNODE_0
          CanHwFilter: CanHwFilterCode=1864, CanHwFilterMask=2047
        Can_Network_CANNODE_0_Rx_Std_MailBox_8: CanObjectType=RECEIVE, CanObjectId=7, CanIdType=STANDARD, CanControllerRef=CanConfigSet/Can_Network_CANNODE_0
          CanHwFilter: CanHwFilterCode=498, CanHwFilterMask=2047
        Can_Network_CANNODE_0_Rx_Std_MailBox_9: CanObjectType=RECEIVE, CanObjectId=8, CanIdType=STANDARD, CanControllerRef=CanConfigSet/Can_Network_CANNODE_0
          CanHwFilter: CanHwFilterCode=355, CanHwFilterMask=2047
        Can_Network_CANNODE_0_Rx_Std_MailBox_10: CanObjectType=RECEIVE, CanObjectId=9, CanIdType=STANDARD, CanControllerRef=CanConfigSet/Can_Network_CANNODE_0
          CanHwFilter: CanHwFilterCode=851, CanHwFilterMask=2047
        Can_Network_CANNODE_0_Rx_Std_MailBox_11: CanObjectType=RECEIVE, CanObjectId=10, CanIdType=STANDARD, CanControllerRef=CanConfigSet/Can_Network_CANNODE_0
          CanHwFilter: CanHwFilterCode=2015, CanHwFilterMask=2047
        Can_Network_CANNODE_0_Rx_Std_MailBox_12: CanObjectType=RECEIVE, CanObjectId=11, CanIdType=STANDARD, CanControllerRef=CanConfigSet/Can_Network_CANNODE_0
          CanHwFilter: CanHwFilterCode=1375, CanHwFilterMask=2047
        Can_Network_CANNODE_0_Rx_Std_MailBox_13: CanObjectType=RECEIVE, CanObjectId=12, CanIdType=STANDARD, CanControllerRef=CanConfigSet/Can_Network_CANNODE_0
          CanHwFilter: CanHwFilterCode=1540, CanHwFilterMask=2047
        Can_Network_CANNODE_0_Rx_Std_MailBox_14: CanObjectType=RECEIVE, CanObjectId=13, CanIdType=STANDARD, CanControllerRef=CanConfigSet/Can_Network_CANNODE_0
          CanHwFilter: CanHwFilterCode=866, CanHwFilterMask=2047
        Can_Network_CANNODE_0_Rx_Std_MailBox_15: CanObjectType=RECEIVE, CanObjectId=14, CanIdType=STANDARD, CanControllerRef=CanConfigSet/Can_Network_CANNODE_0
          CanHwFilter: CanHwFilterCode=1728, CanHwFilterMask=2047
        Can_Network_CANNODE_0_Tx_Std_MailBox_1: CanObjectType=TRANSMIT, CanObjectId=15, CanIdType=STANDARD, CanControllerRef=CanConfigSet/Can_Network_CANNODE_0
        Can_Network_CANNODE_0_Tx_Std_MailBox_2: CanObjectType=TRANSMIT, CanObjectId=16, CanIdType=STANDARD, CanControllerRef=CanConfigSet/Can_Network_CANNODE_0
        Can_Network_CANNODE_0_Tx_Std_MailBox_3: CanObjectType=TRANSMIT, CanObjectId=17, CanIdType=STANDARD, CanControllerRef=CanConfigSet/Can_Network_CANNODE_0
        Can_Network_CANNODE_0_Tx_Std_MailBox_4: CanObjectType=TRANSMIT, CanObjectId=18, CanIdType=STANDARD, CanControllerRef=CanConfigSet/Can_Network_CANNODE_0
        Can_Network_CANNODE_0_Tx_Std_MailBox_5: CanObjectType=TRANSMIT, CanObjectId=19, CanIdType=STANDARD, CanControllerRef=CanConfigSet/Can_Network_CANNODE_0
        Can_Network_CANNODE_0_Tx_Std_MailBox_6: CanObjectType=TRANSMIT, CanObjectId=20, CanIdType=STANDARD, CanControllerRef=CanConfigSet/Can_Network_CANNODE_0
        Can_Network_CANNODE_0_Tx_Std_MailBox_7: CanObjectType=TRANSMIT, CanObjectId=21, CanIdType=STANDARD, CanControllerRef=CanConfigSet/Can_Network_CANNODE_0
        Can_Network_CANNODE_0_Tx_Std_MailBox_8: CanObjectType=TRANSMIT, CanObjectId=22, CanIdType=STANDARD, CanControllerRef=CanConfigSet/Can_Network_CANNODE_0
        Can_Network_CANNODE_0_Tx_Std_MailBox_9: CanObjectType=TRANSMIT, CanObjectId=23, CanIdType=STANDARD, CanControllerRef=CanConfigSet/Can_Network_CANNODE_0
        Can_Network_CANNODE_0_Tx_Std_MailBox_10: CanObjectType=TRANSMIT, CanObjectId=24, CanIdType=STANDARD, CanControllerRef=CanConfigSet/Can_Network_CANNODE_0
        Can_Network_CANNODE_0_Tx_Std_MailBox_11: CanObjectType=TRANSMIT, CanObjectId=25, CanIdType=STANDARD, CanControllerRef=CanConfigSet/Can_Network_CANNODE_0
        Can_Network_CANNODE_0_Tx_Std_MailBox_12: CanObjectType=TRANSMIT, CanObjectId=26, CanIdType=STANDARD, CanControllerRef=CanConfigSet/Can_Network_CANNODE_0
        Can_Network_CANNODE_0_Tx_Std_MailBox_13: CanObjectType=TRANSMIT, CanObjectId=27, CanIdType=STANDARD, CanControllerRef=CanConfigSet/Can_Network_CANNODE_0
        Can_Network_CANNODE_0_Tx_Std_MailBox_14: CanObjectType=TRANSMIT, CanObjectId=28, CanIdType=STANDARD, CanControllerRef=CanConfigSet/Can_Network_CANNODE_0
        Can_Network_CANNODE_0_Tx_Std_MailBox_15: CanObjectType=TRANSMIT, CanObjectId=29, CanIdType=STANDARD, CanControllerRef=CanConfigSet/Can_Network_CANNODE_0
        Can_Network_CANNODE_0_Tx_Std_MailBox_16: CanObjectType=TRANSMIT, CanObjectId=30, CanIdType=STANDARD, CanControllerRef=CanConfigSet/Can_Network_CANNODE_0
        Can_Network_CANNODE_0_Tx_Std_MailBox_17: CanObjectType=TRANSMIT, CanObjectId=31, CanIdType=STANDARD, CanControllerRef=CanConfigSet/Can_Network_CANNODE_0
        Can_Network_CANNODE_0_Tx_Std_MailBox_18: CanObjectType=TRANSMIT, CanObjectId=32, CanIdType=STANDARD, CanControllerRef=CanConfigSet/Can_Network_CANNODE_0
        J1939_Network_CANNODE_0_Rx_Ext_MailBox_1: CanObjectType=RECEIVE, CanObjectId=33, CanIdType=EXTENDED, CanControllerRef=CanConfigSet/J1939_Network_CANNODE_0
          CanHwFilter: CanHwFilterCode=403174486, CanHwFilterMask=536870911
        J1939_Network_CANNODE_0_Rx_Ext_MailBox_2: CanObjectType=RECEIVE, CanObjectId=34, CanIdType=EXTENDED, CanControllerRef=CanConfigSet/J1939_Network_CANNODE_0
          CanHwFilter: CanHwFilterCode=404616278, CanHwFilterMask=536870911
        J1939_Network_CANNODE_0_Rx_Ext_MailBox_3: CanObjectType=RECEIVE, CanObjectId=35, CanIdType=EXTENDED, CanControllerRef=CanConfigSet/J1939_Network_CANNODE_0
          CanHwFilter: CanHwFilterCode=270201942, CanHwFilterMask=536870911
        J1939_Network_CANNODE_0_Rx_Ext_MailBox_4: CanObjectType=RECEIVE, CanObjectId=36, CanIdType=EXTENDED, CanControllerRef=CanConfigSet/J1939_Network_CANNODE_0
          CanHwFilter: CanHwFilterCode=405206102, CanHwFilterMask=536870911
        J1939_Network_CANNODE_0_Rx_Ext_MailBox_5: CanObjectType=RECEIVE, CanObjectId=37, CanIdType=EXTENDED, CanControllerRef=CanConfigSet/J1939_Network_CANNODE_0
          CanHwFilter: CanHwFilterCode=269153366, CanHwFilterMask=536870911
        J1939_Network_CANNODE_0_Rx_Ext_MailBox_6: CanObjectType=RECEIVE, CanObjectId=38, CanIdType=EXTENDED, CanControllerRef=CanConfigSet/J1939_Network_CANNODE_0
          CanHwFilter: CanHwFilterCode=136311894, CanHwFilterMask=536870911
        J1939_Network_CANNODE_0_Rx_Ext_MailBox_7: CanObjectType=RECEIVE, CanObjectId=39, CanIdType=EXTENDED, CanControllerRef=CanConfigSet/J1939_Network_CANNODE_0
          CanHwFilter: CanHwFilterCode=403240022, CanHwFilterMask=536870911
        J1939_Network_CANNODE_0_Rx_Ext_MailBox_8: CanObjectType=RECEIVE, CanObjectId=40, CanIdType=EXTENDED, CanControllerRef=CanConfigSet/J1939_Network_CANNODE_0
          CanHwFilter: CanHwFilterCode=403895382, CanHwFilterMask=536870911
        J1939_Network_CANNODE_0_Rx_Ext_MailBox_9: CanObjectType=RECEIVE, CanObjectId=41, CanIdType=EXTENDED, CanControllerRef=CanConfigSet/J1939_Network_CANNODE_0
          CanHwFilter: CanHwFilterCode=402781270, CanHwFilterMask=536870911
        J1939_Network_CANNODE_0_Rx_Ext_MailBox_10: CanObjectType=RECEIVE, CanObjectId=42, CanIdType=EXTENDED, CanControllerRef=CanConfigSet/J1939_Network_CANNODE_0
          CanHwFilter: CanHwFilterCode=485291094
        J1939_Network_CANNODE_0_Tx_Ext_MailBox_1: CanObjectType=TRANSMIT, CanObjectId=43, CanIdType=EXTENDED, CanControllerRef=CanConfigSet/J1939_Network_CANNODE_0
        J1939_Network_CANNODE_0_Tx_Ext_MailBox_2: CanObjectType=TRANSMIT, CanObjectId=44, CanIdType=EXTENDED, CanControllerRef=CanConfigSet/J1939_Network_CANNODE_0
        J1939_Network_CANNODE_0_Tx_Ext_MailBox_3: CanObjectType=TRANSMIT, CanObjectId=45, CanIdType=EXTENDED, CanControllerRef=CanConfigSet/J1939_Network_CANNODE_0
        J1939_Network_CANNODE_0_Tx_Ext_MailBox_4: CanObjectType=TRANSMIT, CanObjectId=46, CanIdType=EXTENDED, CanControllerRef=CanConfigSet/J1939_Network_CANNODE_0
        J1939_Network_CANNODE_0_Tx_Ext_MailBox_5: CanObjectType=TRANSMIT, CanObjectId=47, CanIdType=EXTENDED, CanControllerRef=CanConfigSet/J1939_Network_CANNODE_0
        J1939_Network_CANNODE_0_Tx_Ext_MailBox_6: CanObjectType=TRANSMIT, CanObjectId=48, CanIdType=EXTENDED, CanControllerRef=CanConfigSet/J1939_Network_CANNODE_0
        J1939_Network_CANNODE_0_Tx_Ext_MailBox_7: CanObjectType=TRANSMIT, CanObjectId=49, CanIdType=EXTENDED, CanControllerRef=CanConfigSet/J1939_Network_CANNODE_0
        J1939_Network_CANNODE_0_Tx_Ext_MailBox_8: CanObjectType=TRANSMIT, CanObjectId=50, CanIdType=EXTENDED, CanControllerRef=CanConfigSet/J1939_Network_CANNODE_0
        J1939_Network_CANNODE_0_Tx_Ext_MailBox_9: CanObjectType=TRANSMIT, CanObjectId=51, CanIdType=EXTENDED, CanControllerRef=CanConfigSet/J1939_Network_CANNODE_0
