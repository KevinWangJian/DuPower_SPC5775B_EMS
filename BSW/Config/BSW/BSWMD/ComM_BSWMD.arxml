AUTOSAR XML (schema 4-0-3)
package /AUTOSAR_ComM/BswModuleEntrys
  bsw module entry ComM_MainFunction_ComMChannel_Can_Network_0_Channel: is-reentrant=false, is-synchronous=true, call-type=SCHEDULED, execution-context=TASK, sw-service-impl-policy=STANDARD
  bsw module entry ComM_MainFunction_ComMChannel_J1939_Network_Channel: is-reentrant=false, is-synchronous=true, call-type=SCHEDULED, execution-context=TASK, sw-service-impl-policy=STANDARD
