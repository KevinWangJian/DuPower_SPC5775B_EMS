AUTOSAR XML (schema 4-2-2)
package /AUTOSAR_Com/ApplicationDataTypes
  5 x app type, all with category=VALUE, sw-calibration-access=READ-WRITE, display-format=%5.0f:
    Com_IPduStatus_type: compu {0=INACTIVE, 1=ACTIVE} "Computation Method for ComIPdu Calibration Status", range phys 0..1  # unsigned char
    Com_uint8: compu-method=Identical, range phys 0..255  # unsigned char
    Com_uint16: compu-method=Identical, range phys 0..65535  # unsigned short
    Com_uint32: compu-method=Identical, range phys 0..4294967295  # unsigned int
    Com_uint64: compu-method=Identical, range phys 0..9.223372036854776E18  # unsigned long long
  15 x application array data type, all with category=ARRAY, sw-calibration-access=READ-WRITE:
    Com_SigBuf_au8  # Application data type for Signals of type - uint8,sint8,boolean.
      element Com_Subapp_u8: category=VALUE, type=Com_uint8, max-number-of-elements=84
    Com_SigBuf_au16  # Application data type for Signals of type - uint16,sint16.
      element Com_Subapp_u16: category=VALUE, type=Com_uint16, max-number-of-elements=18
    Com_SigBuf_au32  # Application data type for Signals of type - uint32,sint32.
      element Com_Subapp_u32: category=VALUE, type=Com_uint32, max-number-of-elements=5
    Com_SigBuf_au64  # Application data type for Signals of type - uint64,sint64.
      element Com_Subapp_u64: category=VALUE, type=Com_uint64, max-number-of-elements=1
    Com_applDataType_au8_Size1  # Application data type for Ipdu buffer of Size1
      element Com_Subapp1: category=VALUE, type=Com_uint8, max-number-of-elements=1
    Com_applDataType_au8_Size2  # Application data type for Ipdu buffer of Size2
      element Com_Subapp2: category=VALUE, type=Com_uint8, max-number-of-elements=2
    Com_applDataType_au8_Size3  # Application data type for Ipdu buffer of Size3
      element Com_Subapp3: category=VALUE, type=Com_uint8, max-number-of-elements=3
    Com_applDataType_au8_Size4  # Application data type for Ipdu buffer of Size4
      element Com_Subapp4: category=VALUE, type=Com_uint8, max-number-of-elements=4
    Com_applDataType_au8_Size5  # Application data type for Ipdu buffer of Size5
      element Com_Subapp5: category=VALUE, type=Com_uint8, max-number-of-elements=5
    Com_applDataType_au8_Size7  # Application data type for Ipdu buffer of Size7
      element Com_Subapp7: category=VALUE, type=Com_uint8, max-number-of-elements=7
    Com_applDataType_au8_Size8  # Application data type for Ipdu buffer of Size8
      element Com_Subapp8: category=VALUE, type=Com_uint8, max-number-of-elements=8
    Com_applDataType_au8_Size9  # Application data type for Ipdu buffer of Size9
      element Com_Subapp9: category=VALUE, type=Com_uint8, max-number-of-elements=9
    Com_applDataType_au8_Size13  # Application data type for Ipdu buffer of Size13
      element Com_Subapp13: category=VALUE, type=Com_uint8, max-number-of-elements=13
    Com_applDataType_au8_Size41  # Application data type for Ipdu buffer of Size41
      element Com_Subapp41: category=VALUE, type=Com_uint8, max-number-of-elements=41
    Com_applDataType_au8_Size49  # Application data type for Ipdu buffer of Size49
      element Com_Subapp49: category=VALUE, type=Com_uint8, max-number-of-elements=49
package /AUTOSAR_Com/BswImplementations
  bsw implementation Com: programming-language=C, sw-version=8.0.0, ar-release-version=4.2.2, behavior=BswInternalBehavior, vendor-specific-module-def=Com
    code-descriptors:
      code CodeDescriptor: artifact-descriptors=autosar-engineering-object={short-label=ArEngObj, category=SWSRC}
package /AUTOSAR_Com/BswModuleDescriptions
  bsw module description Com
    bsw internal behavior BswInternalBehavior: data-type-mapping=DataTypeMappingSet
      static-memorys:
        54 x data, all with category=ARRAY, sw-addr-method=INTERNAL_VAR_CLEARED, sw-calibration-access=READ-ONLY, display-format=%5.0f:
          Com_IpduBuf_BMS_1D8h_Can_Network_CANNODE_0: type=Com_applDataType_au8_Size8  # Tx Ipdu buffer of IPdu -BMS_1D8h_Can_Network_CANNODE_0- as a Measurement parameter
          Com_IpduBuf_BMS_3D7h_Can_Network_CANNODE_0: type=Com_applDataType_au8_Size8  # Tx Ipdu buffer of IPdu -BMS_3D7h_Can_Network_CANNODE_0- as a Measurement parameter
          Com_IpduBuf_BMS_3DAh_Can_Network_CANNODE_0: type=Com_applDataType_au8_Size8  # Tx Ipdu buffer of IPdu -BMS_3DAh_Can_Network_CANNODE_0- as a Measurement parameter
          Com_IpduBuf_BMS_3DBh_Can_Network_CANNODE_0: type=Com_applDataType_au8_Size8  # Tx Ipdu buffer of IPdu -BMS_3DBh_Can_Network_CANNODE_0- as a Measurement parameter
          Com_IpduBuf_BMS_32Ah_Can_Network_CANNODE_0: type=Com_applDataType_au8_Size8  # Tx Ipdu buffer of IPdu -BMS_32Ah_Can_Network_CANNODE_0- as a Measurement parameter
          Com_IpduBuf_BMS_329h_Can_Network_CANNODE_0: type=Com_applDataType_au8_Size8  # Tx Ipdu buffer of IPdu -BMS_329h_Can_Network_CANNODE_0- as a Measurement parameter
          Com_IpduBuf_BMS_501h_Can_Network_CANNODE_0: type=Com_applDataType_au8_Size8  # Tx Ipdu buffer of IPdu -BMS_501h_Can_Network_CANNODE_0- as a Measurement parameter
          Com_IpduBuf_BMS_503h_Can_Network_CANNODE_0: type=Com_applDataType_au8_Size8  # Tx Ipdu buffer of IPdu -BMS_503h_Can_Network_CANNODE_0- as a Measurement parameter
          Com_IpduBuf_BMS_598h_Can_Network_CANNODE_0: type=Com_applDataType_au8_Size8  # Tx Ipdu buffer of IPdu -BMS_598h_Can_Network_CANNODE_0- as a Measurement parameter
          Com_IpduBuf_BMS_594h_Can_Network_CANNODE_0: type=Com_applDataType_au8_Size8  # Tx Ipdu buffer of IPdu -BMS_594h_Can_Network_CANNODE_0- as a Measurement parameter
          Com_IpduBuf_BMS_596h_Can_Network_CANNODE_0: type=Com_applDataType_au8_Size8  # Tx Ipdu buffer of IPdu -BMS_596h_Can_Network_CANNODE_0- as a Measurement parameter
          Com_IpduBuf_BMS_509h_Can_Network_CANNODE_0: type=Com_applDataType_au8_Size8  # Tx Ipdu buffer of IPdu -BMS_509h_Can_Network_CANNODE_0- as a Measurement parameter
          Com_IpduBuf_BCL_BCU_J1939_Network_CANNODE_0: type=Com_applDataType_au8_Size5  # Tx Ipdu buffer of IPdu -BCL_BCU_J1939_Network_CANNODE_0- as a Measurement parameter
          Com_IpduBuf_BCP_BCU_J1939_Network_CANNODE_0: type=Com_applDataType_au8_Size13  # Tx Ipdu buffer of IPdu -BCP_BCU_J1939_Network_CANNODE_0- as a Measurement parameter
          Com_IpduBuf_BCS_BCU_J1939_Network_CANNODE_0: type=Com_applDataType_au8_Size9  # Tx Ipdu buffer of IPdu -BCS_BCU_J1939_Network_CANNODE_0- as a Measurement parameter
          Com_IpduBuf_BEM_BCU_J1939_Network_CANNODE_0: type=Com_applDataType_au8_Size4  # Tx Ipdu buffer of IPdu -BEM_BCU_J1939_Network_CANNODE_0- as a Measurement parameter
          Com_IpduBuf_BHM_BCU_J1939_Network_CANNODE_0: type=Com_applDataType_au8_Size2  # Tx Ipdu buffer of IPdu -BHM_BCU_J1939_Network_CANNODE_0- as a Measurement parameter
          Com_IpduBuf_BMS_603h_Can_Network_CANNODE_0: type=Com_applDataType_au8_Size8  # Tx Ipdu buffer of IPdu -BMS_603h_Can_Network_CANNODE_0- as a Measurement parameter
          Com_IpduBuf_BMS_605h_Can_Network_CANNODE_0: type=Com_applDataType_au8_Size8  # Tx Ipdu buffer of IPdu -BMS_605h_Can_Network_CANNODE_0- as a Measurement parameter
          Com_IpduBuf_BMS_606h_Can_Network_CANNODE_0: type=Com_applDataType_au8_Size8  # Tx Ipdu buffer of IPdu -BMS_606h_Can_Network_CANNODE_0- as a Measurement parameter
          Com_IpduBuf_BMS_795h_Can_Network_CANNODE_0: type=Com_applDataType_au8_Size8  # Tx Ipdu buffer of IPdu -BMS_795h_Can_Network_CANNODE_0- as a Measurement parameter
          Com_IpduBuf_BMS_7C8h_Can_Network_CANNODE_0: type=Com_applDataType_au8_Size8  # Tx Ipdu buffer of IPdu -BMS_7C8h_Can_Network_CANNODE_0- as a Measurement parameter
          Com_IpduBuf_BRM_BCU_J1939_Network_CANNODE_0: type=Com_applDataType_au8_Size49  # Tx Ipdu buffer of IPdu -BRM_BCU_J1939_Network_CANNODE_0- as a Measurement parameter
          Com_IpduBuf_BRO_BCU_J1939_Network_CANNODE_0: type=Com_applDataType_au8_Size1  # Tx Ipdu buffer of IPdu -BRO_BCU_J1939_Network_CANNODE_0- as a Measurement parameter
          Com_IpduBuf_BSD_BCU_J1939_Network_CANNODE_0: type=Com_applDataType_au8_Size7  # Tx Ipdu buffer of IPdu -BSD_BCU_J1939_Network_CANNODE_0- as a Measurement parameter
          Com_IpduBuf_BSM_BCU_J1939_Network_CANNODE_0: type=Com_applDataType_au8_Size7  # Tx Ipdu buffer of IPdu -BSM_BCU_J1939_Network_CANNODE_0- as a Measurement parameter
          Com_IpduBuf_BST_BCU_J1939_Network_CANNODE_0: type=Com_applDataType_au8_Size4  # Tx Ipdu buffer of IPdu -BST_BCU_J1939_Network_CANNODE_0- as a Measurement parameter
          Com_IpduBuf_Old_BRM_BCU_J1939_Network_CANNODE_0: type=Com_applDataType_au8_Size41  # Tx Ipdu buffer of IPdu -Old_BRM_BCU_J1939_Network_CANNODE_0- as a Measurement parameter
          Com_SigType_u8: type=Com_SigBuf_au8  # Measurement variable for Signals of type - uint8,sint8,boolean. To refer Individual element in the Buffer array, Fetch Buffer Index from Com_PBcfg.c for each signal.
          Com_SigType_u16: type=Com_SigBuf_au16  # Measurement variable for Signals of type - uint16,sint16. To refer Individual element in the Buffer array, Fetch Buffer Index from Com_PBcfg.c for each signal.
          Com_SigType_u32: type=Com_SigBuf_au32  # Measurement variable for Signals of type - uint32,sint32. To refer Individual element in the Buffer array, Fetch Buffer Index from Com_PBcfg.c for each signal.
          Com_LocalBuf_CCS_CHG_J1939_Network_CANNODE_0: type=Com_applDataType_au8_Size8  # Rx Local Ipdu buffer of IPdu -CCS_CHG_J1939_Network_CANNODE_0- as a Measurement parameter
          Com_LocalBuf_CEM_CHG_J1939_Network_CANNODE_0: type=Com_applDataType_au8_Size4  # Rx Local Ipdu buffer of IPdu -CEM_CHG_J1939_Network_CANNODE_0- as a Measurement parameter
          Com_LocalBuf_CHM_CHG_J1939_Network_CANNODE_0: type=Com_applDataType_au8_Size3  # Rx Local Ipdu buffer of IPdu -CHM_CHG_J1939_Network_CANNODE_0- as a Measurement parameter
          Com_LocalBuf_CML_CHG_J1939_Network_CANNODE_0: type=Com_applDataType_au8_Size8  # Rx Local Ipdu buffer of IPdu -CML_CHG_J1939_Network_CANNODE_0- as a Measurement parameter
          Com_LocalBuf_CRM_CHG_J1939_Network_CANNODE_0: type=Com_applDataType_au8_Size8  # Rx Local Ipdu buffer of IPdu -CRM_CHG_J1939_Network_CANNODE_0- as a Measurement parameter
          Com_LocalBuf_CRO_CHG_J1939_Network_CANNODE_0: type=Com_applDataType_au8_Size1  # Rx Local Ipdu buffer of IPdu -CRO_CHG_J1939_Network_CANNODE_0- as a Measurement parameter
          Com_LocalBuf_CSD_CHG_J1939_Network_CANNODE_0: type=Com_applDataType_au8_Size8  # Rx Local Ipdu buffer of IPdu -CSD_CHG_J1939_Network_CANNODE_0- as a Measurement parameter
          Com_LocalBuf_CST_CHG_J1939_Network_CANNODE_0: type=Com_applDataType_au8_Size4  # Rx Local Ipdu buffer of IPdu -CST_CHG_J1939_Network_CANNODE_0- as a Measurement parameter
          Com_LocalBuf_CTS_CHG_J1939_Network_CANNODE_0: type=Com_applDataType_au8_Size7  # Rx Local Ipdu buffer of IPdu -CTS_CHG_J1939_Network_CANNODE_0- as a Measurement parameter
          Com_LocalBuf_DCDC_303h_Can_Network_CANNODE_0: type=Com_applDataType_au8_Size8  # Rx Local Ipdu buffer of IPdu -DCDC_303h_Can_Network_CANNODE_0- as a Measurement parameter
          Com_LocalBuf_OBC_604h_Can_Network_CANNODE_0: type=Com_applDataType_au8_Size8  # Rx Local Ipdu buffer of IPdu -OBC_604h_Can_Network_CANNODE_0- as a Measurement parameter
          Com_LocalBuf_PEU_0B4h_Can_Network_CANNODE_0: type=Com_applDataType_au8_Size8  # Rx Local Ipdu buffer of IPdu -PEU_0B4h_Can_Network_CANNODE_0- as a Measurement parameter
          Com_LocalBuf_PEU_18Bh_Can_Network_CANNODE_0: type=Com_applDataType_au8_Size8  # Rx Local Ipdu buffer of IPdu -PEU_18Bh_Can_Network_CANNODE_0- as a Measurement parameter
          Com_LocalBuf_Tester_748h_Can_Network_CANNODE_0: type=Com_applDataType_au8_Size8  # Rx Local Ipdu buffer of IPdu -Tester_748h_Can_Network_CANNODE_0- as a Measurement parameter
          Com_LocalBuf_Tester_7DFh_Can_Network_CANNODE_0: type=Com_applDataType_au8_Size8  # Rx Local Ipdu buffer of IPdu -Tester_7DFh_Can_Network_CANNODE_0- as a Measurement parameter
          Com_LocalBuf_VCU_1E3h_Can_Network_CANNODE_0: type=Com_applDataType_au8_Size8  # Rx Local Ipdu buffer of IPdu -VCU_1E3h_Can_Network_CANNODE_0- as a Measurement parameter
          Com_LocalBuf_VCU_353h_Can_Network_CANNODE_0: type=Com_applDataType_au8_Size8  # Rx Local Ipdu buffer of IPdu -VCU_353h_Can_Network_CANNODE_0- as a Measurement parameter
          Com_LocalBuf_VCU_ABS_23Ch_Can_Network_CANNODE_0: type=Com_applDataType_au8_Size8  # Rx Local Ipdu buffer of IPdu -VCU_ABS_23Ch_Can_Network_CANNODE_0- as a Measurement parameter
          Com_LocalBuf_VCU_BCM_1F1h_Can_Network_CANNODE_0: type=Com_applDataType_au8_Size8  # Rx Local Ipdu buffer of IPdu -VCU_BCM_1F1h_Can_Network_CANNODE_0- as a Measurement parameter
          Com_LocalBuf_VCU_HCM_55Fh_Can_Network_CANNODE_0: type=Com_applDataType_au8_Size8  # Rx Local Ipdu buffer of IPdu -VCU_HCM_55Fh_Can_Network_CANNODE_0- as a Measurement parameter
          Com_LocalBuf_VCU_IPK_1F2h_Can_Network_CANNODE_0: type=Com_applDataType_au8_Size2  # Rx Local Ipdu buffer of IPdu -VCU_IPK_1F2h_Can_Network_CANNODE_0- as a Measurement parameter
          Com_LocalBuf_VCU_IPK_362h_Can_Network_CANNODE_0: type=Com_applDataType_au8_Size8  # Rx Local Ipdu buffer of IPdu -VCU_IPK_362h_Can_Network_CANNODE_0- as a Measurement parameter
          Com_LocalBuf_VCU_SRS_163h_Can_Network_CANNODE_0: type=Com_applDataType_au8_Size8  # Rx Local Ipdu buffer of IPdu -VCU_SRS_163h_Can_Network_CANNODE_0- as a Measurement parameter
      bsw schedulable entity BSWSE_MainFunctionRx: implemented-entry=Com_MainFunctionRx
      bsw schedulable entity BSWSE_MainFunctionTx: implemented-entry=Com_MainFunctionTx
      bsw timing event EV_BSWSE_MainFunctionRx: starts-on-event=BSWSE_MainFunctionRx, period=0.01
      bsw timing event EV_BSWSE_MainFunctionTx: starts-on-event=BSWSE_MainFunctionTx, period=0.01
package /AUTOSAR_Com/DataTypeMappingSets
  data type mapping set DataTypeMappingSet
    data-type-maps:
      application-data-type=Com_IPduStatus_type, implementation-data-type=Com_impl_b
      application-data-type=Com_uint8, implementation-data-type=Com_impl_u8
      application-data-type=Com_uint16, implementation-data-type=Com_impl_u16
      application-data-type=Com_uint32, implementation-data-type=Com_impl_u32
      application-data-type=Com_uint64, implementation-data-type=Com_impl_u64
      application-data-type=Com_SigBuf_au8, implementation-data-type=Com_SigBuf_au8_impl
      application-data-type=Com_SigBuf_au16, implementation-data-type=Com_SigBuf_au16_impl
      application-data-type=Com_SigBuf_au32, implementation-data-type=Com_SigBuf_au32_impl
      application-data-type=Com_SigBuf_au64, implementation-data-type=Com_SigBuf_au64_impl
      application-data-type=Com_applDataType_au8_Size{1..5}, implementation-data-type=Com_implDataType_au8_Size{1..5}
      application-data-type=Com_applDataType_au8_Size{7..9}, implementation-data-type=Com_implDataType_au8_Size{7..9}
      application-data-type=Com_applDataType_au8_Size13, implementation-data-type=Com_implDataType_au8_Size13
      application-data-type=Com_applDataType_au8_Size41, implementation-data-type=Com_implDataType_au8_Size41
      application-data-type=Com_applDataType_au8_Size49, implementation-data-type=Com_implDataType_au8_Size49
package /AUTOSAR_Com/ImplementationDataTypes
  20 x impl type:
    Com_impl_b: implementation-data-type=boolean  # unsigned char
    Com_impl_u8: implementation-data-type=uint8  # unsigned char
    Com_impl_u16: implementation-data-type=uint16  # unsigned short
    Com_impl_u32: implementation-data-type=uint32  # unsigned long
    Com_impl_u64: implementation-data-type=uint64  # unsigned long long
    Com_SigBuf_au8_impl: category=ARRAY  # Implementation data type for Signals of type - uint8,sint8,boolean.
      element Com_Subimpl_u8: array-size=84, array-size-semantics=FIXED-SIZE, implementation-data-type=Com_impl_u8
    Com_SigBuf_au16_impl: category=ARRAY  # Implementation data type for Signals of type - uint16,sint16.
      element Com_Subimpl_u16: array-size=18, array-size-semantics=FIXED-SIZE, implementation-data-type=Com_impl_u16
    Com_SigBuf_au32_impl: category=ARRAY  # Implementation data type for Signals of type - uint32,sint32.
      element Com_Subimpl_u32: array-size=5, array-size-semantics=FIXED-SIZE, implementation-data-type=Com_impl_u32
    Com_SigBuf_au64_impl: category=ARRAY  # Implementation data type for Signals of type - uint64,sint64.
      element Com_Subimpl_u64: array-size=1, array-size-semantics=FIXED-SIZE, implementation-data-type=Com_impl_u64
    Com_implDataType_au8_Size1: category=ARRAY  # Implementation data type for Ipdu buffer of Size1
      element Com_Subimpl1: array-size=1, array-size-semantics=FIXED-SIZE, implementation-data-type=Com_impl_u8
    Com_implDataType_au8_Size2: category=ARRAY  # Implementation data type for Ipdu buffer of Size2
      element Com_Subimpl2: array-size=2, array-size-semantics=FIXED-SIZE, implementation-data-type=Com_impl_u8
    Com_implDataType_au8_Size3: category=ARRAY  # Implementation data type for Ipdu buffer of Size3
      element Com_Subimpl3: array-size=3, array-size-semantics=FIXED-SIZE, implementation-data-type=Com_impl_u8
    Com_implDataType_au8_Size4: category=ARRAY  # Implementation data type for Ipdu buffer of Size4
      element Com_Subimpl4: array-size=4, array-size-semantics=FIXED-SIZE, implementation-data-type=Com_impl_u8
    Com_implDataType_au8_Size5: category=ARRAY  # Implementation data type for Ipdu buffer of Size5
      element Com_Subimpl5: array-size=5, array-size-semantics=FIXED-SIZE, implementation-data-type=Com_impl_u8
    Com_implDataType_au8_Size7: category=ARRAY  # Implementation data type for Ipdu buffer of Size7
      element Com_Subimpl7: array-size=7, array-size-semantics=FIXED-SIZE, implementation-data-type=Com_impl_u8
    Com_implDataType_au8_Size8: category=ARRAY  # Implementation data type for Ipdu buffer of Size8
      element Com_Subimpl8: array-size=8, array-size-semantics=FIXED-SIZE, implementation-data-type=Com_impl_u8
    Com_implDataType_au8_Size9: category=ARRAY  # Implementation data type for Ipdu buffer of Size9
      element Com_Subimpl9: array-size=9, array-size-semantics=FIXED-SIZE, implementation-data-type=Com_impl_u8
    Com_implDataType_au8_Size13: category=ARRAY  # Implementation data type for Ipdu buffer of Size13
      element Com_Subimpl13: array-size=13, array-size-semantics=FIXED-SIZE, implementation-data-type=Com_impl_u8
    Com_implDataType_au8_Size41: category=ARRAY  # Implementation data type for Ipdu buffer of Size41
      element Com_Subimpl41: array-size=41, array-size-semantics=FIXED-SIZE, implementation-data-type=Com_impl_u8
    Com_implDataType_au8_Size49: category=ARRAY  # Implementation data type for Ipdu buffer of Size49
      element Com_Subimpl49: array-size=49, array-size-semantics=FIXED-SIZE, implementation-data-type=Com_impl_u8
package /AUTOSAR_Com/Units
  unit NoUnit: display-name=noUnit, factor-si-to-unit=1.0, offset-si-to-unit=0.0, physical-dimension=NoUnit  # No Unit
package /AUTOSAR_Com/PhysicalDimensions
  physical dimension NoUnit: length-exp=0
