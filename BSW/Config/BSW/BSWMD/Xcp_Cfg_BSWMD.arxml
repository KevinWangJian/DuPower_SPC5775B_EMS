AUTOSAR XML (schema 4-2-2)
package /AUTOSAR_Xcp/BswImplementations
  bsw implementation Xcp: programming-language=C, sw-version=4.0.1, ar-release-version=4.2.2, behavior=BswInternalBehavior, vendor-specific-module-def=Xcp
    code-descriptors:
      code CodeDescriptor: artifact-descriptors=autosar-engineering-object={short-label=ArEngObj, category=SWSRC}
package /AUTOSAR_Xcp/BswModuleDescriptions
  bsw module description Xcp: category=BSW_MODULE, module-id=212
    bsw internal behavior BswInternalBehavior
      6 x bsw schedulable entity:
        BSWSE_MainFunction: implemented-entry=Xcp_MainFunction
        BSWSE_EventChannel_10msRstr: implemented-entry=Xcp_EventChannel_10msRstr
        BSWSE_EventChannel_20msRstr: implemented-entry=Xcp_EventChannel_20msRstr
        BSWSE_EventChannel_50msRstr: implemented-entry=Xcp_EventChannel_50msRstr
        BSWSE_EventChannel_100msRstr: implemented-entry=Xcp_EventChannel_100msRstr
        BSWSE_EventChannel_1sRstr: implemented-entry=Xcp_EventChannel_1sRstr
      6 x bsw timing event:
        EV_BSWSE_MainFunction: starts-on-event=BSWSE_MainFunction, period=0.01
        EV_BSWSE_EventChannel_10msRstr: starts-on-event=BSWSE_EventChannel_10msRstr, period=0.01
        EV_BSWSE_EventChannel_20msRstr: starts-on-event=BSWSE_EventChannel_20msRstr, period=0.02
        EV_BSWSE_EventChannel_50msRstr: starts-on-event=BSWSE_EventChannel_50msRstr, period=0.05
        EV_BSWSE_EventChannel_100msRstr: starts-on-event=BSWSE_EventChannel_100msRstr, period=0.1
        EV_BSWSE_EventChannel_1sRstr: starts-on-event=BSWSE_EventChannel_1sRstr, period=1.0
package /AUTOSAR_Xcp/Units
  unit NoUnit: display-name=noUnit, factor-si-to-unit=1.0, offset-si-to-unit=0.0, physical-dimension=NoUnit  # No Unit
package /AUTOSAR_Xcp/PhysicalDimensions
  physical dimension NoUnit: length-exp=0
