AUTOSAR XML (schema 4-2-2)
package /AUTOSAR_WdgIf/BswImplementations
  bsw implementation WdgIf: programming-language=C, sw-version=3.0.0, ar-release-version=4.2.2, behavior=BswInternalBehavior
    code-descriptors:
      code CodeDescriptor: artifact-descriptors=autosar-engineering-object={short-label=ArEngObj, category=SWSRC}
package /AUTOSAR_WdgIf/BswModuleDescriptions
  bsw module description WdgIf: category=BSW_MODULE, module-id=43, provided-entrys=[WdgIf_SetMode, WdgIf_SetTriggerCondition, WdgIf_GetVersionInfo]  # Watchdog Interface
    bsw module dependency Wdg: target-module-id=102
    bsw module dependency Det: target-module-id=15
    bsw internal behavior BswInternalBehavior
      bsw called entity SetMode: implemented-entry=WdgIf_SetMode
      bsw called entity SetTriggerCondition: implemented-entry=WdgIf_SetTriggerCondition
      bsw called entity GetVersionInfo: implemented-entry=WdgIf_GetVersionInfo
package /AUTOSAR_WdgIf/BswModuleEntry
  bsw module entry WdgIf_SetMode: service-id=1, is-reentrant=false, is-synchronous=true, call-type=REGULAR, execution-context=UNSPECIFIED, sw-service-impl-policy=STANDARD  # Maps WdgIf_SetMode to service Wdg_SetMode of the corresponding Watchdog Driver. | The Watchdog Interface module maps the service WdgIf_SetMode to the service Wdg_SetMode of the corresponding Watchdog Driver.The service WdgIf_SetMode changes the mode of the lower layer watchdog drivers which will lead to longer(Slow Mode), shorter(Fast Mode) or turn off(Off Mode) timeout periods.
    return type ReturnValue: direction=OUT, implementation-data-type=Std_ReturnType  # E_OK - Success(execution successful).E_NOT_OK - Failure (execution failed).
    sw service arg DeviceIndex: direction=IN, implementation-data-type=uint8  # (In)Used to identify the watchdog driver instance.
    sw service arg WdgMode: direction=IN, implementation-data-type=WdgIf_ModeType  # (In)Watchdog driver mode.
  bsw module entry WdgIf_SetTriggerCondition: service-id=2, is-reentrant=false, is-synchronous=true, call-type=REGULAR, execution-context=UNSPECIFIED, sw-service-impl-policy=STANDARD  # Maps WdgIf_SetTriggerCondition to Wdg_SetTriggerCondition of the corresponding Watchdog Driver. | The Watchdog Interface module maps the service WdgIf_SetTriggerCondition to the service Wdg_SetTriggerCondition of the corresponding Watchdog Driver. WdgIf_SetTriggerCondition provides timeout period information to lower layer drivers. The lower layer driver should not timeout for the period passed by the higher layer.
    sw service arg DeviceIndex: direction=IN, implementation-data-type=uint8  # (In)Used to identify the watchdog driver instance.
    sw service arg Timeout: direction=IN, implementation-data-type=uint16  # (In)Timeout value for setting the trigger counter.
  bsw module entry WdgIf_GetVersionInfo: service-id=3, is-reentrant=true, is-synchronous=true, call-type=REGULAR, execution-context=UNSPECIFIED, sw-service-impl-policy=STANDARD  # Provides the version information of this module. | The WdgIf_GetVersionInfo service returns the version information of this module. The version information includes: a)WdgIf Module Id(43) b) BOSCH vendor Id(06) c) Software release version number.
    sw service arg VersionInfoPtr: category=DATA_REFERENCE, direction=INOUT, sw-pointer-target-props={target-category=VALUE, implementation-data-type=Std_VersionInfoType}  # (Out)Pointer to where to store the version information of the module WdgIf.
package /AUTOSAR_WdgIf/ImplementationDataTypes
  impl type WdgIf_ModeType: compu {0=WDGIF_OFF_MODE (In this mode, the watchdog driver is disabled (switched off).), 1=WDGIF_SLOW_MODE (In this mode, the watchdog driver is set up for a long timeout period (slow triggering).), 2=WDGIF_FAST_MODE (In this mode, the watchdog driver is set up for a short timeout period (fast triggering).)}, implementation-data-type=uint8, type-emitter=HEADER_FILE  # Mode type of the WdgIf module | The WdgIf_ModeType values are passed as parameters to the watchdog drivers mode switching function.
