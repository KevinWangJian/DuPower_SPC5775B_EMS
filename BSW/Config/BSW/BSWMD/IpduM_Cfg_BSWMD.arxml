AUTOSAR XML (schema 4-2-2)
package /AUTOSAR_IpduM/BswImplementations
  bsw implementation IpduM: programming-language=C, sw-version=8.0.0, ar-release-version=4.2.2, behavior=BswInternalBehavior, vendor-specific-module-def=IpduM
    code-descriptors:
      code CodeDescriptor: artifact-descriptors=autosar-engineering-object={short-label=ArEngObj, category=SWSRC}
package /AUTOSAR_IpduM/BswModuleDescriptions
  bsw module description IpduM: category=BSW_MODULE, module-id=52  # IPDUMultiplexer
    bsw internal behavior BswInternalBehavior
      bsw schedulable entity BSWSE_MainFunctionRx: implemented-entry=IpduM_MainFunctionRx
      bsw schedulable entity BSWSE_MainFunctionTx: implemented-entry=IpduM_MainFunctionTx
      bsw background event EV_BSWSE_MainFunctionRx: starts-on-event=BSWSE_MainFunctionRx
      bsw background event EV_BSWSE_MainFunctionTx: starts-on-event=BSWSE_MainFunctionTx
package /AUTOSAR_IpduM/Units
  unit NoUnit: display-name=noUnit, factor-si-to-unit=1.0, offset-si-to-unit=0.0, physical-dimension=NoUnit  # No Unit
package /AUTOSAR_IpduM/PhysicalDimensions
  physical dimension NoUnit: length-exp=0
