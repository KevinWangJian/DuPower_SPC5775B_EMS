AUTOSAR XML (schema 4-2-2)
package /AUTOSAR_PduR/ApplicationDataTypes
  app type PduR_uint8: category=VALUE, sw-calibration-access=READ-WRITE, compu-method=Identical, range phys 0..255, display-format=%5.0f  # uint8
package /AUTOSAR_PduR/BswImplementations
  bsw implementation PduR: programming-language=C, sw-version=8.0.0, ar-release-version=4.2.2, behavior=BswInternalBehavior, vendor-specific-module-def=PduR
    code-descriptors:
      code CodeDescriptor: artifact-descriptors=autosar-engineering-object={short-label=ArEngObj, category=SWSRC}
package /AUTOSAR_PduR/BswModuleDescriptions
  bsw module description PduR
    bsw internal behavior BswInternalBehavior: data-type-mapping=DataTypeMappingSet
      static-memorys:
        data PduR_State: category=VALUE, sw-addr-method=INTERNAL_VAR_CLEARED, sw-calibration-access=READ-ONLY, display-format=%5.0f, type=PduR_uint8  # State information of Pdur module
package /AUTOSAR_PduR/DataTypeMappingSets
  data type mapping set DataTypeMappingSet: data-type-map{application-data-type=PduR_uint8, implementation-data-type=PduR_uint8_impl}
package /AUTOSAR_PduR/ImplementationDataTypes
  impl type PduR_uint8_impl: implementation-data-type=uint8  # implementation data type for application data type uint8
package /AUTOSAR_PduR/Units
  unit NoUnit: display-name=noUnit, factor-si-to-unit=1.0, offset-si-to-unit=0.0, physical-dimension=NoUnit  # No Unit
package /AUTOSAR_PduR/PhysicalDimensions
  physical dimension NoUnit: length-exp=0
