AUTOSAR XML (schema 4-2-2)
package /AUTOSAR_CanIf/ApplicationDataTypes
  app type CanIf_boolean_app: category=VALUE, sw-calibration-access=READ-WRITE, compu-method=Identical, range phys 0..1, display-format=%5.0f  # boolean application datatype in CanIf
  application record data type CanIf_ControllerStateType_struct_app: category=STRUCTURE, sw-calibration-access=READ-WRITE  # structure in CanIf
    application record element DeviceMode: category=VALUE, type=CanIf_ControllerModeType_Enum_app
    application record element ChannelMode: category=VALUE, type=CanIf_PduGetModeType_Enum_app
  4 x app type, all with category=VALUE, sw-calibration-access=READ-WRITE, range phys 0..255, display-format=%5.0f:
    CanIf_NotifStatusType_Enum_app: compu {0=CANIF_NO_NOTIFICATION, 1=CANIF_TX_RX_NOTIFICATION} "Computation method for enum type CanIf_NotifStatusType"  # enumeration data type
    CanIf_ControllerModeType_Enum_app: compu {0=CANIF_CS_UNINIT, 1=CANIF_CS_STOPPED, 2=CANIF_CS_STARTED, 3=CANIF_CS_SLEEP, 4=CANIF_CS_MAXMODE} "Computation method for enum type CanIf_ControllerModeType"  # enumeration data type
    CanIf_PduGetModeType_Enum_app: compu {0=CANIF_GET_OFFLINE, 1=CANIF_GET_RX_ONLINE, 2=CANIF_GET_TX_ONLINE, 3=CANIF_GET_ONLINE, 4=CANIF_GET_OFFLINE_ACTIVE, 5=CANIF_GET_OFFLINE_ACTIVE_RX_ONLINE} "Computation method for enum type CanIf_PduGetModeType"  # enumeration data type
    CanIf_u8_app: compu-method=Identical  # unsigned char application datatype in CanIf
  application array data type CanIf_ControllerState_Astruct_app: category=ARRAY, sw-calibration-access=READ-WRITE  # Structure datatype in CanIf
    element CanIf_ControllerStateType: category=STRUCTURE, type=CanIf_ControllerStateType_struct_app, max-number-of-elements=2
  application array data type CanIf_NotifStatusType_Aenum_app: category=ARRAY, sw-calibration-access=READ-WRITE  # application data type for array of enum
    element CanIf_NotifStatusType: category=VALUE, type=CanIf_NotifStatusType_Enum_app, max-number-of-elements=27
package /AUTOSAR_CanIf/BswImplementations
  bsw implementation CanIf: programming-language=C, sw-version=3.4.0, ar-release-version=4.2.2, behavior=BswInternalBehavior, vendor-specific-module-def=CanIf
    code-descriptors:
      code CodeDescriptor: artifact-descriptors=autosar-engineering-object={short-label=ArEngObj, category=SWSRC}
package /AUTOSAR_CanIf/BswModuleDescriptions
  bsw module description CanIf: category=BSW_MODULE, module-id=60  # CANInterface
    bsw internal behavior BswInternalBehavior: data-type-mapping=DataTypeMappingSet
      static-memorys:
        data CanIf_Init_Flag: category=VALUE, sw-addr-method=INTERNAL_VAR_CLEARED, sw-calibration-access=READ-ONLY, display-format=%5.0f, type=CanIf_boolean_app  # Flag to check if CANIF is Initialized(TRUE) or Not Initialized (FALSE)
        data CanIf_ControllerState: category=ARRAY, sw-addr-method=INTERNAL_VAR_CLEARED, sw-calibration-access=READ-ONLY, display-format=%5.0f, type=CanIf_ControllerState_Astruct_app  # Can Interface controller State
        data CanIf_TxNotification: category=ARRAY, sw-addr-method=INTERNAL_VAR_CLEARED, sw-calibration-access=READ-ONLY, display-format=%5.0f, type=CanIf_NotifStatusType_Aenum_app  # Can Interface Transmit Notification
package /AUTOSAR_CanIf/DataTypeMappingSets
  data type mapping set DataTypeMappingSet
    data-type-maps:
      application-data-type=CanIf_boolean_app, implementation-data-type=CanIf_boolean_impl
      application-data-type=CanIf_ControllerStateType_struct_app, implementation-data-type=CanIf_ControllerStateType_struct_impl
      application-data-type=CanIf_NotifStatusType_Enum_app, implementation-data-type=uint8
      application-data-type=CanIf_ControllerModeType_Enum_app, implementation-data-type=uint8
      application-data-type=CanIf_PduGetModeType_Enum_app, implementation-data-type=uint8
      application-data-type=CanIf_u8_app, implementation-data-type=CanIf_u8_impl
      application-data-type=CanIf_ControllerState_Astruct_app, implementation-data-type=CanIf_ControllerState_Astruct_impl
      application-data-type=CanIf_NotifStatusType_Aenum_app, implementation-data-type=CanIf_NotifStatusType_Aenum_impl
package /AUTOSAR_CanIf/ImplementationDataTypes
  8 x impl type:
    CanIf_boolean_impl: implementation-data-type=uint8  # implementation data type for application data type boolean
    CanIf_u8_impl: implementation-data-type=uint8  # implementation data type for application data type uint8
    CanIf_NotifStatusType_Enum_impl: implementation-data-type=uint8  # implementation data type for application data type enum
    CanIf_ControllerModeType_Enum_impl: implementation-data-type=uint8  # implementation data type for application data type enum
    CanIf_PduGetModeType_Enum_impl: implementation-data-type=uint8  # implementation data type for application data type enum
    CanIf_ControllerStateType_struct_impl: category=STRUCTURE  # implementation data type for structure
      element DeviceMode: implementation-data-type=CanIf_ControllerModeType_Enum_impl
      element ChannelMode: implementation-data-type=CanIf_PduGetModeType_Enum_impl
    CanIf_ControllerState_Astruct_impl: category=ARRAY  # Implementation datatype for array of struct
      element CanIf_struct_impl: array-size=2, array-size-semantics=FIXED-SIZE, implementation-data-type=CanIf_ControllerStateType_struct_impl
    CanIf_NotifStatusType_Aenum_impl: category=ARRAY  # implementation data type for array of enum
      element CanIf_NotifStatusType: array-size=27, array-size-semantics=FIXED-SIZE, implementation-data-type=CanIf_NotifStatusType_Enum_impl
package /AUTOSAR_CanIf/Units
  unit NoUnit: display-name=noUnit, factor-si-to-unit=1.0, offset-si-to-unit=0.0, physical-dimension=NoUnit  # No Unit
package /AUTOSAR_CanIf/PhysicalDimensions
  physical dimension NoUnit: length-exp=0
