AUTOSAR XML (schema 4-2-2)
package /AUTOSAR_IpduM/BswModuleEntrys
  4 x bsw module entry, all with is-synchronous=true, sw-service-impl-policy=STANDARD:
    IpduM_MainFunctionRx: is-reentrant=true, call-type=SCHEDULED, execution-context=TASK
    IpduM_MainFunctionTx: is-reentrant=false, call-type=SCHEDULED, execution-context=TASK
    IpduM_TxConfirmation: is-reentrant=true, call-type=CALLBACK, execution-context=UNSPECIFIED
    IpduM_RxIndication: is-reentrant=true, call-type=CALLBACK, execution-context=UNSPECIFIED
