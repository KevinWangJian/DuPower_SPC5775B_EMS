AUTOSAR XML (schema 4-0-3)
package /AUTOSAR_J1939Tp/BswModuleEntrys
  bsw module entry J1939Tp_MainFunction: is-reentrant=false, is-synchronous=true, call-type=SCHEDULED, execution-context=TASK, sw-service-impl-policy=STANDARD
package /AUTOSAR_J1939Tp/BswModuleDescriptions
  bsw module description J1939Tp: category=BSW_MODULE, module-id=37
    bsw internal behavior BswInternalBehaviour
      exclusive area ExclusiveArea_0
      bsw schedulable entity BSWSE_J1939Tp_MainFunction: can-enter-exclusive-area=ExclusiveArea_0, implemented-entry=J1939Tp_MainFunction
      bsw timing event BSWTE_J1939Tp_MainFunction: starts-on-event=BSWSE_J1939Tp_MainFunction, period=0.01
package /AUTOSAR_J1939Tp/BswImplementations
  bsw implementation BSWIMPL_J1939Tp: programming-language=C, ar-release-version=4.0.2, behavior=BswInternalBehaviour
    code-descriptors:
      code CodeDescriptor: artifact-descriptors=autosar-engineering-object={short-label=EngObject, category=SWSRC}
