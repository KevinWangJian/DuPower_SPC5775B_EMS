AUTOSAR XML (schema 4-0-3)
package /AUTOSAR_Xcp/BswModuleEntrys
  6 x bsw module entry, all with is-reentrant=false, is-synchronous=true, call-type=SCHEDULED, execution-context=TASK, sw-service-impl-policy=STANDARD:
    Xcp_MainFunction
    Xcp_EventChannel_10msRstr
    Xcp_EventChannel_20msRstr
    Xcp_EventChannel_50msRstr
    Xcp_EventChannel_100msRstr
    Xcp_EventChannel_1sRstr
