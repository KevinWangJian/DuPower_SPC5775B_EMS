AUTOSAR XML (schema 4-2-2)
package /ETAS_Project/EcucModuleConfigurationValuess
  module config NvM
    3 x NvMBlockDescriptor, all with NvMBlockCrcType=NVM_CRC16, NvMBlockJobPriority=1, NvMBlockManagementType=NVM_BLOCK_NATIVE, NvMBlockUseAutoValidation=0, NvMBlockUseCrc=1, NvMBlockUseSyncMechanism=0, NvMBlockWriteProt=0, NvMCalcRamBlockCrc=0, NvMInitBlockCallback=NULL_PTR, NvMMaxNumOfReadRetries=0, NvMMaxNumOfWriteRetries=0, NvMNvBlockNum=1, NvMNvramDeviceId=1, NvMRbFirstReadDataMigration=0, NvMRbGenRteAdminPort=0, NvMRbGenRteServicePort=1, NvMRbInitBlockAtLayoutChange=0, NvMRbNoFallback=0, NvMRbResistantToLayoutRemoval=0, NvMRbSelectBlockForFirstInitAll=0, NvMReadRamBlockFromNvCallback=NULL_PTR, NvMResistantToChangedSw=0, NvMRomBlockDataAddress=NULL_PTR, NvMRomBlockNum=0, NvMStaticBlockIDCheck=0, NvMWriteBlockOnce=0, NvMWriteRamBlockToNvCallback=NULL_PTR, NvMWriteVerification=0, NvMWriteVerificationDataSize=0:
      NVDataBlock1: NvMNvBlockLength=2048, NvMNvramBlockIdentifier=3, NvMRamBlockDataAddress=gaucNVData1, NvMRbBlockPersistentId=2, NvMSelectBlockForReadAll=1, NvMSelectBlockForWriteAll=1, NvMSingleBlockCallback=Rte_Call_NVDataBlock1_Finished_JobFinished
      NvM_ConfigId: NvMNvBlockLength=2, NvMRamBlockDataAddress=NvM_Prv_idConfigStored_u16, NvMRbBlockPersistentId=22, NvMSelectBlockForReadAll=true, NvMSelectBlockForWriteAll=true, NvMSingleBlockCallback=NULL_PTR
      NvM_MultiBlock: NvMNvBlockLength=1, NvMRamBlockDataAddress=NULL_PTR, NvMRbBlockPersistentId=11, NvMSelectBlockForReadAll=0, NvMSelectBlockForWriteAll=0, NvMSingleBlockCallback=NULL_PTR
    NvMCommon:
      NvMApiConfigClass = NVM_API_CONFIG_CLASS_3
      NvMBswMMultiBlockJobStatusInformation = 1
      NvMCompiledConfigId = 0
      NvMCrcNumOfBytes = 1
      NvMDevErrorDetect = 1
      NvMDrvModeSwitch = 0
      NvMDynamicConfiguration = 0
      NvMJobPrioritization = 1
      NvMMainFunctionCycleTime = 0.005
      NvMMultiBlockCallback = NULL_PTR
      NvMPollingMode = 1
      NvMRbAuxInterface = 0
      NvMRbGenArxmlVersion = NVM_GEN_ARXML_VERSION_402
      NvMRbInitAtLayoutChange = 0
      NvMRbRamInitCheck = NVM_RB_RAM_INIT_CHECK_NONE
      NvMRbRemoveNonResistantBlocks = 0
      NvMRbReqMonitor = NVM_RB_REQ_MON_DISABLED
      NvMRbRuntimeRamBlockConfiguration = 0
      NvMRbSetWriteAllTriggerApi = 1
      NvMRepeatMirrorOperations = 0
      NvMSetRamBlockStatusApi = 1
      NvMSizeImmediateJobQueue = 5
      NvMSizeStandardJobQueue = 5
      NvMVersionInfoApi = 0
