AUTOSAR XML (schema 4-2-2)
package /ETAS_Project/EcucModuleConfigurationValuess
  module config Rte
    RteGeneration:
      RteGenerationMode = VENDOR_MODE
      RteCalibrationSupport = NONE
      RteDevErrorDetect = 0
      RteDevErrorDetectUninit = 0
      RteIocInteractionReturnValue = RTE_COM
      RteMeasurementSupport = 1
      RteOptimizationMode = RUNTIME
      RteToolChainSignificantCharacters = 127
      RteVfbTraceEnabled = 0
    7 x RteBswModuleInstance:
      EcuM: RteBswImplementationRef=EcuM
        TE_EcuM_MainFunction (RteBswEventToTaskMapping): RteBswPositionInTask=2, RteBswActivationOffset=0.0, RteBswMappedToTaskRef=BSW_OsTask_10ms, RteBswEventRef=TE_EcuM_MainFunction
      Com: RteBswImplementationRef=Com
        EV_BSWSE_MainFunctionRx (RteBswEventToTaskMapping): RteBswPositionInTask=8, RteBswActivationOffset=0.0, RteBswMappedToTaskRef=BSW_OsTask_10ms, RteBswEventRef=EV_BSWSE_MainFunctionRx
        EV_BSWSE_MainFunctionTx (RteBswEventToTaskMapping): RteBswPositionInTask=9, RteBswActivationOffset=0.0, RteBswMappedToTaskRef=BSW_OsTask_10ms, RteBswEventRef=EV_BSWSE_MainFunctionTx
      ComM: RteBswImplementationRef=ComM
        EV_BSWSE_MainFunction_ComMChannel_Can_Network_0_Channel (RteBswEventToTaskMapping):
          RteBswPositionInTask = 4
          RteBswActivationOffset = 0.0
          RteBswMappedToTaskRef = BSW_OsTask_10ms
          RteBswEventRef = EV_BSWSE_MainFunction_ComMChannel_Can_Network_0_Channel
        EV_BSWSE_MainFunction_ComMChannel_J1939_Network_Channel (RteBswEventToTaskMapping):
          RteBswPositionInTask = 17
          RteBswActivationOffset = 0.0
          RteBswMappedToTaskRef = BSW_OsTask_10ms
          RteBswEventRef = EV_BSWSE_MainFunction_ComMChannel_J1939_Network_Channel
      CanSM: RteBswImplementationRef=CanSM
        EV_BSWSE_MainFunction (RteBswEventToTaskMapping): RteBswPositionInTask=5, RteBswActivationOffset=0.0, RteBswMappedToTaskRef=BSW_OsTask_10ms, RteBswEventRef=EV_BSWSE_MainFunction
      BSWIMPL_BswM: RteBswImplementationRef=BSWIMPL_BswM
        TE_BswM_MainFunction (RteBswEventToTaskMapping): RteBswPositionInTask=3, RteBswActivationOffset=0.0, RteBswMappedToTaskRef=BSW_OsTask_10ms, RteBswEventRef=TE_BswM_MainFunction
        RteBswRequiredModeGroupConnection:
          RteBswProvidedModeGrpModInstRef = BSWIMPL_BswM
          RteBswRequiredModeGroupRef = MDGR_BswM_MRP_BswM_MDG
          RteBswProvidedModeGroupRef = MDGP_AUTOSAR_BswM_ModeDeclarationGroups_MDG_ECUM_STATE
        5 x RteBswEventToTaskMapping:
          MSE_BswM_Cfg_DfrdBswNotification_BswM_MRP_BswM_MDG_ECUM_STATE_STARTUP_ONE: RteBswPositionInTask=1, RteBswEventRef=MSE_BswM_Cfg_DfrdBswNotification_BswM_MRP_BswM_MDG_ECUM_STATE_STARTUP_ONE
          MSE_BswM_Cfg_DfrdBswNotification_BswM_MRP_BswM_MDG_ECUM_STATE_STARTUP_TWO: RteBswPositionInTask=2, RteBswEventRef=MSE_BswM_Cfg_DfrdBswNotification_BswM_MRP_BswM_MDG_ECUM_STATE_STARTUP_TWO
          MSE_BswM_Cfg_DfrdBswNotification_BswM_MRP_BswM_MDG_ECUM_STATE_RUN: RteBswPositionInTask=3, RteBswEventRef=MSE_BswM_Cfg_DfrdBswNotification_BswM_MRP_BswM_MDG_ECUM_STATE_RUN
          MSE_BswM_Cfg_DfrdBswNotification_BswM_MRP_BswM_MDG_ECUM_STATE_PREP_SHUTDOWN: RteBswPositionInTask=6, RteBswEventRef=MSE_BswM_Cfg_DfrdBswNotification_BswM_MRP_BswM_MDG_ECUM_STATE_PREP_SHUTDOWN
          MSE_BswM_Cfg_DfrdBswNotification_BswM_MRP_BswM_MDG_ECUM_STATE_SHUTDOWN: RteBswPositionInTask=7, RteBswEventRef=MSE_BswM_Cfg_DfrdBswNotification_BswM_MRP_BswM_MDG_ECUM_STATE_SHUTDOWN
      CanIf: RteBswImplementationRef=CanIf
      PduR: RteBswImplementationRef=PduR
    CPT_BswM (RteSwComponentInstance): RteSoftwareComponentInstanceRef=CPT_BswM
      DRE_BswM_Cfg_DfrdSwcReqst_BswM_MRP_SwcModeRequest (RteEventToTaskMapping):
        RtePositionInTask = 2
        RteActivationOffset = 0.0
        RteMappedToTaskRef = BSW_OsTask_SwcRequest
        RteEventRef = DRE_BswM_Cfg_DfrdSwcReqst_BswM_MRP_SwcModeRequest
    Xcp (RteBswModuleInstance): RteBswImplementationRef=Xcp
      6 x RteBswEventToTaskMapping, all with RteBswActivationOffset=0.0:
        EV_BSWSE_MainFunction: RteBswPositionInTask=10, RteBswMappedToTaskRef=BSW_OsTask_10ms, RteBswEventRef=EV_BSWSE_MainFunction
        EV_BSWSE_EventChannel_10msRstr: RteBswPositionInTask=11, RteBswMappedToTaskRef=BSW_OsTask_10ms, RteBswEventRef=EV_BSWSE_EventChannel_10msRstr
        EV_BSWSE_EventChannel_1sRstr: RteBswPositionInTask=2, RteBswMappedToTaskRef=BSW_OsTask_1000ms, RteBswEventRef=EV_BSWSE_EventChannel_1sRstr
        EV_BSWSE_EventChannel_100msRstr: RteBswPositionInTask=2, RteBswMappedToTaskRef=BSW_OsTask_100ms, RteBswEventRef=EV_BSWSE_EventChannel_100msRstr
        EV_BSWSE_EventChannel_50msRstr: RteBswPositionInTask=2, RteBswMappedToTaskRef=BSW_OsTask_50ms, RteBswEventRef=EV_BSWSE_EventChannel_50msRstr
        EV_BSWSE_EventChannel_20msRstr: RteBswPositionInTask=2, RteBswMappedToTaskRef=BSW_OsTask_20ms, RteBswEventRef=EV_BSWSE_EventChannel_20msRstr
    CPT_Xcp_SWC (RteSwComponentInstance): RteSoftwareComponentInstanceRef=CPT_Xcp_SWC
      TE_Xcp_SWC_10ms (RteEventToTaskMapping): RtePositionInTask=5, RteActivationOffset=0.0, RteMappedToTaskRef=ASW_OsTask_10ms, RteEventRef=TE_Xcp_SWC_10ms
    Os (RteBswModuleInstance): RteBswImplementationRef=Os
      5 x RteBswEventToTaskMapping, all with RteBswActivationOffset=0.0:
        EV_BSWSE_BSW_OsTask_1ms: RteBswPositionInTask=2, RteBswMappedToTaskRef=BSW_OsTask_1ms, RteBswEventRef=EV_BSWSE_BSW_OsTask_1ms
        EV_BSWSE_BSW_OsTask_2ms: RteBswPositionInTask=1, RteBswMappedToTaskRef=BSW_OsTask_2ms, RteBswEventRef=EV_BSWSE_BSW_OsTask_2ms
        EV_BSWSE_BSW_OsTask_5ms: RteBswPositionInTask=2, RteBswMappedToTaskRef=BSW_OsTask_5ms, RteBswEventRef=EV_BSWSE_BSW_OsTask_5ms
        EV_BSWSE_BSW_OsTask_10ms: RteBswPositionInTask=15, RteBswMappedToTaskRef=BSW_OsTask_10ms, RteBswEventRef=EV_BSWSE_BSW_OsTask_10ms
        EV_BSWSE_BSW_OsTask_50ms: RteBswPositionInTask=3, RteBswMappedToTaskRef=BSW_OsTask_50ms, RteBswEventRef=EV_BSWSE_BSW_OsTask_50ms
    WdgM (RteBswModuleInstance): RteBswImplementationRef=WdgM
      TE_WdgMSupervisionCycle0 (RteBswEventToTaskMapping): RteBswPositionInTask=14, RteBswActivationOffset=0.0, RteBswMappedToTaskRef=BSW_OsTask_10ms, RteBswEventRef=TE_WdgMSupervisionCycle0
    3 x RteSwComponentInstance:
      CPT_WdgM_SWC: RteSoftwareComponentInstanceRef=CPT_WdgM_SWC
        7 x RteEventToTaskMapping, all with RteActivationOffset=0.0:
          TimingEvent_0: RtePositionInTask=2, RteMappedToTaskRef=ASW_OsTask_5ms, RteEventRef=TimingEvent_0
          TimingEvent_6: RtePositionInTask=1, RteMappedToTaskRef=BSW_OsTask_1000ms, RteEventRef=TimingEvent_6
          TimingEvent_5: RtePositionInTask=1, RteMappedToTaskRef=BSW_OsTask_100ms, RteEventRef=TimingEvent_5
          TimingEvent_2: RtePositionInTask=1, RteMappedToTaskRef=BSW_OsTask_10ms, RteEventRef=TimingEvent_2
          TimingEvent_3: RtePositionInTask=1, RteMappedToTaskRef=BSW_OsTask_20ms, RteEventRef=TimingEvent_3
          TimingEvent_4: RtePositionInTask=1, RteMappedToTaskRef=BSW_OsTask_50ms, RteEventRef=TimingEvent_4
          TimingEvent_1: RtePositionInTask=1, RteMappedToTaskRef=BSW_OsTask_5ms, RteEventRef=TimingEvent_1
      CPT_Asw_Swc: RteSoftwareComponentInstanceRef=CPT_Asw_Swc
        TE_Asw_MainFunction_5ms (RteEventToTaskMapping): RtePositionInTask=3, RteActivationOffset=0.0, RteMappedToTaskRef=ASW_OsTask_5ms, RteEventRef=TE_Asw_MainFunction_5ms
      CPT_Cmu_Cdd: RteSoftwareComponentInstanceRef=CPT_Cmu_Cdd
        TE_Cmu_MainFunction_10ms (RteEventToTaskMapping): RtePositionInTask=16, RteActivationOffset=0.0, RteMappedToTaskRef=BSW_OsTask_10ms, RteEventRef=TE_Cmu_MainFunction_10ms
    MemIf (RteBswModuleInstance): RteBswImplementationRef=MemIf
      EV_MemIf_Rb_MainFunction (RteBswEventToTaskMapping): RteBswPositionInTask=6, RteBswActivationOffset=0.0, RteBswMappedToTaskRef=BSW_OsTask_5ms, RteBswEventRef=EV_MemIf_Rb_MainFunction
    NvM (RteBswModuleInstance): RteBswImplementationRef=NvM
      EV_SE_MainFunction (RteBswEventToTaskMapping): RteBswPositionInTask=7, RteBswActivationOffset=0.0, RteBswMappedToTaskRef=BSW_OsTask_5ms, RteBswEventRef=EV_SE_MainFunction
    CPT_Sbc_Cdd (RteSwComponentInstance): RteSoftwareComponentInstanceRef=CPT_Sbc_Cdd
      TE_Sbc_MainFunction_10ms (RteEventToTaskMapping): RtePositionInTask=3, RteActivationOffset=0.0, RteMappedToTaskRef=BSW_OsTask_5ms, RteEventRef=TE_Sbc_MainFunction_10ms
    CPT_IoHwAb (RteSwComponentInstance): RteSoftwareComponentInstanceRef=CPT_IoHwAb
      TE_IoHwAb_MainFunction_2ms (RteEventToTaskMapping): RtePositionInTask=2, RteActivationOffset=0.0, RteMappedToTaskRef=BSW_OsTask_2ms, RteEventRef=TE_IoHwAb_MainFunction_2ms
    BSWIMPL_J1939Tp (RteBswModuleInstance): RteBswImplementationRef=BSWIMPL_J1939Tp
      BSWTE_J1939Tp_MainFunction (RteBswEventToTaskMapping): RteBswPositionInTask=18, RteBswActivationOffset=0.0, RteBswMappedToTaskRef=BSW_OsTask_10ms, RteBswEventRef=BSWTE_J1939Tp_MainFunction
