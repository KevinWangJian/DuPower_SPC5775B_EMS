AUTOSAR XML (schema 4-2-2)
package /ETAS_Project/EcucModuleConfigurationValuess
  module config Ea
    NVDataBlock1 (EaBlockConfiguration): EaBlockNumber=1, EaBlockSize=2048, EaImmediateData=0, EaNumberOfWriteCycles=1, EaRbBlockPersistentId=2, EaRbSecLevel=1
    EaGeneral:
      EaRbMigEraseBufferSize = 256
      EaDevErrorDetect = 1
      EaIndex = 0
      EaPollingMode = 1
      EaVersionInfoApi = 1
      EaSetModeSupported = 0
      EaVirtualPageSize = 32
      EaRbAddonsCCAS = 1
      EaRbActUnknownBlockMig = 0
      EaRbActSurvivalEval = 0
      EaPushedEepSize = 8192
    EaPublishedInformation: EaBlockOverhead=14, EaMaximumBlockingTime=1.0, EaPageOverhead=256
