AUTOSAR XML (schema 4-2-2)
package /ETAS_Project/EcucModuleConfigurationValuess
  module config WdgM
    WdgMConfigSet: WdgMInitialMode=WdgMMode_Fast
      WdgMMode_Fast (WdgMMode): WdgMExpiredSupervisionCycleTol=0, WdgMModeId=0, WdgMSupervisionCycle=0.01
        WdgMTrigger_Fast (WdgMTrigger): WdgMWatchDogMode=WDGIF_FAST_MODE, WdgMTriggerConditionValue=50, WdgMTriggerWatchDogRef=WdgMWatchdog_Internal
        WdgMAliveSupervision_Asw_5ms (WdgMAliveSupervision):
          WdgMExpectedAliveIndications = 10
          WdgMMaxMargin = 2
          WdgMMinMargin = 2
          WdgMSupervisionReferenceCycle = 5
          WdgMAliveSupervisionCheckpointRef = WdgMCheckpoint_Asw_5ms
        WdgMLocalStatusParams_Asw_5ms (WdgMLocalStatusParams): WdgMFailedAliveSupervisionRefCycleTol=1, WdgMLocalStatusSupervisedEntityRef=WdgMAliveSupervisedEntity_Asw_5ms
        6 x WdgMAliveSupervision, all with WdgMExpectedAliveIndications=10, WdgMMaxMargin=2, WdgMMinMargin=2:
          WdgMAliveSupervision_Bsw_5ms: WdgMSupervisionReferenceCycle=5, WdgMAliveSupervisionCheckpointRef=WdgMCheckpoint_Bsw_5ms
          WdgMAliveSupervision_Bsw_10ms: WdgMSupervisionReferenceCycle=10, WdgMAliveSupervisionCheckpointRef=WdgMCheckpoint_Bsw_10ms
          WdgMAliveSupervision_Bsw_20ms: WdgMSupervisionReferenceCycle=20, WdgMAliveSupervisionCheckpointRef=WdgMCheckpoint_Bsw_20ms
          WdgMAliveSupervision_Bsw_50ms: WdgMSupervisionReferenceCycle=50, WdgMAliveSupervisionCheckpointRef=WdgMCheckpoint_Bsw_50ms
          WdgMAliveSupervision_Bsw_100ms: WdgMSupervisionReferenceCycle=100, WdgMAliveSupervisionCheckpointRef=WdgMCheckpoint_Bsw_100ms
          WdgMAliveSupervision_Bsw_1000ms: WdgMSupervisionReferenceCycle=1000, WdgMAliveSupervisionCheckpointRef=WdgMCheckpoint_Bsw_1000ms
        6 x WdgMLocalStatusParams, all with WdgMFailedAliveSupervisionRefCycleTol=1:
          WdgMLocalStatusParams_Bsw_5ms: WdgMLocalStatusSupervisedEntityRef=WdgMAliveSupervisedEntity_Bsw_5ms
          WdgMLocalStatusParams_Bsw_10ms: WdgMLocalStatusSupervisedEntityRef=WdgMAliveSupervisedEntity_Bsw_10ms
          WdgMLocalStatusParams_Bsw_20ms: WdgMLocalStatusSupervisedEntityRef=WdgMAliveSupervisedEntity_Bsw_20ms
          WdgMLocalStatusParams_Bsw_50ms: WdgMLocalStatusSupervisedEntityRef=WdgMAliveSupervisedEntity_Bsw_50ms
          WdgMLocalStatusParams_Bsw_100ms: WdgMLocalStatusSupervisedEntityRef=WdgMAliveSupervisedEntity_Bsw_100ms
          WdgMLocalStatusParams_Bsw_1000ms: WdgMLocalStatusSupervisedEntityRef=WdgMAliveSupervisedEntity_Bsw_1000ms
    WdgMGeneral:
      WdgMVersionInfoApi = 1
      WdgMDevErrorDetect = 1
      WdgMRbDebugOptionEnable = 0
      WdgMRbDeadlineTimeOutDetect = 0
      WdgMRbDeadlineTimerSelection = AUTOSAR_OS_TIMER
      WdgMDefensiveBehavior = 0
      WdgMDemStoppedSupervisionReport = 0
      WdgMImmediateReset = 0
      WdgMOffModeEnabled = 0
      WdgMRbInterruptLockDisable = 1
      WdgMRbRteDisabled = 0
      WdgMWatchdog_Internal (WdgMWatchdog): WdgMWatchdogName=WdgMWatchdog_Internal, WdgMWatchdogDeviceRef=WdgIfDevice
      WdgMCallerIds: WdgMCallerId=42
      7 x WdgMSupervisedEntity, all with WdgMOSCounter=Rte_TickCounter:
        WdgMAliveSupervisedEntity_Asw_5ms: WdgMSupervisedEntityId=0, WdgMInternalCheckpointInitialRef=WdgMCheckpoint_Asw_5ms, WdgMInternalCheckpointFinalRef=WdgMCheckpoint_Asw_5ms
          WdgMCheckpoint_Asw_5ms (WdgMCheckpoint): WdgMCheckpointId=0
        WdgMAliveSupervisedEntity_Bsw_5ms: WdgMSupervisedEntityId=1, WdgMInternalCheckpointInitialRef=WdgMCheckpoint_Bsw_5ms, WdgMInternalCheckpointFinalRef=WdgMCheckpoint_Bsw_5ms
          WdgMCheckpoint_Bsw_5ms (WdgMCheckpoint): WdgMCheckpointId=0
        WdgMAliveSupervisedEntity_Bsw_10ms: WdgMSupervisedEntityId=2, WdgMInternalCheckpointInitialRef=WdgMCheckpoint_Bsw_10ms, WdgMInternalCheckpointFinalRef=WdgMCheckpoint_Bsw_10ms
          WdgMCheckpoint_Bsw_10ms (WdgMCheckpoint): WdgMCheckpointId=0
        WdgMAliveSupervisedEntity_Bsw_20ms: WdgMSupervisedEntityId=3, WdgMInternalCheckpointInitialRef=WdgMCheckpoint_Bsw_20ms, WdgMInternalCheckpointFinalRef=WdgMCheckpoint_Bsw_20ms
          WdgMCheckpoint_Bsw_20ms (WdgMCheckpoint): WdgMCheckpointId=0
        WdgMAliveSupervisedEntity_Bsw_50ms: WdgMSupervisedEntityId=4, WdgMInternalCheckpointInitialRef=WdgMCheckpoint_Bsw_50ms, WdgMInternalCheckpointFinalRef=WdgMCheckpoint_Bsw_50ms
          WdgMCheckpoint_Bsw_50ms (WdgMCheckpoint)
        WdgMAliveSupervisedEntity_Bsw_100ms: WdgMSupervisedEntityId=5, WdgMInternalCheckpointInitialRef=WdgMCheckpoint_Bsw_100ms, WdgMInternalCheckpointFinalRef=WdgMCheckpoint_Bsw_100ms
          WdgMCheckpoint_Bsw_100ms (WdgMCheckpoint)
        WdgMAliveSupervisedEntity_Bsw_1000ms: WdgMSupervisedEntityId=6, WdgMInternalCheckpointInitialRef=WdgMCheckpoint_Bsw_1000ms, WdgMInternalCheckpointFinalRef=WdgMCheckpoint_Bsw_1000ms
          WdgMCheckpoint_Bsw_1000ms (WdgMCheckpoint)
