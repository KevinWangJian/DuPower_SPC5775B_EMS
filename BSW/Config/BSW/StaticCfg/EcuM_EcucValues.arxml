AUTOSAR XML (schema 4-2-2)
package /ETAS_Project/EcucModuleConfigurationValuess
  module config EcuM
    EcuMConfiguration
      EcuMCommonConfiguration: EcuMDefaultAppMode=OSDEFAULTAPPMODE
        EcuMDefaultShutdownTarget: EcuMDefaultState=EcuMStateOff
        ECUM_WKSOURCE_POWER (EcuMWakeupSource): EcuMCheckWakeupTimeout=0
        EcuMDriverInitListOne
          8 x EcuMDriverInitItem:
            Det: EcuMModuleID=Det, EcuMModuleParameter=NULL_PTR, EcuMModuleService=Init
            Mcu: EcuMModuleID=Mcu, EcuMModuleParameter=POSTBUILD_PTR, EcuMModuleService=Init
            McuFunc: EcuMModuleID=McuFunc, EcuMModuleParameter=VOID, EcuMModuleService=InitializeClock
            Mcl: EcuMModuleID=Mcl, EcuMModuleParameter=POSTBUILD_PTR, EcuMModuleService=Init
            Port: EcuMModuleParameter=POSTBUILD_PTR, EcuMModuleService=Init, EcuMModuleID=Port
            Gpt: EcuMModuleParameter=POSTBUILD_PTR, EcuMModuleService=Init, EcuMModuleID=Gpt
            Wdg: EcuMModuleID=Wdg, EcuMModuleParameter=POSTBUILD_PTR, EcuMModuleService=Init
            WdgM: EcuMModuleID=WdgM, EcuMModuleParameter=POSTBUILD_PTR, EcuMModuleService=Init
        4 x EcuMWakeupSource, all with EcuMCheckWakeupTimeout=0:
          ECUM_WKSOURCE_RESET
          ECUM_WKSOURCE_INTERNAL_RESET
          ECUM_WKSOURCE_INTERNAL_WDG
          ECUM_WKSOURCE_EXTERNAL_WDG
      EcuMFlexConfiguration
        EcuMFlexUserConfig: EcuMFlexUser=42
        ECUM_RESET_MCU (EcuMResetMode)
        ECUM_CAUSE_ECU_STATE (EcuMShutdownCause)
        EcuMGoDownAllowedUsers: EcuMGoDownAllowedUserRef=EcuMFlexUserConfig
        ECUM_RESET_WDGM (EcuMResetMode)
        ECUM_RESET_IO (EcuMResetMode)
        ECUM_CAUSE_WDGM (EcuMShutdownCause)
        ECUM_CAUSE_DCM (EcuMShutdownCause)
    EcuMGeneral: EcuMRbSlaveCoreEarlierStart=0, EcuMDevErrorDetect=1, EcuMIncludeDet=1, EcuMMainFunctionPeriod=0.01, EcuMVersionInfoApi=1, EcuMRbNvMBlockDeviceId=1
      EcuMRbIncludeHeaderList: EcuMRbModuleHeader=McuFunc
