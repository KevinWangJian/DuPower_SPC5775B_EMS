AUTOSAR XML (schema 4-2-2)
package /ETAS_Project/EcucModuleConfigurationValuess
  module config Wdg
    WdgGeneral: WdgDevErrorDetect=1, WdgVersionInfoApi=1
