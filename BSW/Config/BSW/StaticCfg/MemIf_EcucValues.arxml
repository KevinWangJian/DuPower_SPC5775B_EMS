AUTOSAR XML (schema 4-2-2)
package /ETAS_Project/EcucModuleConfigurationValuess
  module config MemIf
    MemIfGeneral: MemIfDevErrorDetect=1, MemIfNumberOfDevices=1, MemIfRbFeeUsed=0, MemIfRbNumberOfEADevices=1, MemIfVersionInfoApi=1
