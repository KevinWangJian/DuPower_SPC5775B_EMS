AUTOSAR XML (schema 4-2-2)
package /ETAS_Project/EcucModuleConfigurationValuess
  module config Det
    DetGeneral: DetForwardToDlt=0, DetRbCheckApiConsistency=1, DetVersionInfoApi=0
      DetRbBuffer: DetRbErrorBufferSize=10, DetRbUseErrorBufferApi=0
