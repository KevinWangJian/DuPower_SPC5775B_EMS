AUTOSAR XML (schema 4-2-2)
package /ETAS_Project/EcucModuleConfigurationValuess
  module config Os
    4 x OsTask, all with OsTaskActivation=1, OsTaskSchedule=FULL:
      ASW_OsTask_1ms: OsTaskPriority=20
      ASW_OsTask_2ms: OsTaskPriority=19
      ASW_OsTask_5ms: OsTaskPriority=18
      ASW_OsTask_10ms: OsTaskPriority=17
    OSDEFAULTAPPMODE (OsAppMode)
    9 x OsTask, all with OsTaskActivation=1, OsTaskSchedule=FULL:
      BSW_OsTask_1ms: OsTaskPriority=30
      BSW_OsTask_2ms: OsTaskPriority=29
      BSW_OsTask_5ms: OsTaskPriority=28
      BSW_OsTask_10ms: OsTaskPriority=27
      BSW_OsTask_20ms: OsTaskPriority=26
      BSW_OsTask_50ms: OsTaskPriority=25
      BSW_OsTask_100ms: OsTaskPriority=24
      BSW_OsTask_1000ms: OsTaskPriority=23
      BSW_OsTask_SwcRequest: OsTaskPriority=10
    Rte_TickCounter (OsCounter)
