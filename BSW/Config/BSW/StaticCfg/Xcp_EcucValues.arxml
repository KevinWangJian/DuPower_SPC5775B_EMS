AUTOSAR XML (schema 4-2-2)
package /ETAS_Project/EcucModuleConfigurationValuess
  module config Xcp
    XcpConfig
      XcpTransportLayer:
        XcpDaqOverloadIndication = NO_OVERLOAD_INDICATION
        XcpIdentificationFieldType = ABSOLUTE
        XcpTimestampType = TWO_BYTE
        XcpOdtOptimization = OM_DEFAULT
        XcpConsistency = ODT
        XcpFrameConcatenation = 0
        XcpTransportLayerType = CAN
        XcpMaxCto = 8
        XcpMaxDto = 8
        XcpTransportLayerName = XCP_TPL
        XcpRxPdu_CMD (XcpRxPdu): XcpRxPacketType=CMD_STIM, XcpRxPduRef=XCP_CMD_Can_Network_CANNODE_0_CanIf2Xcp
        XcpTxPdu_RES_DAQ (XcpTxPdu): XcpTxPacketType=RES_ERR_EV_SERV_DAQ, XcpTxPduRef=XCP_RES_DAQ_Can_Network_CANNODE_0_Xcp2CanIf
      5 x XcpEventChannel, all with XcpEventChannelType=DAQ:
        XcpEventChannel_10ms: XcpEventChannelTimeUnit=TIMESTAMP_UNIT_10MS, XcpEventChannelTimeCycle=1, XcpEventChannelPriority=5, XcpEventChannelShortName=10msRstr, XcpEventChannelName=XcpEvent_10ms_Raster
        XcpEventChannel_20ms: XcpEventChannelTimeUnit=TIMESTAMP_UNIT_10MS, XcpEventChannelTimeCycle=2, XcpEventChannelPriority=4, XcpEventChannelShortName=20msRstr, XcpEventChannelName=XcpEvent_20ms_Raster
        XcpEventChannel_50ms: XcpEventChannelTimeUnit=TIMESTAMP_UNIT_10MS, XcpEventChannelTimeCycle=5, XcpEventChannelPriority=3, XcpEventChannelShortName=50msRstr, XcpEventChannelName=XcpEvent_50ms_Raster
        XcpEventChannel_100ms: XcpEventChannelTimeUnit=TIMESTAMP_UNIT_10MS, XcpEventChannelTimeCycle=10, XcpEventChannelPriority=2, XcpEventChannelShortName=100msRstr, XcpEventChannelName=XcpEvent_100ms_Raster
        XcpEventChannel_1000ms: XcpEventChannelTimeUnit=TIMESTAMP_UNIT_100MS, XcpEventChannelTimeCycle=10, XcpEventChannelPriority=1, XcpEventChannelShortName=1sRstr, XcpEventChannelName=XcpEvent_1000ms_Raster
    XcpGeneral:
      XcpCalibrationCal = 1
      XcpPageSwitchingPag = 0
      XcpSynchronousDataAcquisitionDaq = 1
      XcpSynchronousDataStimulationStim = 0
      XcpDaqMemoryLimitEmulationDevice = 0
      XcpDaqQueueFactor = 2.0
      XcpStimQueueFactor = 3
      XcpSecondSlaveInstance = 0
      XcpDaqRamShifting = 0
      XcpDaqRamShiftSize = 1024
      XcpOdtOptimizationErrorReaction = FALLBACK_TO_OM_DEFAULT
      XcpResumeMode = 0
      XcpBlockTransferUpload = 1
      XcpBlockTransferDownload = 1
      XcpSeedAndKey = 1
      XcpCommandChecksum = 1
      XcpMtaBlockSizeAlign = 1
      XcpConnectTransportLayerCallout = 0
      XcpMemoryReadProtection = 1
      XcpMemoryWriteProtection = 1
      XcpUploadDownloadMemoryAccessByAppl = 1
      XcpDaqStimMemoryAccessByAppl = 0
      XcpStaticAddressTransformation = 0
      XcpCommandGetCommModeInfo = 0
      XcpCommandGetId = 0
      XcpCommandUserCmd = 0
      XcpCommandModifyBits = 1
      XcpCommandsGetPagInfo = 0
      XcpCommandGetDaqListMode = 0
      XcpCommandReadDaq = 1
      XcpCommandsGetDaqInfo = 1
      XcpEventChannelScheduling = 1
      XcpVersion = VERSION_1_2
      XcpVersionInfoApi = 1
      XcpTimestampUnit = TIMESTAMP_UNIT_1MS
      XcpMainFunctionPeriod = 0.01
      XcpDevErrorDetect = 1
      XcpTimestampTicks = 1
      XcpDaqMemoryLimit = 8192
      XcpProductLine = CSMOSAR
      XcpSeedAndKeyExternalFunction = XcpSeedNKey.dll
    XcpA2LFile: XcpTimeoutT1=2000, XcpTimeoutT2=2000, XcpTimeoutT7=2000
      XcpTransportLayerA2L: XcpMaxBusLoad=100, XcpOneTlPerCanCtrlBDRConfig=0, XcpTransportLayerRef=XcpTransportLayer, XcpEventChannelA2LRef=XcpEventChannelA2L
      XcpEventChannelA2L:
        XcpEventChannelRef = XcpEventChannel_1000ms
        XcpEventChannelRef = XcpEventChannel_100ms
        XcpEventChannelRef = XcpEventChannel_10ms
        XcpEventChannelRef = XcpEventChannel_20ms
        XcpEventChannelRef = XcpEventChannel_50ms
