AUTOSAR XML (schema 4-2-2)
package /AUTOSAR_Os/BswModuleDescriptions
  bsw module description Os
    bsw internal behavior BswInternalBehavior
      5 x bsw schedulable entity:
        BSWSE_BSW_OsTask_1ms: implemented-entry=RE_BSW_OsTask_1ms
        BSWSE_BSW_OsTask_2ms: implemented-entry=RE_BSW_OsTask_2ms
        BSWSE_BSW_OsTask_5ms: implemented-entry=RE_BSW_OsTask_5ms
        BSWSE_BSW_OsTask_10ms: implemented-entry=RE_BSW_OsTask_10ms
        BSWSE_BSW_OsTask_50ms: implemented-entry=RE_BSW_OsTask_50ms
      5 x bsw timing event:
        EV_BSWSE_BSW_OsTask_1ms: starts-on-event=BSWSE_BSW_OsTask_1ms, period=0.001
        EV_BSWSE_BSW_OsTask_2ms: starts-on-event=BSWSE_BSW_OsTask_2ms, period=0.002
        EV_BSWSE_BSW_OsTask_5ms: starts-on-event=BSWSE_BSW_OsTask_5ms, period=0.005
        EV_BSWSE_BSW_OsTask_10ms: starts-on-event=BSWSE_BSW_OsTask_10ms, period=0.01
        EV_BSWSE_BSW_OsTask_50ms: starts-on-event=BSWSE_BSW_OsTask_50ms, period=0.05
package /AUTOSAR_Os/BswModuleEntrys
  5 x bsw module entry, all with is-reentrant=false, is-synchronous=true, call-type=SCHEDULED, execution-context=TASK, sw-service-impl-policy=STANDARD:
    RE_BSW_OsTask_1ms
    RE_BSW_OsTask_2ms
    RE_BSW_OsTask_5ms
    RE_BSW_OsTask_10ms
    RE_BSW_OsTask_50ms
package /AUTOSAR_Os/BswImplementations
  bsw implementation Os: programming-language=C, sw-version=8.0.0, ar-release-version=4.2.2, behavior=BswInternalBehavior, vendor-specific-module-def=Os
    code-descriptors:
      code CodeDescriptor: artifact-descriptors=autosar-engineering-object={short-label=ArEngObj, category=SWSRC}
