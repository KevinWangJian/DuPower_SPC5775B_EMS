AUTOSAR XML (schema 4-2-2)
package /ETAS_Project/EcucModuleConfigurationValuess
  module config BswM
    BswMConfig
      BswMArbitration
        6 x BswMLogicalExpression:
          BswM_LE_StartupOne: BswMArgumentRef=BswM_MC_BswM_StartupOne
          BswM_LE_StartupTwo: BswMLogicalOperator=BSWM_AND, BswMArgumentRef=BswM_MC_BswM_StartupTwo, BswMArgumentRef=BswM_MC_BswModules_ReadAllComplete
          BswM_LE_Run: BswMArgumentRef=BswM_MC_BswM_Run
          BswM_LE_PostRun: BswMArgumentRef=BswM_MC_BswM_PostRun
          BswM_LE_PrepShutdown: BswMLogicalOperator=BSWM_AND, BswMArgumentRef=BswM_MC_BswM_PrepShutdown, BswMArgumentRef=BswM_MC_ComMNoCom
          BswM_LE_Shutdown: BswMLogicalOperator=BSWM_AND, BswMArgumentRef=BswM_MC_BswM_Shutdown, BswMArgumentRef=BswM_MC_BswModules_WriteAllComplete
        6 x BswMModeCondition, all with BswMConditionType=BSWM_EQUALS:
          BswM_MC_BswM_StartupOne: BswMConditionMode=BswM_MRP_BswM_MDG
            BswMConditionValue
              BswMModeDeclaration: BswMModeValueRef=ECUM_STATE_STARTUP_ONE
          BswM_MC_BswM_StartupTwo: BswMConditionMode=BswM_MRP_BswM_MDG
            BswMConditionValue
              BswMModeDeclaration: BswMModeValueRef=ECUM_STATE_STARTUP_TWO
          BswM_MC_BswM_Run: BswMConditionMode=BswM_MRP_BswM_MDG
            BswMConditionValue
              BswMModeDeclaration: BswMModeValueRef=ECUM_STATE_RUN
          BswM_MC_BswM_PostRun: BswMConditionMode=BswM_MRP_SwcModeRequest
            BswMConditionValue
              BswMModeDeclaration: BswMModeValueRef=ECUM_STATE_POST_RUN
          BswM_MC_BswM_PrepShutdown: BswMConditionMode=BswM_MRP_BswM_MDG
            BswMConditionValue
              BswMModeDeclaration: BswMModeValueRef=ECUM_STATE_PREP_SHUTDOWN
          BswM_MC_BswM_Shutdown: BswMConditionMode=BswM_MRP_BswM_MDG
            BswMConditionValue
              BswMModeDeclaration: BswMModeValueRef=ECUM_STATE_SHUTDOWN
        BswM_MRP_BswM_MDG (BswMModeRequestPort): BswMRequestProcessing=BSWM_DEFERRED
          BswMModeRequestSource
            BswMBswModeNotification: BswMRbBswModeDeclarationGroup=/AUTOSAR_BswM/ModeDeclarationGroups/MDG_ECUM_STATE
        6 x BswMRule, all with BswMNestedExecutionOnly=0, BswMRuleInitState=BSWM_FALSE:
          BswM_AR_StartupOne: BswMRuleExpressionRef=BswM_LE_StartupOne, BswMRuleTrueActionList=BswM_AL_BswMSwitchStartupTwo
          BswM_AR_StartupTwo: BswMRuleExpressionRef=BswM_LE_StartupTwo, BswMRuleTrueActionList=BswM_AL_BswMSwitchRun
          BswM_AR_Run: BswMRuleExpressionRef=BswM_LE_Run, BswMRuleTrueActionList=BswM_AL_BswMSwitchAppRun
          BswM_AR_PostRun: BswMRuleExpressionRef=BswM_LE_PostRun, BswMRuleTrueActionList=BswM_AL_BswMSwitchPrepShutdown
          BswM_AR_Shutdown: BswMRuleExpressionRef=BswM_LE_PrepShutdown, BswMRuleTrueActionList=BswM_AL_BswMSwitchShutdown
          BswM_AR_Godown: BswMRuleExpressionRef=BswM_LE_Shutdown, BswMRuleTrueActionList=BswM_AL_BswMSwitchGoDown
        BswM_MRP_SwcModeRequest (BswMModeRequestPort): BswMRequestProcessing=BSWM_DEFERRED
          BswMModeRequestSource
            BswMSwcModeRequest: BswMRbModeRequestQueueSize=0, BswMSwcModeRequestVariableDataPrototypeRef=VDP_uint16
        BswM_MC_ComMNoCom (BswMModeCondition): BswMConditionType=BSWM_EQUALS, BswMConditionMode=BswM_MRP_ComM_Can0
          BswMConditionValue
            BswMBswMode: BswMBswRequestedMode=COMM_NO_COMMUNICATION
        3 x BswMModeRequestPort, all with BswMRequestProcessing=BSWM_IMMEDIATE:
          BswM_MRP_ComM_Can0
            BswMModeRequestSource
              BswMComMIndication: BswMComMChannelRef=ComMChannel_Can_Network_0_Channel
          BswM_MRP_NvMReadAllComplete
            BswMModeRequestSource
              BswMNvMJobModeIndication: BswMNvmService=NvmReadAll
            BswMModeInitValue: BswMBswModeInitValue=NVM_REQ_PENDING
          BswM_MRP_NvMWriteAllComplete
            BswMModeRequestSource
              BswMNvMJobModeIndication: BswMNvmService=NvmWriteAll
            BswMModeInitValue: BswMBswModeInitValue=NVM_REQ_PENDING
        BswM_MC_BswModules_ReadAllComplete (BswMModeCondition): BswMConditionType=BSWM_EQUALS_NOT, BswMConditionMode=BswM_MRP_NvMReadAllComplete
          BswMConditionValue
            BswMBswMode: BswMBswRequestedMode=NVM_REQ_PENDING
        BswM_MC_BswModules_WriteAllComplete (BswMModeCondition): BswMConditionType=BSWM_EQUALS_NOT, BswMConditionMode=BswM_MRP_NvMWriteAllComplete
          BswMConditionValue
            BswMBswMode: BswMBswRequestedMode=NVM_REQ_PENDING
        BswM_MPR_ComM_Can1 (BswMModeRequestPort): BswMRequestProcessing=BSWM_IMMEDIATE
          BswMModeRequestSource_0 (BswMModeRequestSource)
            BswMComMIndication_0 (BswMComMIndication): BswMComMChannelRef=ComMChannel_J1939_Network_Channel
        BswM_MC_ComMNoCom_CAN1 (BswMModeCondition): BswMConditionType=BSWM_EQUALS, BswMConditionMode=BswM_MPR_ComM_Can1
          BswMConditionValue_0 (BswMConditionValue)
            BswMBswMode_0 (BswMBswMode): BswMBswRequestedMode=COMM_NO_COMMUNICATION
      BswMModeControl
        6 x BswMActionList:
          BswM_AL_BswMSwitchStartupTwo: BswMActionListExecution=BSWM_CONDITION
            12 x BswMActionListItem, all with BswMAbortOnFail=0:
              BswM_ALI_AdcInit: BswMActionListItemIndex=0, BswMActionListItemRef=BswM_AI_AdcInit
              BswM_ALI_PwmInit: BswMActionListItemIndex=2, BswMActionListItemRef=BswM_AI_PwmInit
              BswM_ALI_SpiInit: BswMActionListItemIndex=3, BswMActionListItemRef=BswM_AI_SpiInit
              BswM_ALI_SbcInit: BswMActionListItemIndex=4, BswMActionListItemRef=BswM_AI_SbcInit
              BswM_ALI_EepInit: BswMActionListItemIndex=5, BswMActionListItemRef=BswM_AI_EepInit
              BswM_ALI_EaInit: BswMActionListItemIndex=6, BswMActionListItemRef=BswM_AI_EaInit
              BswM_ALI_FlsInit: BswMActionListItemIndex=7, BswMActionListItemRef=BswM_AI_FlsInit
              BswM_ALI_NvMInit: BswMActionListItemIndex=10, BswMActionListItemRef=BswM_AI_NvMInit
              BswM_ALI_NvMReadAll: BswMActionListItemIndex=11, BswMActionListItemRef=BswM_AI_NvMReadAll
              BswM_ALI_BswMStartupTwo: BswMActionListItemIndex=12, BswMActionListItemRef=BswM_AI_BswMSwitchStartupTwo
              BswM_ALI_AfeInit: BswMActionListItemIndex=8, BswMActionListItemRef=BswM_AI_AfeInit
              BswM_ALI_CddInit: BswMActionListItemIndex=9, BswMActionListItemRef=BswM_AI_CddInit
          BswM_AL_BswMSwitchRun: BswMActionListExecution=BSWM_TRIGGER
            11 x BswMActionListItem, all with BswMAbortOnFail=0:
              BswM_ALI_CanInit: BswMActionListItemIndex=1, BswMActionListItemRef=BswM_AI_CanInit
              BswM_ALI_CanIfInit: BswMActionListItemIndex=2, BswMActionListItemRef=BswM_AI_CanIfInit
              BswM_ALI_CanSmInit: BswMActionListItemIndex=3, BswMActionListItemRef=BswM_AI_CanSmInit
              BswM_ALI_PduRInit: BswMActionListItemIndex=4, BswMActionListItemRef=BswM_AI_PduRInit
              BswM_ALI_IpduMInit: BswMActionListItemIndex=5, BswMActionListItemRef=BswM_AI_IpduMInit
              BswM_ALI_ComInit: BswMActionListItemIndex=6, BswMActionListItemRef=BswM_AI_ComInit
              BswM_ALI_ComMInit: BswMActionListItemIndex=7, BswMActionListItemRef=BswM_AI_ComMInit
              BswM_ALI_XcpInit: BswMActionListItemIndex=8, BswMActionListItemRef=BswM_AI_XcpInit
              BswM_ALI_RteTimerStart: BswMActionListItemIndex=9, BswMActionListItemRef=BswM_AI_RteTimerStart
              BswM_ALI_BswMRun: BswMActionListItemIndex=10, BswMActionListItemRef=BswM_AI_BswMSwitchRun
              BswM_ALI_SbcRun: BswMActionListItemIndex=0, BswMActionListItemRef=BswM_AI_SbcRun
          BswM_AL_BswMSwitchAppRun: BswMActionListExecution=BSWM_TRIGGER
            6 x BswMActionListItem, all with BswMAbortOnFail=0:
              BswM_ALI_StartPdu: BswMActionListItemIndex=0, BswMActionListItemRef=BswM_AI_StartPdu
              BswM_ALI_AllowComm_Can0: BswMActionListItemIndex=1, BswMActionListItemRef=BswM_AI_ComMCommAllowed_Can0
              BswM_ALI_ComMReqFullComm_User0: BswMActionListItemIndex=2, BswMActionListItemRef=BswM_AI_ComMReqFullComm_User0
              BswM_ALI_BswMAppRun: BswMActionListItemIndex=5, BswMActionListItemRef=BswM_AI_BswMSwitchAppRun
              BswM_ALI_AllowComm_Can1: BswMActionListItemIndex=3, BswMActionListItemRef=BswM_AI_ComMCommAllowed_Can1
              BswM_ALI_ComMReqFullComm_User1: BswMActionListItemIndex=4, BswMActionListItemRef=BswM_AI_ComMReqFullComm_User1
          BswM_AL_BswMSwitchPrepShutdown: BswMActionListExecution=BSWM_TRIGGER
            6 x BswMActionListItem, all with BswMAbortOnFail=0:
              BswM_ALI_NotAllowComm_Can0: BswMActionListItemIndex=1, BswMActionListItemRef=BswM_AI_ComMCommNotAllowed_Can0
              BswM_ALI_ComMReqNoComm_User0: BswMActionListItemIndex=2, BswMActionListItemRef=BswM_AI_ComMReqNoComm_User0
              BswM_ALI_StopPdu: BswMActionListItemIndex=5, BswMActionListItemRef=BswM_AI_StopPdu
              BswM_ALI_BswMPrepShutdown: BswMActionListItemIndex=6, BswMActionListItemRef=BswM_AI_BswMSwitchPrepShutdown
              BswM_ALI_NotAllowComm_Can1: BswMActionListItemIndex=3, BswMActionListItemRef=BswM_AI_ComMCommNotAllowed_Can1
              BswM_ALI_ComMReqNoComm_User1: BswMActionListItemIndex=4, BswMActionListItemRef=BswM_AI_ComMReqNoComm_User1
          BswM_AL_BswMSwitchShutdown: BswMActionListExecution=BSWM_TRIGGER
            4 x BswMActionListItem, all with BswMAbortOnFail=0:
              BswM_ALI_ComMDeInit: BswMActionListItemIndex=0, BswMActionListItemRef=BswM_AI_ComMDeInit
              BswM_ALI_BswMShutdown: BswMActionListItemIndex=3, BswMActionListItemRef=BswM_AI_BswMSwitchShutdown
              BswM_ALI_SbcPrepShutdown: BswMActionListItemIndex=1, BswMActionListItemRef=BswM_AI_SbcPrepShutdown
              BswM_ALI_WriteAll: BswMActionListItemIndex=2, BswMActionListItemRef=BswM_AI_NvMWriteAll
          BswM_AL_BswMSwitchGoDown: BswMActionListExecution=BSWM_TRIGGER
            3 x BswMActionListItem, all with BswMAbortOnFail=0:
              BswM_ALI_RteStop: BswMActionListItemIndex=0, BswMActionListItemRef=BswM_AI_RteStop
              BswM_ALI_GoDown: BswMActionListItemIndex=1, BswMActionListItemRef=BswM_AI_GoDown
              BswM_ALI_EcuM_MainFunction: BswMActionListItemIndex=2, BswMActionListItemRef=BswM_AI_EcuM_MainFunction
        43 x BswMAction:
          BswM_AI_BswMSwitchStartupTwo
            BswMAvailableActions
              BswMSchMSwitch: BswMSchMSwitchedMode=ECUM_STATE_STARTUP_TWO
          BswM_AI_BswMSwitchRun
            BswMAvailableActions
              BswMSchMSwitch: BswMSchMSwitchedMode=ECUM_STATE_RUN
          BswM_AI_BswMSwitchAppRun
            BswMAvailableActions
              BswMSchMSwitch: BswMSchMSwitchedMode=ECUM_STATE_APP_RUN
          BswM_AI_BswMSwitchPostRun
            BswMAvailableActions
              BswMSchMSwitch: BswMSchMSwitchedMode=ECUM_STATE_POST_RUN
          BswM_AI_BswMSwitchPrepShutdown
            BswMAvailableActions
              BswMSchMSwitch: BswMSchMSwitchedMode=ECUM_STATE_PREP_SHUTDOWN
          BswM_AI_BswMSwitchShutdown
            BswMAvailableActions
              BswMSchMSwitch: BswMSchMSwitchedMode=ECUM_STATE_SHUTDOWN
          BswM_AI_GoDown
            BswMAvailableActions
              BswMUserCallout: BswMUserCalloutFunction=EcuM_GoDown(42)
          BswM_AI_ComMReqFullComm_User0
            BswMAvailableActions
              BswMComMModeSwitch: BswMComMRequestedMode=BSWM_FULL_COM, BswMComMUserRef=ComMUser_Can_Network_0_Channel
          BswM_AI_ComMReqNoComm_User0
            BswMAvailableActions
              BswMComMModeSwitch: BswMComMRequestedMode=BSWM_NO_COM, BswMComMUserRef=ComMUser_Can_Network_0_Channel
          BswM_AI_ComMCommAllowed_Can0
            BswMAvailableActions
              BswMComMAllowCom: BswMComAllowed=1, BswMComMAllowChannelRef=ComMChannel_Can_Network_0_Channel
          BswM_AI_ComMCommNotAllowed_Can0
            BswMAvailableActions
              BswMComMAllowCom: BswMComAllowed=0, BswMComMAllowChannelRef=ComMChannel_Can_Network_0_Channel
          BswM_AI_RteTimerStart
            BswMAvailableActions
              BswM_UserCallout (BswMUserCallout): BswMUserCalloutFunction=IC_RteTimerStart()
          BswM_AI_RteStop
            BswMAvailableActions
              BswMUserCallout: BswMUserCalloutFunction=Rte_Stop()
          BswM_AI_CanIfInit
            BswMAvailableActions
              BswMUserCallout: BswMUserCalloutFunction=CanIf_Init(NULL_PTR)
          BswM_AI_ComMInit
            BswMAvailableActions
              BswMUserCallout: BswMUserCalloutFunction=ComM_Init(NULL_PTR)
          BswM_AI_CanSmInit
            BswMAvailableActions
              BswMUserCallout: BswMUserCalloutFunction=CanSM_Init(NULL_PTR)
          BswM_AI_ComInit
            BswMAvailableActions
              BswMUserCallout: BswMUserCalloutFunction=Com_Init(NULL_PTR)
          BswM_AI_PduRInit
            BswMAvailableActions
              BswMUserCallout: BswMUserCalloutFunction=PduR_Init(&PduR_Config)
          BswM_AI_EcuM_MainFunction
            BswMAvailableActions
              BswMUserCallout: BswMUserCalloutFunction=Loop_EcuM_MainFunction()
          BswM_AI_ComMDeInit
            BswMAvailableActions
              BswMUserCallout: BswMUserCalloutFunction=ComM_DeInit()
          BswM_AI_IpduMInit
            BswMAvailableActions
              BswMUserCallout: BswMUserCalloutFunction=IpduM_Init(&IpduMConfig)
          BswM_AI_XcpInit
            BswMAvailableActions
              BswMUserCallout: BswMUserCalloutFunction=Xcp_Init(NULL_PTR)
          BswM_AI_AdcInit
            BswMAvailableActions
              BswMUserCallout: BswMUserCalloutFunction=ADC_INIT()
          BswM_AI_PwmInit
            BswMAvailableActions
              BswMUserCallout: BswMUserCalloutFunction=PWM_INIT()
          BswM_AI_SpiInit
            BswMAvailableActions
              BswMUserCallout: BswMUserCalloutFunction=SPI_INIT()
          BswM_AI_CanInit
            BswMAvailableActions
              BswMUserCallout: BswMUserCalloutFunction=CAN_INIT()
          BswM_AI_SbcInit
            BswMAvailableActions
              BswMUserCallout: BswMUserCalloutFunction=SBC_INIT()
          BswM_AI_EaInit
            BswMAvailableActions
              BswMUserCallout: BswMUserCalloutFunction=EA_INIT()
          BswM_AI_NvMInit
            BswMAvailableActions
              BswMUserCallout: BswMUserCalloutFunction=NvM_Init()
          BswM_AI_StartPdu
            BswMAvailableActions
              BswMPduGroupSwitch: BswMPduGroupSwitchReinit=0, BswMEnabledPduGroupRef=ComIPduGroup_Rx, BswMEnabledPduGroupRef=ComIPduGroup_Tx
          BswM_AI_StopPdu
            BswMAvailableActions
              BswMPduGroupSwitch: BswMPduGroupSwitchReinit=0, BswMDisabledPduGroupRef=ComIPduGroup_Rx, BswMDisabledPduGroupRef=ComIPduGroup_Tx
          BswM_AI_NvMReadAll
            BswMAvailableActions
              BswMUserCallout: BswMUserCalloutFunction=IC_BswM_NvM_ReadAll()
          BswM_AI_NvMWriteAll
            BswMAvailableActions
              BswMUserCallout: BswMUserCalloutFunction=IC_BswM_NvM_WriteAll()
          BswM_AI_EepInit
            BswMAvailableActions
              BswMUserCallout: BswMUserCalloutFunction=Eep_Init(NULL_PTR)
          BswM_AI_FlsInit
            BswMAvailableActions
              BswMUserCallout: BswMUserCalloutFunction=FLS_INIT()
          BswM_AI_SbcPrepShutdown
            BswMAvailableActions
              BswMUserCallout: BswMUserCalloutFunction=SBC_PREP_SHUTDOWN()
          BswM_AI_SbcRun
            BswMAvailableActions
              BswMUserCallout: BswMUserCalloutFunction=SBC_RUN()
          BswM_AI_AfeInit
            BswMAvailableActions
              BswMUserCallout: BswMUserCalloutFunction=AFE_INIT()
          BswM_AI_CddInit
            BswMAvailableActions
              BswMUserCallout: BswMUserCalloutFunction=CDD_INIT()
          BswM_AI_ComMReqFullComm_User1
            BswMAvailableActions_0 (BswMAvailableActions)
              BswMComMModeSwitch_0 (BswMComMModeSwitch): BswMComMRequestedMode=BSWM_FULL_COM, BswMComMUserRef=ComMUser_J1939_Network_Channel
          BswM_AI_ComMReqNoComm_User1
            BswMAvailableActions_0 (BswMAvailableActions)
              BswMComMModeSwitch_0 (BswMComMModeSwitch): BswMComMRequestedMode=BSWM_NO_COM, BswMComMUserRef=ComMUser_J1939_Network_Channel
          BswM_AI_ComMCommAllowed_Can1
            BswMAvailableActions_0 (BswMAvailableActions)
              BswMComMAllowCom_0 (BswMComMAllowCom): BswMComAllowed=1, BswMComMAllowChannelRef=ComMChannel_J1939_Network_Channel
          BswM_AI_ComMCommNotAllowed_Can1
            BswMAvailableActions_0 (BswMAvailableActions)
              BswMComMAllowCom_0 (BswMComMAllowCom): BswMComAllowed=0, BswMComMAllowChannelRef=ComMChannel_J1939_Network_Channel
      BswMDataTypeMappingSets: BswMDataTypeMappingSetRef=ECUM_STATE_Mapping
    BswMGeneral:
      BswMCanSMEnabled = 1
      BswMComMEnabled = 1
      BswMDcmEnabled = 0
      BswMDevErrorDetect = 1
      BswMEcuMEnabled = 1
      BswMEthSMEnabled = 0
      BswMFrSMEnabled = 0
      BswMGenericRequestEnabled = 1
      BswMJ1939DcmEnabled = 0
      BswMJ1939NmEnabled = 0
      BswMLinSMEnabled = 0
      BswMLinTPEnabled = 0
      BswMNvMEnabled = 1
      BswMSchMEnabled = 1
      BswMSdEnabled = 0
      BswMVersionInfoApi = 1
      BswMWdgMEnabled = 1
      BswMRbDebugEnable = 0
      BswMRbIntrptQueueMaxSize = 5
      BswMMainFunctionPeriod = 0.01
      BswMEthIfEnabled = 0
      BswMNmEnabled = 0
      BswMRbMaxNumOfRules = 30
      BswMUserIncludeFiles:
        BswMUserIncludeFile = Rte_Main.h
        BswMUserIncludeFile = CanSM.h
        BswMUserIncludeFile = CanIf.h
        BswMUserIncludeFile = ComM.h
        BswMUserIncludeFile = Com.h
        BswMUserIncludeFile = PduR.h
        BswMUserIncludeFile = EcuM.h
        BswMUserIncludeFile = Integration.h
        BswMUserIncludeFile = IpduM.h
        BswMUserIncludeFile = Xcp.h
        BswMUserIncludeFile = WdgM.h
        BswMUserIncludeFile = McuFunc.h
        BswMUserIncludeFile = Ea.h
        BswMUserIncludeFile = NvM.h
