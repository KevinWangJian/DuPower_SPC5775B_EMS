AUTOSAR XML (schema 4-2-2)
standard types defined: boolean, float32, float64, sint16, sint32, sint8, uint16, uint32, uint8, uint64, sint64
package /AUTOSAR_PlatformTypes/ImplementationDataTypes  # AUTOSAR platform types
package /AUTOSAR_PlatformTypes/DataConstraints  # AUTOSAR platform types
  range DataConstr_uint8: phys 0..255, raw 0..255
  range DataConstr_uint16: phys 0..65535, raw 0..65535
  range DataConstr_uint32: phys 0..4294967295, raw 0..4294967295
  range DataConstr_sint8: phys -128..127, raw -128..127
  range DataConstr_sint16: phys -32768..32767, raw -32768..32767
  range DataConstr_sint32: phys -2147483648..2147483647, raw -2147483648..2147483647
  range DataConstr_boolean: phys 0..1, raw 0..1
  range DataConstr_sint64: phys -9223372036854775808..9223372036854775807, raw -9223372036854775808..9223372036854775807
  range DataConstr_uint64: phys 0..18446744073709551615, raw 0..18446744073709551615
package /AUTOSAR_PlatformTypes/SwBaseTypes  # AUTOSAR platform types
