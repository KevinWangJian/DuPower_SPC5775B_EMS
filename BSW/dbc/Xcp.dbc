VERSION ""

NS_ :

BS_:

BU_: BMSL

BO_ 1795 XCP_CMD: 8 Vector__XXX
 SG_ XCP_SIG1 : 7|64@0+ (1,0) [0|0] ""  BMSL

BO_ 1796 XCP_RES_DAQ: 8 BMSL
 SG_ XCP_SIG2 : 7|64@0+ (1,0) [0|0] "" Vector__XXX

BA_DEF_  "BusType" STRING ;
BA_DEF_DEF_  "BusType" "CAN";
