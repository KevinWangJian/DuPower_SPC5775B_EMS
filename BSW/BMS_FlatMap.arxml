AUTOSAR XML (schema 4-2-2)
package /BMSL_FlatView
  flat map BMSL_FlatMap
    533 x flat instance descriptor:
      CPT_Asw_Swc: upstream-reference=RootSwCompositionPrototype.CPT_Asw_Swc, ecu-extract-reference=CPT_BMSL_FlatView.CPT_Asw_Swc
      VDP_uint16: sw-refresh-timing={cse-code=3, cse-code-factor=5}, upstream-reference=RootSwCompositionPrototype.CPT_Asw_Swc.PPort_BswMArbitration_BswM_MRP_SwcModeRequest.VDP_uint16, ecu-extract-reference=CPT_BMSL_FlatView.CPT_Asw_Swc.PPort_BswMArbitration_BswM_MRP_SwcModeRequest.VDP_uint16
      CellBalCmd_flg: sw-refresh-timing={cse-code=3, cse-code-factor=5}, upstream-reference=RootSwCompositionPrototype.CPT_Asw_Swc.CmuCmd.CellMeasCmd_flg, ecu-extract-reference=CPT_BMSL_FlatView.CPT_Asw_Swc.CmuCmd.CellMeasCmd_flg
      FBLForbid_flg: sw-refresh-timing={cse-code=3, cse-code-factor=5}, upstream-reference=RootSwCompositionPrototype.CPT_Asw_Swc.FblCmd.FBLForbid_flg, ecu-extract-reference=CPT_BMSL_FlatView.CPT_Asw_Swc.FblCmd.FBLForbid_flg
      PackVoltMeasCmd_flg: sw-refresh-timing={cse-code=3, cse-code-factor=5}, upstream-reference=RootSwCompositionPrototype.CPT_Asw_Swc.HighVoltCmd.PackVoltMeasCmd_flg, ecu-extract-reference=CPT_BMSL_FlatView.CPT_Asw_Swc.HighVoltCmd.PackVoltMeasCmd_flg
      GlobalHCtrCmd_flg: sw-refresh-timing={cse-code=3, cse-code-factor=5}, upstream-reference=RootSwCompositionPrototype.CPT_Asw_Swc.RelayCmd.GlobalHCtrCmd_flg, ecu-extract-reference=CPT_BMSL_FlatView.CPT_Asw_Swc.RelayCmd.GlobalHCtrCmd_flg
      PosCtrCmd_flg: sw-refresh-timing={cse-code=3, cse-code-factor=5}, upstream-reference=RootSwCompositionPrototype.CPT_Asw_Swc.RelayCmd.KpCtrlCmd_flg, ecu-extract-reference=CPT_BMSL_FlatView.CPT_Asw_Swc.RelayCmd.KpCtrlCmd_flg
      CPT_BswM: upstream-reference=RootSwCompositionPrototype.CPT_BswM, ecu-extract-reference=CPT_BMSL_FlatView.CPT_BswM
      CPT_Cmu_Cdd: upstream-reference=RootSwCompositionPrototype.CPT_Cmu_Cdd, ecu-extract-reference=CPT_BMSL_FlatView.CPT_Cmu_Cdd
      CellBalState_flg: sw-refresh-timing={cse-code=4, cse-code-factor=1}, upstream-reference=RootSwCompositionPrototype.CPT_Cmu_Cdd.CmuValue.InCMUHWAlarmPWMFeq_Hz, ecu-extract-reference=CPT_BMSL_FlatView.CPT_Cmu_Cdd.CmuValue.InCMUHWAlarmPWMFeq_Hz
      CellTemp1_C: sw-refresh-timing={cse-code=4, cse-code-factor=1}, upstream-reference=RootSwCompositionPrototype.CPT_Cmu_Cdd.CmuValue.CMUPwrDiagVolt_V, ecu-extract-reference=CPT_BMSL_FlatView.CPT_Cmu_Cdd.CmuValue.CMUPwrDiagVolt_V
      CellTemp1Vld_flg: sw-refresh-timing={cse-code=4, cse-code-factor=1}, upstream-reference=RootSwCompositionPrototype.CPT_Cmu_Cdd.CmuValue.CMUPwrDiagVoltVld_flg, ecu-extract-reference=CPT_BMSL_FlatView.CPT_Cmu_Cdd.CmuValue.CMUPwrDiagVoltVld_flg
      CellTemp2_C: sw-refresh-timing={cse-code=4, cse-code-factor=1}, upstream-reference=RootSwCompositionPrototype.CPT_Cmu_Cdd.CmuValue.CtxOpenDiagStatus_flg, ecu-extract-reference=CPT_BMSL_FlatView.CPT_Cmu_Cdd.CmuValue.CtxOpenDiagStatus_flg
      CellTemp2Vld_flg: sw-refresh-timing={cse-code=4, cse-code-factor=1}, upstream-reference=RootSwCompositionPrototype.CPT_Cmu_Cdd.CmuValue.ChanelFuncDiagStatus_flg, ecu-extract-reference=CPT_BMSL_FlatView.CPT_Cmu_Cdd.CmuValue.ChanelFuncDiagStatus_flg
      CMUPCBTemp1_C: sw-refresh-timing={cse-code=4, cse-code-factor=1}, upstream-reference=RootSwCompositionPrototype.CPT_Cmu_Cdd.CmuValue.GpioxOpenDiagStatus_flg, ecu-extract-reference=CPT_BMSL_FlatView.CPT_Cmu_Cdd.CmuValue.GpioxOpenDiagStatus_flg
      CMUPCBTemp1Vld_flg: sw-refresh-timing={cse-code=4, cse-code-factor=1}, upstream-reference=RootSwCompositionPrototype.CPT_Cmu_Cdd.CmuValue.BalOpenLoadDiagStatus_flg, ecu-extract-reference=CPT_BMSL_FlatView.CPT_Cmu_Cdd.CmuValue.BalOpenLoadDiagStatus_flg
      CMUPCBTemp2_C: sw-refresh-timing={cse-code=4, cse-code-factor=1}, upstream-reference=RootSwCompositionPrototype.CPT_Cmu_Cdd.CmuValue.CmuReCfgStatus_flg, ecu-extract-reference=CPT_BMSL_FlatView.CPT_Cmu_Cdd.CmuValue.CmuReCfgStatus_flg
      CellVolt_mV: sw-refresh-timing={cse-code=4, cse-code-factor=1}, upstream-reference=RootSwCompositionPrototype.CPT_Cmu_Cdd.CmuValue.CellLeakageDiagStatus_flg, ecu-extract-reference=CPT_BMSL_FlatView.CPT_Cmu_Cdd.CmuValue.CellLeakageDiagStatus_flg
      CellVoltVld_flg: sw-refresh-timing={cse-code=4, cse-code-factor=1}, upstream-reference=RootSwCompositionPrototype.CPT_Cmu_Cdd.CmuValue.GpioOTUTFuncDiagStatus_flg, ecu-extract-reference=CPT_BMSL_FlatView.CPT_Cmu_Cdd.CmuValue.GpioOTUTFuncDiagStatus_flg
      CellComErr_flg: sw-refresh-timing={cse-code=4, cse-code-factor=1}, upstream-reference=RootSwCompositionPrototype.CPT_Cmu_Cdd.CmuValue.InCMUHWAlarmPWMFeqVld_flg, ecu-extract-reference=CPT_BMSL_FlatView.CPT_Cmu_Cdd.CmuValue.InCMUHWAlarmPWMFeqVld_flg
      CellOpenErr_flg: sw-refresh-timing={cse-code=4, cse-code-factor=1}, upstream-reference=RootSwCompositionPrototype.CPT_Cmu_Cdd.CmuValue.InCMUHWAlarmPWMDutyVld_flg, ecu-extract-reference=CPT_BMSL_FlatView.CPT_Cmu_Cdd.CmuValue.InCMUHWAlarmPWMDutyVld_flg
      CellMeasCmd_flg: sw-refresh-timing={cse-code=4, cse-code-factor=1}, upstream-reference=RootSwCompositionPrototype.CPT_Cmu_Cdd.CmuValue.InCMUHWAlarmPWMDuty_pct, ecu-extract-reference=CPT_BMSL_FlatView.CPT_Cmu_Cdd.CmuValue.InCMUHWAlarmPWMDuty_pct
      CPT_ComM: upstream-reference=RootSwCompositionPrototype.CPT_ComM, ecu-extract-reference=CPT_BMSL_FlatView.CPT_ComM
      CPT_Det: upstream-reference=RootSwCompositionPrototype.CPT_Det, ecu-extract-reference=CPT_BMSL_FlatView.CPT_Det
      CPT_EcuM: upstream-reference=RootSwCompositionPrototype.CPT_EcuM, ecu-extract-reference=CPT_BMSL_FlatView.CPT_EcuM
      CPT_IoHwAb: upstream-reference=RootSwCompositionPrototype.CPT_IoHwAb, ecu-extract-reference=CPT_BMSL_FlatView.CPT_IoHwAb
      BSWInitFinish_flg: sw-refresh-timing={cse-code=3, cse-code-factor=2}, upstream-reference=RootSwCompositionPrototype.CPT_IoHwAb.McuValue.BSWInitFinish_flg, ecu-extract-reference=CPT_BMSL_FlatView.CPT_IoHwAb.McuValue.BSWInitFinish_flg
      KL30Volt_V: sw-refresh-timing={cse-code=3, cse-code-factor=2}, upstream-reference=RootSwCompositionPrototype.CPT_IoHwAb.PowerValue.KL30Volt_V, ecu-extract-reference=CPT_BMSL_FlatView.CPT_IoHwAb.PowerValue.KL30Volt_V
      KL30VoltVld_flg: sw-refresh-timing={cse-code=3, cse-code-factor=2}, upstream-reference=RootSwCompositionPrototype.CPT_IoHwAb.PowerValue.KL30VoltVld_flg, ecu-extract-reference=CPT_BMSL_FlatView.CPT_IoHwAb.PowerValue.KL30VoltVld_flg
      GlobalHCtrState_flg: sw-refresh-timing={cse-code=3, cse-code-factor=2}, upstream-reference=RootSwCompositionPrototype.CPT_IoHwAb.RelayValue.GlobalHsideDiagVolt_V, ecu-extract-reference=CPT_BMSL_FlatView.CPT_IoHwAb.RelayValue.GlobalHsideDiagVolt_V
      PosCtrCmdState_flg: sw-refresh-timing={cse-code=3, cse-code-factor=2}, upstream-reference=RootSwCompositionPrototype.CPT_IoHwAb.RelayValue.GlobalHsideDiagVoltVld_flg, ecu-extract-reference=CPT_BMSL_FlatView.CPT_IoHwAb.RelayValue.GlobalHsideDiagVoltVld_flg
      CPT_NvM: upstream-reference=RootSwCompositionPrototype.CPT_NvM, ecu-extract-reference=CPT_BMSL_FlatView.CPT_NvM
      CPT_Sbc_Cdd: upstream-reference=RootSwCompositionPrototype.CPT_Sbc_Cdd, ecu-extract-reference=CPT_BMSL_FlatView.CPT_Sbc_Cdd
      KL15WakeupState_flg: sw-refresh-timing={cse-code=3, cse-code-factor=5}, upstream-reference=RootSwCompositionPrototype.CPT_Sbc_Cdd.SbcValue.KL15WakeupState_flg, ecu-extract-reference=CPT_BMSL_FlatView.CPT_Sbc_Cdd.SbcValue.KL15WakeupState_flg
      BMULastPwrDownState: sw-refresh-timing={cse-code=3, cse-code-factor=5}, upstream-reference=RootSwCompositionPrototype.CPT_Sbc_Cdd.SbcValue.BMULastPwrDownState, ecu-extract-reference=CPT_BMSL_FlatView.CPT_Sbc_Cdd.SbcValue.BMULastPwrDownState
      CPT_WdgM: upstream-reference=RootSwCompositionPrototype.CPT_WdgM, ecu-extract-reference=CPT_BMSL_FlatView.CPT_WdgM
      CPT_WdgM_SWC: upstream-reference=RootSwCompositionPrototype.CPT_WdgM_SWC, ecu-extract-reference=CPT_BMSL_FlatView.CPT_WdgM_SWC
      CPT_Xcp_SWC: upstream-reference=RootSwCompositionPrototype.CPT_Xcp_SWC, ecu-extract-reference=CPT_BMSL_FlatView.CPT_Xcp_SWC
      PackVoltVld_flg: sw-refresh-timing={cse-code=3, cse-code-factor=2}, upstream-reference=RootSwCompositionPrototype.CPT_Asw_Swc.HighVoltValue.PackVoltVld_flg, ecu-extract-reference=CPT_BMSL_FlatView.CPT_Asw_Swc.HighVoltValue.PackVoltVld_flg
      PreChgCheckVoltVld_flg: sw-refresh-timing={cse-code=3, cse-code-factor=2}, upstream-reference=RootSwCompositionPrototype.CPT_Asw_Swc.HighVoltValue.PreChgCheckVoltVld_flg, ecu-extract-reference=CPT_BMSL_FlatView.CPT_Asw_Swc.HighVoltValue.PreChgCheckVoltVld_flg
      PreChgCheckVolt_V: sw-refresh-timing={cse-code=3, cse-code-factor=2}, upstream-reference=RootSwCompositionPrototype.CPT_Asw_Swc.HighVoltValue.PreChgCheckVolt_V, ecu-extract-reference=CPT_BMSL_FlatView.CPT_Asw_Swc.HighVoltValue.PreChgCheckVolt_V
      PreChgCheckRedVolt_V: sw-refresh-timing={cse-code=3, cse-code-factor=2}, upstream-reference=RootSwCompositionPrototype.CPT_Asw_Swc.HighVoltValue.PreChgCheckRedVolt_V, ecu-extract-reference=CPT_BMSL_FlatView.CPT_Asw_Swc.HighVoltValue.PreChgCheckRedVolt_V
      PreChgCheckRedVoltVld_flg: sw-refresh-timing={cse-code=3, cse-code-factor=2}, upstream-reference=RootSwCompositionPrototype.CPT_Asw_Swc.HighVoltValue.PreChgCheckRedVoltVld_flg, ecu-extract-reference=CPT_BMSL_FlatView.CPT_Asw_Swc.HighVoltValue.PreChgCheckRedVoltVld_flg
      P1CheckVolt_V: sw-refresh-timing={cse-code=3, cse-code-factor=2}, upstream-reference=RootSwCompositionPrototype.CPT_Asw_Swc.HighVoltValue.P1CheckVolt_V, ecu-extract-reference=CPT_BMSL_FlatView.CPT_Asw_Swc.HighVoltValue.P1CheckVolt_V
      PackVolt_V: sw-refresh-timing={cse-code=3, cse-code-factor=2}, upstream-reference=RootSwCompositionPrototype.CPT_Asw_Swc.HighVoltValue.PackVolt_V, ecu-extract-reference=CPT_BMSL_FlatView.CPT_Asw_Swc.HighVoltValue.PackVolt_V
      P1CheckVoltVld_flg: sw-refresh-timing={cse-code=3, cse-code-factor=2}, upstream-reference=RootSwCompositionPrototype.CPT_Asw_Swc.HighVoltValue.P1CheckVoltVld_flg, ecu-extract-reference=CPT_BMSL_FlatView.CPT_Asw_Swc.HighVoltValue.P1CheckVoltVld_flg
      P2CheckVolt_V: sw-refresh-timing={cse-code=3, cse-code-factor=2}, upstream-reference=RootSwCompositionPrototype.CPT_Asw_Swc.HighVoltValue.P2CheckVolt_V, ecu-extract-reference=CPT_BMSL_FlatView.CPT_Asw_Swc.HighVoltValue.P2CheckVolt_V
      P2CheckVoltVld_flg: sw-refresh-timing={cse-code=3, cse-code-factor=2}, upstream-reference=RootSwCompositionPrototype.CPT_Asw_Swc.HighVoltValue.P2CheckVoltVld_flg, ecu-extract-reference=CPT_BMSL_FlatView.CPT_Asw_Swc.HighVoltValue.P2CheckVoltVld_flg
      P3CheckVolt_V: sw-refresh-timing={cse-code=3, cse-code-factor=2}, upstream-reference=RootSwCompositionPrototype.CPT_Asw_Swc.HighVoltValue.P3CheckVolt_V, ecu-extract-reference=CPT_BMSL_FlatView.CPT_Asw_Swc.HighVoltValue.P3CheckVolt_V
      P3CheckVoltVld_flg: sw-refresh-timing={cse-code=3, cse-code-factor=2}, upstream-reference=RootSwCompositionPrototype.CPT_Asw_Swc.HighVoltValue.P3CheckVoltVld_flg, ecu-extract-reference=CPT_BMSL_FlatView.CPT_Asw_Swc.HighVoltValue.P3CheckVoltVld_flg
      CANWakeupState_flg: sw-refresh-timing={cse-code=3, cse-code-factor=5}, upstream-reference=RootSwCompositionPrototype.CPT_Asw_Swc.SbcValue.CANWakeupState_flg, ecu-extract-reference=CPT_BMSL_FlatView.CPT_Asw_Swc.SbcValue.CANWakeupState_flg
      RTCWakeupState_flg: sw-refresh-timing={cse-code=3, cse-code-factor=5}, upstream-reference=RootSwCompositionPrototype.CPT_Asw_Swc.SbcValue.RTCWakeupState_flg, ecu-extract-reference=CPT_BMSL_FlatView.CPT_Asw_Swc.SbcValue.RTCWakeupState_flg
      SBCWakeupP{1..3}State_flg: sw-refresh-timing={cse-code=3, cse-code-factor=5}, upstream-reference=RootSwCompositionPrototype.CPT_Asw_Swc.SbcValue.SBCWakeupP{1..3}State_flg, ecu-extract-reference=CPT_BMSL_FlatView.CPT_Asw_Swc.SbcValue.SBCWakeupP{1..3}State_flg
      BmuSbcVpreUV_flg: sw-refresh-timing={cse-code=3, cse-code-factor=5}, upstream-reference=RootSwCompositionPrototype.CPT_Asw_Swc.SbcValue.BmuSbcVpreUV_flg, ecu-extract-reference=CPT_BMSL_FlatView.CPT_Asw_Swc.SbcValue.BmuSbcVpreUV_flg
      BmuSbcVpreOV_flg: sw-refresh-timing={cse-code=3, cse-code-factor=5}, upstream-reference=RootSwCompositionPrototype.CPT_Asw_Swc.SbcValue.BmuSbcVpreOV_flg, ecu-extract-reference=CPT_BMSL_FlatView.CPT_Asw_Swc.SbcValue.BmuSbcVpreOV_flg
      BmuSbxVcoreUV_flg: sw-refresh-timing={cse-code=3, cse-code-factor=5}, upstream-reference=RootSwCompositionPrototype.CPT_Asw_Swc.SbcValue.BmuSbxVcoreUV_flg, ecu-extract-reference=CPT_BMSL_FlatView.CPT_Asw_Swc.SbcValue.BmuSbxVcoreUV_flg
      BmuSbcVcoreOV_flg: sw-refresh-timing={cse-code=3, cse-code-factor=5}, upstream-reference=RootSwCompositionPrototype.CPT_Asw_Swc.SbcValue.BmuSbcVcoreOV_flg, ecu-extract-reference=CPT_BMSL_FlatView.CPT_Asw_Swc.SbcValue.BmuSbcVcoreOV_flg
      BmuSbcVccaUV_flg: sw-refresh-timing={cse-code=3, cse-code-factor=5}, upstream-reference=RootSwCompositionPrototype.CPT_Asw_Swc.SbcValue.BmuSbcVccaUV_flg, ecu-extract-reference=CPT_BMSL_FlatView.CPT_Asw_Swc.SbcValue.BmuSbcVccaUV_flg
      BmuSbcVccaOV_flg: sw-refresh-timing={cse-code=3, cse-code-factor=5}, upstream-reference=RootSwCompositionPrototype.CPT_Asw_Swc.SbcValue.BmuSbcVccaOV_flg, ecu-extract-reference=CPT_BMSL_FlatView.CPT_Asw_Swc.SbcValue.BmuSbcVccaOV_flg
      BmuSbcVauxUV_flg: sw-refresh-timing={cse-code=3, cse-code-factor=5}, upstream-reference=RootSwCompositionPrototype.CPT_Asw_Swc.SbcValue.BmuSbcVauxUV_flg, ecu-extract-reference=CPT_BMSL_FlatView.CPT_Asw_Swc.SbcValue.BmuSbcVauxUV_flg
      BmuSbcVauxOV_flg: sw-refresh-timing={cse-code=3, cse-code-factor=5}, upstream-reference=RootSwCompositionPrototype.CPT_Asw_Swc.SbcValue.BmuSbcVauxOV_flg, ecu-extract-reference=CPT_BMSL_FlatView.CPT_Asw_Swc.SbcValue.BmuSbcVauxOV_flg
      BmuSbcVcanUV_flg: sw-refresh-timing={cse-code=3, cse-code-factor=5}, upstream-reference=RootSwCompositionPrototype.CPT_Asw_Swc.SbcValue.BmuSbcVcanUV_flg, ecu-extract-reference=CPT_BMSL_FlatView.CPT_Asw_Swc.SbcValue.BmuSbcVcanUV_flg
      BmuSbcVcanOV_flg: sw-refresh-timing={cse-code=3, cse-code-factor=5}, upstream-reference=RootSwCompositionPrototype.CPT_Asw_Swc.SbcValue.BmuSbcVcanOV_flg, ecu-extract-reference=CPT_BMSL_FlatView.CPT_Asw_Swc.SbcValue.BmuSbcVcanOV_flg
      BmuSbcCanTRSt_flg: sw-refresh-timing={cse-code=3, cse-code-factor=5}, upstream-reference=RootSwCompositionPrototype.CPT_Asw_Swc.SbcValue.BmuSbcCanTRSt_flg, ecu-extract-reference=CPT_BMSL_FlatView.CPT_Asw_Swc.SbcValue.BmuSbcCanTRSt_flg
      BmuSbcRstbPinSt_flg: sw-refresh-timing={cse-code=3, cse-code-factor=5}, upstream-reference=RootSwCompositionPrototype.CPT_Asw_Swc.SbcValue.BmuSbcRstbPinSt_flg, ecu-extract-reference=CPT_BMSL_FlatView.CPT_Asw_Swc.SbcValue.BmuSbcRstbPinSt_flg
      DCWakeupVolt_V: sw-refresh-timing={cse-code=3, cse-code-factor=2}, upstream-reference=RootSwCompositionPrototype.CPT_IoHwAb.ChargeValue.DCWakeupVolt_V, ecu-extract-reference=CPT_BMSL_FlatView.CPT_IoHwAb.ChargeValue.DCWakeupVolt_V
      DCWakeupVoltVld_flg: sw-refresh-timing={cse-code=3, cse-code-factor=2}, upstream-reference=RootSwCompositionPrototype.CPT_IoHwAb.ChargeValue.DCWakeupVoltVld_flg, ecu-extract-reference=CPT_BMSL_FlatView.CPT_IoHwAb.ChargeValue.DCWakeupVoltVld_flg
      CCRes_ohm: sw-refresh-timing={cse-code=3, cse-code-factor=2}, upstream-reference=RootSwCompositionPrototype.CPT_IoHwAb.ChargeValue.CCRes_ohm, ecu-extract-reference=CPT_BMSL_FlatView.CPT_IoHwAb.ChargeValue.CCRes_ohm
      CCResVld_flg: sw-refresh-timing={cse-code=3, cse-code-factor=2}, upstream-reference=RootSwCompositionPrototype.CPT_IoHwAb.ChargeValue.CCResVld_flg, ecu-extract-reference=CPT_BMSL_FlatView.CPT_IoHwAb.ChargeValue.CCResVld_flg
      CPVolt_V: sw-refresh-timing={cse-code=3, cse-code-factor=2}, upstream-reference=RootSwCompositionPrototype.CPT_IoHwAb.ChargeValue.CPVolt_V, ecu-extract-reference=CPT_BMSL_FlatView.CPT_IoHwAb.ChargeValue.CPVolt_V
      CPVoltVld_flg: sw-refresh-timing={cse-code=3, cse-code-factor=2}, upstream-reference=RootSwCompositionPrototype.CPT_IoHwAb.ChargeValue.CPVoltVld_flg, ecu-extract-reference=CPT_BMSL_FlatView.CPT_IoHwAb.ChargeValue.CPVoltVld_flg
      CPFrq_Hz: sw-refresh-timing={cse-code=3, cse-code-factor=2}, upstream-reference=RootSwCompositionPrototype.CPT_IoHwAb.ChargeValue.CPFrq_Hz, ecu-extract-reference=CPT_BMSL_FlatView.CPT_IoHwAb.ChargeValue.CPFrq_Hz
      CPFrqVld_flg: sw-refresh-timing={cse-code=3, cse-code-factor=2}, upstream-reference=RootSwCompositionPrototype.CPT_IoHwAb.ChargeValue.CPFrqVld_flg, ecu-extract-reference=CPT_BMSL_FlatView.CPT_IoHwAb.ChargeValue.CPFrqVld_flg
      CPDuty_pct: sw-refresh-timing={cse-code=3, cse-code-factor=2}, upstream-reference=RootSwCompositionPrototype.CPT_IoHwAb.ChargeValue.CPDuty_pct, ecu-extract-reference=CPT_BMSL_FlatView.CPT_IoHwAb.ChargeValue.CPDuty_pct
      CPDutyVld_flg: sw-refresh-timing={cse-code=3, cse-code-factor=2}, upstream-reference=RootSwCompositionPrototype.CPT_IoHwAb.ChargeValue.CPDutyVld_flg, ecu-extract-reference=CPT_BMSL_FlatView.CPT_IoHwAb.ChargeValue.CPDutyVld_flg
      CC2Volt_V: sw-refresh-timing={cse-code=3, cse-code-factor=2}, upstream-reference=RootSwCompositionPrototype.CPT_IoHwAb.ChargeValue.CC2Volt_V, ecu-extract-reference=CPT_BMSL_FlatView.CPT_IoHwAb.ChargeValue.CC2Volt_V
      CC2VoltVld_flg: sw-refresh-timing={cse-code=3, cse-code-factor=2}, upstream-reference=RootSwCompositionPrototype.CPT_IoHwAb.ChargeValue.CC2VoltVld_flg, ecu-extract-reference=CPT_BMSL_FlatView.CPT_IoHwAb.ChargeValue.CC2VoltVld_flg
      LampCcHDiagVolt_V: sw-refresh-timing={cse-code=3, cse-code-factor=2}, upstream-reference=RootSwCompositionPrototype.CPT_IoHwAb.ChargeValue.LampCcHDiagVolt_V, ecu-extract-reference=CPT_BMSL_FlatView.CPT_IoHwAb.ChargeValue.LampCcHDiagVolt_V
      LampCcHDiagVoltVld_flg: sw-refresh-timing={cse-code=3, cse-code-factor=2}, upstream-reference=RootSwCompositionPrototype.CPT_IoHwAb.ChargeValue.LampCcHDiagVoltVld_flg, ecu-extract-reference=CPT_BMSL_FlatView.CPT_IoHwAb.ChargeValue.LampCcHDiagVoltVld_flg
      LampChgHDiagVolt_V: sw-refresh-timing={cse-code=3, cse-code-factor=2}, upstream-reference=RootSwCompositionPrototype.CPT_IoHwAb.ChargeValue.LampChgHDiagVolt_V, ecu-extract-reference=CPT_BMSL_FlatView.CPT_IoHwAb.ChargeValue.LampChgHDiagVolt_V
      LampChgHDiagVoltVld_flg: sw-refresh-timing={cse-code=3, cse-code-factor=2}, upstream-reference=RootSwCompositionPrototype.CPT_IoHwAb.ChargeValue.LampChgHDiagVoltVld_flg, ecu-extract-reference=CPT_BMSL_FlatView.CPT_IoHwAb.ChargeValue.LampChgHDiagVoltVld_flg
      ELockDiagVolt_V: sw-refresh-timing={cse-code=3, cse-code-factor=2}, upstream-reference=RootSwCompositionPrototype.CPT_IoHwAb.ChargeValue.ELockDiagVolt_V, ecu-extract-reference=CPT_BMSL_FlatView.CPT_IoHwAb.ChargeValue.ELockDiagVolt_V
      ELockDiagVoltVld_flg: sw-refresh-timing={cse-code=3, cse-code-factor=2}, upstream-reference=RootSwCompositionPrototype.CPT_IoHwAb.ChargeValue.ELockDiagVoltVld_flg, ecu-extract-reference=CPT_BMSL_FlatView.CPT_IoHwAb.ChargeValue.ELockDiagVoltVld_flg
      HVIsoPosVolt_V: sw-refresh-timing={cse-code=3, cse-code-factor=2}, upstream-reference=RootSwCompositionPrototype.CPT_IoHwAb.IsoValue.HVIsoPosVolt_V, ecu-extract-reference=CPT_BMSL_FlatView.CPT_IoHwAb.IsoValue.HVIsoPosVolt_V
      HVIsoPosVoltVld_flg: sw-refresh-timing={cse-code=3, cse-code-factor=2}, upstream-reference=RootSwCompositionPrototype.CPT_IoHwAb.IsoValue.HVIsoPosVoltVld_flg, ecu-extract-reference=CPT_BMSL_FlatView.CPT_IoHwAb.IsoValue.HVIsoPosVoltVld_flg
      HVIsoNegVolt_V: sw-refresh-timing={cse-code=3, cse-code-factor=2}, upstream-reference=RootSwCompositionPrototype.CPT_IoHwAb.IsoValue.HVIsoNegVolt_V, ecu-extract-reference=CPT_BMSL_FlatView.CPT_IoHwAb.IsoValue.HVIsoNegVolt_V
      HVIsoNegVoltVld_flg: sw-refresh-timing={cse-code=3, cse-code-factor=2}, upstream-reference=RootSwCompositionPrototype.CPT_IoHwAb.IsoValue.HVIsoNegVoltVld_flg, ecu-extract-reference=CPT_BMSL_FlatView.CPT_IoHwAb.IsoValue.HVIsoNegVoltVld_flg
      BmuPullupVolt_V: sw-refresh-timing={cse-code=3, cse-code-factor=2}, upstream-reference=RootSwCompositionPrototype.CPT_IoHwAb.PowerValue.BmuPullupVolt_V, ecu-extract-reference=CPT_BMSL_FlatView.CPT_IoHwAb.PowerValue.BmuPullupVolt_V
      BmuPullupVoltVld_flg: sw-refresh-timing={cse-code=3, cse-code-factor=2}, upstream-reference=RootSwCompositionPrototype.CPT_IoHwAb.PowerValue.BmuPullupVoltVld_flg, ecu-extract-reference=CPT_BMSL_FlatView.CPT_IoHwAb.PowerValue.BmuPullupVoltVld_flg
      BmuPullupSwitchDiag_flg: sw-refresh-timing={cse-code=3, cse-code-factor=2}, upstream-reference=RootSwCompositionPrototype.CPT_IoHwAb.PowerValue.BmuPullupSwitchDiag_flg, ecu-extract-reference=CPT_BMSL_FlatView.CPT_IoHwAb.PowerValue.BmuPullupSwitchDiag_flg
      KPowertVolt_V: sw-refresh-timing={cse-code=3, cse-code-factor=2}, upstream-reference=RootSwCompositionPrototype.CPT_IoHwAb.PowerValue.KPowertVolt_V, ecu-extract-reference=CPT_BMSL_FlatView.CPT_IoHwAb.PowerValue.KPowertVolt_V
      KPowertVoltVld_flg: sw-refresh-timing={cse-code=3, cse-code-factor=2}, upstream-reference=RootSwCompositionPrototype.CPT_IoHwAb.PowerValue.KPowertVoltVld_flg, ecu-extract-reference=CPT_BMSL_FlatView.CPT_IoHwAb.PowerValue.KPowertVoltVld_flg
      KL15Volt_V: sw-refresh-timing={cse-code=3, cse-code-factor=2}, upstream-reference=RootSwCompositionPrototype.CPT_IoHwAb.PowerValue.KL15Volt_V, ecu-extract-reference=CPT_BMSL_FlatView.CPT_IoHwAb.PowerValue.KL15Volt_V
      KL15VoltVld_flg: sw-refresh-timing={cse-code=3, cse-code-factor=2}, upstream-reference=RootSwCompositionPrototype.CPT_IoHwAb.PowerValue.KL15VoltVld_flg, ecu-extract-reference=CPT_BMSL_FlatView.CPT_IoHwAb.PowerValue.KL15VoltVld_flg
      ResWakeUp1HVolt_V: sw-refresh-timing={cse-code=3, cse-code-factor=2}, upstream-reference=RootSwCompositionPrototype.CPT_IoHwAb.PowerValue.ResWakeUp1HVolt_V, ecu-extract-reference=CPT_BMSL_FlatView.CPT_IoHwAb.PowerValue.ResWakeUp1HVolt_V
      ResWakeUp1HVoltVld_flg: sw-refresh-timing={cse-code=3, cse-code-factor=2}, upstream-reference=RootSwCompositionPrototype.CPT_IoHwAb.PowerValue.ResWakeUp1HVoltVld_flg, ecu-extract-reference=CPT_BMSL_FlatView.CPT_IoHwAb.PowerValue.ResWakeUp1HVoltVld_flg
      ResWakeUp2HVolt_V: sw-refresh-timing={cse-code=3, cse-code-factor=2}, upstream-reference=RootSwCompositionPrototype.CPT_IoHwAb.PowerValue.ResWakeUp2HVolt_V, ecu-extract-reference=CPT_BMSL_FlatView.CPT_IoHwAb.PowerValue.ResWakeUp2HVolt_V
      ResWakeUp2HVoltVld_flg: sw-refresh-timing={cse-code=3, cse-code-factor=2}, upstream-reference=RootSwCompositionPrototype.CPT_IoHwAb.PowerValue.ResWakeUp2HVoltVld_flg, ecu-extract-reference=CPT_BMSL_FlatView.CPT_IoHwAb.PowerValue.ResWakeUp2HVoltVld_flg
      ResWakeUp3LVolt_V: sw-refresh-timing={cse-code=3, cse-code-factor=2}, upstream-reference=RootSwCompositionPrototype.CPT_IoHwAb.PowerValue.ResWakeUp3LVolt_V, ecu-extract-reference=CPT_BMSL_FlatView.CPT_IoHwAb.PowerValue.ResWakeUp3LVolt_V
      ResWakeUp3LVoltVld_flg: sw-refresh-timing={cse-code=3, cse-code-factor=2}, upstream-reference=RootSwCompositionPrototype.CPT_IoHwAb.PowerValue.ResWakeUp3LVoltVld_flg, ecu-extract-reference=CPT_BMSL_FlatView.CPT_IoHwAb.PowerValue.ResWakeUp3LVoltVld_flg
      Unconnected_LampChgHCmd_flg: sw-refresh-timing={cse-code=3, cse-code-factor=5}, upstream-reference=RootSwCompositionPrototype.CPT_Asw_Swc.ChargeCmd.LampChgHCmd_flg, ecu-extract-reference=CPT_BMSL_FlatView.CPT_Asw_Swc.ChargeCmd.LampChgHCmd_flg
      Unconnected_ELockCtrlCmd_enum: sw-refresh-timing={cse-code=3, cse-code-factor=5}, upstream-reference=RootSwCompositionPrototype.CPT_Asw_Swc.ChargeCmd.ELockCtrlCmd_enum, ecu-extract-reference=CPT_BMSL_FlatView.CPT_Asw_Swc.ChargeCmd.ELockCtrlCmd_enum
      Unconnected_ELockSel0Cmd_flg: sw-refresh-timing={cse-code=3, cse-code-factor=5}, upstream-reference=RootSwCompositionPrototype.CPT_Asw_Swc.ChargeCmd.ELockSel0Cmd_flg, ecu-extract-reference=CPT_BMSL_FlatView.CPT_Asw_Swc.ChargeCmd.ELockSel0Cmd_flg
      PackCurrRed_A: sw-refresh-timing={cse-code=3, cse-code-factor=2}, upstream-reference=RootSwCompositionPrototype.CPT_Asw_Swc.CurrValue.PackCurrRed_A, ecu-extract-reference=CPT_BMSL_FlatView.CPT_Asw_Swc.CurrValue.PackCurrRed_A
      PackCurrRedVld_flg: sw-refresh-timing={cse-code=3, cse-code-factor=2}, upstream-reference=RootSwCompositionPrototype.CPT_Asw_Swc.CurrValue.PackCurrRedVld_flg, ecu-extract-reference=CPT_BMSL_FlatView.CPT_Asw_Swc.CurrValue.PackCurrRedVld_flg
      HallSpyVolt_V: sw-refresh-timing={cse-code=3, cse-code-factor=2}, upstream-reference=RootSwCompositionPrototype.CPT_Asw_Swc.CurrValue.HallSpyVolt_V, ecu-extract-reference=CPT_BMSL_FlatView.CPT_Asw_Swc.CurrValue.HallSpyVolt_V
      HallSpyVoltVld_flg: sw-refresh-timing={cse-code=3, cse-code-factor=2}, upstream-reference=RootSwCompositionPrototype.CPT_Asw_Swc.CurrValue.HallSpyVoltVld_flg, ecu-extract-reference=CPT_BMSL_FlatView.CPT_Asw_Swc.CurrValue.HallSpyVoltVld_flg
      HallCH1Volt_V: sw-refresh-timing={cse-code=3, cse-code-factor=2}, upstream-reference=RootSwCompositionPrototype.CPT_Asw_Swc.CurrValue.HallCH1Volt_V, ecu-extract-reference=CPT_BMSL_FlatView.CPT_Asw_Swc.CurrValue.HallCH1Volt_V
      HallCH1VoltVld_flg: sw-refresh-timing={cse-code=3, cse-code-factor=2}, upstream-reference=RootSwCompositionPrototype.CPT_Asw_Swc.CurrValue.HallCH1VoltVld_flg, ecu-extract-reference=CPT_BMSL_FlatView.CPT_Asw_Swc.CurrValue.HallCH1VoltVld_flg
      HallCH2Volt_V: sw-refresh-timing={cse-code=3, cse-code-factor=2}, upstream-reference=RootSwCompositionPrototype.CPT_Asw_Swc.CurrValue.HallCH2Volt_V, ecu-extract-reference=CPT_BMSL_FlatView.CPT_Asw_Swc.CurrValue.HallCH2Volt_V
      HallCH2VoltVld_flg: sw-refresh-timing={cse-code=3, cse-code-factor=2}, upstream-reference=RootSwCompositionPrototype.CPT_Asw_Swc.CurrValue.HallCH2VoltVld_flg, ecu-extract-reference=CPT_BMSL_FlatView.CPT_Asw_Swc.CurrValue.HallCH2VoltVld_flg
      HallCH1RedVolt_V: sw-refresh-timing={cse-code=3, cse-code-factor=2}, upstream-reference=RootSwCompositionPrototype.CPT_Asw_Swc.CurrValue.HallCH1RedVolt_V, ecu-extract-reference=CPT_BMSL_FlatView.CPT_Asw_Swc.CurrValue.HallCH1RedVolt_V
      HallCH1RedVoltVld_flg: sw-refresh-timing={cse-code=3, cse-code-factor=2}, upstream-reference=RootSwCompositionPrototype.CPT_Asw_Swc.CurrValue.HallCH1RedVoltVld_flg, ecu-extract-reference=CPT_BMSL_FlatView.CPT_Asw_Swc.CurrValue.HallCH1RedVoltVld_flg
      HallCH2RedVolt_V: sw-refresh-timing={cse-code=3, cse-code-factor=2}, upstream-reference=RootSwCompositionPrototype.CPT_Asw_Swc.CurrValue.HallCH2RedVolt_V, ecu-extract-reference=CPT_BMSL_FlatView.CPT_Asw_Swc.CurrValue.HallCH2RedVolt_V
      HallCH2RedVoltVld_flg: sw-refresh-timing={cse-code=3, cse-code-factor=2}, upstream-reference=RootSwCompositionPrototype.CPT_Asw_Swc.CurrValue.HallCH2RedVoltVld_flg, ecu-extract-reference=CPT_BMSL_FlatView.CPT_Asw_Swc.CurrValue.HallCH2RedVoltVld_flg
      CrashPWMFrq_Hz: sw-refresh-timing={cse-code=3, cse-code-factor=2}, upstream-reference=RootSwCompositionPrototype.CPT_IoHwAb.CrashValue.CrashPWMFrq_Hz, ecu-extract-reference=CPT_BMSL_FlatView.CPT_IoHwAb.CrashValue.CrashPWMFrq_Hz
      CrashPWMFrqVld_flg: sw-refresh-timing={cse-code=3, cse-code-factor=2}, upstream-reference=RootSwCompositionPrototype.CPT_IoHwAb.CrashValue.CrashPWMFrqVld_flg, ecu-extract-reference=CPT_BMSL_FlatView.CPT_IoHwAb.CrashValue.CrashPWMFrqVld_flg
      CrashPWMDuty_pct: sw-refresh-timing={cse-code=3, cse-code-factor=2}, upstream-reference=RootSwCompositionPrototype.CPT_IoHwAb.CrashValue.CrashPWMDuty_pct, ecu-extract-reference=CPT_BMSL_FlatView.CPT_IoHwAb.CrashValue.CrashPWMDuty_pct
      CrashPWMDutyVld_flg: sw-refresh-timing={cse-code=3, cse-code-factor=2}, upstream-reference=RootSwCompositionPrototype.CPT_IoHwAb.CrashValue.CrashPWMDutyVld_flg, ecu-extract-reference=CPT_BMSL_FlatView.CPT_IoHwAb.CrashValue.CrashPWMDutyVld_flg
      InHVILPWMFrq_Hz: sw-refresh-timing={cse-code=3, cse-code-factor=2}, upstream-reference=RootSwCompositionPrototype.CPT_IoHwAb.HvilValue.InHVILPWMFrq_Hz, ecu-extract-reference=CPT_BMSL_FlatView.CPT_IoHwAb.HvilValue.InHVILPWMFrq_Hz
      InHVILPWMFrqVld_flg: sw-refresh-timing={cse-code=3, cse-code-factor=2}, upstream-reference=RootSwCompositionPrototype.CPT_IoHwAb.HvilValue.InHVILPWMFrqVld_flg, ecu-extract-reference=CPT_BMSL_FlatView.CPT_IoHwAb.HvilValue.InHVILPWMFrqVld_flg
      InHVILPWMDutyVld_flg: sw-refresh-timing={cse-code=3, cse-code-factor=2}, upstream-reference=RootSwCompositionPrototype.CPT_IoHwAb.HvilValue.InHVILPWMDutyVld_flg, ecu-extract-reference=CPT_BMSL_FlatView.CPT_IoHwAb.HvilValue.InHVILPWMDutyVld_flg
      InHVILPWMDuty_pct: sw-refresh-timing={cse-code=3, cse-code-factor=2}, upstream-reference=RootSwCompositionPrototype.CPT_IoHwAb.HvilValue.InHVILPWMDuty_pct, ecu-extract-reference=CPT_BMSL_FlatView.CPT_IoHwAb.HvilValue.InHVILPWMDuty_pct
      HVILHighVolt_V: sw-refresh-timing={cse-code=3, cse-code-factor=2}, upstream-reference=RootSwCompositionPrototype.CPT_IoHwAb.HvilValue.HVILHighVolt_V, ecu-extract-reference=CPT_BMSL_FlatView.CPT_IoHwAb.HvilValue.HVILHighVolt_V
      HVILHighVoltVld_flg: sw-refresh-timing={cse-code=3, cse-code-factor=2}, upstream-reference=RootSwCompositionPrototype.CPT_IoHwAb.HvilValue.HVILHighVoltVld_flg, ecu-extract-reference=CPT_BMSL_FlatView.CPT_IoHwAb.HvilValue.HVILHighVoltVld_flg
      HVILLowVolt_V: sw-refresh-timing={cse-code=3, cse-code-factor=2}, upstream-reference=RootSwCompositionPrototype.CPT_IoHwAb.HvilValue.HVILLowVolt_V, ecu-extract-reference=CPT_BMSL_FlatView.CPT_IoHwAb.HvilValue.HVILLowVolt_V
      HVILLowVoltVld_flg: sw-refresh-timing={cse-code=3, cse-code-factor=2}, upstream-reference=RootSwCompositionPrototype.CPT_IoHwAb.HvilValue.HVILLowVoltVld_flg, ecu-extract-reference=CPT_BMSL_FlatView.CPT_IoHwAb.HvilValue.HVILLowVoltVld_flg
      GlobalHsideDriverVolt_V: sw-refresh-timing={cse-code=3, cse-code-factor=2}, upstream-reference=RootSwCompositionPrototype.CPT_IoHwAb.RelayValue.GlobalHsideDriverVolt_V, ecu-extract-reference=CPT_BMSL_FlatView.CPT_IoHwAb.RelayValue.GlobalHsideDriverVolt_V
      GlobalHsideDriverVoltVld_flg: sw-refresh-timing={cse-code=3, cse-code-factor=2}, upstream-reference=RootSwCompositionPrototype.CPT_IoHwAb.RelayValue.GlobalHsideDriverVoltVld_flg, ecu-extract-reference=CPT_BMSL_FlatView.CPT_IoHwAb.RelayValue.GlobalHsideDriverVoltVld_flg
      KpCtrDriverVolt_V: sw-refresh-timing={cse-code=3, cse-code-factor=2}, upstream-reference=RootSwCompositionPrototype.CPT_IoHwAb.RelayValue.KpCtrDriverVolt_V, ecu-extract-reference=CPT_BMSL_FlatView.CPT_IoHwAb.RelayValue.KpCtrDriverVolt_V
      KpCtrDriverVoltVld_flg: sw-refresh-timing={cse-code=3, cse-code-factor=2}, upstream-reference=RootSwCompositionPrototype.CPT_IoHwAb.RelayValue.KpCtrDriverVoltVld_flg, ecu-extract-reference=CPT_BMSL_FlatView.CPT_IoHwAb.RelayValue.KpCtrDriverVoltVld_flg
      KnCtrDriverVolt_V: sw-refresh-timing={cse-code=3, cse-code-factor=2}, upstream-reference=RootSwCompositionPrototype.CPT_IoHwAb.RelayValue.KnCtrDriverVolt_V, ecu-extract-reference=CPT_BMSL_FlatView.CPT_IoHwAb.RelayValue.KnCtrDriverVolt_V
      KnCtrDriverVoltVld_flg: sw-refresh-timing={cse-code=3, cse-code-factor=2}, upstream-reference=RootSwCompositionPrototype.CPT_IoHwAb.RelayValue.KnCtrDriverVoltVld_flg, ecu-extract-reference=CPT_BMSL_FlatView.CPT_IoHwAb.RelayValue.KnCtrDriverVoltVld_flg
      K1CtrDriverVolt_V: sw-refresh-timing={cse-code=3, cse-code-factor=2}, upstream-reference=RootSwCompositionPrototype.CPT_IoHwAb.RelayValue.K1CtrDriverVolt_V, ecu-extract-reference=CPT_BMSL_FlatView.CPT_IoHwAb.RelayValue.K1CtrDriverVolt_V
      K1CtrDriverVoltVld_flg: sw-refresh-timing={cse-code=3, cse-code-factor=2}, upstream-reference=RootSwCompositionPrototype.CPT_IoHwAb.RelayValue.K1CtrDriverVoltVld_flg, ecu-extract-reference=CPT_BMSL_FlatView.CPT_IoHwAb.RelayValue.K1CtrDriverVoltVld_flg
      K2CtrDriverVolt_V: sw-refresh-timing={cse-code=3, cse-code-factor=2}, upstream-reference=RootSwCompositionPrototype.CPT_IoHwAb.RelayValue.K2CtrDriverVolt_V, ecu-extract-reference=CPT_BMSL_FlatView.CPT_IoHwAb.RelayValue.K2CtrDriverVolt_V
      K2CtrDriverVoltVld_flg: sw-refresh-timing={cse-code=3, cse-code-factor=2}, upstream-reference=RootSwCompositionPrototype.CPT_IoHwAb.RelayValue.K2CtrDriverVoltVld_flg, ecu-extract-reference=CPT_BMSL_FlatView.CPT_IoHwAb.RelayValue.K2CtrDriverVoltVld_flg
      K3CtrDriverVolt_V: sw-refresh-timing={cse-code=3, cse-code-factor=2}, upstream-reference=RootSwCompositionPrototype.CPT_IoHwAb.RelayValue.K3CtrDriverVolt_V, ecu-extract-reference=CPT_BMSL_FlatView.CPT_IoHwAb.RelayValue.K3CtrDriverVolt_V
      K3CtrDriverVoltVld_flg: sw-refresh-timing={cse-code=3, cse-code-factor=2}, upstream-reference=RootSwCompositionPrototype.CPT_IoHwAb.RelayValue.K3CtrDriverVoltVld_flg, ecu-extract-reference=CPT_BMSL_FlatView.CPT_IoHwAb.RelayValue.K3CtrDriverVoltVld_flg
      K4CtrDriverVolt_V: sw-refresh-timing={cse-code=3, cse-code-factor=2}, upstream-reference=RootSwCompositionPrototype.CPT_IoHwAb.RelayValue.K4CtrDriverVolt_V, ecu-extract-reference=CPT_BMSL_FlatView.CPT_IoHwAb.RelayValue.K4CtrDriverVolt_V
      K4CtrDriverVoltVld_flg: sw-refresh-timing={cse-code=3, cse-code-factor=2}, upstream-reference=RootSwCompositionPrototype.CPT_IoHwAb.RelayValue.K4CtrDriverVoltVld_flg, ecu-extract-reference=CPT_BMSL_FlatView.CPT_IoHwAb.RelayValue.K4CtrDriverVoltVld_flg
      K5CtrDriverVolt_V: sw-refresh-timing={cse-code=3, cse-code-factor=2}, upstream-reference=RootSwCompositionPrototype.CPT_IoHwAb.RelayValue.K5CtrDriverVolt_V, ecu-extract-reference=CPT_BMSL_FlatView.CPT_IoHwAb.RelayValue.K5CtrDriverVolt_V
      K5CtrDriverVoltVld_flg: sw-refresh-timing={cse-code=3, cse-code-factor=2}, upstream-reference=RootSwCompositionPrototype.CPT_IoHwAb.RelayValue.K5CtrDriverVoltVld_flg, ecu-extract-reference=CPT_BMSL_FlatView.CPT_IoHwAb.RelayValue.K5CtrDriverVoltVld_flg
      K6CtrDriverVolt_V: sw-refresh-timing={cse-code=3, cse-code-factor=2}, upstream-reference=RootSwCompositionPrototype.CPT_IoHwAb.RelayValue.K6CtrDriverVolt_V, ecu-extract-reference=CPT_BMSL_FlatView.CPT_IoHwAb.RelayValue.K6CtrDriverVolt_V
      K6CtrDriverVoltVld_flg: sw-refresh-timing={cse-code=3, cse-code-factor=2}, upstream-reference=RootSwCompositionPrototype.CPT_IoHwAb.RelayValue.K6CtrDriverVoltVld_flg, ecu-extract-reference=CPT_BMSL_FlatView.CPT_IoHwAb.RelayValue.K6CtrDriverVoltVld_flg
      KpEnOutState_flg: sw-refresh-timing={cse-code=3, cse-code-factor=2}, upstream-reference=RootSwCompositionPrototype.CPT_IoHwAb.RelayValue.KpEnOutState_flg, ecu-extract-reference=CPT_BMSL_FlatView.CPT_IoHwAb.RelayValue.KpEnOutState_flg
      KpEnStateVld_flg: sw-refresh-timing={cse-code=3, cse-code-factor=2}, upstream-reference=RootSwCompositionPrototype.CPT_IoHwAb.RelayValue.KpEnStateVld_flg, ecu-extract-reference=CPT_BMSL_FlatView.CPT_IoHwAb.RelayValue.KpEnStateVld_flg
      KnchgEnOutState_flg: sw-refresh-timing={cse-code=3, cse-code-factor=2}, upstream-reference=RootSwCompositionPrototype.CPT_IoHwAb.RelayValue.KnchgEnOutState_flg, ecu-extract-reference=CPT_BMSL_FlatView.CPT_IoHwAb.RelayValue.KnchgEnOutState_flg
      KnchgEnStateVld_flg: sw-refresh-timing={cse-code=3, cse-code-factor=2}, upstream-reference=RootSwCompositionPrototype.CPT_IoHwAb.RelayValue.KnchgEnStateVld_flg, ecu-extract-reference=CPT_BMSL_FlatView.CPT_IoHwAb.RelayValue.KnchgEnStateVld_flg
      RsvAD1Volt_V: sw-refresh-timing={cse-code=3, cse-code-factor=2}, upstream-reference=RootSwCompositionPrototype.CPT_IoHwAb.RsvValue.RsvAD1Volt_V, ecu-extract-reference=CPT_BMSL_FlatView.CPT_IoHwAb.RsvValue.RsvAD1Volt_V
      RsvAD1VoltVld_flg: sw-refresh-timing={cse-code=3, cse-code-factor=2}, upstream-reference=RootSwCompositionPrototype.CPT_IoHwAb.RsvValue.RsvAD1VoltVld_flg, ecu-extract-reference=CPT_BMSL_FlatView.CPT_IoHwAb.RsvValue.RsvAD1VoltVld_flg
      RsvAD2Volt_V: sw-refresh-timing={cse-code=3, cse-code-factor=2}, upstream-reference=RootSwCompositionPrototype.CPT_IoHwAb.RsvValue.RsvAD2Volt_V, ecu-extract-reference=CPT_BMSL_FlatView.CPT_IoHwAb.RsvValue.RsvAD2Volt_V
      RsvAD2VoltVld_flg: sw-refresh-timing={cse-code=3, cse-code-factor=2}, upstream-reference=RootSwCompositionPrototype.CPT_IoHwAb.RsvValue.RsvAD2VoltVld_flg, ecu-extract-reference=CPT_BMSL_FlatView.CPT_IoHwAb.RsvValue.RsvAD2VoltVld_flg
      RsvAD3Volt_V: sw-refresh-timing={cse-code=3, cse-code-factor=2}, upstream-reference=RootSwCompositionPrototype.CPT_IoHwAb.RsvValue.RsvAD3Volt_V, ecu-extract-reference=CPT_BMSL_FlatView.CPT_IoHwAb.RsvValue.RsvAD3Volt_V
      RsvAD3VoltVld_flg: sw-refresh-timing={cse-code=3, cse-code-factor=2}, upstream-reference=RootSwCompositionPrototype.CPT_IoHwAb.RsvValue.RsvAD3VoltVld_flg, ecu-extract-reference=CPT_BMSL_FlatView.CPT_IoHwAb.RsvValue.RsvAD3VoltVld_flg
      RsvAD4Volt_V: sw-refresh-timing={cse-code=3, cse-code-factor=2}, upstream-reference=RootSwCompositionPrototype.CPT_IoHwAb.RsvValue.RsvAD4Volt_V, ecu-extract-reference=CPT_BMSL_FlatView.CPT_IoHwAb.RsvValue.RsvAD4Volt_V
      RsvAD4VoltVld_flg: sw-refresh-timing={cse-code=3, cse-code-factor=2}, upstream-reference=RootSwCompositionPrototype.CPT_IoHwAb.RsvValue.RsvAD4VoltVld_flg, ecu-extract-reference=CPT_BMSL_FlatView.CPT_IoHwAb.RsvValue.RsvAD4VoltVld_flg
      RsvAD5Volt_V: sw-refresh-timing={cse-code=3, cse-code-factor=2}, upstream-reference=RootSwCompositionPrototype.CPT_IoHwAb.RsvValue.RsvAD5Volt_V, ecu-extract-reference=CPT_BMSL_FlatView.CPT_IoHwAb.RsvValue.RsvAD5Volt_V
      RsvAD5VoltVld_flg: sw-refresh-timing={cse-code=3, cse-code-factor=2}, upstream-reference=RootSwCompositionPrototype.CPT_IoHwAb.RsvValue.RsvAD5VoltVld_flg, ecu-extract-reference=CPT_BMSL_FlatView.CPT_IoHwAb.RsvValue.RsvAD5VoltVld_flg
      InRsvPWMFrq_Hz: sw-refresh-timing={cse-code=3, cse-code-factor=2}, upstream-reference=RootSwCompositionPrototype.CPT_IoHwAb.RsvValue.InRsvPWMFrq_Hz, ecu-extract-reference=CPT_BMSL_FlatView.CPT_IoHwAb.RsvValue.InRsvPWMFrq_Hz
      InRsvPWMFrqVld_flg: sw-refresh-timing={cse-code=3, cse-code-factor=2}, upstream-reference=RootSwCompositionPrototype.CPT_IoHwAb.RsvValue.InRsvPWMFrqVld_flg, ecu-extract-reference=CPT_BMSL_FlatView.CPT_IoHwAb.RsvValue.InRsvPWMFrqVld_flg
      InRsvPWMDuty_pct: sw-refresh-timing={cse-code=3, cse-code-factor=2}, upstream-reference=RootSwCompositionPrototype.CPT_IoHwAb.RsvValue.InRsvPWMDuty_pct, ecu-extract-reference=CPT_BMSL_FlatView.CPT_IoHwAb.RsvValue.InRsvPWMDuty_pct
      InRsvPWMDutyVld_flg: sw-refresh-timing={cse-code=3, cse-code-factor=2}, upstream-reference=RootSwCompositionPrototype.CPT_IoHwAb.RsvValue.InRsvPWMDutyVld_flg, ecu-extract-reference=CPT_BMSL_FlatView.CPT_IoHwAb.RsvValue.InRsvPWMDutyVld_flg
      InCoolPumpPWMFrq_Hz: sw-refresh-timing={cse-code=3, cse-code-factor=2}, upstream-reference=RootSwCompositionPrototype.CPT_IoHwAb.ThermalValue.InCoolPumpPWMFrq_Hz, ecu-extract-reference=CPT_BMSL_FlatView.CPT_IoHwAb.ThermalValue.InCoolPumpPWMFrq_Hz
      InCoolPumpPWMFrqVld_flg: sw-refresh-timing={cse-code=3, cse-code-factor=2}, upstream-reference=RootSwCompositionPrototype.CPT_IoHwAb.ThermalValue.InCoolPumpPWMFrqVld_flg, ecu-extract-reference=CPT_BMSL_FlatView.CPT_IoHwAb.ThermalValue.InCoolPumpPWMFrqVld_flg
      InCoolPumpPWMDuty_Pct: sw-refresh-timing={cse-code=3, cse-code-factor=2}, upstream-reference=RootSwCompositionPrototype.CPT_IoHwAb.ThermalValue.InCoolPumpPWMDuty_Pct, ecu-extract-reference=CPT_BMSL_FlatView.CPT_IoHwAb.ThermalValue.InCoolPumpPWMDuty_Pct
      InCoolPumpPWMDutyVld_flg: sw-refresh-timing={cse-code=3, cse-code-factor=2}, upstream-reference=RootSwCompositionPrototype.CPT_IoHwAb.ThermalValue.InCoolPumpPWMDutyVld_flg, ecu-extract-reference=CPT_BMSL_FlatView.CPT_IoHwAb.ThermalValue.InCoolPumpPWMDutyVld_flg
      InFanPWMFrq_Hz: sw-refresh-timing={cse-code=3, cse-code-factor=2}, upstream-reference=RootSwCompositionPrototype.CPT_IoHwAb.ThermalValue.InFanPWMFrq_Hz, ecu-extract-reference=CPT_BMSL_FlatView.CPT_IoHwAb.ThermalValue.InFanPWMFrq_Hz
      InFanPWMFrqVld_flg: sw-refresh-timing={cse-code=3, cse-code-factor=2}, upstream-reference=RootSwCompositionPrototype.CPT_IoHwAb.ThermalValue.InFanPWMFrqVld_flg, ecu-extract-reference=CPT_BMSL_FlatView.CPT_IoHwAb.ThermalValue.InFanPWMFrqVld_flg
      InFanPWMDuty_Pct: sw-refresh-timing={cse-code=3, cse-code-factor=2}, upstream-reference=RootSwCompositionPrototype.CPT_IoHwAb.ThermalValue.InFanPWMDuty_Pct, ecu-extract-reference=CPT_BMSL_FlatView.CPT_IoHwAb.ThermalValue.InFanPWMDuty_Pct
      InFanPWMDutyVld_flg: sw-refresh-timing={cse-code=3, cse-code-factor=2}, upstream-reference=RootSwCompositionPrototype.CPT_IoHwAb.ThermalValue.InFanPWMDutyVld_flg, ecu-extract-reference=CPT_BMSL_FlatView.CPT_IoHwAb.ThermalValue.InFanPWMDutyVld_flg
      ValveDiagVolt_V: sw-refresh-timing={cse-code=3, cse-code-factor=2}, upstream-reference=RootSwCompositionPrototype.CPT_IoHwAb.ThermalValue.ValveDiagVolt_V, ecu-extract-reference=CPT_BMSL_FlatView.CPT_IoHwAb.ThermalValue.ValveDiagVolt_V
      ValveDiagVoltVld_flg: sw-refresh-timing={cse-code=3, cse-code-factor=2}, upstream-reference=RootSwCompositionPrototype.CPT_IoHwAb.ThermalValue.ValveDiagVoltVld_flg, ecu-extract-reference=CPT_BMSL_FlatView.CPT_IoHwAb.ThermalValue.ValveDiagVoltVld_flg
      BmuTemp1Ntc_Ohm: sw-refresh-timing={cse-code=3, cse-code-factor=2}, upstream-reference=RootSwCompositionPrototype.CPT_IoHwAb.ThermalValue.BmuTemp1Ntc_Ohm, ecu-extract-reference=CPT_BMSL_FlatView.CPT_IoHwAb.ThermalValue.BmuTemp1Ntc_Ohm
      BmuTemp1NtcVld_flg: sw-refresh-timing={cse-code=3, cse-code-factor=2}, upstream-reference=RootSwCompositionPrototype.CPT_IoHwAb.ThermalValue.BmuTemp1NtcVld_flg, ecu-extract-reference=CPT_BMSL_FlatView.CPT_IoHwAb.ThermalValue.BmuTemp1NtcVld_flg
      BmuTemp2Ntc_Ohm: sw-refresh-timing={cse-code=3, cse-code-factor=2}, upstream-reference=RootSwCompositionPrototype.CPT_IoHwAb.ThermalValue.BmuTemp2Ntc_Ohm, ecu-extract-reference=CPT_BMSL_FlatView.CPT_IoHwAb.ThermalValue.BmuTemp2Ntc_Ohm
      BmuTemp2NtcVld_flg: sw-refresh-timing={cse-code=3, cse-code-factor=2}, upstream-reference=RootSwCompositionPrototype.CPT_IoHwAb.ThermalValue.BmuTemp2NtcVld_flg, ecu-extract-reference=CPT_BMSL_FlatView.CPT_IoHwAb.ThermalValue.BmuTemp2NtcVld_flg
      BmuTemp3Ntc_Ohm: sw-refresh-timing={cse-code=3, cse-code-factor=2}, upstream-reference=RootSwCompositionPrototype.CPT_IoHwAb.ThermalValue.BmuTemp3Ntc_Ohm, ecu-extract-reference=CPT_BMSL_FlatView.CPT_IoHwAb.ThermalValue.BmuTemp3Ntc_Ohm
      BmuTemp3NtcVld_flg: sw-refresh-timing={cse-code=3, cse-code-factor=2}, upstream-reference=RootSwCompositionPrototype.CPT_IoHwAb.ThermalValue.BmuTemp3NtcVld_flg, ecu-extract-reference=CPT_BMSL_FlatView.CPT_IoHwAb.ThermalValue.BmuTemp3NtcVld_flg
      BmuTemp4Ntc_Ohm: sw-refresh-timing={cse-code=3, cse-code-factor=2}, upstream-reference=RootSwCompositionPrototype.CPT_IoHwAb.ThermalValue.BmuTemp4Ntc_Ohm, ecu-extract-reference=CPT_BMSL_FlatView.CPT_IoHwAb.ThermalValue.BmuTemp4Ntc_Ohm
      BmuTemp4NtcVld_flg: sw-refresh-timing={cse-code=3, cse-code-factor=2}, upstream-reference=RootSwCompositionPrototype.CPT_IoHwAb.ThermalValue.BmuTemp4NtcVld_flg, ecu-extract-reference=CPT_BMSL_FlatView.CPT_IoHwAb.ThermalValue.BmuTemp4NtcVld_flg
      BmuTemp5Ntc_Ohm: sw-refresh-timing={cse-code=3, cse-code-factor=2}, upstream-reference=RootSwCompositionPrototype.CPT_IoHwAb.ThermalValue.BmuTemp5Ntc_Ohm, ecu-extract-reference=CPT_BMSL_FlatView.CPT_IoHwAb.ThermalValue.BmuTemp5Ntc_Ohm
      BmuTemp5NtcVld_flg: sw-refresh-timing={cse-code=3, cse-code-factor=2}, upstream-reference=RootSwCompositionPrototype.CPT_IoHwAb.ThermalValue.BmuTemp5NtcVld_flg, ecu-extract-reference=CPT_BMSL_FlatView.CPT_IoHwAb.ThermalValue.BmuTemp5NtcVld_flg
      BmuTemp6Ntc_Ohm: sw-refresh-timing={cse-code=3, cse-code-factor=2}, upstream-reference=RootSwCompositionPrototype.CPT_IoHwAb.ThermalValue.BmuTemp6Ntc_Ohm, ecu-extract-reference=CPT_BMSL_FlatView.CPT_IoHwAb.ThermalValue.BmuTemp6Ntc_Ohm
      BmuTemp6NtcVld_flg: sw-refresh-timing={cse-code=3, cse-code-factor=2}, upstream-reference=RootSwCompositionPrototype.CPT_IoHwAb.ThermalValue.BmuTemp6NtcVld_flg, ecu-extract-reference=CPT_BMSL_FlatView.CPT_IoHwAb.ThermalValue.BmuTemp6NtcVld_flg
      BmuTemp7Ntc_Ohm: sw-refresh-timing={cse-code=3, cse-code-factor=2}, upstream-reference=RootSwCompositionPrototype.CPT_IoHwAb.ThermalValue.BmuTemp7Ntc_Ohm, ecu-extract-reference=CPT_BMSL_FlatView.CPT_IoHwAb.ThermalValue.BmuTemp7Ntc_Ohm
      BmuTemp7NtcVld_flg: sw-refresh-timing={cse-code=3, cse-code-factor=2}, upstream-reference=RootSwCompositionPrototype.CPT_IoHwAb.ThermalValue.BmuTemp7NtcVld_flg, ecu-extract-reference=CPT_BMSL_FlatView.CPT_IoHwAb.ThermalValue.BmuTemp7NtcVld_flg
      ACS2Cmd_flg: sw-refresh-timing={cse-code=3, cse-code-factor=5}, upstream-reference=RootSwCompositionPrototype.CPT_Asw_Swc.ChargeCmd.ACS2Cmd_flg, ecu-extract-reference=CPT_BMSL_FlatView.CPT_Asw_Swc.ChargeCmd.ACS2Cmd_flg
      LampCcHCmd_flg: sw-refresh-timing={cse-code=3, cse-code-factor=5}, upstream-reference=RootSwCompositionPrototype.CPT_Asw_Swc.ChargeCmd.LampCcHCmd_flg, ecu-extract-reference=CPT_BMSL_FlatView.CPT_Asw_Swc.ChargeCmd.LampCcHCmd_flg
      OutCMUHWAlarmPWMDuty_Pct: sw-refresh-timing={cse-code=3, cse-code-factor=5}, upstream-reference=RootSwCompositionPrototype.CPT_Asw_Swc.CmuCmd.OutCMUHWAlarmPWMDuty_Pct, ecu-extract-reference=CPT_BMSL_FlatView.CPT_Asw_Swc.CmuCmd.OutCMUHWAlarmPWMDuty_Pct
      CMUPwrCmd_flg: sw-refresh-timing={cse-code=3, cse-code-factor=5}, upstream-reference=RootSwCompositionPrototype.CPT_Asw_Swc.CmuCmd.CMUPwrCmd_flg, ecu-extract-reference=CPT_BMSL_FlatView.CPT_Asw_Swc.CmuCmd.CMUPwrCmd_flg
      CtxOpenDiagCmd_flg: sw-refresh-timing={cse-code=3, cse-code-factor=5}, upstream-reference=RootSwCompositionPrototype.CPT_Asw_Swc.CmuCmd.CtxOpenDiagCmd_flg, ecu-extract-reference=CPT_BMSL_FlatView.CPT_Asw_Swc.CmuCmd.CtxOpenDiagCmd_flg
      ChanelFuncDiagCmd_flg: sw-refresh-timing={cse-code=3, cse-code-factor=5}, upstream-reference=RootSwCompositionPrototype.CPT_Asw_Swc.CmuCmd.ChanelFuncDiagCmd_flg, ecu-extract-reference=CPT_BMSL_FlatView.CPT_Asw_Swc.CmuCmd.ChanelFuncDiagCmd_flg
      CellLeakageDiagCmd_flg: sw-refresh-timing={cse-code=3, cse-code-factor=5}, upstream-reference=RootSwCompositionPrototype.CPT_Asw_Swc.CmuCmd.CellLeakageDiagCmd_flg, ecu-extract-reference=CPT_BMSL_FlatView.CPT_Asw_Swc.CmuCmd.CellLeakageDiagCmd_flg
      GpioOTUTFuncDiagCmd_flg: sw-refresh-timing={cse-code=3, cse-code-factor=5}, upstream-reference=RootSwCompositionPrototype.CPT_Asw_Swc.CmuCmd.GpioOTUTFuncDiagCmd_flg, ecu-extract-reference=CPT_BMSL_FlatView.CPT_Asw_Swc.CmuCmd.GpioOTUTFuncDiagCmd_flg
      GpioxOpenDiagCmd_flg: sw-refresh-timing={cse-code=3, cse-code-factor=5}, upstream-reference=RootSwCompositionPrototype.CPT_Asw_Swc.CmuCmd.GpioxOpenDiagCmd_flg, ecu-extract-reference=CPT_BMSL_FlatView.CPT_Asw_Swc.CmuCmd.GpioxOpenDiagCmd_flg
      BalOpenLoadDiagCmd_flg: sw-refresh-timing={cse-code=3, cse-code-factor=5}, upstream-reference=RootSwCompositionPrototype.CPT_Asw_Swc.CmuCmd.BalOpenLoadDiagCmd_flg, ecu-extract-reference=CPT_BMSL_FlatView.CPT_Asw_Swc.CmuCmd.BalOpenLoadDiagCmd_flg
      CmuClrFaultPin_flg: sw-refresh-timing={cse-code=3, cse-code-factor=5}, upstream-reference=RootSwCompositionPrototype.CPT_Asw_Swc.CmuCmd.CmuClrFaultPin_flg, ecu-extract-reference=CPT_BMSL_FlatView.CPT_Asw_Swc.CmuCmd.CmuClrFaultPin_flg
      CmuReCfg_flg: sw-refresh-timing={cse-code=3, cse-code-factor=5}, upstream-reference=RootSwCompositionPrototype.CPT_Asw_Swc.CmuCmd.CmuReCfg_flg, ecu-extract-reference=CPT_BMSL_FlatView.CPT_Asw_Swc.CmuCmd.CmuReCfg_flg
      OutHVILPWMDuty_Pct: sw-refresh-timing={cse-code=3, cse-code-factor=5}, upstream-reference=RootSwCompositionPrototype.CPT_Asw_Swc.HvilCmd.OutHVILPWMDuty_Pct, ecu-extract-reference=CPT_BMSL_FlatView.CPT_Asw_Swc.HvilCmd.OutHVILPWMDuty_Pct
      HVIsoPosMosCmd_flg: sw-refresh-timing={cse-code=3, cse-code-factor=5}, upstream-reference=RootSwCompositionPrototype.CPT_Asw_Swc.IsoCmd.HVIsoPosMosCmd_flg, ecu-extract-reference=CPT_BMSL_FlatView.CPT_Asw_Swc.IsoCmd.HVIsoPosMosCmd_flg
      HVIsoNegMosCmd_flg: sw-refresh-timing={cse-code=3, cse-code-factor=5}, upstream-reference=RootSwCompositionPrototype.CPT_Asw_Swc.IsoCmd.HVIsoNegMosCmd_flg, ecu-extract-reference=CPT_BMSL_FlatView.CPT_Asw_Swc.IsoCmd.HVIsoNegMosCmd_flg
      KnCtrlCmd_flg: sw-refresh-timing={cse-code=3, cse-code-factor=5}, upstream-reference=RootSwCompositionPrototype.CPT_Asw_Swc.RelayCmd.KnCtrlCmd_flg, ecu-extract-reference=CPT_BMSL_FlatView.CPT_Asw_Swc.RelayCmd.KnCtrlCmd_flg
      K{1..6}CtrCmd_flg: sw-refresh-timing={cse-code=3, cse-code-factor=5}, upstream-reference=RootSwCompositionPrototype.CPT_Asw_Swc.RelayCmd.K{1..6}CtrCmd_flg, ecu-extract-reference=CPT_BMSL_FlatView.CPT_Asw_Swc.RelayCmd.K{1..6}CtrCmd_flg
      OutCoolPumpPWMDuty_Pct: sw-refresh-timing={cse-code=3, cse-code-factor=5}, upstream-reference=RootSwCompositionPrototype.CPT_Asw_Swc.ThermalCmd.OutCoolPumpPWMDuty_Pct, ecu-extract-reference=CPT_BMSL_FlatView.CPT_Asw_Swc.ThermalCmd.OutCoolPumpPWMDuty_Pct
      OutFanPWMDuty_Pct: sw-refresh-timing={cse-code=3, cse-code-factor=5}, upstream-reference=RootSwCompositionPrototype.CPT_Asw_Swc.ThermalCmd.OutFanPWMDuty_Pct, ecu-extract-reference=CPT_BMSL_FlatView.CPT_Asw_Swc.ThermalCmd.OutFanPWMDuty_Pct
      ValveEn_flg: sw-refresh-timing={cse-code=3, cse-code-factor=5}, upstream-reference=RootSwCompositionPrototype.CPT_Asw_Swc.ThermalCmd.ValveEn_flg, ecu-extract-reference=CPT_BMSL_FlatView.CPT_Asw_Swc.ThermalCmd.ValveEn_flg
      CPT_Asw_Swc_CPT_Asw_Swc_CPT_Asw_Swc_RadyToSleep_flg: sw-refresh-timing={cse-code=3, cse-code-factor=5}, upstream-reference=RootSwCompositionPrototype.CPT_Asw_Swc.McuCmd.RadyToSleep_flg, ecu-extract-reference=CPT_BMSL_FlatView.CPT_Asw_Swc.McuCmd.RadyToSleep_flg
      HVCntctrStat: sw-refresh-timing={cse-code=3, cse-code-factor=5}, upstream-reference=RootSwCompositionPrototype.CPT_Asw_Swc.BMS_1D8h.HVCntctrStat, ecu-extract-reference=CPT_BMSL_FlatView.CPT_Asw_Swc.BMS_1D8h.HVCntctrStat
      Unconnected_HVBatFltSevrtyStat: sw-refresh-timing={cse-code=3, cse-code-factor=5}, upstream-reference=RootSwCompositionPrototype.CPT_Asw_Swc.BMS_1D8h.HVBatFltSevrtyStat, ecu-extract-reference=CPT_BMSL_FlatView.CPT_Asw_Swc.BMS_1D8h.HVBatFltSevrtyStat
      Unconnected_BMSlightReq: sw-refresh-timing={cse-code=3, cse-code-factor=5}, upstream-reference=RootSwCompositionPrototype.CPT_Asw_Swc.BMS_1D8h.BMSlightReq, ecu-extract-reference=CPT_BMSL_FlatView.CPT_Asw_Swc.BMS_1D8h.BMSlightReq
      Unconnected_HVCntctrStatARC: sw-refresh-timing={cse-code=3, cse-code-factor=5}, upstream-reference=RootSwCompositionPrototype.CPT_Asw_Swc.BMS_1D8h.HVCntctrStatARC, ecu-extract-reference=CPT_BMSL_FlatView.CPT_Asw_Swc.BMS_1D8h.HVCntctrStatARC
      Unconnected_ChrgrStatPTHVCntctrReq: sw-refresh-timing={cse-code=3, cse-code-factor=5}, upstream-reference=RootSwCompositionPrototype.CPT_Asw_Swc.BMS_1D8h.ChrgrStatPTHVCntctrReq, ecu-extract-reference=CPT_BMSL_FlatView.CPT_Asw_Swc.BMS_1D8h.ChrgrStatPTHVCntctrReq
      Unconnected_HVBatPrcdCrntV: sw-refresh-timing={cse-code=3, cse-code-factor=5}, upstream-reference=RootSwCompositionPrototype.CPT_Asw_Swc.BMS_1D8h.HVBatPrcdCrntV, ecu-extract-reference=CPT_BMSL_FlatView.CPT_Asw_Swc.BMS_1D8h.HVBatPrcdCrntV
      Unconnected_HVBatPrcdCrnt: sw-refresh-timing={cse-code=3, cse-code-factor=5}, upstream-reference=RootSwCompositionPrototype.CPT_Asw_Swc.BMS_1D8h.HVBatPrcdCrnt, ecu-extract-reference=CPT_BMSL_FlatView.CPT_Asw_Swc.BMS_1D8h.HVBatPrcdCrnt
      Unconnected_MesCellTempNumIndex: sw-refresh-timing={cse-code=3, cse-code-factor=5}, upstream-reference=RootSwCompositionPrototype.CPT_Asw_Swc.BMS_329h.MesCellTempNumIndex, ecu-extract-reference=CPT_BMSL_FlatView.CPT_Asw_Swc.BMS_329h.MesCellTempNumIndex
      Unconnected_CellTempMes{1..7}: sw-refresh-timing={cse-code=3, cse-code-factor=5}, upstream-reference=RootSwCompositionPrototype.CPT_Asw_Swc.BMS_329h.CellTempMes{1..7}, ecu-extract-reference=CPT_BMSL_FlatView.CPT_Asw_Swc.BMS_329h.CellTempMes{1..7}
      Unconnected_MesCellVoltNumIndex: sw-refresh-timing={cse-code=3, cse-code-factor=5}, upstream-reference=RootSwCompositionPrototype.CPT_Asw_Swc.BMS_32Ah.MesCellVoltNumIndex, ecu-extract-reference=CPT_BMSL_FlatView.CPT_Asw_Swc.BMS_32Ah.MesCellVoltNumIndex
      Unconnected_Mes1CellVolt: sw-refresh-timing={cse-code=3, cse-code-factor=5}, upstream-reference=RootSwCompositionPrototype.CPT_Asw_Swc.BMS_32Ah.Mes1CellVolt, ecu-extract-reference=CPT_BMSL_FlatView.CPT_Asw_Swc.BMS_32Ah.Mes1CellVolt
      Unconnected_Mes1CellBalState: sw-refresh-timing={cse-code=3, cse-code-factor=5}, upstream-reference=RootSwCompositionPrototype.CPT_Asw_Swc.BMS_32Ah.Mes1CellBalState, ecu-extract-reference=CPT_BMSL_FlatView.CPT_Asw_Swc.BMS_32Ah.Mes1CellBalState
      Unconnected_Mes2CellVolt: sw-refresh-timing={cse-code=3, cse-code-factor=5}, upstream-reference=RootSwCompositionPrototype.CPT_Asw_Swc.BMS_32Ah.Mes2CellVolt, ecu-extract-reference=CPT_BMSL_FlatView.CPT_Asw_Swc.BMS_32Ah.Mes2CellVolt
      Unconnected_Mes2CellBalState: sw-refresh-timing={cse-code=3, cse-code-factor=5}, upstream-reference=RootSwCompositionPrototype.CPT_Asw_Swc.BMS_32Ah.Mes2CellBalState, ecu-extract-reference=CPT_BMSL_FlatView.CPT_Asw_Swc.BMS_32Ah.Mes2CellBalState
      Unconnected_Mes3CellVolt: sw-refresh-timing={cse-code=3, cse-code-factor=5}, upstream-reference=RootSwCompositionPrototype.CPT_Asw_Swc.BMS_32Ah.Mes3CellVolt, ecu-extract-reference=CPT_BMSL_FlatView.CPT_Asw_Swc.BMS_32Ah.Mes3CellVolt
      Unconnected_Mes3CellBalState: sw-refresh-timing={cse-code=3, cse-code-factor=5}, upstream-reference=RootSwCompositionPrototype.CPT_Asw_Swc.BMS_32Ah.Mes3CellBalState, ecu-extract-reference=CPT_BMSL_FlatView.CPT_Asw_Swc.BMS_32Ah.Mes3CellBalState
      Unconnected_HVBatPackPrcdVltgV: sw-refresh-timing={cse-code=3, cse-code-factor=5}, upstream-reference=RootSwCompositionPrototype.CPT_Asw_Swc.BMS_3D7h.HVBatPackPrcdVltgV, ecu-extract-reference=CPT_BMSL_FlatView.CPT_Asw_Swc.BMS_3D7h.HVBatPackPrcdVltgV
      Unconnected_HVBatPackPrcdVltg: sw-refresh-timing={cse-code=3, cse-code-factor=5}, upstream-reference=RootSwCompositionPrototype.CPT_Asw_Swc.BMS_3D7h.HVBatPackPrcdVltg, ecu-extract-reference=CPT_BMSL_FlatView.CPT_Asw_Swc.BMS_3D7h.HVBatPackPrcdVltg
      Unconnected_HVBCP_LngTrmChrgPwr: sw-refresh-timing={cse-code=3, cse-code-factor=5}, upstream-reference=RootSwCompositionPrototype.CPT_Asw_Swc.BMS_3DAh.HVBCP_LngTrmChrgPwr, ecu-extract-reference=CPT_BMSL_FlatView.CPT_Asw_Swc.BMS_3DAh.HVBCP_LngTrmChrgPwr
      Unconnected_HVBCP_CrnkChrgPwrV: sw-refresh-timing={cse-code=3, cse-code-factor=5}, upstream-reference=RootSwCompositionPrototype.CPT_Asw_Swc.BMS_3DAh.HVBCP_CrnkChrgPwrV, ecu-extract-reference=CPT_BMSL_FlatView.CPT_Asw_Swc.BMS_3DAh.HVBCP_CrnkChrgPwrV
      Unconnected_HVBCP_ShrtTrmChrgPwr: sw-refresh-timing={cse-code=3, cse-code-factor=5}, upstream-reference=RootSwCompositionPrototype.CPT_Asw_Swc.BMS_3DAh.HVBCP_ShrtTrmChrgPwr, ecu-extract-reference=CPT_BMSL_FlatView.CPT_Asw_Swc.BMS_3DAh.HVBCP_ShrtTrmChrgPwr
      Unconnected_ChrgPeakTimeFactor: sw-refresh-timing={cse-code=3, cse-code-factor=5}, upstream-reference=RootSwCompositionPrototype.CPT_Asw_Swc.BMS_3DAh.ChrgPeakTimeFactor, ecu-extract-reference=CPT_BMSL_FlatView.CPT_Asw_Swc.BMS_3DAh.ChrgPeakTimeFactor
      Unconnected_HVBatSOCHiRes: sw-refresh-timing={cse-code=3, cse-code-factor=5}, upstream-reference=RootSwCompositionPrototype.CPT_Asw_Swc.BMS_3DAh.HVBatSOCHiRes, ecu-extract-reference=CPT_BMSL_FlatView.CPT_Asw_Swc.BMS_3DAh.HVBatSOCHiRes
      Unconnected_BMSChecksum_3DAh: sw-refresh-timing={cse-code=3, cse-code-factor=5}, upstream-reference=RootSwCompositionPrototype.CPT_Asw_Swc.BMS_3DAh.BMSChecksum_3DAh, ecu-extract-reference=CPT_BMSL_FlatView.CPT_Asw_Swc.BMS_3DAh.BMSChecksum_3DAh
      Unconnected_HVBDP_LngTrmDischrgPwr: sw-refresh-timing={cse-code=3, cse-code-factor=5}, upstream-reference=RootSwCompositionPrototype.CPT_Asw_Swc.BMS_3DBh.HVBDP_LngTrmDischrgPwr, ecu-extract-reference=CPT_BMSL_FlatView.CPT_Asw_Swc.BMS_3DBh.HVBDP_LngTrmDischrgPwr
      Unconnected_HVBDP_CrnkDischrgPwrV: sw-refresh-timing={cse-code=3, cse-code-factor=5}, upstream-reference=RootSwCompositionPrototype.CPT_Asw_Swc.BMS_3DBh.HVBDP_CrnkDischrgPwrV, ecu-extract-reference=CPT_BMSL_FlatView.CPT_Asw_Swc.BMS_3DBh.HVBDP_CrnkDischrgPwrV
      Unconnected_HVBDP_ShrtTrmDischrgPwr: sw-refresh-timing={cse-code=3, cse-code-factor=5}, upstream-reference=RootSwCompositionPrototype.CPT_Asw_Swc.BMS_3DBh.HVBDP_ShrtTrmDischrgPwr, ecu-extract-reference=CPT_BMSL_FlatView.CPT_Asw_Swc.BMS_3DBh.HVBDP_ShrtTrmDischrgPwr
      Unconnected_DischrgPeakTimeFactor: sw-refresh-timing={cse-code=3, cse-code-factor=5}, upstream-reference=RootSwCompositionPrototype.CPT_Asw_Swc.BMS_3DBh.DischrgPeakTimeFactor, ecu-extract-reference=CPT_BMSL_FlatView.CPT_Asw_Swc.BMS_3DBh.DischrgPeakTimeFactor
      Unconnected_BMSChecksum_3DBh: sw-refresh-timing={cse-code=3, cse-code-factor=5}, upstream-reference=RootSwCompositionPrototype.CPT_Asw_Swc.BMS_3DBh.BMSChecksum_3DBh, ecu-extract-reference=CPT_BMSL_FlatView.CPT_Asw_Swc.BMS_3DBh.BMSChecksum_3DBh
      HVIsoWarning: sw-refresh-timing={cse-code=3, cse-code-factor=5}, upstream-reference=RootSwCompositionPrototype.CPT_Asw_Swc.BMS_501h.HVIsoWarning, ecu-extract-reference=CPT_BMSL_FlatView.CPT_Asw_Swc.BMS_501h.HVIsoWarning
      HVILWarning: sw-refresh-timing={cse-code=3, cse-code-factor=5}, upstream-reference=RootSwCompositionPrototype.CPT_Asw_Swc.BMS_501h.HVILWarning, ecu-extract-reference=CPT_BMSL_FlatView.CPT_Asw_Swc.BMS_501h.HVILWarning
      SOCLowWarning: sw-refresh-timing={cse-code=3, cse-code-factor=5}, upstream-reference=RootSwCompositionPrototype.CPT_Asw_Swc.BMS_501h.SOCLowWarning, ecu-extract-reference=CPT_BMSL_FlatView.CPT_Asw_Swc.BMS_501h.SOCLowWarning
      TempDiffWarning: sw-refresh-timing={cse-code=3, cse-code-factor=5}, upstream-reference=RootSwCompositionPrototype.CPT_Asw_Swc.BMS_501h.TempDiffWarning, ecu-extract-reference=CPT_BMSL_FlatView.CPT_Asw_Swc.BMS_501h.TempDiffWarning
      TempHighWarning: sw-refresh-timing={cse-code=3, cse-code-factor=5}, upstream-reference=RootSwCompositionPrototype.CPT_Asw_Swc.BMS_501h.TempHighWarning, ecu-extract-reference=CPT_BMSL_FlatView.CPT_Asw_Swc.BMS_501h.TempHighWarning
      PackOvWarning: sw-refresh-timing={cse-code=3, cse-code-factor=5}, upstream-reference=RootSwCompositionPrototype.CPT_Asw_Swc.BMS_501h.PackOvWarning, ecu-extract-reference=CPT_BMSL_FlatView.CPT_Asw_Swc.BMS_501h.PackOvWarning
      PackUvWarning: sw-refresh-timing={cse-code=3, cse-code-factor=5}, upstream-reference=RootSwCompositionPrototype.CPT_Asw_Swc.BMS_501h.PackUvWarning, ecu-extract-reference=CPT_BMSL_FlatView.CPT_Asw_Swc.BMS_501h.PackUvWarning
      CellOvWarning: sw-refresh-timing={cse-code=3, cse-code-factor=5}, upstream-reference=RootSwCompositionPrototype.CPT_Asw_Swc.BMS_501h.CellOvWarning, ecu-extract-reference=CPT_BMSL_FlatView.CPT_Asw_Swc.BMS_501h.CellOvWarning
      CellUvWarning: sw-refresh-timing={cse-code=3, cse-code-factor=5}, upstream-reference=RootSwCompositionPrototype.CPT_Asw_Swc.BMS_501h.CellUvWarning, ecu-extract-reference=CPT_BMSL_FlatView.CPT_Asw_Swc.BMS_501h.CellUvWarning
      SOCHighWarning: sw-refresh-timing={cse-code=3, cse-code-factor=5}, upstream-reference=RootSwCompositionPrototype.CPT_Asw_Swc.BMS_501h.SOCHighWarning, ecu-extract-reference=CPT_BMSL_FlatView.CPT_Asw_Swc.BMS_501h.SOCHighWarning
      SOCFastChgWarning: sw-refresh-timing={cse-code=3, cse-code-factor=5}, upstream-reference=RootSwCompositionPrototype.CPT_Asw_Swc.BMS_501h.SOCFastChgWarning, ecu-extract-reference=CPT_BMSL_FlatView.CPT_Asw_Swc.BMS_501h.SOCFastChgWarning
      PwrBatPackMismatchWarning: sw-refresh-timing={cse-code=3, cse-code-factor=5}, upstream-reference=RootSwCompositionPrototype.CPT_Asw_Swc.BMS_501h.PwrBatPackMismatchWarning, ecu-extract-reference=CPT_BMSL_FlatView.CPT_Asw_Swc.BMS_501h.PwrBatPackMismatchWarning
      BMSCelConsistencyWarning: sw-refresh-timing={cse-code=3, cse-code-factor=5}, upstream-reference=RootSwCompositionPrototype.CPT_Asw_Swc.BMS_501h.BMSCelConsistencyWarning, ecu-extract-reference=CPT_BMSL_FlatView.CPT_Asw_Swc.BMS_501h.BMSCelConsistencyWarning
      BMSVolHighWarning: sw-refresh-timing={cse-code=3, cse-code-factor=5}, upstream-reference=RootSwCompositionPrototype.CPT_Asw_Swc.BMS_501h.BMSVolHighWarning, ecu-extract-reference=CPT_BMSL_FlatView.CPT_Asw_Swc.BMS_501h.BMSVolHighWarning
      EnergyConsumption: sw-refresh-timing={cse-code=3, cse-code-factor=5}, upstream-reference=RootSwCompositionPrototype.CPT_Asw_Swc.BMS_501h.EnergyConsumptionPer, ecu-extract-reference=CPT_BMSL_FlatView.CPT_Asw_Swc.BMS_501h.EnergyConsumptionPer
      SOE: sw-refresh-timing={cse-code=3, cse-code-factor=5}, upstream-reference=RootSwCompositionPrototype.CPT_Asw_Swc.BMS_501h.RestEnergy, ecu-extract-reference=CPT_BMSL_FlatView.CPT_Asw_Swc.BMS_501h.RestEnergy
      BMSCellQuantity: sw-refresh-timing={cse-code=3, cse-code-factor=5}, upstream-reference=RootSwCompositionPrototype.CPT_Asw_Swc.BMS_503h.BMSCellQuantity, ecu-extract-reference=CPT_BMSL_FlatView.CPT_Asw_Swc.BMS_503h.BMSCellQuantity
      BMSTempProbeQuantity: sw-refresh-timing={cse-code=3, cse-code-factor=5}, upstream-reference=RootSwCompositionPrototype.CPT_Asw_Swc.BMS_503h.BMSTempProbeQuantity, ecu-extract-reference=CPT_BMSL_FlatView.CPT_Asw_Swc.BMS_503h.BMSTempProbeQuantity
      HVIsoValue: sw-refresh-timing={cse-code=3, cse-code-factor=5}, upstream-reference=RootSwCompositionPrototype.CPT_Asw_Swc.BMS_503h.HVIsoValue, ecu-extract-reference=CPT_BMSL_FlatView.CPT_Asw_Swc.BMS_503h.HVIsoValue
      Unconnected_RechgEnergyStorSysNumb: sw-refresh-timing={cse-code=3, cse-code-factor=5}, upstream-reference=RootSwCompositionPrototype.CPT_Asw_Swc.BMS_509h.RechgEnergyStorSysNumb, ecu-extract-reference=CPT_BMSL_FlatView.CPT_Asw_Swc.BMS_509h.RechgEnergyStorSysNumb
      Unconnected_CurRechgEnergyStorSysIndex: sw-refresh-timing={cse-code=3, cse-code-factor=5}, upstream-reference=RootSwCompositionPrototype.CPT_Asw_Swc.BMS_509h.CurRechgEnergyStorSysIndex, ecu-extract-reference=CPT_BMSL_FlatView.CPT_Asw_Swc.BMS_509h.CurRechgEnergyStorSysIndex
      Unconnected_RechgEnergyStorSysCodeLength: sw-refresh-timing={cse-code=3, cse-code-factor=5}, upstream-reference=RootSwCompositionPrototype.CPT_Asw_Swc.BMS_509h.RechgEnergyStorSysCodeLength, ecu-extract-reference=CPT_BMSL_FlatView.CPT_Asw_Swc.BMS_509h.RechgEnergyStorSysCodeLength
      Unconnected_RechgEnergyStorSysCodeIndex: sw-refresh-timing={cse-code=3, cse-code-factor=5}, upstream-reference=RootSwCompositionPrototype.CPT_Asw_Swc.BMS_509h.RechgEnergyStorSysCodeIndex, ecu-extract-reference=CPT_BMSL_FlatView.CPT_Asw_Swc.BMS_509h.RechgEnergyStorSysCodeIndex
      Unconnected_RechgEnergyStorSysCode{1..6}: sw-refresh-timing={cse-code=3, cse-code-factor=5}, upstream-reference=RootSwCompositionPrototype.CPT_Asw_Swc.BMS_509h.RechgEnergyStorSysCode{1..6}, ecu-extract-reference=CPT_BMSL_FlatView.CPT_Asw_Swc.BMS_509h.RechgEnergyStorSysCode{1..6}
      MaxClVlt: sw-refresh-timing={cse-code=3, cse-code-factor=5}, upstream-reference=RootSwCompositionPrototype.CPT_Asw_Swc.BMS_594h.MaxClVlt, ecu-extract-reference=CPT_BMSL_FlatView.CPT_Asw_Swc.BMS_594h.MaxClVlt
      MaxCellVoltNumb: sw-refresh-timing={cse-code=3, cse-code-factor=5}, upstream-reference=RootSwCompositionPrototype.CPT_Asw_Swc.BMS_594h.MaxCellVoltNumb, ecu-extract-reference=CPT_BMSL_FlatView.CPT_Asw_Swc.BMS_594h.MaxCellVoltNumb
      MinClVlt: sw-refresh-timing={cse-code=3, cse-code-factor=5}, upstream-reference=RootSwCompositionPrototype.CPT_Asw_Swc.BMS_594h.MinClVlt, ecu-extract-reference=CPT_BMSL_FlatView.CPT_Asw_Swc.BMS_594h.MinClVlt
      MinCellVoltNumb: sw-refresh-timing={cse-code=3, cse-code-factor=5}, upstream-reference=RootSwCompositionPrototype.CPT_Asw_Swc.BMS_594h.MinCellVoltNumb, ecu-extract-reference=CPT_BMSL_FlatView.CPT_Asw_Swc.BMS_594h.MinCellVoltNumb
      HVBatPackAccVltgV: sw-refresh-timing={cse-code=3, cse-code-factor=5}, upstream-reference=RootSwCompositionPrototype.CPT_Asw_Swc.BMS_594h.HVBatPackAccVltgV, ecu-extract-reference=CPT_BMSL_FlatView.CPT_Asw_Swc.BMS_594h.HVBatPackAccVltgV
      HVBatPackAccVltg: sw-refresh-timing={cse-code=3, cse-code-factor=5}, upstream-reference=RootSwCompositionPrototype.CPT_Asw_Swc.BMS_594h.HVBatPackAccVltg, ecu-extract-reference=CPT_BMSL_FlatView.CPT_Asw_Swc.BMS_594h.HVBatPackAccVltg
      MaxBatTmp: sw-refresh-timing={cse-code=3, cse-code-factor=5}, upstream-reference=RootSwCompositionPrototype.CPT_Asw_Swc.BMS_596h.MaxBatTmp, ecu-extract-reference=CPT_BMSL_FlatView.CPT_Asw_Swc.BMS_596h.MaxBatTmp
      MaxCellTempNumb: sw-refresh-timing={cse-code=3, cse-code-factor=5}, upstream-reference=RootSwCompositionPrototype.CPT_Asw_Swc.BMS_596h.MaxCellTempNumb, ecu-extract-reference=CPT_BMSL_FlatView.CPT_Asw_Swc.BMS_596h.MaxCellTempNumb
      MinBatTmp: sw-refresh-timing={cse-code=3, cse-code-factor=5}, upstream-reference=RootSwCompositionPrototype.CPT_Asw_Swc.BMS_596h.MinBatTmp, ecu-extract-reference=CPT_BMSL_FlatView.CPT_Asw_Swc.BMS_596h.MinBatTmp
      MinCellTempNumb: sw-refresh-timing={cse-code=3, cse-code-factor=5}, upstream-reference=RootSwCompositionPrototype.CPT_Asw_Swc.BMS_596h.MinCellTempNumb, ecu-extract-reference=CPT_BMSL_FlatView.CPT_Asw_Swc.BMS_596h.MinCellTempNumb
      BatLf: sw-refresh-timing={cse-code=3, cse-code-factor=5}, upstream-reference=RootSwCompositionPrototype.CPT_Asw_Swc.BMS_598h.BatLf, ecu-extract-reference=CPT_BMSL_FlatView.CPT_Asw_Swc.BMS_598h.BatLf
      ChrgPlugStatus: sw-refresh-timing={cse-code=3, cse-code-factor=5}, upstream-reference=RootSwCompositionPrototype.CPT_Asw_Swc.BMS_598h.ChrgPlugStatus, ecu-extract-reference=CPT_BMSL_FlatView.CPT_Asw_Swc.BMS_598h.ChrgPlugStatus
      PreChrgUnitRdy: sw-refresh-timing={cse-code=3, cse-code-factor=5}, upstream-reference=RootSwCompositionPrototype.CPT_Asw_Swc.BMS_598h.PreChrgUnitRdy, ecu-extract-reference=CPT_BMSL_FlatView.CPT_Asw_Swc.BMS_598h.PreChrgUnitRdy
      BMSChrgStatus: sw-refresh-timing={cse-code=3, cse-code-factor=5}, upstream-reference=RootSwCompositionPrototype.CPT_Asw_Swc.BMS_598h.BMSChrgStatus, ecu-extract-reference=CPT_BMSL_FlatView.CPT_Asw_Swc.BMS_598h.BMSChrgStatus
      HVSystemStatus: sw-refresh-timing={cse-code=3, cse-code-factor=5}, upstream-reference=RootSwCompositionPrototype.CPT_Asw_Swc.BMS_598h.HVSystemStatus, ecu-extract-reference=CPT_BMSL_FlatView.CPT_Asw_Swc.BMS_598h.HVSystemStatus
      TotalBatteryCap: sw-refresh-timing={cse-code=3, cse-code-factor=5}, upstream-reference=RootSwCompositionPrototype.CPT_Asw_Swc.BMS_598h.TotalBatteryCap, ecu-extract-reference=CPT_BMSL_FlatView.CPT_Asw_Swc.BMS_598h.TotalBatteryCap
      ACChrgVoltRq: sw-refresh-timing={cse-code=3, cse-code-factor=5}, upstream-reference=RootSwCompositionPrototype.CPT_Asw_Swc.BMS_603h.ACChrgVoltRq, ecu-extract-reference=CPT_BMSL_FlatView.CPT_Asw_Swc.BMS_603h.ACChrgVoltRq
      ACChrgCurrRq: sw-refresh-timing={cse-code=3, cse-code-factor=5}, upstream-reference=RootSwCompositionPrototype.CPT_Asw_Swc.BMS_603h.ACChrgCurrRq, ecu-extract-reference=CPT_BMSL_FlatView.CPT_Asw_Swc.BMS_603h.ACChrgCurrRq
      ACChrgMode: sw-refresh-timing={cse-code=3, cse-code-factor=5}, upstream-reference=RootSwCompositionPrototype.CPT_Asw_Swc.BMS_603h.ACChrgMode, ecu-extract-reference=CPT_BMSL_FlatView.CPT_Asw_Swc.BMS_603h.ACChrgMode
      ACChrgFault: sw-refresh-timing={cse-code=3, cse-code-factor=5}, upstream-reference=RootSwCompositionPrototype.CPT_Asw_Swc.BMS_603h.ACChrgFault, ecu-extract-reference=CPT_BMSL_FlatView.CPT_Asw_Swc.BMS_603h.ACChrgFault
      CCVaule: sw-refresh-timing={cse-code=3, cse-code-factor=5}, upstream-reference=RootSwCompositionPrototype.CPT_Asw_Swc.BMS_603h.CCVaule, ecu-extract-reference=CPT_BMSL_FlatView.CPT_Asw_Swc.BMS_603h.CCVaule
      CPVaule: sw-refresh-timing={cse-code=3, cse-code-factor=5}, upstream-reference=RootSwCompositionPrototype.CPT_Asw_Swc.BMS_603h.CPVaule, ecu-extract-reference=CPT_BMSL_FlatView.CPT_Asw_Swc.BMS_603h.CPVaule
      FullChargeRemainingTime: sw-refresh-timing={cse-code=3, cse-code-factor=5}, upstream-reference=RootSwCompositionPrototype.CPT_Asw_Swc.BMS_605h.FullChargeRemainingTime, ecu-extract-reference=CPT_BMSL_FlatView.CPT_Asw_Swc.BMS_605h.FullChargeRemainingTime
      RequestChargeCurrent: sw-refresh-timing={cse-code=3, cse-code-factor=5}, upstream-reference=RootSwCompositionPrototype.CPT_Asw_Swc.BMS_605h.RequestChargeCurrent, ecu-extract-reference=CPT_BMSL_FlatView.CPT_Asw_Swc.BMS_605h.RequestChargeCurrent
      ChargingVoltage: sw-refresh-timing={cse-code=3, cse-code-factor=5}, upstream-reference=RootSwCompositionPrototype.CPT_Asw_Swc.BMS_605h.ChargingVoltage, ecu-extract-reference=CPT_BMSL_FlatView.CPT_Asw_Swc.BMS_605h.ChargingVoltage
      StopChargingReson: sw-refresh-timing={cse-code=3, cse-code-factor=5}, upstream-reference=RootSwCompositionPrototype.CPT_Asw_Swc.BMS_606h.StopChargingReson, ecu-extract-reference=CPT_BMSL_FlatView.CPT_Asw_Swc.BMS_606h.StopChargingReson
      BEM_CRM00: sw-refresh-timing={cse-code=3, cse-code-factor=5}, upstream-reference=RootSwCompositionPrototype.CPT_Asw_Swc.BMS_606h.BEM_CRM00, ecu-extract-reference=CPT_BMSL_FlatView.CPT_Asw_Swc.BMS_606h.BEM_CRM00
      BEM_CRMAA: sw-refresh-timing={cse-code=3, cse-code-factor=5}, upstream-reference=RootSwCompositionPrototype.CPT_Asw_Swc.BMS_606h.BEM_CRMAA, ecu-extract-reference=CPT_BMSL_FlatView.CPT_Asw_Swc.BMS_606h.BEM_CRMAA
      BEM_CML: sw-refresh-timing={cse-code=3, cse-code-factor=5}, upstream-reference=RootSwCompositionPrototype.CPT_Asw_Swc.BMS_606h.BEM_CML, ecu-extract-reference=CPT_BMSL_FlatView.CPT_Asw_Swc.BMS_606h.BEM_CML
      BEM_CRO: sw-refresh-timing={cse-code=3, cse-code-factor=5}, upstream-reference=RootSwCompositionPrototype.CPT_Asw_Swc.BMS_606h.BEM_CRO, ecu-extract-reference=CPT_BMSL_FlatView.CPT_Asw_Swc.BMS_606h.BEM_CRO
      BEM_CCS: sw-refresh-timing={cse-code=3, cse-code-factor=5}, upstream-reference=RootSwCompositionPrototype.CPT_Asw_Swc.BMS_606h.BEM_CCS, ecu-extract-reference=CPT_BMSL_FlatView.CPT_Asw_Swc.BMS_606h.BEM_CCS
      BEM_CST: sw-refresh-timing={cse-code=3, cse-code-factor=5}, upstream-reference=RootSwCompositionPrototype.CPT_Asw_Swc.BMS_606h.BEM_CST, ecu-extract-reference=CPT_BMSL_FlatView.CPT_Asw_Swc.BMS_606h.BEM_CST
      BEM_CSD: sw-refresh-timing={cse-code=3, cse-code-factor=5}, upstream-reference=RootSwCompositionPrototype.CPT_Asw_Swc.BMS_606h.BEM_CSD, ecu-extract-reference=CPT_BMSL_FlatView.CPT_Asw_Swc.BMS_606h.BEM_CSD
      BEM_Other: sw-refresh-timing={cse-code=3, cse-code-factor=5}, upstream-reference=RootSwCompositionPrototype.CPT_Asw_Swc.BMS_606h.BEM_Other, ecu-extract-reference=CPT_BMSL_FlatView.CPT_Asw_Swc.BMS_606h.BEM_Other
      CEM_BRM: sw-refresh-timing={cse-code=3, cse-code-factor=5}, upstream-reference=RootSwCompositionPrototype.CPT_Asw_Swc.BMS_606h.CEM_BRM, ecu-extract-reference=CPT_BMSL_FlatView.CPT_Asw_Swc.BMS_606h.CEM_BRM
      CEM_BCP: sw-refresh-timing={cse-code=3, cse-code-factor=5}, upstream-reference=RootSwCompositionPrototype.CPT_Asw_Swc.BMS_606h.CEM_BCP, ecu-extract-reference=CPT_BMSL_FlatView.CPT_Asw_Swc.BMS_606h.CEM_BCP
      CEM_BRO: sw-refresh-timing={cse-code=3, cse-code-factor=5}, upstream-reference=RootSwCompositionPrototype.CPT_Asw_Swc.BMS_606h.CEM_BRO, ecu-extract-reference=CPT_BMSL_FlatView.CPT_Asw_Swc.BMS_606h.CEM_BRO
      CEM_BCS: sw-refresh-timing={cse-code=3, cse-code-factor=5}, upstream-reference=RootSwCompositionPrototype.CPT_Asw_Swc.BMS_606h.CEM_BCS, ecu-extract-reference=CPT_BMSL_FlatView.CPT_Asw_Swc.BMS_606h.CEM_BCS
      CEM_BCL: sw-refresh-timing={cse-code=3, cse-code-factor=5}, upstream-reference=RootSwCompositionPrototype.CPT_Asw_Swc.BMS_606h.CEM_BCL, ecu-extract-reference=CPT_BMSL_FlatView.CPT_Asw_Swc.BMS_606h.CEM_BCL
      CEM_BST: sw-refresh-timing={cse-code=3, cse-code-factor=5}, upstream-reference=RootSwCompositionPrototype.CPT_Asw_Swc.BMS_606h.CEM_BST, ecu-extract-reference=CPT_BMSL_FlatView.CPT_Asw_Swc.BMS_606h.CEM_BST
      CEM_BSD: sw-refresh-timing={cse-code=3, cse-code-factor=5}, upstream-reference=RootSwCompositionPrototype.CPT_Asw_Swc.BMS_606h.CEM_BSD, ecu-extract-reference=CPT_BMSL_FlatView.CPT_Asw_Swc.BMS_606h.CEM_BSD
      CEM_Other: sw-refresh-timing={cse-code=3, cse-code-factor=5}, upstream-reference=RootSwCompositionPrototype.CPT_Asw_Swc.BMS_606h.CEM_Other, ecu-extract-reference=CPT_BMSL_FlatView.CPT_Asw_Swc.BMS_606h.CEM_Other
      BMSStopChargeFaultCode{1..8}: sw-refresh-timing={cse-code=3, cse-code-factor=5}, upstream-reference=RootSwCompositionPrototype.CPT_Asw_Swc.BMS_606h.BMSStopChargeFaultCode{1..8}, ecu-extract-reference=CPT_BMSL_FlatView.CPT_Asw_Swc.BMS_606h.BMSStopChargeFaultCode{1..8}
      CHGStopChargeFaultCode{1..6}: sw-refresh-timing={cse-code=3, cse-code-factor=5}, upstream-reference=RootSwCompositionPrototype.CPT_Asw_Swc.BMS_606h.CHGStopChargeFaultCode{1..6}, ecu-extract-reference=CPT_BMSL_FlatView.CPT_Asw_Swc.BMS_606h.CHGStopChargeFaultCode{1..6}
      Unconnected_CHGStopChargeFaultCode7: sw-refresh-timing={cse-code=3, cse-code-factor=5}, upstream-reference=RootSwCompositionPrototype.CPT_Asw_Swc.BMS_606h.CHGStopChargeFaultCode7, ecu-extract-reference=CPT_BMSL_FlatView.CPT_Asw_Swc.BMS_606h.CHGStopChargeFaultCode7
      CHGStopChargeFaultCode8: sw-refresh-timing={cse-code=3, cse-code-factor=5}, upstream-reference=RootSwCompositionPrototype.CPT_Asw_Swc.BMS_606h.CHGStopChargeFaultCode8, ecu-extract-reference=CPT_BMSL_FlatView.CPT_Asw_Swc.BMS_606h.CHGStopChargeFaultCode8
      BMSDTCSeriousLevel: sw-refresh-timing={cse-code=3, cse-code-factor=5}, upstream-reference=RootSwCompositionPrototype.CPT_Asw_Swc.BMS_795h.BMSDTCSeriousLevel, ecu-extract-reference=CPT_BMSL_FlatView.CPT_Asw_Swc.BMS_795h.BMSDTCSeriousLevel
      BMSDTCHighByte: sw-refresh-timing={cse-code=3, cse-code-factor=5}, upstream-reference=RootSwCompositionPrototype.CPT_Asw_Swc.BMS_795h.BMSDTCHighByte, ecu-extract-reference=CPT_BMSL_FlatView.CPT_Asw_Swc.BMS_795h.BMSDTCHighByte
      BMSDTCLowByte: sw-refresh-timing={cse-code=3, cse-code-factor=5}, upstream-reference=RootSwCompositionPrototype.CPT_Asw_Swc.BMS_795h.BMSDTCLowByte, ecu-extract-reference=CPT_BMSL_FlatView.CPT_Asw_Swc.BMS_795h.BMSDTCLowByte
      BMSDTCFailureTypeByte: sw-refresh-timing={cse-code=3, cse-code-factor=5}, upstream-reference=RootSwCompositionPrototype.CPT_Asw_Swc.BMS_795h.BMSDTCFailureTypeByte, ecu-extract-reference=CPT_BMSL_FlatView.CPT_Asw_Swc.BMS_795h.BMSDTCFailureTypeByte
      BMSDTCStatus: sw-refresh-timing={cse-code=3, cse-code-factor=5}, upstream-reference=RootSwCompositionPrototype.CPT_Asw_Swc.BMS_795h.BMSDTCStatus, ecu-extract-reference=CPT_BMSL_FlatView.CPT_Asw_Swc.BMS_795h.BMSDTCStatus
      BMSDTCType: sw-refresh-timing={cse-code=3, cse-code-factor=5}, upstream-reference=RootSwCompositionPrototype.CPT_Asw_Swc.BMS_795h.BMSDTCType, ecu-extract-reference=CPT_BMSL_FlatView.CPT_Asw_Swc.BMS_795h.BMSDTCType
      PackCurr_A: sw-refresh-timing={cse-code=3, cse-code-factor=2}, upstream-reference=RootSwCompositionPrototype.CPT_IoHwAb.CurrValue.PackCurr_A, ecu-extract-reference=CPT_BMSL_FlatView.CPT_IoHwAb.CurrValue.PackCurr_A
      PackCurrVld_flg: sw-refresh-timing={cse-code=3, cse-code-factor=2}, upstream-reference=RootSwCompositionPrototype.CPT_IoHwAb.CurrValue.PackCurrVld_flg, ecu-extract-reference=CPT_BMSL_FlatView.CPT_IoHwAb.CurrValue.PackCurrVld_flg
      Unconnected_CANWakeupEnable_flg: sw-refresh-timing={cse-code=3, cse-code-factor=5}, upstream-reference=RootSwCompositionPrototype.CPT_Asw_Swc.SbcCmd.CANWakeupEnable_flg, ecu-extract-reference=CPT_BMSL_FlatView.CPT_Asw_Swc.SbcCmd.CANWakeupEnable_flg
      CANWakeupEnable_flg_0: sw-refresh-timing={cse-code=3, cse-code-factor=5}, upstream-reference=RootSwCompositionPrototype.CPT_Sbc_Cdd.SbcCmd.CANWakeupEnable_flg, ecu-extract-reference=CPT_BMSL_FlatView.CPT_Sbc_Cdd.SbcCmd.CANWakeupEnable_flg
      I_LDC_In: sw-refresh-timing={cse-code=3, cse-code-factor=5}, upstream-reference=RootSwCompositionPrototype.CPT_Asw_Swc.DCDC_303h.I_LDC_In, ecu-extract-reference=CPT_BMSL_FlatView.CPT_Asw_Swc.DCDC_303h.I_LDC_In
      SysPwrMd: sw-refresh-timing={cse-code=3, cse-code-factor=5}, upstream-reference=RootSwCompositionPrototype.CPT_Asw_Swc.VCU_BCM_1F1h.SysPwrMd, ecu-extract-reference=CPT_BMSL_FlatView.CPT_Asw_Swc.VCU_BCM_1F1h.SysPwrMd
      SysOpnlMd: sw-refresh-timing={cse-code=3, cse-code-factor=5}, upstream-reference=RootSwCompositionPrototype.CPT_Asw_Swc.VCU_BCM_1F1h.SysOpnlMd, ecu-extract-reference=CPT_BMSL_FlatView.CPT_Asw_Swc.VCU_BCM_1F1h.SysOpnlMd
      SysVolMdV: sw-refresh-timing={cse-code=3, cse-code-factor=5}, upstream-reference=RootSwCompositionPrototype.CPT_Asw_Swc.VCU_BCM_1F1h.SysVolMdV, ecu-extract-reference=CPT_BMSL_FlatView.CPT_Asw_Swc.VCU_BCM_1F1h.SysVolMdV
      SysVolV: sw-refresh-timing={cse-code=3, cse-code-factor=5}, upstream-reference=RootSwCompositionPrototype.CPT_Asw_Swc.VCU_BCM_1F1h.SysVolV, ecu-extract-reference=CPT_BMSL_FlatView.CPT_Asw_Swc.VCU_BCM_1F1h.SysVolV
      SysVol: sw-refresh-timing={cse-code=3, cse-code-factor=5}, upstream-reference=RootSwCompositionPrototype.CPT_Asw_Swc.VCU_BCM_1F1h.SysVol, ecu-extract-reference=CPT_BMSL_FlatView.CPT_Asw_Swc.VCU_BCM_1F1h.SysVol
      SysVolMd: sw-refresh-timing={cse-code=3, cse-code-factor=5}, upstream-reference=RootSwCompositionPrototype.CPT_Asw_Swc.VCU_BCM_1F1h.SysVolMd, ecu-extract-reference=CPT_BMSL_FlatView.CPT_Asw_Swc.VCU_BCM_1F1h.SysVolMd
      VehicleSpeedStatus: sw-refresh-timing={cse-code=3, cse-code-factor=5}, upstream-reference=RootSwCompositionPrototype.CPT_Asw_Swc.VCU_ABS_23Ch.VehicleSpeedStatus, ecu-extract-reference=CPT_BMSL_FlatView.CPT_Asw_Swc.VCU_ABS_23Ch.VehicleSpeedStatus
      VehicleSpeed: sw-refresh-timing={cse-code=3, cse-code-factor=5}, upstream-reference=RootSwCompositionPrototype.CPT_Asw_Swc.VCU_ABS_23Ch.VehicleSpeed, ecu-extract-reference=CPT_BMSL_FlatView.CPT_Asw_Swc.VCU_ABS_23Ch.VehicleSpeed
      MessageCounter_23Ch: sw-refresh-timing={cse-code=3, cse-code-factor=5}, upstream-reference=RootSwCompositionPrototype.CPT_Asw_Swc.VCU_ABS_23Ch.MessageCounter_23Ch, ecu-extract-reference=CPT_BMSL_FlatView.CPT_Asw_Swc.VCU_ABS_23Ch.MessageCounter_23Ch
      CheckSum_23Ch: sw-refresh-timing={cse-code=3, cse-code-factor=5}, upstream-reference=RootSwCompositionPrototype.CPT_Asw_Swc.VCU_ABS_23Ch.CheckSum_23Ch, ecu-extract-reference=CPT_BMSL_FlatView.CPT_Asw_Swc.VCU_ABS_23Ch.CheckSum_23Ch
      FrontCompStatFdbck: sw-refresh-timing={cse-code=3, cse-code-factor=5}, upstream-reference=RootSwCompositionPrototype.CPT_Asw_Swc.VCU_HCM_55Fh.FrontCompStatFdbck, ecu-extract-reference=CPT_BMSL_FlatView.CPT_Asw_Swc.VCU_HCM_55Fh.FrontCompStatFdbck
      FrontCmprElctrCrnt: sw-refresh-timing={cse-code=3, cse-code-factor=5}, upstream-reference=RootSwCompositionPrototype.CPT_Asw_Swc.VCU_HCM_55Fh.FrontCmprElctrCrnt, ecu-extract-reference=CPT_BMSL_FlatView.CPT_Asw_Swc.VCU_HCM_55Fh.FrontCmprElctrCrnt
      FrontPTCStatFdbck: sw-refresh-timing={cse-code=3, cse-code-factor=5}, upstream-reference=RootSwCompositionPrototype.CPT_Asw_Swc.VCU_HCM_55Fh.FrontPTCStatFdbck, ecu-extract-reference=CPT_BMSL_FlatView.CPT_Asw_Swc.VCU_HCM_55Fh.FrontPTCStatFdbck
      FrontPTCElctrCrnt: sw-refresh-timing={cse-code=3, cse-code-factor=5}, upstream-reference=RootSwCompositionPrototype.CPT_Asw_Swc.VCU_HCM_55Fh.FrontPTCElctrCrnt, ecu-extract-reference=CPT_BMSL_FlatView.CPT_Asw_Swc.VCU_HCM_55Fh.FrontPTCElctrCrnt
      SysBPM: sw-refresh-timing={cse-code=3, cse-code-factor=5}, upstream-reference=RootSwCompositionPrototype.CPT_Asw_Swc.VCU_IPK_1F2h.SysBPM, ecu-extract-reference=CPT_BMSL_FlatView.CPT_Asw_Swc.VCU_IPK_1F2h.SysBPM
      SysBPMEnbd: sw-refresh-timing={cse-code=3, cse-code-factor=5}, upstream-reference=RootSwCompositionPrototype.CPT_Asw_Swc.VCU_IPK_1F2h.SysBPMEnbd, ecu-extract-reference=CPT_BMSL_FlatView.CPT_Asw_Swc.VCU_IPK_1F2h.SysBPMEnbd
      HighPreVehOdo: sw-refresh-timing={cse-code=3, cse-code-factor=5}, upstream-reference=RootSwCompositionPrototype.CPT_Asw_Swc.VCU_IPK_362h.HighPreVehOdo, ecu-extract-reference=CPT_BMSL_FlatView.CPT_Asw_Swc.VCU_IPK_362h.HighPreVehOdo
      HighPreVehOdoV: sw-refresh-timing={cse-code=3, cse-code-factor=5}, upstream-reference=RootSwCompositionPrototype.CPT_Asw_Swc.VCU_IPK_362h.HighPreVehOdoV, ecu-extract-reference=CPT_BMSL_FlatView.CPT_Asw_Swc.VCU_IPK_362h.HighPreVehOdoV
      OBCChgVolt: sw-refresh-timing={cse-code=3, cse-code-factor=5}, upstream-reference=RootSwCompositionPrototype.CPT_Asw_Swc.OBC_604h.OBCChgVolt, ecu-extract-reference=CPT_BMSL_FlatView.CPT_Asw_Swc.OBC_604h.OBCChgVolt
      OBCChgCurrent: sw-refresh-timing={cse-code=3, cse-code-factor=5}, upstream-reference=RootSwCompositionPrototype.CPT_Asw_Swc.OBC_604h.OBCChgCurrent, ecu-extract-reference=CPT_BMSL_FlatView.CPT_Asw_Swc.OBC_604h.OBCChgCurrent
      OBCMaxChrgVoltage: sw-refresh-timing={cse-code=3, cse-code-factor=5}, upstream-reference=RootSwCompositionPrototype.CPT_Asw_Swc.OBC_604h.OBCMaxChrgVoltage, ecu-extract-reference=CPT_BMSL_FlatView.CPT_Asw_Swc.OBC_604h.OBCMaxChrgVoltage
      OBCMaxChrgCurrent: sw-refresh-timing={cse-code=3, cse-code-factor=5}, upstream-reference=RootSwCompositionPrototype.CPT_Asw_Swc.OBC_604h.OBCMaxChrgCurrent, ecu-extract-reference=CPT_BMSL_FlatView.CPT_Asw_Swc.OBC_604h.OBCMaxChrgCurrent
      OBCStatus: sw-refresh-timing={cse-code=3, cse-code-factor=5}, upstream-reference=RootSwCompositionPrototype.CPT_Asw_Swc.OBC_604h.OBCStatus, ecu-extract-reference=CPT_BMSL_FlatView.CPT_Asw_Swc.OBC_604h.OBCStatus
      OBCFltCode: sw-refresh-timing={cse-code=3, cse-code-factor=5}, upstream-reference=RootSwCompositionPrototype.CPT_Asw_Swc.OBC_604h.OBCCurrentFltCode, ecu-extract-reference=CPT_BMSL_FlatView.CPT_Asw_Swc.OBC_604h.OBCCurrentFltCode
      V_DC: sw-refresh-timing={cse-code=3, cse-code-factor=5}, upstream-reference=RootSwCompositionPrototype.CPT_Asw_Swc.PEU_0B4h.V_DC, ecu-extract-reference=CPT_BMSL_FlatView.CPT_Asw_Swc.PEU_0B4h.V_DC
      V_DCValidity: sw-refresh-timing={cse-code=3, cse-code-factor=5}, upstream-reference=RootSwCompositionPrototype.CPT_Asw_Swc.PEU_0B4h.V_DCValidity, ecu-extract-reference=CPT_BMSL_FlatView.CPT_Asw_Swc.PEU_0B4h.V_DCValidity
      InvADCCrntV: sw-refresh-timing={cse-code=3, cse-code-factor=5}, upstream-reference=RootSwCompositionPrototype.CPT_Asw_Swc.PEU_18Bh.InvADCCrntV, ecu-extract-reference=CPT_BMSL_FlatView.CPT_Asw_Swc.PEU_18Bh.InvADCCrntV
      InvADCCrnt: sw-refresh-timing={cse-code=3, cse-code-factor=5}, upstream-reference=RootSwCompositionPrototype.CPT_Asw_Swc.PEU_18Bh.InvADCCrnt, ecu-extract-reference=CPT_BMSL_FlatView.CPT_Asw_Swc.PEU_18Bh.InvADCCrnt
      RollingCounter: sw-refresh-timing={cse-code=3, cse-code-factor=5}, upstream-reference=RootSwCompositionPrototype.CPT_Asw_Swc.VCU_SRS_163h.RollingCounter, ecu-extract-reference=CPT_BMSL_FlatView.CPT_Asw_Swc.VCU_SRS_163h.RollingCounter
      SRSCheckSum: sw-refresh-timing={cse-code=3, cse-code-factor=5}, upstream-reference=RootSwCompositionPrototype.CPT_Asw_Swc.VCU_SRS_163h.SRSCheckSum, ecu-extract-reference=CPT_BMSL_FlatView.CPT_Asw_Swc.VCU_SRS_163h.SRSCheckSum
      VehCrshTyp: sw-refresh-timing={cse-code=3, cse-code-factor=5}, upstream-reference=RootSwCompositionPrototype.CPT_Asw_Swc.VCU_SRS_163h.VehCrshTyp, ecu-extract-reference=CPT_BMSL_FlatView.CPT_Asw_Swc.VCU_SRS_163h.VehCrshTyp
      ChrgrStatPTHVCntctrClsAlwd: sw-refresh-timing={cse-code=3, cse-code-factor=5}, upstream-reference=RootSwCompositionPrototype.CPT_Asw_Swc.VCU_1E3h.ChrgrStatPTHVCntctrClsAlwd, ecu-extract-reference=CPT_BMSL_FlatView.CPT_Asw_Swc.VCU_1E3h.ChrgrStatPTHVCntctrClsAlwd
      ChrgrStatPTHVCntctOpnrAlwd: sw-refresh-timing={cse-code=3, cse-code-factor=5}, upstream-reference=RootSwCompositionPrototype.CPT_Asw_Swc.VCU_1E3h.ChrgrStatPTHVCntctOpnrAlwd, ecu-extract-reference=CPT_BMSL_FlatView.CPT_Asw_Swc.VCU_1E3h.ChrgrStatPTHVCntctOpnrAlwd
      PTHVCntctrReq: sw-refresh-timing={cse-code=3, cse-code-factor=5}, upstream-reference=RootSwCompositionPrototype.CPT_Asw_Swc.VCU_1E3h.PTHVCntctrReq, ecu-extract-reference=CPT_BMSL_FlatView.CPT_Asw_Swc.VCU_1E3h.PTHVCntctrReq
      RollingCounter_1E3h: sw-refresh-timing={cse-code=3, cse-code-factor=5}, upstream-reference=RootSwCompositionPrototype.CPT_Asw_Swc.VCU_1E3h.RollingCounter_1E3h, ecu-extract-reference=CPT_BMSL_FlatView.CPT_Asw_Swc.VCU_1E3h.RollingCounter_1E3h
      CheckSum_1E3h: sw-refresh-timing={cse-code=3, cse-code-factor=5}, upstream-reference=RootSwCompositionPrototype.CPT_Asw_Swc.VCU_1E3h.CheckSum_1E3h, ecu-extract-reference=CPT_BMSL_FlatView.CPT_Asw_Swc.VCU_1E3h.CheckSum_1E3h
      VehSpdAvgDrvnV: sw-refresh-timing={cse-code=3, cse-code-factor=5}, upstream-reference=RootSwCompositionPrototype.CPT_Asw_Swc.VCU_353h.VehSpdAvgDrvnV, ecu-extract-reference=CPT_BMSL_FlatView.CPT_Asw_Swc.VCU_353h.VehSpdAvgDrvnV
      VehSpdAvgDrvn: sw-refresh-timing={cse-code=3, cse-code-factor=5}, upstream-reference=RootSwCompositionPrototype.CPT_Asw_Swc.VCU_353h.VehSpdAvgDrvn, ecu-extract-reference=CPT_BMSL_FlatView.CPT_Asw_Swc.VCU_353h.VehSpdAvgDrvn
      ThermalAlarm: sw-refresh-timing={cse-code=3, cse-code-factor=5}, upstream-reference=RootSwCompositionPrototype.CPT_Asw_Swc.BMS_501h.ThermalAlarm, ecu-extract-reference=CPT_BMSL_FlatView.CPT_Asw_Swc.BMS_501h.ThermalAlarm
      ThermalAlarmV: sw-refresh-timing={cse-code=3, cse-code-factor=5}, upstream-reference=RootSwCompositionPrototype.CPT_Asw_Swc.BMS_501h.ThermalAlarmV, ecu-extract-reference=CPT_BMSL_FlatView.CPT_Asw_Swc.BMS_501h.ThermalAlarmV
      RealSOC: sw-refresh-timing={cse-code=3, cse-code-factor=5}, upstream-reference=RootSwCompositionPrototype.CPT_Asw_Swc.BMS_503h.RealSOC, ecu-extract-reference=CPT_BMSL_FlatView.CPT_Asw_Swc.BMS_503h.RealSOC
      S2_Status: sw-refresh-timing={cse-code=3, cse-code-factor=5}, upstream-reference=RootSwCompositionPrototype.CPT_Asw_Swc.BMS_603h.S2_Status, ecu-extract-reference=CPT_BMSL_FlatView.CPT_Asw_Swc.BMS_603h.S2_Status
      CDU_HVILWarning: sw-refresh-timing={cse-code=3, cse-code-factor=5}, upstream-reference=RootSwCompositionPrototype.CPT_Asw_Swc.DCDC_303h.CDU_HVILWarning, ecu-extract-reference=CPT_BMSL_FlatView.CPT_Asw_Swc.DCDC_303h.CDU_HVILWarning
      OBCHistoryFltCode: sw-refresh-timing={cse-code=3, cse-code-factor=5}, upstream-reference=RootSwCompositionPrototype.CPT_Asw_Swc.OBC_604h.OBCHistoryFltCode, ecu-extract-reference=CPT_BMSL_FlatView.CPT_Asw_Swc.OBC_604h.OBCHistoryFltCode
      BCL_SPN3074_ChgMode: sw-refresh-timing={cse-code=3, cse-code-factor=5}, upstream-reference=RootSwCompositionPrototype.CPT_Asw_Swc.BCL_BCU.BCL_SPN3074_ChgMode, ecu-extract-reference=CPT_BMSL_FlatView.CPT_Asw_Swc.BCL_BCU.BCL_SPN3074_ChgMode
      BCL_SPN3073_I_Req: sw-refresh-timing={cse-code=3, cse-code-factor=5}, upstream-reference=RootSwCompositionPrototype.CPT_Asw_Swc.BCL_BCU.BCL_SPN3073_I_Req, ecu-extract-reference=CPT_BMSL_FlatView.CPT_Asw_Swc.BCL_BCU.BCL_SPN3073_I_Req
      BCL_SPN3072_U_Req: sw-refresh-timing={cse-code=3, cse-code-factor=5}, upstream-reference=RootSwCompositionPrototype.CPT_Asw_Swc.BCL_BCU.BCL_SPN3072_U_Req, ecu-extract-reference=CPT_BMSL_FlatView.CPT_Asw_Swc.BCL_BCU.BCL_SPN3072_U_Req
      BCP_SPN2816_Ucell_Max_Permit: sw-refresh-timing={cse-code=3, cse-code-factor=5}, upstream-reference=RootSwCompositionPrototype.CPT_Asw_Swc.BCP_BCU.BCP_SPN2816_Ucell_Max_Permit, ecu-extract-reference=CPT_BMSL_FlatView.CPT_Asw_Swc.BCP_BCU.BCP_SPN2816_Ucell_Max_Permit
      BCP_SPN2817_I_Max_Permit: sw-refresh-timing={cse-code=3, cse-code-factor=5}, upstream-reference=RootSwCompositionPrototype.CPT_Asw_Swc.BCP_BCU.BCP_SPN2817_I_Max_Permit, ecu-extract-reference=CPT_BMSL_FlatView.CPT_Asw_Swc.BCP_BCU.BCP_SPN2817_I_Max_Permit
      BCP_SPN2818_kWh_Nom: sw-refresh-timing={cse-code=3, cse-code-factor=5}, upstream-reference=RootSwCompositionPrototype.CPT_Asw_Swc.BCP_BCU.BCP_SPN2818_kWh_Nom, ecu-extract-reference=CPT_BMSL_FlatView.CPT_Asw_Swc.BCP_BCU.BCP_SPN2818_kWh_Nom
      BCP_SPN2819_U_Max_Permit: sw-refresh-timing={cse-code=3, cse-code-factor=5}, upstream-reference=RootSwCompositionPrototype.CPT_Asw_Swc.BCP_BCU.BCP_SPN2819_U_Max_Permit, ecu-extract-reference=CPT_BMSL_FlatView.CPT_Asw_Swc.BCP_BCU.BCP_SPN2819_U_Max_Permit
      BCP_SPN2820_T_Max_Permit: sw-refresh-timing={cse-code=3, cse-code-factor=5}, upstream-reference=RootSwCompositionPrototype.CPT_Asw_Swc.BCP_BCU.BCP_SPN2820_T_Max_Permit, ecu-extract-reference=CPT_BMSL_FlatView.CPT_Asw_Swc.BCP_BCU.BCP_SPN2820_T_Max_Permit
      BCP_SPN2821_SOC: sw-refresh-timing={cse-code=3, cse-code-factor=5}, upstream-reference=RootSwCompositionPrototype.CPT_Asw_Swc.BCP_BCU.BCP_SPN2821_SOC, ecu-extract-reference=CPT_BMSL_FlatView.CPT_Asw_Swc.BCP_BCU.BCP_SPN2821_SOC
      BCP_SPN2822_U: sw-refresh-timing={cse-code=3, cse-code-factor=5}, upstream-reference=RootSwCompositionPrototype.CPT_Asw_Swc.BCP_BCU.BCP_SPN2822_U, ecu-extract-reference=CPT_BMSL_FlatView.CPT_Asw_Swc.BCP_BCU.BCP_SPN2822_U
      BCS_SPN3075_U_Mea: sw-refresh-timing={cse-code=3, cse-code-factor=5}, upstream-reference=RootSwCompositionPrototype.CPT_Asw_Swc.BCS_BCU.BCS_SPN3075_U_Mea, ecu-extract-reference=CPT_BMSL_FlatView.CPT_Asw_Swc.BCS_BCU.BCS_SPN3075_U_Mea
      BCS_SPN3076_I_Mea: sw-refresh-timing={cse-code=3, cse-code-factor=5}, upstream-reference=RootSwCompositionPrototype.CPT_Asw_Swc.BCS_BCU.BCS_SPN3076_I_Mea, ecu-extract-reference=CPT_BMSL_FlatView.CPT_Asw_Swc.BCS_BCU.BCS_SPN3076_I_Mea
      BCS_SPN3077_Ucell_Max: sw-refresh-timing={cse-code=3, cse-code-factor=5}, upstream-reference=RootSwCompositionPrototype.CPT_Asw_Swc.BCS_BCU.BCS_SPN3077_Ucell_Max, ecu-extract-reference=CPT_BMSL_FlatView.CPT_Asw_Swc.BCS_BCU.BCS_SPN3077_Ucell_Max
      BCS_SPN3077_Ucell_Max_Grp: sw-refresh-timing={cse-code=3, cse-code-factor=5}, upstream-reference=RootSwCompositionPrototype.CPT_Asw_Swc.BCS_BCU.BCS_SPN3077_Ucell_Max_Grp, ecu-extract-reference=CPT_BMSL_FlatView.CPT_Asw_Swc.BCS_BCU.BCS_SPN3077_Ucell_Max_Grp
      BCS_SPN3078_SOC: sw-refresh-timing={cse-code=3, cse-code-factor=5}, upstream-reference=RootSwCompositionPrototype.CPT_Asw_Swc.BCS_BCU.BCS_SPN3078_SOC, ecu-extract-reference=CPT_BMSL_FlatView.CPT_Asw_Swc.BCS_BCU.BCS_SPN3078_SOC
      BCS_SPN3079_Time_Remain: sw-refresh-timing={cse-code=3, cse-code-factor=5}, upstream-reference=RootSwCompositionPrototype.CPT_Asw_Swc.BCS_BCU.BCS_SPN3079_Time_Remain, ecu-extract-reference=CPT_BMSL_FlatView.CPT_Asw_Swc.BCS_BCU.BCS_SPN3079_Time_Remain
      BEM_other: sw-refresh-timing={cse-code=3, cse-code-factor=5}, upstream-reference=RootSwCompositionPrototype.CPT_Asw_Swc.BEM_BCU.BEM_other, ecu-extract-reference=CPT_BMSL_FlatView.CPT_Asw_Swc.BEM_BCU.BEM_other
      BEM_SPN3907_Timeout_CSD: sw-refresh-timing={cse-code=3, cse-code-factor=5}, upstream-reference=RootSwCompositionPrototype.CPT_Asw_Swc.BEM_BCU.BEM_SPN3907_Timeout_CSD, ecu-extract-reference=CPT_BMSL_FlatView.CPT_Asw_Swc.BEM_BCU.BEM_SPN3907_Timeout_CSD
      BEM_SPN3906_Timeout_CST: sw-refresh-timing={cse-code=3, cse-code-factor=5}, upstream-reference=RootSwCompositionPrototype.CPT_Asw_Swc.BEM_BCU.BEM_SPN3906_Timeout_CST, ecu-extract-reference=CPT_BMSL_FlatView.CPT_Asw_Swc.BEM_BCU.BEM_SPN3906_Timeout_CST
      BEM_SPN3905_Timeout_CCS: sw-refresh-timing={cse-code=3, cse-code-factor=5}, upstream-reference=RootSwCompositionPrototype.CPT_Asw_Swc.BEM_BCU.BEM_SPN3905_Timeout_CCS, ecu-extract-reference=CPT_BMSL_FlatView.CPT_Asw_Swc.BEM_BCU.BEM_SPN3905_Timeout_CCS
      BEM_SPN3904_Timeout_CRO: sw-refresh-timing={cse-code=3, cse-code-factor=5}, upstream-reference=RootSwCompositionPrototype.CPT_Asw_Swc.BEM_BCU.BEM_SPN3904_Timeout_CRO, ecu-extract-reference=CPT_BMSL_FlatView.CPT_Asw_Swc.BEM_BCU.BEM_SPN3904_Timeout_CRO
      BEM_SPN3903_Timeout_CTS_CML: sw-refresh-timing={cse-code=3, cse-code-factor=5}, upstream-reference=RootSwCompositionPrototype.CPT_Asw_Swc.BEM_BCU.BEM_SPN3903_Timeout_CTS_CML, ecu-extract-reference=CPT_BMSL_FlatView.CPT_Asw_Swc.BEM_BCU.BEM_SPN3903_Timeout_CTS_CML
      BEM_SPN3902_Timeout_SPN2560_0xAA: sw-refresh-timing={cse-code=3, cse-code-factor=5}, upstream-reference=RootSwCompositionPrototype.CPT_Asw_Swc.BEM_BCU.BEM_SPN3902_Timeout_SPN2560_0xAA, ecu-extract-reference=CPT_BMSL_FlatView.CPT_Asw_Swc.BEM_BCU.BEM_SPN3902_Timeout_SPN2560_0xAA
      BEM_SPN3901_Timeout_SPN2560_0x00: sw-refresh-timing={cse-code=3, cse-code-factor=5}, upstream-reference=RootSwCompositionPrototype.CPT_Asw_Swc.BEM_BCU.BEM_SPN3901_Timeout_SPN2560_0x00, ecu-extract-reference=CPT_BMSL_FlatView.CPT_Asw_Swc.BEM_BCU.BEM_SPN3901_Timeout_SPN2560_0x00
      BHM_SPN2601_Ubat_Max_Permit: sw-refresh-timing={cse-code=3, cse-code-factor=5}, upstream-reference=RootSwCompositionPrototype.CPT_Asw_Swc.BHM_BCU.BHM_SPN2601_Ubat_Max_Permit, ecu-extract-reference=CPT_BMSL_FlatView.CPT_Asw_Swc.BHM_BCU.BHM_SPN2601_Ubat_Max_Permit
      BRM_SPN2576_BMSVer_Year: sw-refresh-timing={cse-code=3, cse-code-factor=5}, upstream-reference=RootSwCompositionPrototype.CPT_Asw_Swc.BRM_BCU.BRM_SPN2576_BMSVer_Year, ecu-extract-reference=CPT_BMSL_FlatView.CPT_Asw_Swc.BRM_BCU.BRM_SPN2576_BMSVer_Year
      BRM_SPN2576_BMSVer_Version: sw-refresh-timing={cse-code=3, cse-code-factor=5}, upstream-reference=RootSwCompositionPrototype.CPT_Asw_Swc.BRM_BCU.BRM_SPN2576_BMSVer_Version, ecu-extract-reference=CPT_BMSL_FlatView.CPT_Asw_Swc.BRM_BCU.BRM_SPN2576_BMSVer_Version
      BRM_SPN2576_BMSVer_Reserver: sw-refresh-timing={cse-code=3, cse-code-factor=5}, upstream-reference=RootSwCompositionPrototype.CPT_Asw_Swc.BRM_BCU.BRM_SPN2576_BMSVer_Reserver, ecu-extract-reference=CPT_BMSL_FlatView.CPT_Asw_Swc.BRM_BCU.BRM_SPN2576_BMSVer_Reserver
      BRM_SPN2576_BMSVer_Month: sw-refresh-timing={cse-code=3, cse-code-factor=5}, upstream-reference=RootSwCompositionPrototype.CPT_Asw_Swc.BRM_BCU.BRM_SPN2576_BMSVer_Month, ecu-extract-reference=CPT_BMSL_FlatView.CPT_Asw_Swc.BRM_BCU.BRM_SPN2576_BMSVer_Month
      BRM_SPN2576_BMSVer_Day: sw-refresh-timing={cse-code=3, cse-code-factor=5}, upstream-reference=RootSwCompositionPrototype.CPT_Asw_Swc.BRM_BCU.BRM_SPN2576_BMSVer_Day, ecu-extract-reference=CPT_BMSL_FlatView.CPT_Asw_Swc.BRM_BCU.BRM_SPN2576_BMSVer_Day
      BRM_SPN2575_VIN{1..17}: sw-refresh-timing={cse-code=3, cse-code-factor=5}, upstream-reference=RootSwCompositionPrototype.CPT_Asw_Swc.BRM_BCU.BRM_SPN2575_VIN{1..17}, ecu-extract-reference=CPT_BMSL_FlatView.CPT_Asw_Swc.BRM_BCU.BRM_SPN2575_VIN{1..17}
      BRM_SPN2574_BMSSW_Reserved: sw-refresh-timing={cse-code=3, cse-code-factor=5}, upstream-reference=RootSwCompositionPrototype.CPT_Asw_Swc.BRM_BCU.BRM_SPN2574_BMSSW_Reserved, ecu-extract-reference=CPT_BMSL_FlatView.CPT_Asw_Swc.BRM_BCU.BRM_SPN2574_BMSSW_Reserved
      BRM_SPN2572_PackChgCnt: sw-refresh-timing={cse-code=3, cse-code-factor=5}, upstream-reference=RootSwCompositionPrototype.CPT_Asw_Swc.BRM_BCU.BRM_SPN2572_PackChgCnt, ecu-extract-reference=CPT_BMSL_FlatView.CPT_Asw_Swc.BRM_BCU.BRM_SPN2572_PackChgCnt
      BRM_SPN2573_PackRight: sw-refresh-timing={cse-code=3, cse-code-factor=5}, upstream-reference=RootSwCompositionPrototype.CPT_Asw_Swc.BRM_BCU.BRM_SPN2573_PackRight, ecu-extract-reference=CPT_BMSL_FlatView.CPT_Asw_Swc.BRM_BCU.BRM_SPN2573_PackRight
      BRM_SPN2571_PackDay: sw-refresh-timing={cse-code=3, cse-code-factor=5}, upstream-reference=RootSwCompositionPrototype.CPT_Asw_Swc.BRM_BCU.BRM_SPN2571_PackDay, ecu-extract-reference=CPT_BMSL_FlatView.CPT_Asw_Swc.BRM_BCU.BRM_SPN2571_PackDay
      BRM_SPN2571_PackMonth: sw-refresh-timing={cse-code=3, cse-code-factor=5}, upstream-reference=RootSwCompositionPrototype.CPT_Asw_Swc.BRM_BCU.BRM_SPN2571_PackMonth, ecu-extract-reference=CPT_BMSL_FlatView.CPT_Asw_Swc.BRM_BCU.BRM_SPN2571_PackMonth
      BRM_SPN2571_PackYear: sw-refresh-timing={cse-code=3, cse-code-factor=5}, upstream-reference=RootSwCompositionPrototype.CPT_Asw_Swc.BRM_BCU.BRM_SPN2571_PackYear, ecu-extract-reference=CPT_BMSL_FlatView.CPT_Asw_Swc.BRM_BCU.BRM_SPN2571_PackYear
      BRM_SPN2570_PackSN: sw-refresh-timing={cse-code=3, cse-code-factor=5}, upstream-reference=RootSwCompositionPrototype.CPT_Asw_Swc.BRM_BCU.BRM_SPN2570_PackSN, ecu-extract-reference=CPT_BMSL_FlatView.CPT_Asw_Swc.BRM_BCU.BRM_SPN2570_PackSN
      BRM_SPN2569_BatFactory: sw-refresh-timing={cse-code=3, cse-code-factor=5}, upstream-reference=RootSwCompositionPrototype.CPT_Asw_Swc.BRM_BCU.BRM_SPN2569_BatFactory, ecu-extract-reference=CPT_BMSL_FlatView.CPT_Asw_Swc.BRM_BCU.BRM_SPN2569_BatFactory
      BRM_SPN2565_Ver: sw-refresh-timing={cse-code=3, cse-code-factor=5}, upstream-reference=RootSwCompositionPrototype.CPT_Asw_Swc.BRM_BCU.BRM_SPN2565_Ver, ecu-extract-reference=CPT_BMSL_FlatView.CPT_Asw_Swc.BRM_BCU.BRM_SPN2565_Ver
      BRM_SPN2566_Bat_Type: sw-refresh-timing={cse-code=3, cse-code-factor=5}, upstream-reference=RootSwCompositionPrototype.CPT_Asw_Swc.BRM_BCU.BRM_SPN2566_Bat_Type, ecu-extract-reference=CPT_BMSL_FlatView.CPT_Asw_Swc.BRM_BCU.BRM_SPN2566_Bat_Type
      BRM_SPN2567_Cap_Nom: sw-refresh-timing={cse-code=3, cse-code-factor=5}, upstream-reference=RootSwCompositionPrototype.CPT_Asw_Swc.BRM_BCU.BRM_SPN2567_Cap_Nom, ecu-extract-reference=CPT_BMSL_FlatView.CPT_Asw_Swc.BRM_BCU.BRM_SPN2567_Cap_Nom
      BRM_SPN2568_U_Nom: sw-refresh-timing={cse-code=3, cse-code-factor=5}, upstream-reference=RootSwCompositionPrototype.CPT_Asw_Swc.BRM_BCU.BRM_SPN2568_U_Nom, ecu-extract-reference=CPT_BMSL_FlatView.CPT_Asw_Swc.BRM_BCU.BRM_SPN2568_U_Nom
      BRO_SPN2829_BCU_Ready: sw-refresh-timing={cse-code=3, cse-code-factor=5}, upstream-reference=RootSwCompositionPrototype.CPT_Asw_Swc.BRO_BCU.BRO_SPN2829_BCU_Ready, ecu-extract-reference=CPT_BMSL_FlatView.CPT_Asw_Swc.BRO_BCU.BRO_SPN2829_BCU_Ready
      BSD_SPN3605_T_Max: sw-refresh-timing={cse-code=3, cse-code-factor=5}, upstream-reference=RootSwCompositionPrototype.CPT_Asw_Swc.BSD_BCU.BSD_SPN3605_T_Max, ecu-extract-reference=CPT_BMSL_FlatView.CPT_Asw_Swc.BSD_BCU.BSD_SPN3605_T_Max
      BSD_SPN3604_T_Min: sw-refresh-timing={cse-code=3, cse-code-factor=5}, upstream-reference=RootSwCompositionPrototype.CPT_Asw_Swc.BSD_BCU.BSD_SPN3604_T_Min, ecu-extract-reference=CPT_BMSL_FlatView.CPT_Asw_Swc.BSD_BCU.BSD_SPN3604_T_Min
      BSD_SPN3603_Ucell_Max: sw-refresh-timing={cse-code=3, cse-code-factor=5}, upstream-reference=RootSwCompositionPrototype.CPT_Asw_Swc.BSD_BCU.BSD_SPN3603_Ucell_Max, ecu-extract-reference=CPT_BMSL_FlatView.CPT_Asw_Swc.BSD_BCU.BSD_SPN3603_Ucell_Max
      BSD_SPN3602_Ucell_Min: sw-refresh-timing={cse-code=3, cse-code-factor=5}, upstream-reference=RootSwCompositionPrototype.CPT_Asw_Swc.BSD_BCU.BSD_SPN3602_Ucell_Min, ecu-extract-reference=CPT_BMSL_FlatView.CPT_Asw_Swc.BSD_BCU.BSD_SPN3602_Ucell_Min
      BSD_SPN3601_SOC_Final: sw-refresh-timing={cse-code=3, cse-code-factor=5}, upstream-reference=RootSwCompositionPrototype.CPT_Asw_Swc.BSD_BCU.BSD_SPN3601_SOC_Final, ecu-extract-reference=CPT_BMSL_FlatView.CPT_Asw_Swc.BSD_BCU.BSD_SPN3601_SOC_Final
      BSM_SPN3096_Chg_Enable: sw-refresh-timing={cse-code=3, cse-code-factor=5}, upstream-reference=RootSwCompositionPrototype.CPT_Asw_Swc.BSM_BCU.BSM_SPN3096_Chg_Enable, ecu-extract-reference=CPT_BMSL_FlatView.CPT_Asw_Swc.BSM_BCU.BSM_SPN3096_Chg_Enable
      BSM_SPN3095_OutConnector_State: sw-refresh-timing={cse-code=3, cse-code-factor=5}, upstream-reference=RootSwCompositionPrototype.CPT_Asw_Swc.BSM_BCU.BSM_SPN3095_OutConnector_State, ecu-extract-reference=CPT_BMSL_FlatView.CPT_Asw_Swc.BSM_BCU.BSM_SPN3095_OutConnector_State
      BSM_SPN3094_Iso_State: sw-refresh-timing={cse-code=3, cse-code-factor=5}, upstream-reference=RootSwCompositionPrototype.CPT_Asw_Swc.BSM_BCU.BSM_SPN3094_Iso_State, ecu-extract-reference=CPT_BMSL_FlatView.CPT_Asw_Swc.BSM_BCU.BSM_SPN3094_Iso_State
      BSM_SPN3093_T_Warn: sw-refresh-timing={cse-code=3, cse-code-factor=5}, upstream-reference=RootSwCompositionPrototype.CPT_Asw_Swc.BSM_BCU.BSM_SPN3093_T_Warn, ecu-extract-reference=CPT_BMSL_FlatView.CPT_Asw_Swc.BSM_BCU.BSM_SPN3093_T_Warn
      BSM_SPN3092_I_Warn: sw-refresh-timing={cse-code=3, cse-code-factor=5}, upstream-reference=RootSwCompositionPrototype.CPT_Asw_Swc.BSM_BCU.BSM_SPN3092_I_Warn, ecu-extract-reference=CPT_BMSL_FlatView.CPT_Asw_Swc.BSM_BCU.BSM_SPN3092_I_Warn
      BSM_SPN3091_SOC_Warn: sw-refresh-timing={cse-code=3, cse-code-factor=5}, upstream-reference=RootSwCompositionPrototype.CPT_Asw_Swc.BSM_BCU.BSM_SPN3091_SOC_Warn, ecu-extract-reference=CPT_BMSL_FlatView.CPT_Asw_Swc.BSM_BCU.BSM_SPN3091_SOC_Warn
      BSM_SPN3090_Ucell_Warn: sw-refresh-timing={cse-code=3, cse-code-factor=5}, upstream-reference=RootSwCompositionPrototype.CPT_Asw_Swc.BSM_BCU.BSM_SPN3090_Ucell_Warn, ecu-extract-reference=CPT_BMSL_FlatView.CPT_Asw_Swc.BSM_BCU.BSM_SPN3090_Ucell_Warn
      BSM_SPN3089_T_Min_Index: sw-refresh-timing={cse-code=3, cse-code-factor=5}, upstream-reference=RootSwCompositionPrototype.CPT_Asw_Swc.BSM_BCU.BSM_SPN3089_T_Min_Index, ecu-extract-reference=CPT_BMSL_FlatView.CPT_Asw_Swc.BSM_BCU.BSM_SPN3089_T_Min_Index
      BSM_SPN3088_T_Min: sw-refresh-timing={cse-code=3, cse-code-factor=5}, upstream-reference=RootSwCompositionPrototype.CPT_Asw_Swc.BSM_BCU.BSM_SPN3088_T_Min, ecu-extract-reference=CPT_BMSL_FlatView.CPT_Asw_Swc.BSM_BCU.BSM_SPN3088_T_Min
      BSM_SPN3087_T_Max_Index: sw-refresh-timing={cse-code=3, cse-code-factor=5}, upstream-reference=RootSwCompositionPrototype.CPT_Asw_Swc.BSM_BCU.BSM_SPN3087_T_Max_Index, ecu-extract-reference=CPT_BMSL_FlatView.CPT_Asw_Swc.BSM_BCU.BSM_SPN3087_T_Max_Index
      BSM_SPN3086_T_Max: sw-refresh-timing={cse-code=3, cse-code-factor=5}, upstream-reference=RootSwCompositionPrototype.CPT_Asw_Swc.BSM_BCU.BSM_SPN3086_T_Max, ecu-extract-reference=CPT_BMSL_FlatView.CPT_Asw_Swc.BSM_BCU.BSM_SPN3086_T_Max
      BSM_SPN3085_Ucell_Max_Index: sw-refresh-timing={cse-code=3, cse-code-factor=5}, upstream-reference=RootSwCompositionPrototype.CPT_Asw_Swc.BSM_BCU.BSM_SPN3085_Ucell_Max_Index, ecu-extract-reference=CPT_BMSL_FlatView.CPT_Asw_Swc.BSM_BCU.BSM_SPN3085_Ucell_Max_Index
      BST_SPN3512_Stop_Fault_HVRelay: sw-refresh-timing={cse-code=3, cse-code-factor=5}, upstream-reference=RootSwCompositionPrototype.CPT_Asw_Swc.BST_BCU.BST_SPN3512_Stop_Fault_HVRelay, ecu-extract-reference=CPT_BMSL_FlatView.CPT_Asw_Swc.BST_BCU.BST_SPN3512_Stop_Fault_HVRelay
      BST_SPN3512_Stop_Fault_CC2: sw-refresh-timing={cse-code=3, cse-code-factor=5}, upstream-reference=RootSwCompositionPrototype.CPT_Asw_Swc.BST_BCU.BST_SPN3512_Stop_Fault_CC2, ecu-extract-reference=CPT_BMSL_FlatView.CPT_Asw_Swc.BST_BCU.BST_SPN3512_Stop_Fault_CC2
      BST_SPN3511_Stop_Reason_CHGStop: sw-refresh-timing={cse-code=3, cse-code-factor=5}, upstream-reference=RootSwCompositionPrototype.CPT_Asw_Swc.BST_BCU.BST_SPN3511_Stop_Reason_CHGStop, ecu-extract-reference=CPT_BMSL_FlatView.CPT_Asw_Swc.BST_BCU.BST_SPN3511_Stop_Reason_CHGStop
      BST_SPN3513_Stop_Fault_U: sw-refresh-timing={cse-code=3, cse-code-factor=5}, upstream-reference=RootSwCompositionPrototype.CPT_Asw_Swc.BST_BCU.BST_SPN3513_Stop_Fault_U, ecu-extract-reference=CPT_BMSL_FlatView.CPT_Asw_Swc.BST_BCU.BST_SPN3513_Stop_Fault_U
      BST_SPN3513_Stop_Fault_I: sw-refresh-timing={cse-code=3, cse-code-factor=5}, upstream-reference=RootSwCompositionPrototype.CPT_Asw_Swc.BST_BCU.BST_SPN3513_Stop_Fault_I, ecu-extract-reference=CPT_BMSL_FlatView.CPT_Asw_Swc.BST_BCU.BST_SPN3513_Stop_Fault_I
      BST_SPN3512_Stop_Fault_T: sw-refresh-timing={cse-code=3, cse-code-factor=5}, upstream-reference=RootSwCompositionPrototype.CPT_Asw_Swc.BST_BCU.BST_SPN3512_Stop_Fault_T, ecu-extract-reference=CPT_BMSL_FlatView.CPT_Asw_Swc.BST_BCU.BST_SPN3512_Stop_Fault_T
      BST_SPN3512_Stop_Fault_Other: sw-refresh-timing={cse-code=3, cse-code-factor=5}, upstream-reference=RootSwCompositionPrototype.CPT_Asw_Swc.BST_BCU.BST_SPN3512_Stop_Fault_Other, ecu-extract-reference=CPT_BMSL_FlatView.CPT_Asw_Swc.BST_BCU.BST_SPN3512_Stop_Fault_Other
      BST_SPN3512_Stop_Fault_Iso: sw-refresh-timing={cse-code=3, cse-code-factor=5}, upstream-reference=RootSwCompositionPrototype.CPT_Asw_Swc.BST_BCU.BST_SPN3512_Stop_Fault_Iso, ecu-extract-reference=CPT_BMSL_FlatView.CPT_Asw_Swc.BST_BCU.BST_SPN3512_Stop_Fault_Iso
      BST_SPN3512_Stop_Fault_OutCnnt: sw-refresh-timing={cse-code=3, cse-code-factor=5}, upstream-reference=RootSwCompositionPrototype.CPT_Asw_Swc.BST_BCU.BST_SPN3512_Stop_Fault_OutCnnt, ecu-extract-reference=CPT_BMSL_FlatView.CPT_Asw_Swc.BST_BCU.BST_SPN3512_Stop_Fault_OutCnnt
      BST_SPN3512_Stop_Fault_BCUcompo: sw-refresh-timing={cse-code=3, cse-code-factor=5}, upstream-reference=RootSwCompositionPrototype.CPT_Asw_Swc.BST_BCU.BST_SPN3512_Stop_Fault_BCUcompo, ecu-extract-reference=CPT_BMSL_FlatView.CPT_Asw_Swc.BST_BCU.BST_SPN3512_Stop_Fault_BCUcompo
      BST_SPN3512_Stop_Fault_ChgCnnt: sw-refresh-timing={cse-code=3, cse-code-factor=5}, upstream-reference=RootSwCompositionPrototype.CPT_Asw_Swc.BST_BCU.BST_SPN3512_Stop_Fault_ChgCnnt, ecu-extract-reference=CPT_BMSL_FlatView.CPT_Asw_Swc.BST_BCU.BST_SPN3512_Stop_Fault_ChgCnnt
      BST_SPN3511_Stop_Reason_Ucell: sw-refresh-timing={cse-code=3, cse-code-factor=5}, upstream-reference=RootSwCompositionPrototype.CPT_Asw_Swc.BST_BCU.BST_SPN3511_Stop_Reason_Ucell, ecu-extract-reference=CPT_BMSL_FlatView.CPT_Asw_Swc.BST_BCU.BST_SPN3511_Stop_Reason_Ucell
      BST_SPN3511_Stop_Reason_U: sw-refresh-timing={cse-code=3, cse-code-factor=5}, upstream-reference=RootSwCompositionPrototype.CPT_Asw_Swc.BST_BCU.BST_SPN3511_Stop_Reason_U, ecu-extract-reference=CPT_BMSL_FlatView.CPT_Asw_Swc.BST_BCU.BST_SPN3511_Stop_Reason_U
      BST_SPN3511_Stop_Reason_SOC: sw-refresh-timing={cse-code=3, cse-code-factor=5}, upstream-reference=RootSwCompositionPrototype.CPT_Asw_Swc.BST_BCU.BST_SPN3511_Stop_Reason_SOC, ecu-extract-reference=CPT_BMSL_FlatView.CPT_Asw_Swc.BST_BCU.BST_SPN3511_Stop_Reason_SOC
      CCS_SPN3081_U_Out: sw-refresh-timing={cse-code=3, cse-code-factor=5}, upstream-reference=RootSwCompositionPrototype.CPT_Asw_Swc.CCS_CHG.CCS_SPN3081_U_Out, ecu-extract-reference=CPT_BMSL_FlatView.CPT_Asw_Swc.CCS_CHG.CCS_SPN3081_U_Out
      CCS_SPN3082_I_Out: sw-refresh-timing={cse-code=3, cse-code-factor=5}, upstream-reference=RootSwCompositionPrototype.CPT_Asw_Swc.CCS_CHG.CCS_SPN3082_I_Out, ecu-extract-reference=CPT_BMSL_FlatView.CPT_Asw_Swc.CCS_CHG.CCS_SPN3082_I_Out
      CCS_SPN3083_Time_Charged: sw-refresh-timing={cse-code=3, cse-code-factor=5}, upstream-reference=RootSwCompositionPrototype.CPT_Asw_Swc.CCS_CHG.CCS_SPN3083_Time_Charged, ecu-extract-reference=CPT_BMSL_FlatView.CPT_Asw_Swc.CCS_CHG.CCS_SPN3083_Time_Charged
      CCS_SPN3929_Chg_enable: sw-refresh-timing={cse-code=3, cse-code-factor=5}, upstream-reference=RootSwCompositionPrototype.CPT_Asw_Swc.CCS_CHG.CCS_SPN3929_Chg_enable, ecu-extract-reference=CPT_BMSL_FlatView.CPT_Asw_Swc.CCS_CHG.CCS_SPN3929_Chg_enable
      CEM_other: sw-refresh-timing={cse-code=3, cse-code-factor=5}, upstream-reference=RootSwCompositionPrototype.CPT_Asw_Swc.CEM_CHG.CEM_other, ecu-extract-reference=CPT_BMSL_FlatView.CPT_Asw_Swc.CEM_CHG.CEM_other
      CEM_SPN3927_Timeout_BSD: sw-refresh-timing={cse-code=3, cse-code-factor=5}, upstream-reference=RootSwCompositionPrototype.CPT_Asw_Swc.CEM_CHG.CEM_SPN3927_Timeout_BSD, ecu-extract-reference=CPT_BMSL_FlatView.CPT_Asw_Swc.CEM_CHG.CEM_SPN3927_Timeout_BSD
      CEM_SPN3926_Timeout_BST: sw-refresh-timing={cse-code=3, cse-code-factor=5}, upstream-reference=RootSwCompositionPrototype.CPT_Asw_Swc.CEM_CHG.CEM_SPN3926_Timeout_BST, ecu-extract-reference=CPT_BMSL_FlatView.CPT_Asw_Swc.CEM_CHG.CEM_SPN3926_Timeout_BST
      CEM_SPN3925_Timeout_BCL: sw-refresh-timing={cse-code=3, cse-code-factor=5}, upstream-reference=RootSwCompositionPrototype.CPT_Asw_Swc.CEM_CHG.CEM_SPN3925_Timeout_BCL, ecu-extract-reference=CPT_BMSL_FlatView.CPT_Asw_Swc.CEM_CHG.CEM_SPN3925_Timeout_BCL
      CEM_SPN3924_Timeout_BCS: sw-refresh-timing={cse-code=3, cse-code-factor=5}, upstream-reference=RootSwCompositionPrototype.CPT_Asw_Swc.CEM_CHG.CEM_SPN3924_Timeout_BCS, ecu-extract-reference=CPT_BMSL_FlatView.CPT_Asw_Swc.CEM_CHG.CEM_SPN3924_Timeout_BCS
      CEM_SPN3923_Timeout_BRO: sw-refresh-timing={cse-code=3, cse-code-factor=5}, upstream-reference=RootSwCompositionPrototype.CPT_Asw_Swc.CEM_CHG.CEM_SPN3923_Timeout_BRO, ecu-extract-reference=CPT_BMSL_FlatView.CPT_Asw_Swc.CEM_CHG.CEM_SPN3923_Timeout_BRO
      CEM_SPN3922_Timeout_BCP: sw-refresh-timing={cse-code=3, cse-code-factor=5}, upstream-reference=RootSwCompositionPrototype.CPT_Asw_Swc.CEM_CHG.CEM_SPN3922_Timeout_BCP, ecu-extract-reference=CPT_BMSL_FlatView.CPT_Asw_Swc.CEM_CHG.CEM_SPN3922_Timeout_BCP
      CEM_SPN3921_Timeout_BRM: sw-refresh-timing={cse-code=3, cse-code-factor=5}, upstream-reference=RootSwCompositionPrototype.CPT_Asw_Swc.CEM_CHG.CEM_SPN3921_Timeout_BRM, ecu-extract-reference=CPT_BMSL_FlatView.CPT_Asw_Swc.CEM_CHG.CEM_SPN3921_Timeout_BRM
      CHM_SPN2600_Comm_Ver: sw-refresh-timing={cse-code=3, cse-code-factor=5}, upstream-reference=RootSwCompositionPrototype.CPT_Asw_Swc.CHM_CHG.CHM_SPN2600_Comm_Ver, ecu-extract-reference=CPT_BMSL_FlatView.CPT_Asw_Swc.CHM_CHG.CHM_SPN2600_Comm_Ver
      CML_SPN2827_I_Min_Out: sw-refresh-timing={cse-code=3, cse-code-factor=5}, upstream-reference=RootSwCompositionPrototype.CPT_Asw_Swc.CML_CHG.CML_SPN2827_I_Min_Out, ecu-extract-reference=CPT_BMSL_FlatView.CPT_Asw_Swc.CML_CHG.CML_SPN2827_I_Min_Out
      CML_SPN2826_I_Max_Out: sw-refresh-timing={cse-code=3, cse-code-factor=5}, upstream-reference=RootSwCompositionPrototype.CPT_Asw_Swc.CML_CHG.CML_SPN2826_I_Max_Out, ecu-extract-reference=CPT_BMSL_FlatView.CPT_Asw_Swc.CML_CHG.CML_SPN2826_I_Max_Out
      CML_SPN2825_U_Min_Out: sw-refresh-timing={cse-code=3, cse-code-factor=5}, upstream-reference=RootSwCompositionPrototype.CPT_Asw_Swc.CML_CHG.CML_SPN2825_U_Min_Out, ecu-extract-reference=CPT_BMSL_FlatView.CPT_Asw_Swc.CML_CHG.CML_SPN2825_U_Min_Out
      CML_SPN2824_U_Max_Out: sw-refresh-timing={cse-code=3, cse-code-factor=5}, upstream-reference=RootSwCompositionPrototype.CPT_Asw_Swc.CML_CHG.CML_SPN2824_U_Max_Out, ecu-extract-reference=CPT_BMSL_FlatView.CPT_Asw_Swc.CML_CHG.CML_SPN2824_U_Max_Out
      CRM_SPN2562_CHG_Loc: sw-refresh-timing={cse-code=3, cse-code-factor=5}, upstream-reference=RootSwCompositionPrototype.CPT_Asw_Swc.CRM_CHG.CRM_SPN2562_CHG_Loc, ecu-extract-reference=CPT_BMSL_FlatView.CPT_Asw_Swc.CRM_CHG.CRM_SPN2562_CHG_Loc
      CRM_SPN2561_CHG_Index: sw-refresh-timing={cse-code=3, cse-code-factor=5}, upstream-reference=RootSwCompositionPrototype.CPT_Asw_Swc.CRM_CHG.CRM_SPN2561_CHG_Index, ecu-extract-reference=CPT_BMSL_FlatView.CPT_Asw_Swc.CRM_CHG.CRM_SPN2561_CHG_Index
      CRM_SPN2560_Ack: sw-refresh-timing={cse-code=3, cse-code-factor=5}, upstream-reference=RootSwCompositionPrototype.CPT_Asw_Swc.CRM_CHG.CRM_SPN2560_Ack, ecu-extract-reference=CPT_BMSL_FlatView.CPT_Asw_Swc.CRM_CHG.CRM_SPN2560_Ack
      CRO_SPN2830_CHG_Ready: sw-refresh-timing={cse-code=3, cse-code-factor=5}, upstream-reference=RootSwCompositionPrototype.CPT_Asw_Swc.CRO_CHG.CRO_SPN2830_CHG_Ready, ecu-extract-reference=CPT_BMSL_FlatView.CPT_Asw_Swc.CRO_CHG.CRO_SPN2830_CHG_Ready
      CSD_SPN3613_CHG_Index: sw-refresh-timing={cse-code=3, cse-code-factor=5}, upstream-reference=RootSwCompositionPrototype.CPT_Asw_Swc.CSD_CHG.CSD_SPN3613_CHG_Index, ecu-extract-reference=CPT_BMSL_FlatView.CPT_Asw_Swc.CSD_CHG.CSD_SPN3613_CHG_Index
      CSD_SPN3612_E_Out: sw-refresh-timing={cse-code=3, cse-code-factor=5}, upstream-reference=RootSwCompositionPrototype.CPT_Asw_Swc.CSD_CHG.CSD_SPN3612_E_Out, ecu-extract-reference=CPT_BMSL_FlatView.CPT_Asw_Swc.CSD_CHG.CSD_SPN3612_E_Out
      CSD_SPN3611_Time_Charged: sw-refresh-timing={cse-code=3, cse-code-factor=5}, upstream-reference=RootSwCompositionPrototype.CPT_Asw_Swc.CSD_CHG.CSD_SPN3611_Time_Charged, ecu-extract-reference=CPT_BMSL_FlatView.CPT_Asw_Swc.CSD_CHG.CSD_SPN3611_Time_Charged
      CST_SPN3521_Stop_Reason_BMSStop: sw-refresh-timing={cse-code=3, cse-code-factor=5}, upstream-reference=RootSwCompositionPrototype.CPT_Asw_Swc.CST_CHG.CST_SPN3521_Stop_Reason_BMSStop, ecu-extract-reference=CPT_BMSL_FlatView.CPT_Asw_Swc.CST_CHG.CST_SPN3521_Stop_Reason_BMSStop
      CST_SPN3523_Stop_Fault_U: sw-refresh-timing={cse-code=3, cse-code-factor=5}, upstream-reference=RootSwCompositionPrototype.CPT_Asw_Swc.CST_CHG.CST_SPN3523_Stop_Fault_U, ecu-extract-reference=CPT_BMSL_FlatView.CPT_Asw_Swc.CST_CHG.CST_SPN3523_Stop_Fault_U
      CST_SPN3523_Stop_Fault_Mismatch: sw-refresh-timing={cse-code=3, cse-code-factor=5}, upstream-reference=RootSwCompositionPrototype.CPT_Asw_Swc.CST_CHG.CST_SPN3523_Stop_Fault_Mismatch, ecu-extract-reference=CPT_BMSL_FlatView.CPT_Asw_Swc.CST_CHG.CST_SPN3523_Stop_Fault_Mismatch
      CST_SPN3522_Stop_Fault_T_Inter: sw-refresh-timing={cse-code=3, cse-code-factor=5}, upstream-reference=RootSwCompositionPrototype.CPT_Asw_Swc.CST_CHG.CST_SPN3522_Stop_Fault_T_Inter, ecu-extract-reference=CPT_BMSL_FlatView.CPT_Asw_Swc.CST_CHG.CST_SPN3522_Stop_Fault_T_Inter
      CST_SPN3522_Stop_Fault_T_CHG: sw-refresh-timing={cse-code=3, cse-code-factor=5}, upstream-reference=RootSwCompositionPrototype.CPT_Asw_Swc.CST_CHG.CST_SPN3522_Stop_Fault_T_CHG, ecu-extract-reference=CPT_BMSL_FlatView.CPT_Asw_Swc.CST_CHG.CST_SPN3522_Stop_Fault_T_CHG
      CST_SPN3522_Stop_Fault_Other: sw-refresh-timing={cse-code=3, cse-code-factor=5}, upstream-reference=RootSwCompositionPrototype.CPT_Asw_Swc.CST_CHG.CST_SPN3522_Stop_Fault_Other, ecu-extract-reference=CPT_BMSL_FlatView.CPT_Asw_Swc.CST_CHG.CST_SPN3522_Stop_Fault_Other
      CST_SPN3522_Stop_Fault_EmerStop: sw-refresh-timing={cse-code=3, cse-code-factor=5}, upstream-reference=RootSwCompositionPrototype.CPT_Asw_Swc.CST_CHG.CST_SPN3522_Stop_Fault_EmerStop, ecu-extract-reference=CPT_BMSL_FlatView.CPT_Asw_Swc.CST_CHG.CST_SPN3522_Stop_Fault_EmerStop
      CST_SPN3522_Stop_Fault_Deliver: sw-refresh-timing={cse-code=3, cse-code-factor=5}, upstream-reference=RootSwCompositionPrototype.CPT_Asw_Swc.CST_CHG.CST_SPN3522_Stop_Fault_Deliver, ecu-extract-reference=CPT_BMSL_FlatView.CPT_Asw_Swc.CST_CHG.CST_SPN3522_Stop_Fault_Deliver
      CST_SPN3522_Stop_Fault_CHGCnnt: sw-refresh-timing={cse-code=3, cse-code-factor=5}, upstream-reference=RootSwCompositionPrototype.CPT_Asw_Swc.CST_CHG.CST_SPN3522_Stop_Fault_CHGCnnt, ecu-extract-reference=CPT_BMSL_FlatView.CPT_Asw_Swc.CST_CHG.CST_SPN3522_Stop_Fault_CHGCnnt
      CST_SPN3521_Stop_Reason_Manual: sw-refresh-timing={cse-code=3, cse-code-factor=5}, upstream-reference=RootSwCompositionPrototype.CPT_Asw_Swc.CST_CHG.CST_SPN3521_Stop_Reason_Manual, ecu-extract-reference=CPT_BMSL_FlatView.CPT_Asw_Swc.CST_CHG.CST_SPN3521_Stop_Reason_Manual
      CST_SPN3521_Stop_Reason_Fault: sw-refresh-timing={cse-code=3, cse-code-factor=5}, upstream-reference=RootSwCompositionPrototype.CPT_Asw_Swc.CST_CHG.CST_SPN3521_Stop_Reason_Fault, ecu-extract-reference=CPT_BMSL_FlatView.CPT_Asw_Swc.CST_CHG.CST_SPN3521_Stop_Reason_Fault
      CST_SPN3521_Stop_Reason_Auto: sw-refresh-timing={cse-code=3, cse-code-factor=5}, upstream-reference=RootSwCompositionPrototype.CPT_Asw_Swc.CST_CHG.CST_SPN3521_Stop_Reason_Auto, ecu-extract-reference=CPT_BMSL_FlatView.CPT_Asw_Swc.CST_CHG.CST_SPN3521_Stop_Reason_Auto
      CTS_SPN2823_SYNC_YearThousand: sw-refresh-timing={cse-code=3, cse-code-factor=5}, upstream-reference=RootSwCompositionPrototype.CPT_Asw_Swc.CTS_CHG.CTS_SPN2823_SYNC_YearThousand, ecu-extract-reference=CPT_BMSL_FlatView.CPT_Asw_Swc.CTS_CHG.CTS_SPN2823_SYNC_YearThousand
      CTS_SPN2823_SYNC_YearTen: sw-refresh-timing={cse-code=3, cse-code-factor=5}, upstream-reference=RootSwCompositionPrototype.CPT_Asw_Swc.CTS_CHG.CTS_SPN2823_SYNC_YearTen, ecu-extract-reference=CPT_BMSL_FlatView.CPT_Asw_Swc.CTS_CHG.CTS_SPN2823_SYNC_YearTen
      CTS_SPN2823_SYNC_YearHundred: sw-refresh-timing={cse-code=3, cse-code-factor=5}, upstream-reference=RootSwCompositionPrototype.CPT_Asw_Swc.CTS_CHG.CTS_SPN2823_SYNC_YearHundred, ecu-extract-reference=CPT_BMSL_FlatView.CPT_Asw_Swc.CTS_CHG.CTS_SPN2823_SYNC_YearHundred
      CTS_SPN2823_SYNC_Year: sw-refresh-timing={cse-code=3, cse-code-factor=5}, upstream-reference=RootSwCompositionPrototype.CPT_Asw_Swc.CTS_CHG.CTS_SPN2823_SYNC_Year, ecu-extract-reference=CPT_BMSL_FlatView.CPT_Asw_Swc.CTS_CHG.CTS_SPN2823_SYNC_Year
      CTS_SPN2823_SYNC_SecondTen: sw-refresh-timing={cse-code=3, cse-code-factor=5}, upstream-reference=RootSwCompositionPrototype.CPT_Asw_Swc.CTS_CHG.CTS_SPN2823_SYNC_SecondTen, ecu-extract-reference=CPT_BMSL_FlatView.CPT_Asw_Swc.CTS_CHG.CTS_SPN2823_SYNC_SecondTen
      CTS_SPN2823_SYNC_Second: sw-refresh-timing={cse-code=3, cse-code-factor=5}, upstream-reference=RootSwCompositionPrototype.CPT_Asw_Swc.CTS_CHG.CTS_SPN2823_SYNC_Second, ecu-extract-reference=CPT_BMSL_FlatView.CPT_Asw_Swc.CTS_CHG.CTS_SPN2823_SYNC_Second
      CTS_SPN2823_SYNC_MonthTen: sw-refresh-timing={cse-code=3, cse-code-factor=5}, upstream-reference=RootSwCompositionPrototype.CPT_Asw_Swc.CTS_CHG.CTS_SPN2823_SYNC_MonthTen, ecu-extract-reference=CPT_BMSL_FlatView.CPT_Asw_Swc.CTS_CHG.CTS_SPN2823_SYNC_MonthTen
      CTS_SPN2823_SYNC_Month: sw-refresh-timing={cse-code=3, cse-code-factor=5}, upstream-reference=RootSwCompositionPrototype.CPT_Asw_Swc.CTS_CHG.CTS_SPN2823_SYNC_Month, ecu-extract-reference=CPT_BMSL_FlatView.CPT_Asw_Swc.CTS_CHG.CTS_SPN2823_SYNC_Month
      CTS_SPN2823_SYNC_MinuteTen: sw-refresh-timing={cse-code=3, cse-code-factor=5}, upstream-reference=RootSwCompositionPrototype.CPT_Asw_Swc.CTS_CHG.CTS_SPN2823_SYNC_MinuteTen, ecu-extract-reference=CPT_BMSL_FlatView.CPT_Asw_Swc.CTS_CHG.CTS_SPN2823_SYNC_MinuteTen
      CTS_SPN2823_SYNC_Minute: sw-refresh-timing={cse-code=3, cse-code-factor=5}, upstream-reference=RootSwCompositionPrototype.CPT_Asw_Swc.CTS_CHG.CTS_SPN2823_SYNC_Minute, ecu-extract-reference=CPT_BMSL_FlatView.CPT_Asw_Swc.CTS_CHG.CTS_SPN2823_SYNC_Minute
      CTS_SPN2823_SYNC_HourTen: sw-refresh-timing={cse-code=3, cse-code-factor=5}, upstream-reference=RootSwCompositionPrototype.CPT_Asw_Swc.CTS_CHG.CTS_SPN2823_SYNC_HourTen, ecu-extract-reference=CPT_BMSL_FlatView.CPT_Asw_Swc.CTS_CHG.CTS_SPN2823_SYNC_HourTen
      CTS_SPN2823_SYNC_Hour: sw-refresh-timing={cse-code=3, cse-code-factor=5}, upstream-reference=RootSwCompositionPrototype.CPT_Asw_Swc.CTS_CHG.CTS_SPN2823_SYNC_Hour, ecu-extract-reference=CPT_BMSL_FlatView.CPT_Asw_Swc.CTS_CHG.CTS_SPN2823_SYNC_Hour
      CTS_SPN2823_SYNC_DayTen: sw-refresh-timing={cse-code=3, cse-code-factor=5}, upstream-reference=RootSwCompositionPrototype.CPT_Asw_Swc.CTS_CHG.CTS_SPN2823_SYNC_DayTen, ecu-extract-reference=CPT_BMSL_FlatView.CPT_Asw_Swc.CTS_CHG.CTS_SPN2823_SYNC_DayTen
      CTS_SPN2823_SYNC_Day: sw-refresh-timing={cse-code=3, cse-code-factor=5}, upstream-reference=RootSwCompositionPrototype.CPT_Asw_Swc.CTS_CHG.CTS_SPN2823_SYNC_Day, ecu-extract-reference=CPT_BMSL_FlatView.CPT_Asw_Swc.CTS_CHG.CTS_SPN2823_SYNC_Day
