AUTOSAR XML (schema 4-2-2)
package /System_EcuExtract
  system EXTR_BMSL: category=ECU_EXTRACT, ecu-extract-version=1.0.0, system-version=1.0.0
    system mapping SYSMPG_BMSL
      data-mappings:
        data-element=CPT_BMSL_FlatView.PPort_BMS_1D8h.HVCntctrStat, system-signal=HVCntctrStat
        data-element=CPT_BMSL_FlatView.PPort_BMS_1D8h.HVBatFltSevrtyStat, system-signal=HVBatFltSevrtyStat
        data-element=CPT_BMSL_FlatView.PPort_BMS_1D8h.BMSlightReq, system-signal=BMSlightReq
        data-element=CPT_BMSL_FlatView.PPort_BMS_1D8h.HVCntctrStatARC, system-signal=HVCntctrStatARC
        data-element=CPT_BMSL_FlatView.PPort_BMS_1D8h.ChrgrStatPTHVCntctrReq, system-signal=ChrgrStatPTHVCntctrReq
        data-element=CPT_BMSL_FlatView.PPort_BMS_1D8h.HVBatPrcdCrntV, system-signal=HVBatPrcdCrntV
        data-element=CPT_BMSL_FlatView.PPort_BMS_1D8h.HVBatPrcdCrnt, system-signal=HVBatPrcdCrnt
        data-element=CPT_BMSL_FlatView.PPort_BMS_329h.MesCellTempNumIndex, system-signal=MesCellTempNumIndex
        data-element=CPT_BMSL_FlatView.PPort_BMS_329h.CellTempMes{1..7}, system-signal=CellTempMes{1..7}
        data-element=CPT_BMSL_FlatView.PPort_BMS_32Ah.MesCellVoltNumIndex, system-signal=MesCellVoltNumIndex
        data-element=CPT_BMSL_FlatView.PPort_BMS_32Ah.Mes1CellVolt, system-signal=Mes1CellVolt
        data-element=CPT_BMSL_FlatView.PPort_BMS_32Ah.Mes1CellBalState, system-signal=Mes1CellBalState
        data-element=CPT_BMSL_FlatView.PPort_BMS_32Ah.Mes2CellVolt, system-signal=Mes2CellVolt
        data-element=CPT_BMSL_FlatView.PPort_BMS_32Ah.Mes2CellBalState, system-signal=Mes2CellBalState
        data-element=CPT_BMSL_FlatView.PPort_BMS_32Ah.Mes3CellVolt, system-signal=Mes3CellVolt
        data-element=CPT_BMSL_FlatView.PPort_BMS_32Ah.Mes3CellBalState, system-signal=Mes3CellBalState
        data-element=CPT_BMSL_FlatView.PPort_BMS_3D7h.HVBatPackPrcdVltg, system-signal=HVBatPackPrcdVltg
        data-element=CPT_BMSL_FlatView.PPort_BMS_3D7h.HVBatPackPrcdVltgV, system-signal=HVBatPackPrcdVltgV
        data-element=CPT_BMSL_FlatView.PPort_BMS_3DAh.HVBCP_LngTrmChrgPwr, system-signal=HVBCP_LngTrmChrgPwr
        data-element=CPT_BMSL_FlatView.PPort_BMS_3DAh.HVBCP_CrnkChrgPwrV, system-signal=HVBCP_CrnkChrgPwrV
        data-element=CPT_BMSL_FlatView.PPort_BMS_3DAh.HVBCP_ShrtTrmChrgPwr, system-signal=HVBCP_ShrtTrmChrgPwr
        data-element=CPT_BMSL_FlatView.PPort_BMS_3DAh.ChrgPeakTimeFactor, system-signal=ChrgPeakTimeFactor
        data-element=CPT_BMSL_FlatView.PPort_BMS_3DAh.BMSChecksum_3DAh, system-signal=BMSChecksum_3DAh
        data-element=CPT_BMSL_FlatView.PPort_BMS_3DBh.HVBDP_LngTrmDischrgPwr, system-signal=HVBDP_LngTrmDischrgPwr
        data-element=CPT_BMSL_FlatView.PPort_BMS_3DBh.HVBDP_CrnkDischrgPwrV, system-signal=HVBDP_CrnkDischrgPwrV
        data-element=CPT_BMSL_FlatView.PPort_BMS_3DBh.HVBDP_ShrtTrmDischrgPwr, system-signal=HVBDP_ShrtTrmDischrgPwr
        data-element=CPT_BMSL_FlatView.PPort_BMS_3DBh.DischrgPeakTimeFactor, system-signal=DischrgPeakTimeFactor
        data-element=CPT_BMSL_FlatView.PPort_BMS_3DBh.BMSChecksum_3DBh, system-signal=BMSChecksum_3DBh
        data-element=CPT_BMSL_FlatView.PPort_BMS_501h.HVIsoWarning, system-signal=HVIsoWarning
        data-element=CPT_BMSL_FlatView.PPort_BMS_501h.HVILWarning, system-signal=HVILWarning
        data-element=CPT_BMSL_FlatView.PPort_BMS_501h.SOCLowWarning, system-signal=SOCLowWarning
        data-element=CPT_BMSL_FlatView.PPort_BMS_501h.TempDiffWarning, system-signal=TempDiffWarning
        data-element=CPT_BMSL_FlatView.PPort_BMS_501h.TempHighWarning, system-signal=TempHighWarning
        data-element=CPT_BMSL_FlatView.PPort_BMS_501h.PackOvWarning, system-signal=PackOvWarning
        data-element=CPT_BMSL_FlatView.PPort_BMS_501h.PackUvWarning, system-signal=PackUvWarning
        data-element=CPT_BMSL_FlatView.PPort_BMS_501h.CellOvWarning, system-signal=CellOvWarning
        data-element=CPT_BMSL_FlatView.PPort_BMS_501h.CellUvWarning, system-signal=CellUvWarning
        data-element=CPT_BMSL_FlatView.PPort_BMS_501h.SOCHighWarning, system-signal=SOCHighWarning
        data-element=CPT_BMSL_FlatView.PPort_BMS_501h.SOCFastChgWarning, system-signal=SOCFastChgWarning
        data-element=CPT_BMSL_FlatView.PPort_BMS_501h.PwrBatPackMismatchWarning, system-signal=PwrBatPackMismatchWarning
        data-element=CPT_BMSL_FlatView.PPort_BMS_501h.BMSCelConsistencyWarning, system-signal=BMSCelConsistencyWarning
        data-element=CPT_BMSL_FlatView.PPort_BMS_501h.BMSVolHighWarning, system-signal=BMSVolHighWarning
        data-element=CPT_BMSL_FlatView.PPort_BMS_503h.BMSCellQuantity, system-signal=BMSCellQuantity
        data-element=CPT_BMSL_FlatView.PPort_BMS_503h.BMSTempProbeQuantity, system-signal=BMSTempProbeQuantity
        data-element=CPT_BMSL_FlatView.PPort_BMS_503h.HVIsoValue, system-signal=HVIsoValue
        data-element=CPT_BMSL_FlatView.PPort_BMS_509h.RechgEnergyStorSysNumb, system-signal=RechgEnergyStorSysNumb
        data-element=CPT_BMSL_FlatView.PPort_BMS_509h.CurRechgEnergyStorSysIndex, system-signal=CurRechgEnergyStorSysIndex
        data-element=CPT_BMSL_FlatView.PPort_BMS_509h.RechgEnergyStorSysCodeLength, system-signal=RechgEnergyStorSysCodeLength
        data-element=CPT_BMSL_FlatView.PPort_BMS_509h.RechgEnergyStorSysCodeIndex, system-signal=RechgEnergyStorSysCodeIndex
        data-element=CPT_BMSL_FlatView.PPort_BMS_509h.RechgEnergyStorSysCode{1..6}, system-signal=RechgEnergyStorSysCode{1..6}
        data-element=CPT_BMSL_FlatView.PPort_BMS_594h.MaxClVlt, system-signal=MaxClVlt
        data-element=CPT_BMSL_FlatView.PPort_BMS_594h.MaxCellVoltNumb, system-signal=MaxCellVoltNumb
        data-element=CPT_BMSL_FlatView.PPort_BMS_594h.MinClVlt, system-signal=MinClVlt
        data-element=CPT_BMSL_FlatView.PPort_BMS_594h.MinCellVoltNumb, system-signal=MinCellVoltNumb
        data-element=CPT_BMSL_FlatView.PPort_BMS_594h.HVBatPackAccVltgV, system-signal=HVBatPackAccVltgV
        data-element=CPT_BMSL_FlatView.PPort_BMS_594h.HVBatPackAccVltg, system-signal=HVBatPackPrcdVltg
        data-element=CPT_BMSL_FlatView.PPort_BMS_596h.MaxBatTmp, system-signal=MaxBatTmp
        data-element=CPT_BMSL_FlatView.PPort_BMS_596h.MaxCellTempNumb, system-signal=MaxCellTempNumb
        data-element=CPT_BMSL_FlatView.PPort_BMS_596h.MinBatTmp, system-signal=MinBatTmp
        data-element=CPT_BMSL_FlatView.PPort_BMS_596h.MinCellTempNumb, system-signal=MinCellTempNumb
        data-element=CPT_BMSL_FlatView.PPort_BMS_598h.BatLf, system-signal=BatLf
        data-element=CPT_BMSL_FlatView.PPort_BMS_598h.ChrgPlugStatus, system-signal=ChrgPlugStatus
        data-element=CPT_BMSL_FlatView.PPort_BMS_598h.PreChrgUnitRdy, system-signal=PreChrgUnitRdy
        data-element=CPT_BMSL_FlatView.PPort_BMS_598h.BMSChrgStatus, system-signal=BMSChrgStatus
        data-element=CPT_BMSL_FlatView.PPort_BMS_598h.HVSystemStatus, system-signal=HVSystemStatus
        data-element=CPT_BMSL_FlatView.PPort_BMS_598h.TotalBatteryCap, system-signal=TotalBatteryCap
        data-element=CPT_BMSL_FlatView.PPort_BMS_603h.ACChrgVoltRq, system-signal=ACChrgVoltRq
        data-element=CPT_BMSL_FlatView.PPort_BMS_603h.ACChrgCurrRq, system-signal=ACChrgCurrRq
        data-element=CPT_BMSL_FlatView.PPort_BMS_603h.ACChrgMode, system-signal=ACChrgMode
        data-element=CPT_BMSL_FlatView.PPort_BMS_603h.ACChrgFault, system-signal=ACChrgFault
        data-element=CPT_BMSL_FlatView.PPort_BMS_603h.CCVaule, system-signal=CCVaule
        data-element=CPT_BMSL_FlatView.PPort_BMS_603h.CPVaule, system-signal=CPVaule
        data-element=CPT_BMSL_FlatView.PPort_BMS_605h.FullChargeRemainingTime, system-signal=FullChargeRemainingTime
        data-element=CPT_BMSL_FlatView.PPort_BMS_605h.RequestChargeCurrent, system-signal=RequestChargeCurrent
        data-element=CPT_BMSL_FlatView.PPort_BMS_605h.ChargingVoltage, system-signal=ChargingVoltage
        data-element=CPT_BMSL_FlatView.PPort_BMS_606h.StopChargingReson, system-signal=StopChargingReson
        data-element=CPT_BMSL_FlatView.PPort_BMS_606h.BEM_CRM00, system-signal=BEM_CRM00
        data-element=CPT_BMSL_FlatView.PPort_BMS_606h.BEM_CRMAA, system-signal=BEM_CRMAA
        data-element=CPT_BMSL_FlatView.PPort_BMS_606h.BEM_CML, system-signal=BEM_CML
        data-element=CPT_BMSL_FlatView.PPort_BMS_606h.BEM_CRO, system-signal=BEM_CRO
        data-element=CPT_BMSL_FlatView.PPort_BMS_606h.BEM_CCS, system-signal=BEM_CCS
        data-element=CPT_BMSL_FlatView.PPort_BMS_606h.BEM_CST, system-signal=BEM_CST
        data-element=CPT_BMSL_FlatView.PPort_BMS_606h.BEM_CSD, system-signal=BEM_CSD
        data-element=CPT_BMSL_FlatView.PPort_BMS_606h.BEM_Other, system-signal=BEM_Other
        data-element=CPT_BMSL_FlatView.PPort_BMS_606h.CEM_BRM, system-signal=CEM_BRM
        data-element=CPT_BMSL_FlatView.PPort_BMS_606h.CEM_BCP, system-signal=CEM_BCP
        data-element=CPT_BMSL_FlatView.PPort_BMS_606h.CEM_BRO, system-signal=CEM_BRO
        data-element=CPT_BMSL_FlatView.PPort_BMS_606h.CEM_BCS, system-signal=CEM_BCS
        data-element=CPT_BMSL_FlatView.PPort_BMS_606h.CEM_BCL, system-signal=CEM_BCL
        data-element=CPT_BMSL_FlatView.PPort_BMS_606h.CEM_BST, system-signal=CEM_BST
        data-element=CPT_BMSL_FlatView.PPort_BMS_606h.CEM_BSD, system-signal=CEM_BSD
        data-element=CPT_BMSL_FlatView.PPort_BMS_606h.CEM_Other, system-signal=CEM_Other
        data-element=CPT_BMSL_FlatView.PPort_BMS_606h.BMSStopChargeFaultCode{1..8}, system-signal=BMSStopChargeFaultCode{1..8}
        data-element=CPT_BMSL_FlatView.PPort_BMS_606h.CHGStopChargeFaultCode{1..7}, system-signal=CHGStopChargeFaultCode{1..7}
        data-element=CPT_BMSL_FlatView.PPort_BMS_795h.BMSDTCSeriousLevel, system-signal=BMSDTCSeriousLevel
        data-element=CPT_BMSL_FlatView.PPort_BMS_795h.BMSDTCHighByte, system-signal=BMSDTCHighByte
        data-element=CPT_BMSL_FlatView.PPort_BMS_795h.BMSDTCLowByte, system-signal=BMSDTCLowByte
        data-element=CPT_BMSL_FlatView.PPort_BMS_795h.BMSDTCFailureTypeByte, system-signal=BMSDTCFailureTypeByte
        data-element=CPT_BMSL_FlatView.PPort_BMS_795h.BMSDTCStatus, system-signal=BMSDTCStatus
        data-element=CPT_BMSL_FlatView.PPort_BMS_795h.BMSDTCType, system-signal=BMSDTCType
        data-element=CPT_BMSL_FlatView.PPort_BMS_606h.CHGStopChargeFaultCode8, system-signal=CHGStopChargeFaultCode8
        data-element=CPT_BMSL_FlatView.RPort_DCDC_303h.I_LDC_In, system-signal=I_LDC_In
        data-element=CPT_BMSL_FlatView.RPort_GW_BCM_1F1h.SysPwrMd, system-signal=SysPwrMd
        data-element=CPT_BMSL_FlatView.RPort_GW_BCM_1F1h.SysOpnlMd, system-signal=SysOpnlMd
        data-element=CPT_BMSL_FlatView.RPort_GW_BCM_1F1h.SysVolMdV, system-signal=SysVolMdV
        data-element=CPT_BMSL_FlatView.RPort_GW_BCM_1F1h.SysVolV, system-signal=SysVolV
        data-element=CPT_BMSL_FlatView.RPort_GW_BCM_1F1h.SysVol, system-signal=SysVol
        data-element=CPT_BMSL_FlatView.RPort_GW_BCM_1F1h.SysVolMd, system-signal=SysVolMd
        data-element=CPT_BMSL_FlatView.RPort_GW_ESC_23Ch.VehicleSpeedStatus, system-signal=VehicleSpeedStatus
        data-element=CPT_BMSL_FlatView.RPort_GW_ESC_23Ch.VehicleSpeed, system-signal=VehicleSpeed
        data-element=CPT_BMSL_FlatView.RPort_GW_ESC_23Ch.MessageCounter_23Ch, system-signal=MessageCounter_23Ch
        data-element=CPT_BMSL_FlatView.RPort_GW_ESC_23Ch.CheckSum_23Ch, system-signal=CheckSum_23Ch
        data-element=CPT_BMSL_FlatView.RPort_GW_HCM_55Fh.FrontCompStatFdbck, system-signal=FrontCompStatFdbck
        data-element=CPT_BMSL_FlatView.RPort_GW_HCM_55Fh.FrontCmprElctrCrnt, system-signal=FrontCmprElctrCrnt
        data-element=CPT_BMSL_FlatView.RPort_GW_HCM_55Fh.FrontPTCStatFdbck, system-signal=FrontPTCStatFdbck
        data-element=CPT_BMSL_FlatView.RPort_GW_HCM_55Fh.FrontPTCElctrCrnt, system-signal=FrontPTCElctrCrnt
        data-element=CPT_BMSL_FlatView.RPort_GW_IPK_1F2h.SysBPM, system-signal=SysBPM
        data-element=CPT_BMSL_FlatView.RPort_GW_IPK_1F2h.SysBPMEnbd, system-signal=SysBPMEnbd
        data-element=CPT_BMSL_FlatView.RPort_GW_IPK_362h.HighPreVehOdo, system-signal=HighPreVehOdo
        data-element=CPT_BMSL_FlatView.RPort_GW_IPK_362h.HighPreVehOdoV, system-signal=HighPreVehOdoV
        data-element=CPT_BMSL_FlatView.RPort_OBC_604h.OBCChgVolt, system-signal=OBCChgVolt
        data-element=CPT_BMSL_FlatView.RPort_OBC_604h.OBCChgCurrent, system-signal=OBCChgCurrent
        data-element=CPT_BMSL_FlatView.RPort_OBC_604h.OBCMaxChrgVoltage, system-signal=OBCMaxChrgVoltage
        data-element=CPT_BMSL_FlatView.RPort_OBC_604h.OBCMaxChrgCurrent, system-signal=OBCMaxChrgCurrent
        data-element=CPT_BMSL_FlatView.RPort_OBC_604h.OBCStatus, system-signal=OBCStatus
        data-element=CPT_BMSL_FlatView.RPort_PEU_0B4h.V_DC, system-signal=V_DC
        data-element=CPT_BMSL_FlatView.RPort_PEU_0B4h.V_DCValidity, system-signal=V_DCValidity
        data-element=CPT_BMSL_FlatView.RPort_PEU_18Bh.InvADCCrntV, system-signal=InvADCCrntV
        data-element=CPT_BMSL_FlatView.RPort_PEU_18Bh.InvADCCrnt, system-signal=InvADCCrnt
        data-element=CPT_BMSL_FlatView.RPort_SRS_163h.RollingCounter, system-signal=RollingCounter
        data-element=CPT_BMSL_FlatView.RPort_SRS_163h.SRSCheckSum, system-signal=SRSCheckSum
        data-element=CPT_BMSL_FlatView.RPort_SRS_163h.VehCrshTyp, system-signal=VehCrshTyp
        data-element=CPT_BMSL_FlatView.RPort_VCU_1E3h.ChrgrStatPTHVCntctrClsAlwd, system-signal=ChrgrStatPTHVCntctrClsAlwd
        data-element=CPT_BMSL_FlatView.RPort_VCU_1E3h.ChrgrStatPTHVCntctOpnrAlwd, system-signal=ChrgrStatPTHVCntctOpnrAlwd
        data-element=CPT_BMSL_FlatView.RPort_VCU_1E3h.PTHVCntctrReq, system-signal=PTHVCntctrReq
        data-element=CPT_BMSL_FlatView.RPort_VCU_1E3h.RollingCounter_1E3h, system-signal=RollingCounter_1E3h
        data-element=CPT_BMSL_FlatView.RPort_VCU_1E3h.CheckSum_1E3h, system-signal=CheckSum_1E3h
        data-element=CPT_BMSL_FlatView.RPort_VCU_353h.VehSpdAvgDrvnV, system-signal=VehSpdAvgDrvnV
        data-element=CPT_BMSL_FlatView.RPort_VCU_353h.VehSpdAvgDrvn, system-signal=VehSpdAvgDrvn
        data-element=CPT_BMSL_FlatView.PPort_BMS_501h.EnergyConsumptionPer, system-signal=EnergyConsumptionPer
        data-element=CPT_BMSL_FlatView.PPort_BMS_501h.RestEnergy, system-signal=RestEnergy
        data-element=CPT_BMSL_FlatView.RPort_OBC_604h.OBCCurrentFltCode, system-signal=OBCCurrentFltCode
        data-element=CPT_BMSL_FlatView.PPort_BMS_501h.ThermalAlarm, system-signal=ThermalAlarm
        data-element=CPT_BMSL_FlatView.PPort_BMS_501h.ThermalAlarmV, system-signal=ThermalAlarmV
        data-element=CPT_BMSL_FlatView.PPort_BMS_503h.RealSOC, system-signal=RealSOC
        data-element=CPT_BMSL_FlatView.PPort_BMS_603h.S2_Status, system-signal=S2_Status
        data-element=CPT_BMSL_FlatView.RPort_DCDC_303h.CDU_HVILWarning, system-signal=CDU_HVILWarning
        data-element=CPT_BMSL_FlatView.RPort_OBC_604h.OBCHistoryFltCode, system-signal=OBCHistoryFltCode
        data-element=CPT_BMSL_FlatView.BHM_BCU.BHM_SPN2601_Ubat_Max_Permit, system-signal=BHM_SPN2601_Ubat_Max_Permit
        data-element=CPT_BMSL_FlatView.CHM_CHG.CHM_SPN2600_Comm_Ver, system-signal=CHM_SPN2600_Comm_Ver
        data-element=CPT_BMSL_FlatView.BCP_BCU.BCP_SPN2816_Ucell_Max_Permit, system-signal=BCP_SPN2816_Ucell_Max_Permit
        data-element=CPT_BMSL_FlatView.BCP_BCU.BCP_SPN2817_I_Max_Permit, system-signal=BCP_SPN2817_I_Max_Permit
        data-element=CPT_BMSL_FlatView.BCP_BCU.BCP_SPN2818_kWh_Nom, system-signal=BCP_SPN2818_kWh_Nom
        data-element=CPT_BMSL_FlatView.BCP_BCU.BCP_SPN2819_U_Max_Permit, system-signal=BCP_SPN2819_U_Max_Permit
        data-element=CPT_BMSL_FlatView.BCP_BCU.BCP_SPN2820_T_Max_Permit, system-signal=BCP_SPN2820_T_Max_Permit
        data-element=CPT_BMSL_FlatView.BCP_BCU.BCP_SPN2821_SOC, system-signal=BCP_SPN2821_SOC
        data-element=CPT_BMSL_FlatView.BCP_BCU.BCP_SPN2822_U, system-signal=BCP_SPN2822_U
        data-element=CPT_BMSL_FlatView.BCS_BCU.BCS_SPN3075_U_Mea, system-signal=BCS_SPN3075_U_Mea
        data-element=CPT_BMSL_FlatView.BCS_BCU.BCS_SPN3076_I_Mea, system-signal=BCS_SPN3076_I_Mea
        data-element=CPT_BMSL_FlatView.BCS_BCU.BCS_SPN3077_Ucell_Max, system-signal=BCS_SPN3077_Ucell_Max
        data-element=CPT_BMSL_FlatView.BCS_BCU.BCS_SPN3077_Ucell_Max_Grp, system-signal=BCS_SPN3077_Ucell_Max_Grp
        data-element=CPT_BMSL_FlatView.BCS_BCU.BCS_SPN3078_SOC, system-signal=BCS_SPN3078_SOC
        data-element=CPT_BMSL_FlatView.BCS_BCU.BCS_SPN3079_Time_Remain, system-signal=BCS_SPN3079_Time_Remain
        data-element=CPT_BMSL_FlatView.CRO_CHG.CRO_SPN2830_CHG_Ready, system-signal=CRO_SPN2830_CHG_Ready
        data-element=CPT_BMSL_FlatView.BRO_BCU.BRO_SPN2829_BCU_Ready, system-signal=BRO_SPN2829_BCU_Ready
        data-element=CPT_BMSL_FlatView.CML_CHG.CML_SPN2827_I_Min_Out, system-signal=CML_SPN2827_I_Min_Out
        data-element=CPT_BMSL_FlatView.CML_CHG.CML_SPN2826_I_Max_Out, system-signal=CML_SPN2826_I_Max_Out
        data-element=CPT_BMSL_FlatView.CML_CHG.CML_SPN2825_U_Min_Out, system-signal=CML_SPN2825_U_Min_Out
        data-element=CPT_BMSL_FlatView.CML_CHG.CML_SPN2824_U_Max_Out, system-signal=CML_SPN2824_U_Max_Out
        data-element=CPT_BMSL_FlatView.CTS_CHG.CTS_SPN2823_SYNC_YearThousand, system-signal=CTS_SPN2823_SYNC_YearThousand
        data-element=CPT_BMSL_FlatView.CTS_CHG.CTS_SPN2823_SYNC_YearTen, system-signal=CTS_SPN2823_SYNC_YearTen
        data-element=CPT_BMSL_FlatView.CTS_CHG.CTS_SPN2823_SYNC_YearHundred, system-signal=CTS_SPN2823_SYNC_YearHundred
        data-element=CPT_BMSL_FlatView.CTS_CHG.CTS_SPN2823_SYNC_Year, system-signal=CTS_SPN2823_SYNC_Year
        data-element=CPT_BMSL_FlatView.CTS_CHG.CTS_SPN2823_SYNC_SecondTen, system-signal=CTS_SPN2823_SYNC_SecondTen
        data-element=CPT_BMSL_FlatView.CTS_CHG.CTS_SPN2823_SYNC_Second, system-signal=CTS_SPN2823_SYNC_Second
        data-element=CPT_BMSL_FlatView.CTS_CHG.CTS_SPN2823_SYNC_MonthTen, system-signal=CTS_SPN2823_SYNC_MonthTen
        data-element=CPT_BMSL_FlatView.CTS_CHG.CTS_SPN2823_SYNC_Month, system-signal=CTS_SPN2823_SYNC_Month
        data-element=CPT_BMSL_FlatView.CTS_CHG.CTS_SPN2823_SYNC_MinuteTen, system-signal=CTS_SPN2823_SYNC_MinuteTen
        data-element=CPT_BMSL_FlatView.CTS_CHG.CTS_SPN2823_SYNC_Minute, system-signal=CTS_SPN2823_SYNC_Minute
        data-element=CPT_BMSL_FlatView.CTS_CHG.CTS_SPN2823_SYNC_HourTen, system-signal=CTS_SPN2823_SYNC_HourTen
        data-element=CPT_BMSL_FlatView.CTS_CHG.CTS_SPN2823_SYNC_Hour, system-signal=CTS_SPN2823_SYNC_Hour
        data-element=CPT_BMSL_FlatView.CTS_CHG.CTS_SPN2823_SYNC_DayTen, system-signal=CTS_SPN2823_SYNC_DayTen
        data-element=CPT_BMSL_FlatView.CTS_CHG.CTS_SPN2823_SYNC_Day, system-signal=CTS_SPN2823_SYNC_Day
        data-element=CPT_BMSL_FlatView.BRM_BCU.BRM_SPN2576_BMSVer_Year, system-signal=BRM_SPN2576_BMSVer_Year
        data-element=CPT_BMSL_FlatView.BRM_BCU.BRM_SPN2576_BMSVer_Version, system-signal=BRM_SPN2576_BMSVer_Version
        data-element=CPT_BMSL_FlatView.BRM_BCU.BRM_SPN2576_BMSVer_Reserver, system-signal=BRM_SPN2576_BMSVer_Reserver
        data-element=CPT_BMSL_FlatView.BRM_BCU.BRM_SPN2576_BMSVer_Month, system-signal=BRM_SPN2576_BMSVer_Month
        data-element=CPT_BMSL_FlatView.BRM_BCU.BRM_SPN2576_BMSVer_Day, system-signal=BRM_SPN2576_BMSVer_Day
        data-element=CPT_BMSL_FlatView.BRM_BCU.BRM_SPN2575_VIN{1..17}, system-signal=BRM_SPN2575_VIN{1..17}
        data-element=CPT_BMSL_FlatView.BRM_BCU.BRM_SPN2574_BMSSW_Reserved, system-signal=BRM_SPN2574_BMSSW_Reserved
        data-element=CPT_BMSL_FlatView.BRM_BCU.BRM_SPN2572_PackChgCnt, system-signal=BRM_SPN2572_PackChgCnt
        data-element=CPT_BMSL_FlatView.BRM_BCU.BRM_SPN2573_PackRight, system-signal=BRM_SPN2573_PackRight
        data-element=CPT_BMSL_FlatView.BRM_BCU.BRM_SPN2571_PackDay, system-signal=BRM_SPN2571_PackDay
        data-element=CPT_BMSL_FlatView.BRM_BCU.BRM_SPN2571_PackMonth, system-signal=BRM_SPN2571_PackMonth
        data-element=CPT_BMSL_FlatView.BRM_BCU.BRM_SPN2571_PackYear, system-signal=BRM_SPN2571_PackYear
        data-element=CPT_BMSL_FlatView.BRM_BCU.BRM_SPN2570_PackSN, system-signal=BRM_SPN2570_PackSN
        data-element=CPT_BMSL_FlatView.BRM_BCU.BRM_SPN2569_BatFactory, system-signal=BRM_SPN2569_BatFactory
        data-element=CPT_BMSL_FlatView.BRM_BCU.BRM_SPN2565_Ver, system-signal=BRM_SPN2565_Ver
        data-element=CPT_BMSL_FlatView.BRM_BCU.BRM_SPN2566_Bat_Type, system-signal=BRM_SPN2566_Bat_Type
        data-element=CPT_BMSL_FlatView.BRM_BCU.BRM_SPN2567_Cap_Nom, system-signal=BRM_SPN2567_Cap_Nom
        data-element=CPT_BMSL_FlatView.BRM_BCU.BRM_SPN2568_U_Nom, system-signal=BRM_SPN2568_U_Nom
        data-element=CPT_BMSL_FlatView.CRM_CHG.CRM_SPN2562_CHG_Loc, system-signal=CRM_SPN2562_CHG_Loc
        data-element=CPT_BMSL_FlatView.CRM_CHG.CRM_SPN2561_CHG_Index, system-signal=CRM_SPN2561_CHG_Index
        data-element=CPT_BMSL_FlatView.CRM_CHG.CRM_SPN2560_Ack, system-signal=CRM_SPN2560_Ack
        data-element=CPT_BMSL_FlatView.CEM_CHG.CEM_other, system-signal=CEM_other
        data-element=CPT_BMSL_FlatView.CEM_CHG.CEM_SPN3927_Timeout_BSD, system-signal=CEM_SPN3927_Timeout_BSD
        data-element=CPT_BMSL_FlatView.CEM_CHG.CEM_SPN3926_Timeout_BST, system-signal=CEM_SPN3926_Timeout_BST
        data-element=CPT_BMSL_FlatView.CEM_CHG.CEM_SPN3925_Timeout_BCL, system-signal=CEM_SPN3925_Timeout_BCL
        data-element=CPT_BMSL_FlatView.CEM_CHG.CEM_SPN3924_Timeout_BCS, system-signal=CEM_SPN3924_Timeout_BCS
        data-element=CPT_BMSL_FlatView.CEM_CHG.CEM_SPN3923_Timeout_BRO, system-signal=CEM_SPN3923_Timeout_BRO
        data-element=CPT_BMSL_FlatView.CEM_CHG.CEM_SPN3922_Timeout_BCP, system-signal=CEM_SPN3922_Timeout_BCP
        data-element=CPT_BMSL_FlatView.CEM_CHG.CEM_SPN3921_Timeout_BRM, system-signal=CEM_SPN3921_Timeout_BRM
        data-element=CPT_BMSL_FlatView.BEM_BCU.BEM_other, system-signal=BEM_other
        data-element=CPT_BMSL_FlatView.BEM_BCU.BEM_SPN3907_Timeout_CSD, system-signal=BEM_SPN3907_Timeout_CSD
        data-element=CPT_BMSL_FlatView.BEM_BCU.BEM_SPN3906_Timeout_CST, system-signal=BEM_SPN3906_Timeout_CST
        data-element=CPT_BMSL_FlatView.BEM_BCU.BEM_SPN3905_Timeout_CCS, system-signal=BEM_SPN3905_Timeout_CCS
        data-element=CPT_BMSL_FlatView.BEM_BCU.BEM_SPN3904_Timeout_CRO, system-signal=BEM_SPN3904_Timeout_CRO
        data-element=CPT_BMSL_FlatView.BEM_BCU.BEM_SPN3903_Timeout_CTS_CML, system-signal=BEM_SPN3903_Timeout_CTS_CML
        data-element=CPT_BMSL_FlatView.BEM_BCU.BEM_SPN3902_Timeout_SPN2560_0xAA, system-signal=BEM_SPN3902_Timeout_SPN2560_0xAA
        data-element=CPT_BMSL_FlatView.BEM_BCU.BEM_SPN3901_Timeout_SPN2560_0x00, system-signal=BEM_SPN3901_Timeout_SPN2560_0x00
        data-element=CPT_BMSL_FlatView.CSD_CHG.CSD_SPN3613_CHG_Index, system-signal=CSD_SPN3613_CHG_Index
        data-element=CPT_BMSL_FlatView.CSD_CHG.CSD_SPN3612_E_Out, system-signal=CSD_SPN3612_E_Out
        data-element=CPT_BMSL_FlatView.CSD_CHG.CSD_SPN3611_Time_Charged, system-signal=CSD_SPN3611_Time_Charged
        data-element=CPT_BMSL_FlatView.BSD_BCU.BSD_SPN3605_T_Max, system-signal=BSD_SPN3605_T_Max
        data-element=CPT_BMSL_FlatView.BSD_BCU.BSD_SPN3604_T_Min, system-signal=BSD_SPN3604_T_Min
        data-element=CPT_BMSL_FlatView.BSD_BCU.BSD_SPN3603_Ucell_Max, system-signal=BSD_SPN3603_Ucell_Max
        data-element=CPT_BMSL_FlatView.BSD_BCU.BSD_SPN3602_Ucell_Min, system-signal=BSD_SPN3602_Ucell_Min
        data-element=CPT_BMSL_FlatView.BSD_BCU.BSD_SPN3601_SOC_Final, system-signal=BSD_SPN3601_SOC_Final
        data-element=CPT_BMSL_FlatView.CST_CHG.CST_SPN3521_Stop_Reason_BMSStop, system-signal=CST_SPN3521_Stop_Reason_BMSStop
        data-element=CPT_BMSL_FlatView.CST_CHG.CST_SPN3523_Stop_Fault_U, system-signal=CST_SPN3523_Stop_Fault_U
        data-element=CPT_BMSL_FlatView.CST_CHG.CST_SPN3523_Stop_Fault_Mismatch, system-signal=CST_SPN3523_Stop_Fault_Mismatch
        data-element=CPT_BMSL_FlatView.CST_CHG.CST_SPN3522_Stop_Fault_T_Inter, system-signal=CST_SPN3522_Stop_Fault_T_Inter
        data-element=CPT_BMSL_FlatView.CST_CHG.CST_SPN3522_Stop_Fault_T_CHG, system-signal=CST_SPN3522_Stop_Fault_T_CHG
        data-element=CPT_BMSL_FlatView.CST_CHG.CST_SPN3522_Stop_Fault_Other, system-signal=CST_SPN3522_Stop_Fault_Other
        data-element=CPT_BMSL_FlatView.CST_CHG.CST_SPN3522_Stop_Fault_EmerStop, system-signal=CST_SPN3522_Stop_Fault_EmerStop
        data-element=CPT_BMSL_FlatView.CST_CHG.CST_SPN3522_Stop_Fault_Deliver, system-signal=CST_SPN3522_Stop_Fault_Deliver
        data-element=CPT_BMSL_FlatView.CST_CHG.CST_SPN3522_Stop_Fault_CHGCnnt, system-signal=CST_SPN3522_Stop_Fault_CHGCnnt
        data-element=CPT_BMSL_FlatView.CST_CHG.CST_SPN3521_Stop_Reason_Manual, system-signal=CST_SPN3521_Stop_Reason_Manual
        data-element=CPT_BMSL_FlatView.CST_CHG.CST_SPN3521_Stop_Reason_Fault, system-signal=CST_SPN3521_Stop_Reason_Fault
        data-element=CPT_BMSL_FlatView.CST_CHG.CST_SPN3521_Stop_Reason_Auto, system-signal=CST_SPN3521_Stop_Reason_Auto
        data-element=CPT_BMSL_FlatView.BST_BCU.BST_SPN3512_Stop_Fault_HVRelay, system-signal=BST_SPN3512_Stop_Fault_HVRelay
        data-element=CPT_BMSL_FlatView.BST_BCU.BST_SPN3512_Stop_Fault_CC2, system-signal=BST_SPN3512_Stop_Fault_CC2
        data-element=CPT_BMSL_FlatView.BST_BCU.BST_SPN3511_Stop_Reason_CHGStop, system-signal=BST_SPN3511_Stop_Reason_CHGStop
        data-element=CPT_BMSL_FlatView.BST_BCU.BST_SPN3513_Stop_Fault_U, system-signal=BST_SPN3513_Stop_Fault_U
        data-element=CPT_BMSL_FlatView.BST_BCU.BST_SPN3513_Stop_Fault_I, system-signal=BST_SPN3513_Stop_Fault_I
        data-element=CPT_BMSL_FlatView.BST_BCU.BST_SPN3512_Stop_Fault_T, system-signal=BST_SPN3512_Stop_Fault_T
        data-element=CPT_BMSL_FlatView.BST_BCU.BST_SPN3512_Stop_Fault_Other, system-signal=BST_SPN3512_Stop_Fault_Other
        data-element=CPT_BMSL_FlatView.BST_BCU.BST_SPN3512_Stop_Fault_Iso, system-signal=BST_SPN3512_Stop_Fault_Iso
        data-element=CPT_BMSL_FlatView.BST_BCU.BST_SPN3512_Stop_Fault_OutCnnt, system-signal=BST_SPN3512_Stop_Fault_OutCnnt
        data-element=CPT_BMSL_FlatView.BST_BCU.BST_SPN3512_Stop_Fault_BCUcompo, system-signal=BST_SPN3512_Stop_Fault_BCUcompo
        data-element=CPT_BMSL_FlatView.BST_BCU.BST_SPN3512_Stop_Fault_ChgCnnt, system-signal=BST_SPN3512_Stop_Fault_ChgCnnt
        data-element=CPT_BMSL_FlatView.BST_BCU.BST_SPN3511_Stop_Reason_Ucell, system-signal=BST_SPN3511_Stop_Reason_Ucell
        data-element=CPT_BMSL_FlatView.BST_BCU.BST_SPN3511_Stop_Reason_U, system-signal=BST_SPN3511_Stop_Reason_U
        data-element=CPT_BMSL_FlatView.BST_BCU.BST_SPN3511_Stop_Reason_SOC, system-signal=BST_SPN3511_Stop_Reason_SOC
        data-element=CPT_BMSL_FlatView.BSM_BCU.BSM_SPN3096_Chg_Enable, system-signal=BSM_SPN3096_Chg_Enable
        data-element=CPT_BMSL_FlatView.BSM_BCU.BSM_SPN3095_OutConnector_State, system-signal=BSM_SPN3095_OutConnector_State
        data-element=CPT_BMSL_FlatView.BSM_BCU.BSM_SPN3094_Iso_State, system-signal=BSM_SPN3094_Iso_State
        data-element=CPT_BMSL_FlatView.BSM_BCU.BSM_SPN3093_T_Warn, system-signal=BSM_SPN3093_T_Warn
        data-element=CPT_BMSL_FlatView.BSM_BCU.BSM_SPN3092_I_Warn, system-signal=BSM_SPN3092_I_Warn
        data-element=CPT_BMSL_FlatView.BSM_BCU.BSM_SPN3091_SOC_Warn, system-signal=BSM_SPN3091_SOC_Warn
        data-element=CPT_BMSL_FlatView.BSM_BCU.BSM_SPN3090_Ucell_Warn, system-signal=BSM_SPN3090_Ucell_Warn
        data-element=CPT_BMSL_FlatView.BSM_BCU.BSM_SPN3089_T_Min_Index, system-signal=BSM_SPN3089_T_Min_Index
        data-element=CPT_BMSL_FlatView.BSM_BCU.BSM_SPN3088_T_Min, system-signal=BSM_SPN3088_T_Min
        data-element=CPT_BMSL_FlatView.BSM_BCU.BSM_SPN3087_T_Max_Index, system-signal=BSM_SPN3087_T_Max_Index
        data-element=CPT_BMSL_FlatView.BSM_BCU.BSM_SPN3086_T_Max, system-signal=BSM_SPN3086_T_Max
        data-element=CPT_BMSL_FlatView.BSM_BCU.BSM_SPN3085_Ucell_Max_Index, system-signal=BSM_SPN3085_Ucell_Max_Index
        data-element=CPT_BMSL_FlatView.CCS_CHG.CCS_SPN3081_U_Out, system-signal=CCS_SPN3081_U_Out
        data-element=CPT_BMSL_FlatView.CCS_CHG.CCS_SPN3082_I_Out, system-signal=CCS_SPN3082_I_Out
        data-element=CPT_BMSL_FlatView.CCS_CHG.CCS_SPN3083_Time_Charged, system-signal=CCS_SPN3083_Time_Charged
        data-element=CPT_BMSL_FlatView.CCS_CHG.CCS_SPN3929_Chg_enable, system-signal=CCS_SPN3929_Chg_enable
        data-element=CPT_BMSL_FlatView.BCL_BCU.BCL_SPN3074_ChgMode, system-signal=BCL_SPN3074_ChgMode
        data-element=CPT_BMSL_FlatView.BCL_BCU.BCL_SPN3073_I_Req, system-signal=BCL_SPN3073_I_Req
        data-element=CPT_BMSL_FlatView.BCL_BCU.BCL_SPN3072_U_Req, system-signal=BCL_SPN3072_U_Req
        data-element=CPT_BMSL_FlatView.PPort_BMS_3DAh.HVBatSOCHiRes, system-signal=HVBatSOCHiRes
      sw-mappings:
        swc to ecu mapping SwcToEcuMapping_0: ecu-instance=BMS
          component:
            CPT_BMSL_FlatView.CPT_Asw_Swc
            CPT_BMSL_FlatView.CPT_BswM
            CPT_BMSL_FlatView.CPT_Cmu_Cdd
            CPT_BMSL_FlatView.CPT_ComM
            CPT_BMSL_FlatView.CPT_Det
            CPT_BMSL_FlatView.CPT_EcuM
            CPT_BMSL_FlatView.CPT_IoHwAb
            CPT_BMSL_FlatView.CPT_NvM
            CPT_BMSL_FlatView.CPT_Sbc_Cdd
            CPT_BMSL_FlatView.CPT_WdgM
            CPT_BMSL_FlatView.CPT_WdgM_SWC
            CPT_BMSL_FlatView.CPT_Xcp_SWC
    root-software-compositions:
      root sw composition prototype CPT_BMSL_FlatView: flat-map=BMSL_FlatMap, software-composition=BMSL_FlatView
