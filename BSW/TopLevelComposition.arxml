AUTOSAR XML (schema 4-2-2)
package /TopLevelComposition
  composition sw component type TopLevelComposition
    12 x component:
      CPT_BswM: type=BswM
      CPT_ComM: type=ComM
      CPT_EcuM: type=EcuM
      CPT_Det: type=Det
      CPT_Xcp_SWC: type=Xcp_SWC
      CPT_WdgM: type=WdgM
      CPT_WdgM_SWC: type=WdgM_SWC
      CPT_NvM: type=NvM
      CPT_IoHwAb: type=IoHwAb
      CPT_Cmu_Cdd: type=Cmu_Cdd
      CPT_Asw_Swc: type=Asw_Swc
      CPT_Sbc_Cdd: type=Sbc_Cdd
    connect CPT_Cmu_Cdd.CmuValue -> CPT_Asw_Swc.CmuValue
    connect CPT_IoHwAb.RelayValue -> CPT_Asw_Swc.RelayValue
    connect CPT_Sbc_Cdd.SbcValue -> CPT_Asw_Swc.SbcValue
    connect CPT_Asw_Swc.RelayCmd -> CPT_IoHwAb.RelayCmd
    connect CPT_Asw_Swc.FblCmd -> CPT_IoHwAb.FblCmd
    connect CPT_IoHwAb.McuValue -> CPT_Asw_Swc.McuValue
    connect CPT_Asw_Swc.CmuCmd -> CPT_Cmu_Cdd.CmuCmd
    connect CPT_NvM.NVDataBlock1 -> CPT_Asw_Swc.RPort_NVDataBlock1
    connect CPT_Asw_Swc.PPort_NVDataBlock1_Finished -> CPT_NvM.NVDataBlock1_Finished
    connect CPT_IoHwAb.PowerValue -> CPT_Asw_Swc.PowerValue
    connect CPT_Asw_Swc.PPort_BswMArbitration_BswM_MRP_SwcModeRequest -> CPT_BswM.RP_BswMArbitration_BswM_MRP_SwcModeRequest
    connect CPT_EcuM.shutdownTarget -> CPT_Asw_Swc.RPort_EcuM_ShutdownTarget
    connect CPT_ComM.UR_ComMUser_Can_Network_0_Channel -> CPT_Asw_Swc.RPort_ComM_UserRequest
    connect CPT_WdgM.alive_WdgMAliveSupervisedEntity_Bsw_100ms -> CPT_WdgM_SWC.RPort_AliveSupervision_Bsw_100ms
    connect CPT_WdgM.alive_WdgMAliveSupervisedEntity_Bsw_10ms -> CPT_WdgM_SWC.RPort_AliveSupervision_Bsw_10ms
    connect CPT_WdgM.alive_WdgMAliveSupervisedEntity_Bsw_20ms -> CPT_WdgM_SWC.RPort_AliveSupervision_Bsw_20ms
    connect CPT_WdgM.alive_WdgMAliveSupervisedEntity_Bsw_5ms -> CPT_WdgM_SWC.RPort_AliveSupervision_Bsw_5ms
    connect CPT_WdgM.alive_WdgMAliveSupervisedEntity_Bsw_50ms -> CPT_WdgM_SWC.RPort_AliveSupervision_Bsw_50ms
    connect CPT_WdgM.alive_WdgMAliveSupervisedEntity_Asw_5ms -> CPT_WdgM_SWC.RPort_AliveSupervision_Asw_5ms
    connect CPT_WdgM.alive_WdgMAliveSupervisedEntity_Bsw_1000ms -> CPT_WdgM_SWC.RPort_AliveSupervision_Bsw_1000ms
    connect CPT_IoHwAb.ChargeValue -> CPT_Asw_Swc.ChargeValue
    connect CPT_IoHwAb.HighVoltValue -> CPT_Asw_Swc.HighVoltValue
    connect CPT_IoHwAb.SbcValue -> CPT_Asw_Swc.SbcValue
    connect CPT_IoHwAb.IsoValue -> CPT_Asw_Swc.IsoValue
    connect CPT_IoHwAb.CurrValue -> CPT_Asw_Swc.CurrValue
    connect CPT_IoHwAb.CrashValue -> CPT_Asw_Swc.CrashValue
    connect CPT_IoHwAb.HvilValue -> CPT_Asw_Swc.HvilValue
    connect CPT_IoHwAb.ThermalValue -> CPT_Asw_Swc.ThermalValue
    connect CPT_IoHwAb.RsvValue -> CPT_Asw_Swc.RsvValue
    connect CPT_Asw_Swc.ChargeCmd -> CPT_IoHwAb.ChargeCmd
    connect CPT_Asw_Swc.HvilCmd -> CPT_IoHwAb.HvilCmd
    connect CPT_Asw_Swc.IsoCmd -> CPT_IoHwAb.IsoCmd
    connect CPT_Asw_Swc.ThermalCmd -> CPT_IoHwAb.ThermalCmd
    connect CPT_Asw_Swc.McuCmd -> CPT_IoHwAb.McuCmd
    connect CPT_Asw_Swc.HighVoltCmd -> CPT_IoHwAb.HighVoltCmd
    connect CPT_IoHwAb.Rtc -> CPT_Asw_Swc.Rtc
    connect CPT_Cmu_Cdd.Cmu -> CPT_Asw_Swc.Cmu
