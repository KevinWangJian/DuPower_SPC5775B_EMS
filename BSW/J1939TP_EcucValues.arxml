AUTOSAR XML (schema 4-2-2)
package /J1939TP
  module config J1939Tp
    J1939TpConfiguration_0 (J1939TpConfiguration)
      J1939TpTxChannel_0 (J1939TpTxChannel):
        J1939TpTxCancellationSupport = 0
        J1939TpTxDynamicBlockCalculation = 0
        J1939TpTxMaxPacketsPerBlock = 255
        J1939TpTxRetrySupport = 0
        J1939TpTxProtocolType = J1939TP_PROTOCOL_CMDT
        J1939TpTxCmNPdu_0 (J1939TpTxCmNPdu): J1939TpTxCmNPduTxConfId=1, J1939TpTxCmNPduRef=NPDU_TX_CM_J1939_Network_CANNODE_0_J1939Tp2CanIf
        J1939TpTxDtNPdu_0 (J1939TpTxDtNPdu): J1939TpTxDtNPduTxConfId=0, J1939TpTxDtNPduRef=NPDU_TX_DT_J1939_Network_CANNODE_0_J1939Tp2CanIf
        BCP_BCU (J1939TpTxPg): J1939TpTxPgDynLength=0, J1939TpTxPgPGN=1536
          J1939TpTxNSdu_0 (J1939TpTxNSdu): J1939TpTxNSduId=0, J1939TpTxNSduRef=BCP_BCU_J1939_Network_CANNODE_0_PduR2J1939Tp
        J1939TpRxFcNPdu_0 (J1939TpRxFcNPdu): J1939TpRxFcNPduId=0, J1939TpRxFcNPduRef=NPDU_RX_CM_CMDT_J1939_Network_CANNODE_0_CanIf2J1939Tp
        3 x J1939TpTxPg, all with J1939TpTxPgDynLength=0:
          BCS_BCU: J1939TpTxPgPGN=4352
            J1939TpTxNSdu_0 (J1939TpTxNSdu): J1939TpTxNSduId=1, J1939TpTxNSduRef=BCS_BCU_J1939_Network_CANNODE_0_PduR2J1939Tp
          BRM_BCU: J1939TpTxPgPGN=512
            J1939TpTxNSdu_0 (J1939TpTxNSdu): J1939TpTxNSduId=2, J1939TpTxNSduRef=BRM_BCU_J1939_Network_CANNODE_0_PduR2J1939Tp
          Old_BRM_BCU: J1939TpTxPgPGN=513
            J1939TpTxNSdu_0 (J1939TpTxNSdu): J1939TpTxNSduId=3, J1939TpTxNSduRef=Old_BRM_BCU_J1939_Network_CANNODE_0_PduR2J1939Tp
    J1939TpGeneral_0 (J1939TpGeneral):
      J1939TpCancellationSupport = 0
      J1939TpMetaDataSupport = 0
      J1939TpDevErrorDetect = 0
      J1939TpMainFunctionPeriod = 0.01
      J1939TpTxConfTimeout = 5.0
      J1939TpVersionInfoApi = 0
