[part 1 of 2: package /AUTOSAR_Rte/BswModuleDescriptions]
AUTOSAR XML (schema 4-2-2)
standard types defined: uint8, Std_ReturnType, uint32, uint16, boolean, float32
package /AUTOSAR_Rte/BswModuleDescriptions
  bsw module description Rte: outgoing-callbacks=[Rte_StartHook_Return, Rte_StartHook_Start, Rte_StopHook_Return, Rte_StopHook_Start, Rte_Task_Activate]
    provided-entrys:
      Rte_ActivateRE
      Rte_Call_Asw_Swc_Cmu_Get_CMUPCBTempVld_flg
      Rte_Call_Asw_Swc_Cmu_Get_CMUPCBTemp_C
      Rte_Call_Asw_Swc_Cmu_Get_CellBalState_flg
      Rte_Call_Asw_Swc_Cmu_Get_CellTempVld_flg
      Rte_Call_Asw_Swc_Cmu_Get_CellTemp_C
      Rte_Call_Asw_Swc_Cmu_Get_CellVoltVld_flg
      Rte_Call_Asw_Swc_Cmu_Get_CellVolt_mV
      Rte_Call_Asw_Swc_Cmu_Get_CmuCbOpenFltArr
      Rte_Call_Asw_Swc_Cmu_Get_CmuCbShortFltArr
      Rte_Call_Asw_Swc_Cmu_Get_CmuCellTermLeakArr
      Rte_Call_Asw_Swc_Cmu_Get_CmuCtOpenFltArr
      Rte_Call_Asw_Swc_Cmu_Get_CmuFaultState1
      Rte_Call_Asw_Swc_Cmu_Get_CmuFaultState2
      Rte_Call_Asw_Swc_Cmu_Get_CmuGpioOTFuncArr
      Rte_Call_Asw_Swc_Cmu_Get_CmuGpioUTFuncArr
      Rte_Call_Asw_Swc_Cmu_Get_CmuGpioxOpenArr
      Rte_Call_Asw_Swc_Cmu_Get_CmuOVFuncArr
      Rte_Call_Asw_Swc_Cmu_Get_CmuUVFuncArr
      Rte_Call_Asw_Swc_Cmu_Get_CmuVoltChaFuncArr
      Rte_Call_Asw_Swc_Cmu_Get_HeatFilmTempVld_flg
      Rte_Call_Asw_Swc_Cmu_Get_HeatFilmTemp_C
      Rte_Call_Asw_Swc_Cmu_Get_StackVoltVld_flg
      Rte_Call_Asw_Swc_Cmu_Get_StackVolt_V
      Rte_Call_Asw_Swc_Cmu_Set_CellBalCmd_flg
      Rte_Call_Asw_Swc_RPort_ComM_UserRequest_GetCurrentComMode
      Rte_Call_Asw_Swc_RPort_EcuM_ShutdownTarget_SelectShutdownTarget
      Rte_Call_Asw_Swc_RPort_NVDataBlock1_SetRamBlockStatus
      Rte_Call_Asw_Swc_RPort_NVDataBlock1_WriteBlock
      Rte_Call_Asw_Swc_Rtc_DisableRTCWakeup_flg
      Rte_Call_Asw_Swc_Rtc_ReadRTCTime
      Rte_Call_Asw_Swc_Rtc_SetSleepTime_Min
      Rte_Call_Asw_Swc_Rtc_WriteRTCTime
      Rte_Call_NvM_NVDataBlock1_Finished_JobFinished
      Rte_Call_WdgM_SWC_RPort_AliveSupervision_Asw_5ms_CheckpointReached
      Rte_Call_WdgM_SWC_RPort_AliveSupervision_Bsw_1000ms_CheckpointReached
      Rte_Call_WdgM_SWC_RPort_AliveSupervision_Bsw_100ms_CheckpointReached
      Rte_Call_WdgM_SWC_RPort_AliveSupervision_Bsw_10ms_CheckpointReached
      Rte_Call_WdgM_SWC_RPort_AliveSupervision_Bsw_20ms_CheckpointReached
      Rte_Call_WdgM_SWC_RPort_AliveSupervision_Bsw_50ms_CheckpointReached
      Rte_Call_WdgM_SWC_RPort_AliveSupervision_Bsw_5ms_CheckpointReached
      Rte_DecrementWaitingCount
      Rte_GetCurrentTaskIndex
      Rte_MainFunction
      Rte_ReadQueue
      Rte_Read_Asw_Swc_CCS_CHG_CCS_SPN3081_U_Out
      Rte_Read_Asw_Swc_CCS_CHG_CCS_SPN3082_I_Out
      Rte_Read_Asw_Swc_CCS_CHG_CCS_SPN3083_Time_Charged
      Rte_Read_Asw_Swc_CCS_CHG_CCS_SPN3929_Chg_enable
      Rte_Read_Asw_Swc_CEM_CHG_CEM_SPN3921_Timeout_BRM
      Rte_Read_Asw_Swc_CEM_CHG_CEM_SPN3922_Timeout_BCP
      Rte_Read_Asw_Swc_CEM_CHG_CEM_SPN3923_Timeout_BRO
      Rte_Read_Asw_Swc_CEM_CHG_CEM_SPN3924_Timeout_BCS
      Rte_Read_Asw_Swc_CEM_CHG_CEM_SPN3925_Timeout_BCL
      Rte_Read_Asw_Swc_CEM_CHG_CEM_SPN3926_Timeout_BST
      Rte_Read_Asw_Swc_CEM_CHG_CEM_SPN3927_Timeout_BSD
      Rte_Read_Asw_Swc_CEM_CHG_CEM_other
      Rte_Read_Asw_Swc_CHM_CHG_CHM_SPN2600_Comm_Ver
      Rte_Read_Asw_Swc_CML_CHG_CML_SPN2824_U_Max_Out
      Rte_Read_Asw_Swc_CML_CHG_CML_SPN2825_U_Min_Out
      Rte_Read_Asw_Swc_CML_CHG_CML_SPN2826_I_Max_Out
      Rte_Read_Asw_Swc_CML_CHG_CML_SPN2827_I_Min_Out
      Rte_Read_Asw_Swc_CRM_CHG_CRM_SPN2560_Ack
      Rte_Read_Asw_Swc_CRM_CHG_CRM_SPN2561_CHG_Index
      Rte_Read_Asw_Swc_CRM_CHG_CRM_SPN2562_CHG_Loc
      Rte_Read_Asw_Swc_CRO_CHG_CRO_SPN2830_CHG_Ready
      Rte_Read_Asw_Swc_CSD_CHG_CSD_SPN3611_Time_Charged
      Rte_Read_Asw_Swc_CSD_CHG_CSD_SPN3612_E_Out
      Rte_Read_Asw_Swc_CSD_CHG_CSD_SPN3613_CHG_Index
      Rte_Read_Asw_Swc_CST_CHG_CST_SPN3521_Stop_Reason_Auto
      Rte_Read_Asw_Swc_CST_CHG_CST_SPN3521_Stop_Reason_BMSStop
      Rte_Read_Asw_Swc_CST_CHG_CST_SPN3521_Stop_Reason_Fault
      Rte_Read_Asw_Swc_CST_CHG_CST_SPN3521_Stop_Reason_Manual
      Rte_Read_Asw_Swc_CST_CHG_CST_SPN3522_Stop_Fault_CHGCnnt
      Rte_Read_Asw_Swc_CST_CHG_CST_SPN3522_Stop_Fault_Deliver
      Rte_Read_Asw_Swc_CST_CHG_CST_SPN3522_Stop_Fault_EmerStop
      Rte_Read_Asw_Swc_CST_CHG_CST_SPN3522_Stop_Fault_Other
      Rte_Read_Asw_Swc_CST_CHG_CST_SPN3522_Stop_Fault_T_CHG
      Rte_Read_Asw_Swc_CST_CHG_CST_SPN3522_Stop_Fault_T_Inter
      Rte_Read_Asw_Swc_CST_CHG_CST_SPN3523_Stop_Fault_Mismatch
      Rte_Read_Asw_Swc_CST_CHG_CST_SPN3523_Stop_Fault_U
      Rte_Read_Asw_Swc_CTS_CHG_CTS_SPN2823_SYNC_Day
      Rte_Read_Asw_Swc_CTS_CHG_CTS_SPN2823_SYNC_DayTen
      Rte_Read_Asw_Swc_CTS_CHG_CTS_SPN2823_SYNC_Hour
      Rte_Read_Asw_Swc_CTS_CHG_CTS_SPN2823_SYNC_HourTen
      Rte_Read_Asw_Swc_CTS_CHG_CTS_SPN2823_SYNC_Minute
      Rte_Read_Asw_Swc_CTS_CHG_CTS_SPN2823_SYNC_MinuteTen
      Rte_Read_Asw_Swc_CTS_CHG_CTS_SPN2823_SYNC_Month
      Rte_Read_Asw_Swc_CTS_CHG_CTS_SPN2823_SYNC_MonthTen
      Rte_Read_Asw_Swc_CTS_CHG_CTS_SPN2823_SYNC_Second
      Rte_Read_Asw_Swc_CTS_CHG_CTS_SPN2823_SYNC_SecondTen
      Rte_Read_Asw_Swc_CTS_CHG_CTS_SPN2823_SYNC_Year
      Rte_Read_Asw_Swc_CTS_CHG_CTS_SPN2823_SYNC_YearHundred
      Rte_Read_Asw_Swc_CTS_CHG_CTS_SPN2823_SYNC_YearTen
      Rte_Read_Asw_Swc_CTS_CHG_CTS_SPN2823_SYNC_YearThousand
      Rte_Read_Asw_Swc_ChargeValue_CC2VoltVld_flg
      Rte_Read_Asw_Swc_ChargeValue_CC2Volt_V
      Rte_Read_Asw_Swc_ChargeValue_CCResVld_flg
      Rte_Read_Asw_Swc_ChargeValue_CCRes_ohm
      Rte_Read_Asw_Swc_ChargeValue_CPDutyVld_flg
      Rte_Read_Asw_Swc_ChargeValue_CPDuty_pct
      Rte_Read_Asw_Swc_ChargeValue_CPFrqVld_flg
      Rte_Read_Asw_Swc_ChargeValue_CPFrq_Hz
      Rte_Read_Asw_Swc_ChargeValue_CPVoltVld_flg
      Rte_Read_Asw_Swc_ChargeValue_CPVolt_V
      Rte_Read_Asw_Swc_ChargeValue_DCWakeupVoltVld_flg
      Rte_Read_Asw_Swc_ChargeValue_DCWakeupVolt_V
      Rte_Read_Asw_Swc_ChargeValue_ELockDiagVoltVld_flg
      Rte_Read_Asw_Swc_ChargeValue_ELockDiagVolt_V
      Rte_Read_Asw_Swc_ChargeValue_LampCcHDiagVoltVld_flg
      Rte_Read_Asw_Swc_ChargeValue_LampCcHDiagVolt_V
      Rte_Read_Asw_Swc_ChargeValue_LampChgHDiagVoltVld_flg
      Rte_Read_Asw_Swc_ChargeValue_LampChgHDiagVolt_V
      Rte_Read_Asw_Swc_CmuValue_BalOpenLoadDiagStatus_flg
      Rte_Read_Asw_Swc_CmuValue_CMUPwrDiagVoltVld_flg
      Rte_Read_Asw_Swc_CmuValue_CMUPwrDiagVolt_V
      Rte_Read_Asw_Swc_CmuValue_CellLeakageDiagStatus_flg
      Rte_Read_Asw_Swc_CmuValue_ChanelFuncDiagStatus_flg
      Rte_Read_Asw_Swc_CmuValue_CmuReCfgStatus_flg
      Rte_Read_Asw_Swc_CmuValue_CtxOpenDiagStatus_flg
      Rte_Read_Asw_Swc_CmuValue_GpioOTUTFuncDiagStatus_flg
      Rte_Read_Asw_Swc_CmuValue_GpioxOpenDiagStatus_flg
      Rte_Read_Asw_Swc_CmuValue_InCMUHWAlarmPWMDutyVld_flg
      Rte_Read_Asw_Swc_CmuValue_InCMUHWAlarmPWMDuty_pct
      Rte_Read_Asw_Swc_CmuValue_InCMUHWAlarmPWMFeqVld_flg
      Rte_Read_Asw_Swc_CmuValue_InCMUHWAlarmPWMFeq_Hz
      Rte_Read_Asw_Swc_CrashValue_CrashPWMDutyVld_flg
      Rte_Read_Asw_Swc_CrashValue_CrashPWMDuty_pct
      Rte_Read_Asw_Swc_CrashValue_CrashPWMFrqVld_flg
      Rte_Read_Asw_Swc_CrashValue_CrashPWMFrq_Hz
      Rte_Read_Asw_Swc_CurrValue_HallCH1RedVoltVld_flg
      Rte_Read_Asw_Swc_CurrValue_HallCH1RedVolt_V
      Rte_Read_Asw_Swc_CurrValue_HallCH1VoltVld_flg
      Rte_Read_Asw_Swc_CurrValue_HallCH1Volt_V
      Rte_Read_Asw_Swc_CurrValue_HallCH2RedVoltVld_flg
      Rte_Read_Asw_Swc_CurrValue_HallCH2RedVolt_V
      Rte_Read_Asw_Swc_CurrValue_HallCH2VoltVld_flg
      Rte_Read_Asw_Swc_CurrValue_HallCH2Volt_V
      Rte_Read_Asw_Swc_CurrValue_HallSpyVoltVld_flg
      Rte_Read_Asw_Swc_CurrValue_HallSpyVolt_V
      Rte_Read_Asw_Swc_CurrValue_PackCurrRedVld_flg
      Rte_Read_Asw_Swc_CurrValue_PackCurrRed_A
      Rte_Read_Asw_Swc_CurrValue_PackCurrVld_flg
      Rte_Read_Asw_Swc_CurrValue_PackCurr_A
      Rte_Read_Asw_Swc_DCDC_303h_CDU_HVILWarning
      Rte_Read_Asw_Swc_DCDC_303h_I_LDC_In
      Rte_Read_Asw_Swc_HighVoltValue_P1CheckVoltVld_flg
      Rte_Read_Asw_Swc_HighVoltValue_P1CheckVolt_V
      Rte_Read_Asw_Swc_HighVoltValue_P2CheckVoltVld_flg
      Rte_Read_Asw_Swc_HighVoltValue_P2CheckVolt_V
      Rte_Read_Asw_Swc_HighVoltValue_P3CheckVoltVld_flg
      Rte_Read_Asw_Swc_HighVoltValue_P3CheckVolt_V
      Rte_Read_Asw_Swc_HighVoltValue_PackVoltVld_flg
      Rte_Read_Asw_Swc_HighVoltValue_PackVolt_V
      Rte_Read_Asw_Swc_HighVoltValue_PreChgCheckRedVoltVld_flg
      Rte_Read_Asw_Swc_HighVoltValue_PreChgCheckRedVolt_V
      Rte_Read_Asw_Swc_HighVoltValue_PreChgCheckVoltVld_flg
      Rte_Read_Asw_Swc_HighVoltValue_PreChgCheckVolt_V
      Rte_Read_Asw_Swc_HvilValue_HVILHighVoltVld_flg
      Rte_Read_Asw_Swc_HvilValue_HVILHighVolt_V
      Rte_Read_Asw_Swc_HvilValue_HVILLowVoltVld_flg
      Rte_Read_Asw_Swc_HvilValue_HVILLowVolt_V
      Rte_Read_Asw_Swc_HvilValue_InHVILPWMDutyVld_flg
      Rte_Read_Asw_Swc_HvilValue_InHVILPWMDuty_pct
      Rte_Read_Asw_Swc_HvilValue_InHVILPWMFrqVld_flg
      Rte_Read_Asw_Swc_HvilValue_InHVILPWMFrq_Hz
      Rte_Read_Asw_Swc_IsoValue_HVIsoNegVoltVld_flg
      Rte_Read_Asw_Swc_IsoValue_HVIsoNegVolt_V
      Rte_Read_Asw_Swc_IsoValue_HVIsoPosVoltVld_flg
      Rte_Read_Asw_Swc_IsoValue_HVIsoPosVolt_V
      Rte_Read_Asw_Swc_McuValue_BSWInitFinish_flg
      Rte_Read_Asw_Swc_OBC_604h_OBCChgCurrent
      Rte_Read_Asw_Swc_OBC_604h_OBCChgVolt
      Rte_Read_Asw_Swc_OBC_604h_OBCCurrentFltCode
      Rte_Read_Asw_Swc_OBC_604h_OBCHistoryFltCode
      Rte_Read_Asw_Swc_OBC_604h_OBCMaxChrgCurrent
      Rte_Read_Asw_Swc_OBC_604h_OBCMaxChrgVoltage
      Rte_Read_Asw_Swc_OBC_604h_OBCStatus
      Rte_Read_Asw_Swc_PEU_0B4h_V_DC
      Rte_Read_Asw_Swc_PEU_0B4h_V_DCValidity
      Rte_Read_Asw_Swc_PEU_18Bh_InvADCCrnt
      Rte_Read_Asw_Swc_PEU_18Bh_InvADCCrntV
      Rte_Read_Asw_Swc_PowerValue_BmuPullupSwitchDiag_flg
      Rte_Read_Asw_Swc_PowerValue_BmuPullupVoltVld_flg
      Rte_Read_Asw_Swc_PowerValue_BmuPullupVolt_V
      Rte_Read_Asw_Swc_PowerValue_KL15VoltVld_flg
      Rte_Read_Asw_Swc_PowerValue_KL15Volt_V
      Rte_Read_Asw_Swc_PowerValue_KL30VoltVld_flg
      Rte_Read_Asw_Swc_PowerValue_KL30Volt_V
      Rte_Read_Asw_Swc_PowerValue_KPowertVoltVld_flg
      Rte_Read_Asw_Swc_PowerValue_KPowertVolt_V
      Rte_Read_Asw_Swc_PowerValue_ResWakeUp1HVoltVld_flg
      Rte_Read_Asw_Swc_PowerValue_ResWakeUp1HVolt_V
      Rte_Read_Asw_Swc_PowerValue_ResWakeUp2HVoltVld_flg
      Rte_Read_Asw_Swc_PowerValue_ResWakeUp2HVolt_V
      Rte_Read_Asw_Swc_PowerValue_ResWakeUp3LVoltVld_flg
      Rte_Read_Asw_Swc_PowerValue_ResWakeUp3LVolt_V
      Rte_Read_Asw_Swc_RelayValue_GlobalHsideDiagVoltVld_flg
      Rte_Read_Asw_Swc_RelayValue_GlobalHsideDiagVolt_V
      Rte_Read_Asw_Swc_RelayValue_GlobalHsideDriverVoltVld_flg
      Rte_Read_Asw_Swc_RelayValue_GlobalHsideDriverVolt_V
      Rte_Read_Asw_Swc_RelayValue_K1CtrDriverVoltVld_flg
      Rte_Read_Asw_Swc_RelayValue_K1CtrDriverVolt_V
      Rte_Read_Asw_Swc_RelayValue_K2CtrDriverVoltVld_flg
      Rte_Read_Asw_Swc_RelayValue_K2CtrDriverVolt_V
      Rte_Read_Asw_Swc_RelayValue_K3CtrDriverVoltVld_flg
      Rte_Read_Asw_Swc_RelayValue_K3CtrDriverVolt_V
      Rte_Read_Asw_Swc_RelayValue_K4CtrDriverVoltVld_flg
      Rte_Read_Asw_Swc_RelayValue_K4CtrDriverVolt_V
      Rte_Read_Asw_Swc_RelayValue_K5CtrDriverVoltVld_flg
      Rte_Read_Asw_Swc_RelayValue_K5CtrDriverVolt_V
      Rte_Read_Asw_Swc_RelayValue_K6CtrDriverVoltVld_flg
      Rte_Read_Asw_Swc_RelayValue_K6CtrDriverVolt_V
      Rte_Read_Asw_Swc_RelayValue_KnCtrDriverVoltVld_flg
      Rte_Read_Asw_Swc_RelayValue_KnCtrDriverVolt_V
      Rte_Read_Asw_Swc_RelayValue_KnchgEnOutState_flg
      Rte_Read_Asw_Swc_RelayValue_KnchgEnStateVld_flg
      Rte_Read_Asw_Swc_RelayValue_KpCtrDriverVoltVld_flg
      Rte_Read_Asw_Swc_RelayValue_KpCtrDriverVolt_V
      Rte_Read_Asw_Swc_RelayValue_KpEnOutState_flg
      Rte_Read_Asw_Swc_RelayValue_KpEnStateVld_flg
      Rte_Read_Asw_Swc_RsvValue_InRsvPWMDutyVld_flg
      Rte_Read_Asw_Swc_RsvValue_InRsvPWMDuty_pct
      Rte_Read_Asw_Swc_RsvValue_InRsvPWMFrqVld_flg
      Rte_Read_Asw_Swc_RsvValue_InRsvPWMFrq_Hz
      Rte_Read_Asw_Swc_RsvValue_RsvAD1VoltVld_flg
      Rte_Read_Asw_Swc_RsvValue_RsvAD1Volt_V
      Rte_Read_Asw_Swc_RsvValue_RsvAD2VoltVld_flg
      Rte_Read_Asw_Swc_RsvValue_RsvAD2Volt_V
      Rte_Read_Asw_Swc_RsvValue_RsvAD3VoltVld_flg
      Rte_Read_Asw_Swc_RsvValue_RsvAD3Volt_V
      Rte_Read_Asw_Swc_RsvValue_RsvAD4VoltVld_flg
      Rte_Read_Asw_Swc_RsvValue_RsvAD4Volt_V
      Rte_Read_Asw_Swc_RsvValue_RsvAD5VoltVld_flg
      Rte_Read_Asw_Swc_RsvValue_RsvAD5Volt_V
      Rte_Read_Asw_Swc_SbcValue_BMULastPwrDownState
      Rte_Read_Asw_Swc_SbcValue_BmuSbcCanTRSt_flg
      Rte_Read_Asw_Swc_SbcValue_BmuSbcRstbPinSt_flg
      Rte_Read_Asw_Swc_SbcValue_BmuSbcVauxOV_flg
      Rte_Read_Asw_Swc_SbcValue_BmuSbcVauxUV_flg
      Rte_Read_Asw_Swc_SbcValue_BmuSbcVcanOV_flg
      Rte_Read_Asw_Swc_SbcValue_BmuSbcVcanUV_flg
      Rte_Read_Asw_Swc_SbcValue_BmuSbcVccaOV_flg
      Rte_Read_Asw_Swc_SbcValue_BmuSbcVccaUV_flg
      Rte_Read_Asw_Swc_SbcValue_BmuSbcVcoreOV_flg
      Rte_Read_Asw_Swc_SbcValue_BmuSbcVpreOV_flg
      Rte_Read_Asw_Swc_SbcValue_BmuSbcVpreUV_flg
      Rte_Read_Asw_Swc_SbcValue_BmuSbxVcoreUV_flg
      Rte_Read_Asw_Swc_SbcValue_CANWakeupState_flg
      Rte_Read_Asw_Swc_SbcValue_KL15WakeupState_flg
      Rte_Read_Asw_Swc_SbcValue_RTCWakeupState_flg
      Rte_Read_Asw_Swc_SbcValue_SBCWakeupP{1..3}State_flg
      Rte_Read_Asw_Swc_ThermalValue_BmuTemp1NtcVld_flg
      Rte_Read_Asw_Swc_ThermalValue_BmuTemp1Ntc_Ohm
      Rte_Read_Asw_Swc_ThermalValue_BmuTemp2NtcVld_flg
      Rte_Read_Asw_Swc_ThermalValue_BmuTemp2Ntc_Ohm
      Rte_Read_Asw_Swc_ThermalValue_BmuTemp3NtcVld_flg
      Rte_Read_Asw_Swc_ThermalValue_BmuTemp3Ntc_Ohm
      Rte_Read_Asw_Swc_ThermalValue_BmuTemp4NtcVld_flg
      Rte_Read_Asw_Swc_ThermalValue_BmuTemp4Ntc_Ohm
      Rte_Read_Asw_Swc_ThermalValue_BmuTemp5NtcVld_flg
      Rte_Read_Asw_Swc_ThermalValue_BmuTemp5Ntc_Ohm
      Rte_Read_Asw_Swc_ThermalValue_BmuTemp6NtcVld_flg
      Rte_Read_Asw_Swc_ThermalValue_BmuTemp6Ntc_Ohm
      Rte_Read_Asw_Swc_ThermalValue_BmuTemp7NtcVld_flg
      Rte_Read_Asw_Swc_ThermalValue_BmuTemp7Ntc_Ohm
      Rte_Read_Asw_Swc_ThermalValue_InCoolPumpPWMDutyVld_flg
      Rte_Read_Asw_Swc_ThermalValue_InCoolPumpPWMDuty_Pct
      Rte_Read_Asw_Swc_ThermalValue_InCoolPumpPWMFrqVld_flg
      Rte_Read_Asw_Swc_ThermalValue_InCoolPumpPWMFrq_Hz
      Rte_Read_Asw_Swc_ThermalValue_InFanPWMDutyVld_flg
      Rte_Read_Asw_Swc_ThermalValue_InFanPWMDuty_Pct
      Rte_Read_Asw_Swc_ThermalValue_InFanPWMFrqVld_flg
      Rte_Read_Asw_Swc_ThermalValue_InFanPWMFrq_Hz
      Rte_Read_Asw_Swc_ThermalValue_ValveDiagVoltVld_flg
      Rte_Read_Asw_Swc_ThermalValue_ValveDiagVolt_V
      Rte_Read_Asw_Swc_VCU_1E3h_CheckSum_1E3h
      Rte_Read_Asw_Swc_VCU_1E3h_ChrgrStatPTHVCntctOpnrAlwd
      Rte_Read_Asw_Swc_VCU_1E3h_ChrgrStatPTHVCntctrClsAlwd
      Rte_Read_Asw_Swc_VCU_1E3h_PTHVCntctrReq
      Rte_Read_Asw_Swc_VCU_1E3h_RollingCounter_1E3h
      Rte_Read_Asw_Swc_VCU_353h_VehSpdAvgDrvn
      Rte_Read_Asw_Swc_VCU_353h_VehSpdAvgDrvnV
      Rte_Read_Asw_Swc_VCU_ABS_23Ch_CheckSum_23Ch
      Rte_Read_Asw_Swc_VCU_ABS_23Ch_MessageCounter_23Ch
      Rte_Read_Asw_Swc_VCU_ABS_23Ch_VehicleSpeed
      Rte_Read_Asw_Swc_VCU_ABS_23Ch_VehicleSpeedStatus
      Rte_Read_Asw_Swc_VCU_BCM_1F1h_SysOpnlMd
      Rte_Read_Asw_Swc_VCU_BCM_1F1h_SysPwrMd
      Rte_Read_Asw_Swc_VCU_BCM_1F1h_SysVol
      Rte_Read_Asw_Swc_VCU_BCM_1F1h_SysVolMd
      Rte_Read_Asw_Swc_VCU_BCM_1F1h_SysVolMdV
      Rte_Read_Asw_Swc_VCU_BCM_1F1h_SysVolV
      Rte_Read_Asw_Swc_VCU_HCM_55Fh_FrontCmprElctrCrnt
      Rte_Read_Asw_Swc_VCU_HCM_55Fh_FrontCompStatFdbck
      Rte_Read_Asw_Swc_VCU_HCM_55Fh_FrontPTCElctrCrnt
      Rte_Read_Asw_Swc_VCU_HCM_55Fh_FrontPTCStatFdbck
      Rte_Read_Asw_Swc_VCU_IPK_1F2h_SysBPM
      Rte_Read_Asw_Swc_VCU_IPK_1F2h_SysBPMEnbd
      Rte_Read_Asw_Swc_VCU_IPK_362h_HighPreVehOdo
      Rte_Read_Asw_Swc_VCU_IPK_362h_HighPreVehOdoV
      Rte_Read_Asw_Swc_VCU_SRS_163h_RollingCounter
      Rte_Read_Asw_Swc_VCU_SRS_163h_SRSCheckSum
      Rte_Read_Asw_Swc_VCU_SRS_163h_VehCrshTyp
      Rte_Read_BswM_RP_BswMArbitration_BswM_MRP_SwcModeRequest_VDP_uint16
      Rte_Read_Cmu_Cdd_CmuCmd_BalOpenLoadDiagCmd_flg
      Rte_Read_Cmu_Cdd_CmuCmd_CMUPwrCmd_flg
      Rte_Read_Cmu_Cdd_CmuCmd_CellLeakageDiagCmd_flg
      Rte_Read_Cmu_Cdd_CmuCmd_CellMeasCmd_flg
      Rte_Read_Cmu_Cdd_CmuCmd_ChanelFuncDiagCmd_flg
      Rte_Read_Cmu_Cdd_CmuCmd_CmuClrFaultPin_flg
      Rte_Read_Cmu_Cdd_CmuCmd_CmuReCfg_flg
      Rte_Read_Cmu_Cdd_CmuCmd_CtxOpenDiagCmd_flg
      Rte_Read_Cmu_Cdd_CmuCmd_GpioOTUTFuncDiagCmd_flg
      Rte_Read_Cmu_Cdd_CmuCmd_GpioxOpenDiagCmd_flg
      Rte_Read_Cmu_Cdd_CmuCmd_OutCMUHWAlarmPWMDuty_Pct
      Rte_Read_IoHwAb_ChargeCmd_ACS2Cmd_flg
      Rte_Read_IoHwAb_ChargeCmd_ELockCtrlCmd_enum
      Rte_Read_IoHwAb_ChargeCmd_ELockSel0Cmd_flg
      Rte_Read_IoHwAb_ChargeCmd_LampCcHCmd_flg
      Rte_Read_IoHwAb_ChargeCmd_LampChgHCmd_flg
      Rte_Read_IoHwAb_FblCmd_FBLForbid_flg
      Rte_Read_IoHwAb_HighVoltCmd_PackVoltMeasCmd_flg
      Rte_Read_IoHwAb_HvilCmd_OutHVILPWMDuty_Pct
      Rte_Read_IoHwAb_IsoCmd_HVIsoNegMosCmd_flg
      Rte_Read_IoHwAb_IsoCmd_HVIsoPosMosCmd_flg
      Rte_Read_IoHwAb_McuCmd_RadyToSleep_flg
      Rte_Read_IoHwAb_RelayCmd_GlobalHCtrCmd_flg
      Rte_Read_IoHwAb_RelayCmd_K{1..6}CtrCmd_flg
      Rte_Read_IoHwAb_RelayCmd_KnCtrlCmd_flg
      Rte_Read_IoHwAb_RelayCmd_KpCtrlCmd_flg
      Rte_Read_IoHwAb_ThermalCmd_OutCoolPumpPWMDuty_Pct
      Rte_Read_IoHwAb_ThermalCmd_OutFanPWMDuty_Pct
      Rte_Read_IoHwAb_ThermalCmd_ValveEn_flg
      Rte_Read_Sbc_Cdd_SbcCmd_CANWakeupEnable_flg
      Rte_SetEvent
      Rte_Start
      Rte_Stop
      Rte_SwitchAck_WdgM_globalMode_currentMode
      Rte_SwitchAck_WdgM_mode_WdgMAliveSupervisedEntity_Asw_5ms_currentMode
      Rte_SwitchAck_WdgM_mode_WdgMAliveSupervisedEntity_Bsw_1000ms_currentMode
      Rte_SwitchAck_WdgM_mode_WdgMAliveSupervisedEntity_Bsw_100ms_currentMode
      Rte_SwitchAck_WdgM_mode_WdgMAliveSupervisedEntity_Bsw_10ms_currentMode
      Rte_SwitchAck_WdgM_mode_WdgMAliveSupervisedEntity_Bsw_20ms_currentMode
      Rte_SwitchAck_WdgM_mode_WdgMAliveSupervisedEntity_Bsw_50ms_currentMode
      Rte_SwitchAck_WdgM_mode_WdgMAliveSupervisedEntity_Bsw_5ms_currentMode
      Rte_Switch_ComM_UM_ComMUser_Can_Network_0_Channel_currentMode
      Rte_Switch_WdgM_globalMode_currentMode
      Rte_Switch_WdgM_mode_WdgMAliveSupervisedEntity_Asw_5ms_currentMode
      Rte_Switch_WdgM_mode_WdgMAliveSupervisedEntity_Bsw_1000ms_currentMode
      Rte_Switch_WdgM_mode_WdgMAliveSupervisedEntity_Bsw_100ms_currentMode
      Rte_Switch_WdgM_mode_WdgMAliveSupervisedEntity_Bsw_10ms_currentMode
      Rte_Switch_WdgM_mode_WdgMAliveSupervisedEntity_Bsw_20ms_currentMode
      Rte_Switch_WdgM_mode_WdgMAliveSupervisedEntity_Bsw_50ms_currentMode
      Rte_Switch_WdgM_mode_WdgMAliveSupervisedEntity_Bsw_5ms_currentMode
      Rte_WaitWithTimeout
      Rte_WriteQueue
      Rte_Write_Asw_Swc_BCL_BCU_BCL_SPN3072_U_Req
      Rte_Write_Asw_Swc_BCL_BCU_BCL_SPN3073_I_Req
      Rte_Write_Asw_Swc_BCL_BCU_BCL_SPN3074_ChgMode
      Rte_Write_Asw_Swc_BCP_BCU_BCP_SPN2816_Ucell_Max_Permit
      Rte_Write_Asw_Swc_BCP_BCU_BCP_SPN2817_I_Max_Permit
      Rte_Write_Asw_Swc_BCP_BCU_BCP_SPN2818_kWh_Nom
      Rte_Write_Asw_Swc_BCP_BCU_BCP_SPN2819_U_Max_Permit
      Rte_Write_Asw_Swc_BCP_BCU_BCP_SPN2820_T_Max_Permit
      Rte_Write_Asw_Swc_BCP_BCU_BCP_SPN2821_SOC
      Rte_Write_Asw_Swc_BCP_BCU_BCP_SPN2822_U
      Rte_Write_Asw_Swc_BCS_BCU_BCS_SPN3075_U_Mea
      Rte_Write_Asw_Swc_BCS_BCU_BCS_SPN3076_I_Mea
      Rte_Write_Asw_Swc_BCS_BCU_BCS_SPN3077_Ucell_Max
      Rte_Write_Asw_Swc_BCS_BCU_BCS_SPN3077_Ucell_Max_Grp
      Rte_Write_Asw_Swc_BCS_BCU_BCS_SPN3078_SOC
      Rte_Write_Asw_Swc_BCS_BCU_BCS_SPN3079_Time_Remain
      Rte_Write_Asw_Swc_BEM_BCU_BEM_SPN3901_Timeout_SPN2560_0x00
      Rte_Write_Asw_Swc_BEM_BCU_BEM_SPN3902_Timeout_SPN2560_0xAA
      Rte_Write_Asw_Swc_BEM_BCU_BEM_SPN3903_Timeout_CTS_CML
      Rte_Write_Asw_Swc_BEM_BCU_BEM_SPN3904_Timeout_CRO
      Rte_Write_Asw_Swc_BEM_BCU_BEM_SPN3905_Timeout_CCS
      Rte_Write_Asw_Swc_BEM_BCU_BEM_SPN3906_Timeout_CST
      Rte_Write_Asw_Swc_BEM_BCU_BEM_SPN3907_Timeout_CSD
      Rte_Write_Asw_Swc_BEM_BCU_BEM_other
      Rte_Write_Asw_Swc_BHM_BCU_BHM_SPN2601_Ubat_Max_Permit
      Rte_Write_Asw_Swc_BMS_1D8h_BMSlightReq
      Rte_Write_Asw_Swc_BMS_1D8h_ChrgrStatPTHVCntctrReq
      Rte_Write_Asw_Swc_BMS_1D8h_HVBatFltSevrtyStat
      Rte_Write_Asw_Swc_BMS_1D8h_HVBatPrcdCrnt
      Rte_Write_Asw_Swc_BMS_1D8h_HVBatPrcdCrntV
      Rte_Write_Asw_Swc_BMS_1D8h_HVCntctrStat
      Rte_Write_Asw_Swc_BMS_1D8h_HVCntctrStatARC
      Rte_Write_Asw_Swc_BMS_329h_CellTempMes{1..7}
      Rte_Write_Asw_Swc_BMS_329h_MesCellTempNumIndex
      Rte_Write_Asw_Swc_BMS_32Ah_Mes1CellBalState
      Rte_Write_Asw_Swc_BMS_32Ah_Mes1CellVolt
      Rte_Write_Asw_Swc_BMS_32Ah_Mes2CellBalState
      Rte_Write_Asw_Swc_BMS_32Ah_Mes2CellVolt
      Rte_Write_Asw_Swc_BMS_32Ah_Mes3CellBalState
      Rte_Write_Asw_Swc_BMS_32Ah_Mes3CellVolt
      Rte_Write_Asw_Swc_BMS_32Ah_MesCellVoltNumIndex
      Rte_Write_Asw_Swc_BMS_3D7h_HVBatPackPrcdVltg
      Rte_Write_Asw_Swc_BMS_3D7h_HVBatPackPrcdVltgV
      Rte_Write_Asw_Swc_BMS_3DAh_BMSChecksum_3DAh
      Rte_Write_Asw_Swc_BMS_3DAh_ChrgPeakTimeFactor
      Rte_Write_Asw_Swc_BMS_3DAh_HVBCP_CrnkChrgPwrV
      Rte_Write_Asw_Swc_BMS_3DAh_HVBCP_LngTrmChrgPwr
      Rte_Write_Asw_Swc_BMS_3DAh_HVBCP_ShrtTrmChrgPwr
      Rte_Write_Asw_Swc_BMS_3DBh_BMSChecksum_3DBh
      Rte_Write_Asw_Swc_BMS_3DBh_DischrgPeakTimeFactor
      Rte_Write_Asw_Swc_BMS_3DBh_HVBDP_CrnkDischrgPwrV
      Rte_Write_Asw_Swc_BMS_3DBh_HVBDP_LngTrmDischrgPwr
      Rte_Write_Asw_Swc_BMS_3DBh_HVBDP_ShrtTrmDischrgPwr
      Rte_Write_Asw_Swc_BMS_501h_BMSCelConsistencyWarning
      Rte_Write_Asw_Swc_BMS_501h_BMSVolHighWarning
      Rte_Write_Asw_Swc_BMS_501h_CellOvWarning
      Rte_Write_Asw_Swc_BMS_501h_CellUvWarning
      Rte_Write_Asw_Swc_BMS_501h_EnergyConsumptionPer
      Rte_Write_Asw_Swc_BMS_501h_HVILWarning
      Rte_Write_Asw_Swc_BMS_501h_HVIsoWarning
      Rte_Write_Asw_Swc_BMS_501h_PackOvWarning
      Rte_Write_Asw_Swc_BMS_501h_PackUvWarning
      Rte_Write_Asw_Swc_BMS_501h_PwrBatPackMismatchWarning
      Rte_Write_Asw_Swc_BMS_501h_RestEnergy
      Rte_Write_Asw_Swc_BMS_501h_SOCFastChgWarning
      Rte_Write_Asw_Swc_BMS_501h_SOCHighWarning
      Rte_Write_Asw_Swc_BMS_501h_SOCLowWarning
      Rte_Write_Asw_Swc_BMS_501h_TempDiffWarning
      Rte_Write_Asw_Swc_BMS_501h_TempHighWarning
      Rte_Write_Asw_Swc_BMS_501h_ThermalAlarm
      Rte_Write_Asw_Swc_BMS_501h_ThermalAlarmV
      Rte_Write_Asw_Swc_BMS_503h_BMSCellQuantity
      Rte_Write_Asw_Swc_BMS_503h_BMSTempProbeQuantity
      Rte_Write_Asw_Swc_BMS_503h_HVIsoValue
      Rte_Write_Asw_Swc_BMS_503h_RealSOC
      Rte_Write_Asw_Swc_BMS_509h_CurRechgEnergyStorSysIndex
      Rte_Write_Asw_Swc_BMS_509h_RechgEnergyStorSysCode{1..6}
      Rte_Write_Asw_Swc_BMS_509h_RechgEnergyStorSysCodeIndex
      Rte_Write_Asw_Swc_BMS_509h_RechgEnergyStorSysCodeLength
      Rte_Write_Asw_Swc_BMS_509h_RechgEnergyStorSysNumb
      Rte_Write_Asw_Swc_BMS_594h_HVBatPackAccVltg
      Rte_Write_Asw_Swc_BMS_594h_HVBatPackAccVltgV
      Rte_Write_Asw_Swc_BMS_594h_MaxCellVoltNumb
      Rte_Write_Asw_Swc_BMS_594h_MaxClVlt
      Rte_Write_Asw_Swc_BMS_594h_MinCellVoltNumb
      Rte_Write_Asw_Swc_BMS_594h_MinClVlt
      Rte_Write_Asw_Swc_BMS_596h_MaxBatTmp
      Rte_Write_Asw_Swc_BMS_596h_MaxCellTempNumb
      Rte_Write_Asw_Swc_BMS_596h_MinBatTmp
      Rte_Write_Asw_Swc_BMS_596h_MinCellTempNumb
      Rte_Write_Asw_Swc_BMS_598h_BMSChrgStatus
      Rte_Write_Asw_Swc_BMS_598h_BatLf
      Rte_Write_Asw_Swc_BMS_598h_ChrgPlugStatus
      Rte_Write_Asw_Swc_BMS_598h_HVSystemStatus
      Rte_Write_Asw_Swc_BMS_598h_PreChrgUnitRdy
      Rte_Write_Asw_Swc_BMS_598h_TotalBatteryCap
      Rte_Write_Asw_Swc_BMS_603h_ACChrgCurrRq
      Rte_Write_Asw_Swc_BMS_603h_ACChrgFault
      Rte_Write_Asw_Swc_BMS_603h_ACChrgMode
      Rte_Write_Asw_Swc_BMS_603h_ACChrgVoltRq
      Rte_Write_Asw_Swc_BMS_603h_CCVaule
      Rte_Write_Asw_Swc_BMS_603h_CPVaule
      Rte_Write_Asw_Swc_BMS_603h_S2_Status
      Rte_Write_Asw_Swc_BMS_605h_ChargingVoltage
      Rte_Write_Asw_Swc_BMS_605h_FullChargeRemainingTime
      Rte_Write_Asw_Swc_BMS_605h_RequestChargeCurrent
      Rte_Write_Asw_Swc_BMS_606h_BEM_CCS
      Rte_Write_Asw_Swc_BMS_606h_BEM_CML
      Rte_Write_Asw_Swc_BMS_606h_BEM_CRM00
      Rte_Write_Asw_Swc_BMS_606h_BEM_CRMAA
      Rte_Write_Asw_Swc_BMS_606h_BEM_CRO
      Rte_Write_Asw_Swc_BMS_606h_BEM_CSD
      Rte_Write_Asw_Swc_BMS_606h_BEM_CST
      Rte_Write_Asw_Swc_BMS_606h_BEM_Other
      Rte_Write_Asw_Swc_BMS_606h_BMSStopChargeFaultCode{1..8}
      Rte_Write_Asw_Swc_BMS_606h_CEM_BCL
      Rte_Write_Asw_Swc_BMS_606h_CEM_BCP
      Rte_Write_Asw_Swc_BMS_606h_CEM_BCS
      Rte_Write_Asw_Swc_BMS_606h_CEM_BRM
      Rte_Write_Asw_Swc_BMS_606h_CEM_BRO
      Rte_Write_Asw_Swc_BMS_606h_CEM_BSD
      Rte_Write_Asw_Swc_BMS_606h_CEM_BST
      Rte_Write_Asw_Swc_BMS_606h_CEM_Other
      Rte_Write_Asw_Swc_BMS_606h_CHGStopChargeFaultCode{1..8}
      Rte_Write_Asw_Swc_BMS_606h_StopChargingReson
      Rte_Write_Asw_Swc_BMS_795h_BMSDTCFailureTypeByte
      Rte_Write_Asw_Swc_BMS_795h_BMSDTCHighByte
      Rte_Write_Asw_Swc_BMS_795h_BMSDTCLowByte
      Rte_Write_Asw_Swc_BMS_795h_BMSDTCSeriousLevel
      Rte_Write_Asw_Swc_BMS_795h_BMSDTCStatus
      Rte_Write_Asw_Swc_BMS_795h_BMSDTCType
      Rte_Write_Asw_Swc_BRM_BCU_BRM_SPN2565_Ver
      Rte_Write_Asw_Swc_BRM_BCU_BRM_SPN2566_Bat_Type
      Rte_Write_Asw_Swc_BRM_BCU_BRM_SPN2567_Cap_Nom
      Rte_Write_Asw_Swc_BRM_BCU_BRM_SPN2568_U_Nom
      Rte_Write_Asw_Swc_BRM_BCU_BRM_SPN2569_BatFactory
      Rte_Write_Asw_Swc_BRM_BCU_BRM_SPN2570_PackSN
      Rte_Write_Asw_Swc_BRM_BCU_BRM_SPN2571_PackDay
      Rte_Write_Asw_Swc_BRM_BCU_BRM_SPN2571_PackMonth
      Rte_Write_Asw_Swc_BRM_BCU_BRM_SPN2571_PackYear
      Rte_Write_Asw_Swc_BRM_BCU_BRM_SPN2572_PackChgCnt
      Rte_Write_Asw_Swc_BRM_BCU_BRM_SPN2573_PackRight
      Rte_Write_Asw_Swc_BRM_BCU_BRM_SPN2574_BMSSW_Reserved
      Rte_Write_Asw_Swc_BRM_BCU_BRM_SPN2575_VIN1
      Rte_Write_Asw_Swc_BRM_BCU_BRM_SPN2575_VIN{10..17}
      Rte_Write_Asw_Swc_BRM_BCU_BRM_SPN2575_VIN{2..9}
      Rte_Write_Asw_Swc_BRM_BCU_BRM_SPN2576_BMSVer_Day
      Rte_Write_Asw_Swc_BRM_BCU_BRM_SPN2576_BMSVer_Month
      Rte_Write_Asw_Swc_BRM_BCU_BRM_SPN2576_BMSVer_Reserver
      Rte_Write_Asw_Swc_BRM_BCU_BRM_SPN2576_BMSVer_Version
      Rte_Write_Asw_Swc_BRM_BCU_BRM_SPN2576_BMSVer_Year
      Rte_Write_Asw_Swc_BRO_BCU_BRO_SPN2829_BCU_Ready
      Rte_Write_Asw_Swc_BSD_BCU_BSD_SPN3601_SOC_Final
      Rte_Write_Asw_Swc_BSD_BCU_BSD_SPN3602_Ucell_Min
      Rte_Write_Asw_Swc_BSD_BCU_BSD_SPN3603_Ucell_Max
      Rte_Write_Asw_Swc_BSD_BCU_BSD_SPN3604_T_Min
      Rte_Write_Asw_Swc_BSD_BCU_BSD_SPN3605_T_Max
      Rte_Write_Asw_Swc_BSM_BCU_BSM_SPN3085_Ucell_Max_Index
      Rte_Write_Asw_Swc_BSM_BCU_BSM_SPN3086_T_Max
      Rte_Write_Asw_Swc_BSM_BCU_BSM_SPN3087_T_Max_Index
      Rte_Write_Asw_Swc_BSM_BCU_BSM_SPN3088_T_Min
      Rte_Write_Asw_Swc_BSM_BCU_BSM_SPN3089_T_Min_Index
      Rte_Write_Asw_Swc_BSM_BCU_BSM_SPN3090_Ucell_Warn
      Rte_Write_Asw_Swc_BSM_BCU_BSM_SPN3091_SOC_Warn
      Rte_Write_Asw_Swc_BSM_BCU_BSM_SPN3092_I_Warn
      Rte_Write_Asw_Swc_BSM_BCU_BSM_SPN3093_T_Warn
      Rte_Write_Asw_Swc_BSM_BCU_BSM_SPN3094_Iso_State
      Rte_Write_Asw_Swc_BSM_BCU_BSM_SPN3095_OutConnector_State
      Rte_Write_Asw_Swc_BSM_BCU_BSM_SPN3096_Chg_Enable
      Rte_Write_Asw_Swc_BST_BCU_BST_SPN3511_Stop_Reason_CHGStop
      Rte_Write_Asw_Swc_BST_BCU_BST_SPN3511_Stop_Reason_SOC
      Rte_Write_Asw_Swc_BST_BCU_BST_SPN3511_Stop_Reason_U
      Rte_Write_Asw_Swc_BST_BCU_BST_SPN3511_Stop_Reason_Ucell
      Rte_Write_Asw_Swc_BST_BCU_BST_SPN3512_Stop_Fault_BCUcompo
      Rte_Write_Asw_Swc_BST_BCU_BST_SPN3512_Stop_Fault_CC2
      Rte_Write_Asw_Swc_BST_BCU_BST_SPN3512_Stop_Fault_ChgCnnt
      Rte_Write_Asw_Swc_BST_BCU_BST_SPN3512_Stop_Fault_HVRelay
      Rte_Write_Asw_Swc_BST_BCU_BST_SPN3512_Stop_Fault_Iso
      Rte_Write_Asw_Swc_BST_BCU_BST_SPN3512_Stop_Fault_Other
      Rte_Write_Asw_Swc_BST_BCU_BST_SPN3512_Stop_Fault_OutCnnt
      Rte_Write_Asw_Swc_BST_BCU_BST_SPN3512_Stop_Fault_T
      Rte_Write_Asw_Swc_BST_BCU_BST_SPN3513_Stop_Fault_I
      Rte_Write_Asw_Swc_BST_BCU_BST_SPN3513_Stop_Fault_U
      Rte_Write_Asw_Swc_ChargeCmd_ACS2Cmd_flg
      Rte_Write_Asw_Swc_ChargeCmd_ELockCtrlCmd_enum
      Rte_Write_Asw_Swc_ChargeCmd_ELockSel0Cmd_flg
      Rte_Write_Asw_Swc_ChargeCmd_LampCcHCmd_flg
      Rte_Write_Asw_Swc_ChargeCmd_LampChgHCmd_flg
      Rte_Write_Asw_Swc_CmuCmd_BalOpenLoadDiagCmd_flg
      Rte_Write_Asw_Swc_CmuCmd_CMUPwrCmd_flg
      Rte_Write_Asw_Swc_CmuCmd_CellLeakageDiagCmd_flg
      Rte_Write_Asw_Swc_CmuCmd_CellMeasCmd_flg
      Rte_Write_Asw_Swc_CmuCmd_ChanelFuncDiagCmd_flg
      Rte_Write_Asw_Swc_CmuCmd_CmuClrFaultPin_flg
      Rte_Write_Asw_Swc_CmuCmd_CmuReCfg_flg
      Rte_Write_Asw_Swc_CmuCmd_CtxOpenDiagCmd_flg
      Rte_Write_Asw_Swc_CmuCmd_GpioOTUTFuncDiagCmd_flg
      Rte_Write_Asw_Swc_CmuCmd_GpioxOpenDiagCmd_flg
      Rte_Write_Asw_Swc_CmuCmd_OutCMUHWAlarmPWMDuty_Pct
      Rte_Write_Asw_Swc_FblCmd_FBLForbid_flg
      Rte_Write_Asw_Swc_HighVoltCmd_PackVoltMeasCmd_flg
      Rte_Write_Asw_Swc_HvilCmd_OutHVILPWMDuty_Pct
      Rte_Write_Asw_Swc_IsoCmd_HVIsoNegMosCmd_flg
      Rte_Write_Asw_Swc_IsoCmd_HVIsoPosMosCmd_flg
      Rte_Write_Asw_Swc_McuCmd_RadyToSleep_flg
      Rte_Write_Asw_Swc_PPort_BswMArbitration_BswM_MRP_SwcModeRequest_VDP_uint16
      Rte_Write_Asw_Swc_RelayCmd_GlobalHCtrCmd_flg
      Rte_Write_Asw_Swc_RelayCmd_K{1..6}CtrCmd_flg
      Rte_Write_Asw_Swc_RelayCmd_KnCtrlCmd_flg
      Rte_Write_Asw_Swc_RelayCmd_KpCtrlCmd_flg
      Rte_Write_Asw_Swc_SbcCmd_CANWakeupEnable_flg
      Rte_Write_Asw_Swc_ThermalCmd_OutCoolPumpPWMDuty_Pct
      Rte_Write_Asw_Swc_ThermalCmd_OutFanPWMDuty_Pct
      Rte_Write_Asw_Swc_ThermalCmd_ValveEn_flg
      Rte_Write_Cmu_Cdd_CmuValue_BalOpenLoadDiagStatus_flg
      Rte_Write_Cmu_Cdd_CmuValue_CMUPwrDiagVoltVld_flg
      Rte_Write_Cmu_Cdd_CmuValue_CMUPwrDiagVolt_V
      Rte_Write_Cmu_Cdd_CmuValue_CellLeakageDiagStatus_flg
      Rte_Write_Cmu_Cdd_CmuValue_ChanelFuncDiagStatus_flg
      Rte_Write_Cmu_Cdd_CmuValue_CmuReCfgStatus_flg
      Rte_Write_Cmu_Cdd_CmuValue_CtxOpenDiagStatus_flg
      Rte_Write_Cmu_Cdd_CmuValue_GpioOTUTFuncDiagStatus_flg
      Rte_Write_Cmu_Cdd_CmuValue_GpioxOpenDiagStatus_flg
      Rte_Write_Cmu_Cdd_CmuValue_InCMUHWAlarmPWMDutyVld_flg
      Rte_Write_Cmu_Cdd_CmuValue_InCMUHWAlarmPWMDuty_pct
      Rte_Write_Cmu_Cdd_CmuValue_InCMUHWAlarmPWMFeqVld_flg
      Rte_Write_Cmu_Cdd_CmuValue_InCMUHWAlarmPWMFeq_Hz
      Rte_Write_IoHwAb_ChargeValue_CC2VoltVld_flg
      Rte_Write_IoHwAb_ChargeValue_CC2Volt_V
      Rte_Write_IoHwAb_ChargeValue_CCResVld_flg
      Rte_Write_IoHwAb_ChargeValue_CCRes_ohm
      Rte_Write_IoHwAb_ChargeValue_CPDutyVld_flg
      Rte_Write_IoHwAb_ChargeValue_CPDuty_pct
      Rte_Write_IoHwAb_ChargeValue_CPFrqVld_flg
      Rte_Write_IoHwAb_ChargeValue_CPFrq_Hz
      Rte_Write_IoHwAb_ChargeValue_CPVoltVld_flg
      Rte_Write_IoHwAb_ChargeValue_CPVolt_V
      Rte_Write_IoHwAb_ChargeValue_DCWakeupVoltVld_flg
      Rte_Write_IoHwAb_ChargeValue_DCWakeupVolt_V
      Rte_Write_IoHwAb_ChargeValue_ELockDiagVoltVld_flg
      Rte_Write_IoHwAb_ChargeValue_ELockDiagVolt_V
      Rte_Write_IoHwAb_ChargeValue_LampCcHDiagVoltVld_flg
      Rte_Write_IoHwAb_ChargeValue_LampCcHDiagVolt_V
      Rte_Write_IoHwAb_ChargeValue_LampChgHDiagVoltVld_flg
      Rte_Write_IoHwAb_ChargeValue_LampChgHDiagVolt_V
      Rte_Write_IoHwAb_CrashValue_CrashPWMDutyVld_flg
      Rte_Write_IoHwAb_CrashValue_CrashPWMDuty_pct
      Rte_Write_IoHwAb_CrashValue_CrashPWMFrqVld_flg
      Rte_Write_IoHwAb_CrashValue_CrashPWMFrq_Hz
      Rte_Write_IoHwAb_CurrValue_HallCH1RedVoltVld_flg
      Rte_Write_IoHwAb_CurrValue_HallCH1RedVolt_V
      Rte_Write_IoHwAb_CurrValue_HallCH1VoltVld_flg
      Rte_Write_IoHwAb_CurrValue_HallCH1Volt_V
      Rte_Write_IoHwAb_CurrValue_HallCH2RedVoltVld_flg
      Rte_Write_IoHwAb_CurrValue_HallCH2RedVolt_V
      Rte_Write_IoHwAb_CurrValue_HallCH2VoltVld_flg
      Rte_Write_IoHwAb_CurrValue_HallCH2Volt_V
      Rte_Write_IoHwAb_CurrValue_HallSpyVoltVld_flg
      Rte_Write_IoHwAb_CurrValue_HallSpyVolt_V
      Rte_Write_IoHwAb_CurrValue_PackCurrRedVld_flg
      Rte_Write_IoHwAb_CurrValue_PackCurrRed_A
      Rte_Write_IoHwAb_CurrValue_PackCurrVld_flg
      Rte_Write_IoHwAb_CurrValue_PackCurr_A
      Rte_Write_IoHwAb_HighVoltValue_P1CheckVoltVld_flg
      Rte_Write_IoHwAb_HighVoltValue_P1CheckVolt_V
      Rte_Write_IoHwAb_HighVoltValue_P2CheckVoltVld_flg
      Rte_Write_IoHwAb_HighVoltValue_P2CheckVolt_V
      Rte_Write_IoHwAb_HighVoltValue_P3CheckVoltVld_flg
      Rte_Write_IoHwAb_HighVoltValue_P3CheckVolt_V
      Rte_Write_IoHwAb_HighVoltValue_PackVoltVld_flg
      Rte_Write_IoHwAb_HighVoltValue_PackVolt_V
      Rte_Write_IoHwAb_HighVoltValue_PreChgCheckRedVoltVld_flg
      Rte_Write_IoHwAb_HighVoltValue_PreChgCheckRedVolt_V
      Rte_Write_IoHwAb_HighVoltValue_PreChgCheckVoltVld_flg
      Rte_Write_IoHwAb_HighVoltValue_PreChgCheckVolt_V
      Rte_Write_IoHwAb_HvilValue_HVILHighVoltVld_flg
      Rte_Write_IoHwAb_HvilValue_HVILHighVolt_V
      Rte_Write_IoHwAb_HvilValue_HVILLowVoltVld_flg
      Rte_Write_IoHwAb_HvilValue_HVILLowVolt_V
      Rte_Write_IoHwAb_HvilValue_InHVILPWMDutyVld_flg
      Rte_Write_IoHwAb_HvilValue_InHVILPWMDuty_pct
      Rte_Write_IoHwAb_HvilValue_InHVILPWMFrqVld_flg
      Rte_Write_IoHwAb_HvilValue_InHVILPWMFrq_Hz
      Rte_Write_IoHwAb_IsoValue_HVIsoNegVoltVld_flg
      Rte_Write_IoHwAb_IsoValue_HVIsoNegVolt_V
      Rte_Write_IoHwAb_IsoValue_HVIsoPosVoltVld_flg
      Rte_Write_IoHwAb_IsoValue_HVIsoPosVolt_V
      Rte_Write_IoHwAb_McuValue_BSWInitFinish_flg
      Rte_Write_IoHwAb_PowerValue_BmuPullupSwitchDiag_flg
      Rte_Write_IoHwAb_PowerValue_BmuPullupVoltVld_flg
      Rte_Write_IoHwAb_PowerValue_BmuPullupVolt_V
      Rte_Write_IoHwAb_PowerValue_KL15VoltVld_flg
      Rte_Write_IoHwAb_PowerValue_KL15Volt_V
      Rte_Write_IoHwAb_PowerValue_KL30VoltVld_flg
      Rte_Write_IoHwAb_PowerValue_KL30Volt_V
      Rte_Write_IoHwAb_PowerValue_KPowertVoltVld_flg
      Rte_Write_IoHwAb_PowerValue_KPowertVolt_V
      Rte_Write_IoHwAb_PowerValue_ResWakeUp1HVoltVld_flg
      Rte_Write_IoHwAb_PowerValue_ResWakeUp1HVolt_V
      Rte_Write_IoHwAb_PowerValue_ResWakeUp2HVoltVld_flg
      Rte_Write_IoHwAb_PowerValue_ResWakeUp2HVolt_V
      Rte_Write_IoHwAb_PowerValue_ResWakeUp3LVoltVld_flg
      Rte_Write_IoHwAb_PowerValue_ResWakeUp3LVolt_V
      Rte_Write_IoHwAb_RelayValue_GlobalHsideDiagVoltVld_flg
      Rte_Write_IoHwAb_RelayValue_GlobalHsideDiagVolt_V
      Rte_Write_IoHwAb_RelayValue_GlobalHsideDriverVoltVld_flg
      Rte_Write_IoHwAb_RelayValue_GlobalHsideDriverVolt_V
      Rte_Write_IoHwAb_RelayValue_K1CtrDriverVoltVld_flg
      Rte_Write_IoHwAb_RelayValue_K1CtrDriverVolt_V
      Rte_Write_IoHwAb_RelayValue_K2CtrDriverVoltVld_flg
      Rte_Write_IoHwAb_RelayValue_K2CtrDriverVolt_V
      Rte_Write_IoHwAb_RelayValue_K3CtrDriverVoltVld_flg
      Rte_Write_IoHwAb_RelayValue_K3CtrDriverVolt_V
      Rte_Write_IoHwAb_RelayValue_K4CtrDriverVoltVld_flg
      Rte_Write_IoHwAb_RelayValue_K4CtrDriverVolt_V
      Rte_Write_IoHwAb_RelayValue_K5CtrDriverVoltVld_flg
      Rte_Write_IoHwAb_RelayValue_K5CtrDriverVolt_V
      Rte_Write_IoHwAb_RelayValue_K6CtrDriverVoltVld_flg
      Rte_Write_IoHwAb_RelayValue_K6CtrDriverVolt_V
      Rte_Write_IoHwAb_RelayValue_KnCtrDriverVoltVld_flg
      Rte_Write_IoHwAb_RelayValue_KnCtrDriverVolt_V
      Rte_Write_IoHwAb_RelayValue_KnchgEnOutState_flg
      Rte_Write_IoHwAb_RelayValue_KnchgEnStateVld_flg
      Rte_Write_IoHwAb_RelayValue_KpCtrDriverVoltVld_flg
      Rte_Write_IoHwAb_RelayValue_KpCtrDriverVolt_V
      Rte_Write_IoHwAb_RelayValue_KpEnOutState_flg
      Rte_Write_IoHwAb_RelayValue_KpEnStateVld_flg
      Rte_Write_IoHwAb_RsvValue_InRsvPWMDutyVld_flg
      Rte_Write_IoHwAb_RsvValue_InRsvPWMDuty_pct
      Rte_Write_IoHwAb_RsvValue_InRsvPWMFrqVld_flg
      Rte_Write_IoHwAb_RsvValue_InRsvPWMFrq_Hz
      Rte_Write_IoHwAb_RsvValue_RsvAD1VoltVld_flg
      Rte_Write_IoHwAb_RsvValue_RsvAD1Volt_V
      Rte_Write_IoHwAb_RsvValue_RsvAD2VoltVld_flg
      Rte_Write_IoHwAb_RsvValue_RsvAD2Volt_V
      Rte_Write_IoHwAb_RsvValue_RsvAD3VoltVld_flg
      Rte_Write_IoHwAb_RsvValue_RsvAD3Volt_V
      Rte_Write_IoHwAb_RsvValue_RsvAD4VoltVld_flg
      Rte_Write_IoHwAb_RsvValue_RsvAD4Volt_V
      Rte_Write_IoHwAb_RsvValue_RsvAD5VoltVld_flg
      Rte_Write_IoHwAb_RsvValue_RsvAD5Volt_V
      Rte_Write_IoHwAb_SbcValue_BMULastPwrDownState
      Rte_Write_IoHwAb_SbcValue_BmuSbcCanTRSt_flg
      Rte_Write_IoHwAb_SbcValue_BmuSbcRstbPinSt_flg
      Rte_Write_IoHwAb_SbcValue_BmuSbcVauxOV_flg
      Rte_Write_IoHwAb_SbcValue_BmuSbcVauxUV_flg
      Rte_Write_IoHwAb_SbcValue_BmuSbcVcanOV_flg
      Rte_Write_IoHwAb_SbcValue_BmuSbcVcanUV_flg
      Rte_Write_IoHwAb_SbcValue_BmuSbcVccaOV_flg
      Rte_Write_IoHwAb_SbcValue_BmuSbcVccaUV_flg
      Rte_Write_IoHwAb_SbcValue_BmuSbcVcoreOV_flg
      Rte_Write_IoHwAb_SbcValue_BmuSbcVpreOV_flg
      Rte_Write_IoHwAb_SbcValue_BmuSbcVpreUV_flg
      Rte_Write_IoHwAb_SbcValue_BmuSbxVcoreUV_flg
      Rte_Write_IoHwAb_SbcValue_CANWakeupState_flg
      Rte_Write_IoHwAb_SbcValue_KL15WakeupState_flg
      Rte_Write_IoHwAb_SbcValue_RTCWakeupState_flg
      Rte_Write_IoHwAb_SbcValue_SBCWakeupP{1..3}State_flg
      Rte_Write_IoHwAb_ThermalValue_BmuTemp1NtcVld_flg
      Rte_Write_IoHwAb_ThermalValue_BmuTemp1Ntc_Ohm
      Rte_Write_IoHwAb_ThermalValue_BmuTemp2NtcVld_flg
      Rte_Write_IoHwAb_ThermalValue_BmuTemp2Ntc_Ohm
      Rte_Write_IoHwAb_ThermalValue_BmuTemp3NtcVld_flg
      Rte_Write_IoHwAb_ThermalValue_BmuTemp3Ntc_Ohm
      Rte_Write_IoHwAb_ThermalValue_BmuTemp4NtcVld_flg
      Rte_Write_IoHwAb_ThermalValue_BmuTemp4Ntc_Ohm
      Rte_Write_IoHwAb_ThermalValue_BmuTemp5NtcVld_flg
      Rte_Write_IoHwAb_ThermalValue_BmuTemp5Ntc_Ohm
      Rte_Write_IoHwAb_ThermalValue_BmuTemp6NtcVld_flg
      Rte_Write_IoHwAb_ThermalValue_BmuTemp6Ntc_Ohm
      Rte_Write_IoHwAb_ThermalValue_BmuTemp7NtcVld_flg
      Rte_Write_IoHwAb_ThermalValue_BmuTemp7Ntc_Ohm
      Rte_Write_IoHwAb_ThermalValue_InCoolPumpPWMDutyVld_flg
      Rte_Write_IoHwAb_ThermalValue_InCoolPumpPWMDuty_Pct
      Rte_Write_IoHwAb_ThermalValue_InCoolPumpPWMFrqVld_flg
      Rte_Write_IoHwAb_ThermalValue_InCoolPumpPWMFrq_Hz
      Rte_Write_IoHwAb_ThermalValue_InFanPWMDutyVld_flg
      Rte_Write_IoHwAb_ThermalValue_InFanPWMDuty_Pct
      Rte_Write_IoHwAb_ThermalValue_InFanPWMFrqVld_flg
      Rte_Write_IoHwAb_ThermalValue_InFanPWMFrq_Hz
      Rte_Write_IoHwAb_ThermalValue_ValveDiagVoltVld_flg
      Rte_Write_IoHwAb_ThermalValue_ValveDiagVolt_V
      Rte_Write_Sbc_Cdd_SbcValue_BMULastPwrDownState
      Rte_Write_Sbc_Cdd_SbcValue_BmuSbcCanTRSt_flg
      Rte_Write_Sbc_Cdd_SbcValue_BmuSbcRstbPinSt_flg
      Rte_Write_Sbc_Cdd_SbcValue_BmuSbcVauxOV_flg
      Rte_Write_Sbc_Cdd_SbcValue_BmuSbcVauxUV_flg
      Rte_Write_Sbc_Cdd_SbcValue_BmuSbcVcanOV_flg
      Rte_Write_Sbc_Cdd_SbcValue_BmuSbcVcanUV_flg
      Rte_Write_Sbc_Cdd_SbcValue_BmuSbcVccaOV_flg
      Rte_Write_Sbc_Cdd_SbcValue_BmuSbcVccaUV_flg
      Rte_Write_Sbc_Cdd_SbcValue_BmuSbcVcoreOV_flg
      Rte_Write_Sbc_Cdd_SbcValue_BmuSbcVpreOV_flg
      Rte_Write_Sbc_Cdd_SbcValue_BmuSbcVpreUV_flg
      Rte_Write_Sbc_Cdd_SbcValue_BmuSbxVcoreUV_flg
      Rte_Write_Sbc_Cdd_SbcValue_CANWakeupState_flg
      Rte_Write_Sbc_Cdd_SbcValue_KL15WakeupState_flg
      Rte_Write_Sbc_Cdd_SbcValue_RTCWakeupState_flg
      Rte_Write_Sbc_Cdd_SbcValue_SBCWakeupP{1..3}State_flg
      Rte_memcpy
      SchM_Deinit
      SchM_IModeInit
      SchM_Init
      SchM_Mode_BswM_MDGR_BswM_MRP_BswM_MDG
      SchM_Mode_WdgM_Current_WdgMSupervisionCycle
      SchM_Switch_BswM_MDGP_AUTOSAR_BswM_ModeDeclarationGroups_MDG_ECUM_STATE
    bsw module dependency AUTOSAR_Os: target-module-id=1
      required-entrys:
        ActivateTask
        GetResource
        ReleaseResource
        ResumeOSInterrupts
        Rte_ResumeOSInterrupts
        Rte_SuspendOSInterrupts
        SuspendOSInterrupts
        TerminateTask
    bsw module dependency AUTOSAR_Com: target-module-id=50, required-entrys=[Com_ReceiveSignal, Com_SendSignal]
      expected-callbacks:
        Rte_COMCbk_CCS_SPN3081_U_Out
        Rte_COMCbk_CCS_SPN3082_I_Out
        Rte_COMCbk_CCS_SPN3083_Time_Charged
        Rte_COMCbk_CCS_SPN3929_Chg_enable
        Rte_COMCbk_CDU_HVILWarning
        Rte_COMCbk_CEM_SPN3921_Timeout_BRM
        Rte_COMCbk_CEM_SPN3922_Timeout_BCP
        Rte_COMCbk_CEM_SPN3923_Timeout_BRO
        Rte_COMCbk_CEM_SPN3924_Timeout_BCS
        Rte_COMCbk_CEM_SPN3925_Timeout_BCL
        Rte_COMCbk_CEM_SPN3926_Timeout_BST
        Rte_COMCbk_CEM_SPN3927_Timeout_BSD
        Rte_COMCbk_CEM_other
        Rte_COMCbk_CHM_SPN2600_Comm_Ver
        Rte_COMCbk_CML_SPN2824_U_Max_Out
        Rte_COMCbk_CML_SPN2825_U_Min_Out
        Rte_COMCbk_CML_SPN2826_I_Max_Out
        Rte_COMCbk_CML_SPN2827_I_Min_Out
        Rte_COMCbk_CRM_SPN2560_Ack
        Rte_COMCbk_CRM_SPN2561_CHG_Index
        Rte_COMCbk_CRM_SPN2562_CHG_Loc
        Rte_COMCbk_CRO_SPN2830_CHG_Ready
        Rte_COMCbk_CSD_SPN3611_Time_Charged
        Rte_COMCbk_CSD_SPN3612_E_Out
        Rte_COMCbk_CSD_SPN3613_CHG_Index
        Rte_COMCbk_CST_SPN3521_Stop_Reason_Auto
        Rte_COMCbk_CST_SPN3521_Stop_Reason_BMSStop
        Rte_COMCbk_CST_SPN3521_Stop_Reason_Fault
        Rte_COMCbk_CST_SPN3521_Stop_Reason_Manual
        Rte_COMCbk_CST_SPN3522_Stop_Fault_CHGCnnt
        Rte_COMCbk_CST_SPN3522_Stop_Fault_Deliver
        Rte_COMCbk_CST_SPN3522_Stop_Fault_EmerStop
        Rte_COMCbk_CST_SPN3522_Stop_Fault_Other
        Rte_COMCbk_CST_SPN3522_Stop_Fault_T_CHG
        Rte_COMCbk_CST_SPN3522_Stop_Fault_T_Inter
        Rte_COMCbk_CST_SPN3523_Stop_Fault_Mismatch
        Rte_COMCbk_CST_SPN3523_Stop_Fault_U
        Rte_COMCbk_CTS_SPN2823_SYNC_Day
        Rte_COMCbk_CTS_SPN2823_SYNC_DayTen
        Rte_COMCbk_CTS_SPN2823_SYNC_Hour
        Rte_COMCbk_CTS_SPN2823_SYNC_HourTen
        Rte_COMCbk_CTS_SPN2823_SYNC_Minute
        Rte_COMCbk_CTS_SPN2823_SYNC_MinuteTen
        Rte_COMCbk_CTS_SPN2823_SYNC_Month
        Rte_COMCbk_CTS_SPN2823_SYNC_MonthTen
        Rte_COMCbk_CTS_SPN2823_SYNC_Second
        Rte_COMCbk_CTS_SPN2823_SYNC_SecondTen
        Rte_COMCbk_CTS_SPN2823_SYNC_Year
        Rte_COMCbk_CTS_SPN2823_SYNC_YearHundred
        Rte_COMCbk_CTS_SPN2823_SYNC_YearTen
        Rte_COMCbk_CTS_SPN2823_SYNC_YearThousand
        Rte_COMCbk_CheckSum_1E3h
        Rte_COMCbk_CheckSum_23Ch
        Rte_COMCbk_ChrgrStatPTHVCntctOpnrAlwd
        Rte_COMCbk_ChrgrStatPTHVCntctrClsAlwd
        Rte_COMCbk_FrontCmprElctrCrnt
        Rte_COMCbk_FrontCompStatFdbck
        Rte_COMCbk_FrontPTCElctrCrnt
        Rte_COMCbk_FrontPTCStatFdbck
        Rte_COMCbk_HighPreVehOdo
        Rte_COMCbk_HighPreVehOdoV
        Rte_COMCbk_I_LDC_In
        Rte_COMCbk_InvADCCrnt
        Rte_COMCbk_InvADCCrntV
        Rte_COMCbk_MessageCounter_23Ch
        Rte_COMCbk_OBCChgCurrent
        Rte_COMCbk_OBCChgVolt
        Rte_COMCbk_OBCCurrentFltCode
        Rte_COMCbk_OBCHistoryFltCode
        Rte_COMCbk_OBCMaxChrgCurrent
        Rte_COMCbk_OBCMaxChrgVoltage
        Rte_COMCbk_OBCStatus
        Rte_COMCbk_PTHVCntctrReq
        Rte_COMCbk_RollingCounter
        Rte_COMCbk_RollingCounter_1E3h
        Rte_COMCbk_SRSCheckSum
        Rte_COMCbk_SysBPM
        Rte_COMCbk_SysBPMEnbd
        Rte_COMCbk_SysOpnlMd
        Rte_COMCbk_SysPwrMd
        Rte_COMCbk_SysVol
        Rte_COMCbk_SysVolMd
        Rte_COMCbk_SysVolMdV
        Rte_COMCbk_SysVolV
        Rte_COMCbk_V_DC
        Rte_COMCbk_V_DCValidity
        Rte_COMCbk_VehCrshTyp
        Rte_COMCbk_VehSpdAvgDrvn
        Rte_COMCbk_VehSpdAvgDrvnV
        Rte_COMCbk_VehicleSpeed
        Rte_COMCbk_VehicleSpeedStatus
    bsw internal behavior RteInternalBehavior
      constant-memorys:
        26 x parameter data prototype:
          Rte_Inst_Asw_Swc: type=Rte_CDS_Asw_Swc
          Rte_Inst_BswM: type=Rte_CDS_BswM
          Rte_Inst_Cmu_Cdd: type=Rte_CDS_Cmu_Cdd
          Rte_Inst_ComM: type=Rte_CDS_ComM
          Rte_Inst_Det: type=Rte_CDS_Det
          Rte_Inst_EcuM: type=Rte_CDS_EcuM
          Rte_Inst_IoHwAb: type=Rte_CDS_IoHwAb
          Rte_Inst_NvM: type=Rte_CDS_NvM
          Rte_Inst_Sbc_Cdd: type=Rte_CDS_Sbc_Cdd
          Rte_Inst_WdgM: type=Rte_CDS_WdgM
          Rte_Inst_WdgM_SWC: type=Rte_CDS_WdgM_SWC
          Rte_Inst_Xcp_SWC: type=Rte_CDS_Xcp_SWC
          Rte_Rx_000296: type=boolean
          Rte_Self_CPT_Asw_Swc: type=Rte_SelfType_Asw_Swc
          Rte_Self_CPT_BswM: type=Rte_SelfType_BswM
          Rte_Self_CPT_Cmu_Cdd: type=Rte_SelfType_Cmu_Cdd
          Rte_Self_CPT_ComM: type=Rte_SelfType_ComM
          Rte_Self_CPT_Det: type=Rte_SelfType_Det
          Rte_Self_CPT_EcuM: type=Rte_SelfType_EcuM
          Rte_Self_CPT_IoHwAb: type=Rte_SelfType_IoHwAb
          Rte_Self_CPT_NvM: type=Rte_SelfType_NvM
          Rte_Self_CPT_Sbc_Cdd: type=Rte_SelfType_Sbc_Cdd
          Rte_Self_CPT_WdgM: type=Rte_SelfType_WdgM
          Rte_Self_CPT_WdgM_SWC: type=Rte_SelfType_WdgM_SWC
          Rte_Self_CPT_Xcp_SWC: type=Rte_SelfType_Xcp_SWC
          Rte_Tasks: type=Rte_TaskInfo
      static-memorys:
        310 x data:
          Rte_ActCount_CPT_BswM_DRE_BswM_Cfg_DfrdSwcReqst_BswM_MRP_SwcModeRequest: type=Rte_REActCounterType
          Rte_ModeCurrent_0: type=uint8
          Rte_ModeCurrent_1: type=uint8
          Rte_ModeCurrent_10: type=uint8
          Rte_ModeCurrent_11: type=uint8
          Rte_ModeCurrent_{2..9}: type=uint8
          Rte_ModeSchMNext_0: type=uint8
          Rte_Rx_{000000..000008}: type=uint8
          Rte_Rx_000009: type=uint32
          Rte_Rx_000010: type=uint8
          Rte_Rx_000011: type=uint16
          Rte_Rx_000012: type=uint16
          Rte_Rx_000013: type=uint8
          Rte_Rx_000014: type=uint8
          Rte_Rx_000015: type=uint16
          Rte_Rx_000016: type=uint16
          Rte_Rx_000017: type=uint8
          Rte_Rx_000018: type=uint8
          Rte_Rx_000019: type=uint16
          Rte_Rx_000020: type=uint16
          Rte_Rx_{000021..000033}: type=uint8
          Rte_Rx_000034: type=uint16
          Rte_Rx_000035: type=uint8
          Rte_Rx_000036: type=uint8
          Rte_Rx_000037: type=uint16
          Rte_Rx_000038: type=uint8
          Rte_Rx_000039: type=uint16
          Rte_Rx_000040: type=uint8
          Rte_Rx_{000041..000043}: type=uint16
          Rte_Rx_{000044..000052}: type=uint8
          Rte_Rx_000053: type=uint32
          Rte_Rx_{000054..000057}: type=uint16
          Rte_Rx_000058: type=uint8
          Rte_Rx_000059: type=uint32
          Rte_Rx_000060: type=uint32
          Rte_Rx_000061: type=uint8
          Rte_Rx_000062: type=uint16
          Rte_Rx_000063: type=uint16
          Rte_Rx_000064: type=uint32
          Rte_Rx_{000065..000090}: type=uint8
          Rte_Rx_000091: type=boolean
          Rte_Rx_000092: type=uint8
          Rte_Rx_{000093..000105}: type=boolean
          Rte_Rx_000106: type=uint8
          Rte_Rx_000107: type=boolean
          Rte_Rx_000108: type=boolean
          Rte_Rx_000109: type=uint8
          Rte_Rx_{000110..000112}: type=boolean
          Rte_Rx_000113: type=uint16
          Rte_Rx_{000114..000122}: type=boolean
          Rte_Rx_000123: type=uint8
          Rte_Rx_000124: type=uint8
          Rte_Rx_{000125..000127}: type=boolean
          Rte_Rx_000128: type=float32
          Rte_Rx_{000129..000133}: type=boolean
          Rte_Rx_000134: type=uint8
          Rte_Rx_000135: type=boolean
          Rte_Rx_000136: type=uint8
          Rte_Rx_000137: type=boolean
          Rte_Rx_000138: type=uint8
          Rte_Rx_000139: type=boolean
          Rte_Rx_000140: type=float32
          Rte_Rx_000141: type=boolean
          Rte_Rx_000142: type=uint16
          Rte_Rx_000143: type=boolean
          Rte_Rx_000144: type=uint8
          Rte_Rx_000145: type=boolean
          Rte_Rx_000146: type=uint16
          Rte_Rx_000147: type=boolean
          Rte_Rx_000148: type=float32
          Rte_Rx_000149: type=boolean
          Rte_Rx_000150: type=float32
          Rte_Rx_000151: type=boolean
          Rte_Rx_000152: type=float32
          Rte_Rx_000153: type=boolean
          Rte_Rx_000154: type=float32
          Rte_Rx_000155: type=boolean
          Rte_Rx_000156: type=float32
          Rte_Rx_000157: type=boolean
          Rte_Rx_000158: type=uint8
          Rte_Rx_000159: type=boolean
          Rte_Rx_000160: type=uint16
          Rte_Rx_000161: type=boolean
          Rte_Rx_000162: type=float32
          Rte_Rx_000163: type=boolean
          Rte_Rx_000164: type=float32
          Rte_Rx_000165: type=boolean
          Rte_Rx_000166: type=float32
          Rte_Rx_000167: type=boolean
          Rte_Rx_000168: type=float32
          Rte_Rx_000169: type=boolean
          Rte_Rx_000170: type=float32
          Rte_Rx_000171: type=boolean
          Rte_Rx_000172: type=float32
          Rte_Rx_000173: type=boolean
          Rte_Rx_000174: type=float32
          Rte_Rx_000175: type=boolean
          Rte_Rx_000176: type=float32
          Rte_Rx_000177: type=boolean
          Rte_Rx_000178: type=float32
          Rte_Rx_000179: type=boolean
          Rte_Rx_000180: type=float32
          Rte_Rx_000181: type=boolean
          Rte_Rx_000182: type=float32
          Rte_Rx_000183: type=boolean
          Rte_Rx_000184: type=float32
          Rte_Rx_000185: type=boolean
          Rte_Rx_000186: type=float32
          Rte_Rx_000187: type=boolean
          Rte_Rx_000188: type=float32
          Rte_Rx_000189: type=boolean
          Rte_Rx_000190: type=uint8
          Rte_Rx_000191: type=boolean
          Rte_Rx_000192: type=uint8
          Rte_Rx_000193: type=boolean
          Rte_Rx_000194: type=uint8
          Rte_Rx_000195: type=boolean
          Rte_Rx_000196: type=float32
          Rte_Rx_000197: type=boolean
          Rte_Rx_000198: type=float32
          Rte_Rx_000199: type=boolean
          Rte_Rx_000200: type=uint8
          Rte_Rx_000201: type=boolean
          Rte_Rx_000202: type=float32
          Rte_Rx_000203: type=boolean
          Rte_Rx_000204: type=float32
          Rte_Rx_000205: type=boolean
          Rte_Rx_000206: type=float32
          Rte_Rx_000207: type=boolean
          Rte_Rx_000208: type=float32
          Rte_Rx_000209: type=boolean
          Rte_Rx_000210: type=float32
          Rte_Rx_000211: type=boolean
          Rte_Rx_000212: type=float32
          Rte_Rx_000213: type=boolean
          Rte_Rx_000214: type=float32
          Rte_Rx_000215: type=boolean
          Rte_Rx_000216: type=float32
          Rte_Rx_000217: type=boolean
          Rte_Rx_000218: type=float32
          Rte_Rx_000219: type=boolean
          Rte_Rx_000220: type=float32
          Rte_Rx_000221: type=boolean
          Rte_Rx_000222: type=float32
          Rte_Rx_000223: type=boolean
          Rte_Rx_000224: type=float32
          Rte_Rx_000225: type=boolean
          Rte_Rx_000226: type=float32
          Rte_Rx_000227: type=boolean
          Rte_Rx_000228: type=float32
          Rte_Rx_000229: type=boolean
          Rte_Rx_000230: type=float32
          Rte_Rx_000231: type=boolean
          Rte_Rx_000232: type=float32
          Rte_Rx_{000233..000235}: type=boolean
          Rte_Rx_000236: type=float32
          Rte_Rx_000237: type=boolean
          Rte_Rx_000238: type=boolean
          Rte_Rx_000239: type=uint8
          Rte_Rx_{000240..000258}: type=boolean
          Rte_Rx_000259: type=uint8
          Rte_Rx_000260: type=boolean
          Rte_Rx_000261: type=uint16
          Rte_Rx_000262: type=boolean
          Rte_Rx_000263: type=float32
          Rte_Rx_000264: type=boolean
          Rte_Rx_000265: type=float32
          Rte_Rx_000266: type=boolean
          Rte_Rx_000267: type=float32
          Rte_Rx_000268: type=boolean
          Rte_Rx_000269: type=float32
          Rte_Rx_000270: type=boolean
          Rte_Rx_000271: type=float32
          Rte_Rx_000272: type=boolean
          Rte_Rx_000273: type=float32
          Rte_Rx_000274: type=boolean
          Rte_Rx_000275: type=float32
          Rte_Rx_000276: type=boolean
          Rte_Rx_000277: type=float32
          Rte_Rx_000278: type=boolean
          Rte_Rx_000279: type=float32
          Rte_Rx_000280: type=boolean
          Rte_Rx_000281: type=float32
          Rte_Rx_000282: type=boolean
          Rte_Rx_000283: type=float32
          Rte_Rx_000284: type=boolean
          Rte_Rx_000285: type=float32
          Rte_Rx_000286: type=boolean
          Rte_Rx_000287: type=uint8
          Rte_Rx_000288: type=boolean
          Rte_Rx_000289: type=uint8
          Rte_Rx_000290: type=boolean
          Rte_Rx_000291: type=uint8
          Rte_Rx_000292: type=boolean
          Rte_Rx_000293: type=uint16
          Rte_Rx_000294: type=boolean
          Rte_Rx_000295: type=float32
      909 x bsw called entity, all with sw-addr-method=CODE:
        Rte_ActivateRE: implemented-entry=Rte_ActivateRE
        Rte_COMCbk_CCS_SPN3081_U_Out: implemented-entry=Rte_COMCbk_CCS_SPN3081_U_Out
        Rte_COMCbk_CCS_SPN3082_I_Out: implemented-entry=Rte_COMCbk_CCS_SPN3082_I_Out
        Rte_COMCbk_CCS_SPN3083_Time_Charged: implemented-entry=Rte_COMCbk_CCS_SPN3083_Time_Charged
        Rte_COMCbk_CCS_SPN3929_Chg_enable: implemented-entry=Rte_COMCbk_CCS_SPN3929_Chg_enable
        Rte_COMCbk_CDU_HVILWarning: implemented-entry=Rte_COMCbk_CDU_HVILWarning
        Rte_COMCbk_CEM_SPN3921_Timeout_BRM: implemented-entry=Rte_COMCbk_CEM_SPN3921_Timeout_BRM
        Rte_COMCbk_CEM_SPN3922_Timeout_BCP: implemented-entry=Rte_COMCbk_CEM_SPN3922_Timeout_BCP
        Rte_COMCbk_CEM_SPN3923_Timeout_BRO: implemented-entry=Rte_COMCbk_CEM_SPN3923_Timeout_BRO
        Rte_COMCbk_CEM_SPN3924_Timeout_BCS: implemented-entry=Rte_COMCbk_CEM_SPN3924_Timeout_BCS
        Rte_COMCbk_CEM_SPN3925_Timeout_BCL: implemented-entry=Rte_COMCbk_CEM_SPN3925_Timeout_BCL
        Rte_COMCbk_CEM_SPN3926_Timeout_BST: implemented-entry=Rte_COMCbk_CEM_SPN3926_Timeout_BST
        Rte_COMCbk_CEM_SPN3927_Timeout_BSD: implemented-entry=Rte_COMCbk_CEM_SPN3927_Timeout_BSD
        Rte_COMCbk_CEM_other: implemented-entry=Rte_COMCbk_CEM_other
        Rte_COMCbk_CHM_SPN2600_Comm_Ver: implemented-entry=Rte_COMCbk_CHM_SPN2600_Comm_Ver
        Rte_COMCbk_CML_SPN2824_U_Max_Out: implemented-entry=Rte_COMCbk_CML_SPN2824_U_Max_Out
        Rte_COMCbk_CML_SPN2825_U_Min_Out: implemented-entry=Rte_COMCbk_CML_SPN2825_U_Min_Out
        Rte_COMCbk_CML_SPN2826_I_Max_Out: implemented-entry=Rte_COMCbk_CML_SPN2826_I_Max_Out
        Rte_COMCbk_CML_SPN2827_I_Min_Out: implemented-entry=Rte_COMCbk_CML_SPN2827_I_Min_Out
        Rte_COMCbk_CRM_SPN2560_Ack: implemented-entry=Rte_COMCbk_CRM_SPN2560_Ack
        Rte_COMCbk_CRM_SPN2561_CHG_Index: implemented-entry=Rte_COMCbk_CRM_SPN2561_CHG_Index
        Rte_COMCbk_CRM_SPN2562_CHG_Loc: implemented-entry=Rte_COMCbk_CRM_SPN2562_CHG_Loc
        Rte_COMCbk_CRO_SPN2830_CHG_Ready: implemented-entry=Rte_COMCbk_CRO_SPN2830_CHG_Ready
        Rte_COMCbk_CSD_SPN3611_Time_Charged: implemented-entry=Rte_COMCbk_CSD_SPN3611_Time_Charged
        Rte_COMCbk_CSD_SPN3612_E_Out: implemented-entry=Rte_COMCbk_CSD_SPN3612_E_Out
        Rte_COMCbk_CSD_SPN3613_CHG_Index: implemented-entry=Rte_COMCbk_CSD_SPN3613_CHG_Index
        Rte_COMCbk_CST_SPN3521_Stop_Reason_Auto: implemented-entry=Rte_COMCbk_CST_SPN3521_Stop_Reason_Auto
        Rte_COMCbk_CST_SPN3521_Stop_Reason_BMSStop: implemented-entry=Rte_COMCbk_CST_SPN3521_Stop_Reason_BMSStop
        Rte_COMCbk_CST_SPN3521_Stop_Reason_Fault: implemented-entry=Rte_COMCbk_CST_SPN3521_Stop_Reason_Fault
        Rte_COMCbk_CST_SPN3521_Stop_Reason_Manual: implemented-entry=Rte_COMCbk_CST_SPN3521_Stop_Reason_Manual
        Rte_COMCbk_CST_SPN3522_Stop_Fault_CHGCnnt: implemented-entry=Rte_COMCbk_CST_SPN3522_Stop_Fault_CHGCnnt
        Rte_COMCbk_CST_SPN3522_Stop_Fault_Deliver: implemented-entry=Rte_COMCbk_CST_SPN3522_Stop_Fault_Deliver
        Rte_COMCbk_CST_SPN3522_Stop_Fault_EmerStop: implemented-entry=Rte_COMCbk_CST_SPN3522_Stop_Fault_EmerStop
        Rte_COMCbk_CST_SPN3522_Stop_Fault_Other: implemented-entry=Rte_COMCbk_CST_SPN3522_Stop_Fault_Other
        Rte_COMCbk_CST_SPN3522_Stop_Fault_T_CHG: implemented-entry=Rte_COMCbk_CST_SPN3522_Stop_Fault_T_CHG
        Rte_COMCbk_CST_SPN3522_Stop_Fault_T_Inter: implemented-entry=Rte_COMCbk_CST_SPN3522_Stop_Fault_T_Inter
        Rte_COMCbk_CST_SPN3523_Stop_Fault_Mismatch: implemented-entry=Rte_COMCbk_CST_SPN3523_Stop_Fault_Mismatch
        Rte_COMCbk_CST_SPN3523_Stop_Fault_U: implemented-entry=Rte_COMCbk_CST_SPN3523_Stop_Fault_U
        Rte_COMCbk_CTS_SPN2823_SYNC_Day: implemented-entry=Rte_COMCbk_CTS_SPN2823_SYNC_Day
        Rte_COMCbk_CTS_SPN2823_SYNC_DayTen: implemented-entry=Rte_COMCbk_CTS_SPN2823_SYNC_DayTen
        Rte_COMCbk_CTS_SPN2823_SYNC_Hour: implemented-entry=Rte_COMCbk_CTS_SPN2823_SYNC_Hour
        Rte_COMCbk_CTS_SPN2823_SYNC_HourTen: implemented-entry=Rte_COMCbk_CTS_SPN2823_SYNC_HourTen
        Rte_COMCbk_CTS_SPN2823_SYNC_Minute: implemented-entry=Rte_COMCbk_CTS_SPN2823_SYNC_Minute
        Rte_COMCbk_CTS_SPN2823_SYNC_MinuteTen: implemented-entry=Rte_COMCbk_CTS_SPN2823_SYNC_MinuteTen
        Rte_COMCbk_CTS_SPN2823_SYNC_Month: implemented-entry=Rte_COMCbk_CTS_SPN2823_SYNC_Month
        Rte_COMCbk_CTS_SPN2823_SYNC_MonthTen: implemented-entry=Rte_COMCbk_CTS_SPN2823_SYNC_MonthTen
        Rte_COMCbk_CTS_SPN2823_SYNC_Second: implemented-entry=Rte_COMCbk_CTS_SPN2823_SYNC_Second
        Rte_COMCbk_CTS_SPN2823_SYNC_SecondTen: implemented-entry=Rte_COMCbk_CTS_SPN2823_SYNC_SecondTen
        Rte_COMCbk_CTS_SPN2823_SYNC_Year: implemented-entry=Rte_COMCbk_CTS_SPN2823_SYNC_Year
        Rte_COMCbk_CTS_SPN2823_SYNC_YearHundred: implemented-entry=Rte_COMCbk_CTS_SPN2823_SYNC_YearHundred
        Rte_COMCbk_CTS_SPN2823_SYNC_YearTen: implemented-entry=Rte_COMCbk_CTS_SPN2823_SYNC_YearTen
        Rte_COMCbk_CTS_SPN2823_SYNC_YearThousand: implemented-entry=Rte_COMCbk_CTS_SPN2823_SYNC_YearThousand
        Rte_COMCbk_CheckSum_1E3h: implemented-entry=Rte_COMCbk_CheckSum_1E3h
        Rte_COMCbk_CheckSum_23Ch: implemented-entry=Rte_COMCbk_CheckSum_23Ch
        Rte_COMCbk_ChrgrStatPTHVCntctOpnrAlwd: implemented-entry=Rte_COMCbk_ChrgrStatPTHVCntctOpnrAlwd
        Rte_COMCbk_ChrgrStatPTHVCntctrClsAlwd: implemented-entry=Rte_COMCbk_ChrgrStatPTHVCntctrClsAlwd
        Rte_COMCbk_FrontCmprElctrCrnt: implemented-entry=Rte_COMCbk_FrontCmprElctrCrnt
        Rte_COMCbk_FrontCompStatFdbck: implemented-entry=Rte_COMCbk_FrontCompStatFdbck
        Rte_COMCbk_FrontPTCElctrCrnt: implemented-entry=Rte_COMCbk_FrontPTCElctrCrnt
        Rte_COMCbk_FrontPTCStatFdbck: implemented-entry=Rte_COMCbk_FrontPTCStatFdbck
        Rte_COMCbk_HighPreVehOdo: implemented-entry=Rte_COMCbk_HighPreVehOdo
        Rte_COMCbk_HighPreVehOdoV: implemented-entry=Rte_COMCbk_HighPreVehOdoV
        Rte_COMCbk_I_LDC_In: implemented-entry=Rte_COMCbk_I_LDC_In
        Rte_COMCbk_InvADCCrnt: implemented-entry=Rte_COMCbk_InvADCCrnt
        Rte_COMCbk_InvADCCrntV: implemented-entry=Rte_COMCbk_InvADCCrntV
        Rte_COMCbk_MessageCounter_23Ch: implemented-entry=Rte_COMCbk_MessageCounter_23Ch
        Rte_COMCbk_OBCChgCurrent: implemented-entry=Rte_COMCbk_OBCChgCurrent
        Rte_COMCbk_OBCChgVolt: implemented-entry=Rte_COMCbk_OBCChgVolt
        Rte_COMCbk_OBCCurrentFltCode: implemented-entry=Rte_COMCbk_OBCCurrentFltCode
        Rte_COMCbk_OBCHistoryFltCode: implemented-entry=Rte_COMCbk_OBCHistoryFltCode
        Rte_COMCbk_OBCMaxChrgCurrent: implemented-entry=Rte_COMCbk_OBCMaxChrgCurrent
        Rte_COMCbk_OBCMaxChrgVoltage: implemented-entry=Rte_COMCbk_OBCMaxChrgVoltage
        Rte_COMCbk_OBCStatus: implemented-entry=Rte_COMCbk_OBCStatus
        Rte_COMCbk_PTHVCntctrReq: implemented-entry=Rte_COMCbk_PTHVCntctrReq
        Rte_COMCbk_RollingCounter: implemented-entry=Rte_COMCbk_RollingCounter
        Rte_COMCbk_RollingCounter_1E3h: implemented-entry=Rte_COMCbk_RollingCounter_1E3h
        Rte_COMCbk_SRSCheckSum: implemented-entry=Rte_COMCbk_SRSCheckSum
        Rte_COMCbk_SysBPM: implemented-entry=Rte_COMCbk_SysBPM
        Rte_COMCbk_SysBPMEnbd: implemented-entry=Rte_COMCbk_SysBPMEnbd
        Rte_COMCbk_SysOpnlMd: implemented-entry=Rte_COMCbk_SysOpnlMd
        Rte_COMCbk_SysPwrMd: implemented-entry=Rte_COMCbk_SysPwrMd
        Rte_COMCbk_SysVol: implemented-entry=Rte_COMCbk_SysVol
        Rte_COMCbk_SysVolMd: implemented-entry=Rte_COMCbk_SysVolMd
        Rte_COMCbk_SysVolMdV: implemented-entry=Rte_COMCbk_SysVolMdV
        Rte_COMCbk_SysVolV: implemented-entry=Rte_COMCbk_SysVolV
        Rte_COMCbk_V_DC: implemented-entry=Rte_COMCbk_V_DC
        Rte_COMCbk_V_DCValidity: implemented-entry=Rte_COMCbk_V_DCValidity
        Rte_COMCbk_VehCrshTyp: implemented-entry=Rte_COMCbk_VehCrshTyp
        Rte_COMCbk_VehSpdAvgDrvn: implemented-entry=Rte_COMCbk_VehSpdAvgDrvn
        Rte_COMCbk_VehSpdAvgDrvnV: implemented-entry=Rte_COMCbk_VehSpdAvgDrvnV
        Rte_COMCbk_VehicleSpeed: implemented-entry=Rte_COMCbk_VehicleSpeed
        Rte_COMCbk_VehicleSpeedStatus: implemented-entry=Rte_COMCbk_VehicleSpeedStatus
        Rte_Call_Asw_Swc_Cmu_Get_CMUPCBTempVld_flg: implemented-entry=Rte_Call_Asw_Swc_Cmu_Get_CMUPCBTempVld_flg
        Rte_Call_Asw_Swc_Cmu_Get_CMUPCBTemp_C: implemented-entry=Rte_Call_Asw_Swc_Cmu_Get_CMUPCBTemp_C
        Rte_Call_Asw_Swc_Cmu_Get_CellBalState_flg: implemented-entry=Rte_Call_Asw_Swc_Cmu_Get_CellBalState_flg
        Rte_Call_Asw_Swc_Cmu_Get_CellTempVld_flg: implemented-entry=Rte_Call_Asw_Swc_Cmu_Get_CellTempVld_flg
        Rte_Call_Asw_Swc_Cmu_Get_CellTemp_C: implemented-entry=Rte_Call_Asw_Swc_Cmu_Get_CellTemp_C
        Rte_Call_Asw_Swc_Cmu_Get_CellVoltVld_flg: implemented-entry=Rte_Call_Asw_Swc_Cmu_Get_CellVoltVld_flg
        Rte_Call_Asw_Swc_Cmu_Get_CellVolt_mV: implemented-entry=Rte_Call_Asw_Swc_Cmu_Get_CellVolt_mV
        Rte_Call_Asw_Swc_Cmu_Get_CmuCbOpenFltArr: implemented-entry=Rte_Call_Asw_Swc_Cmu_Get_CmuCbOpenFltArr
        Rte_Call_Asw_Swc_Cmu_Get_CmuCbShortFltArr: implemented-entry=Rte_Call_Asw_Swc_Cmu_Get_CmuCbShortFltArr
        Rte_Call_Asw_Swc_Cmu_Get_CmuCellTermLeakArr: implemented-entry=Rte_Call_Asw_Swc_Cmu_Get_CmuCellTermLeakArr
        Rte_Call_Asw_Swc_Cmu_Get_CmuCtOpenFltArr: implemented-entry=Rte_Call_Asw_Swc_Cmu_Get_CmuCtOpenFltArr
        Rte_Call_Asw_Swc_Cmu_Get_CmuFaultState1: implemented-entry=Rte_Call_Asw_Swc_Cmu_Get_CmuFaultState1
        Rte_Call_Asw_Swc_Cmu_Get_CmuFaultState2: implemented-entry=Rte_Call_Asw_Swc_Cmu_Get_CmuFaultState2
        Rte_Call_Asw_Swc_Cmu_Get_CmuGpioOTFuncArr: implemented-entry=Rte_Call_Asw_Swc_Cmu_Get_CmuGpioOTFuncArr
        Rte_Call_Asw_Swc_Cmu_Get_CmuGpioUTFuncArr: implemented-entry=Rte_Call_Asw_Swc_Cmu_Get_CmuGpioUTFuncArr
        Rte_Call_Asw_Swc_Cmu_Get_CmuGpioxOpenArr: implemented-entry=Rte_Call_Asw_Swc_Cmu_Get_CmuGpioxOpenArr
        Rte_Call_Asw_Swc_Cmu_Get_CmuOVFuncArr: implemented-entry=Rte_Call_Asw_Swc_Cmu_Get_CmuOVFuncArr
        Rte_Call_Asw_Swc_Cmu_Get_CmuUVFuncArr: implemented-entry=Rte_Call_Asw_Swc_Cmu_Get_CmuUVFuncArr
        Rte_Call_Asw_Swc_Cmu_Get_CmuVoltChaFuncArr: implemented-entry=Rte_Call_Asw_Swc_Cmu_Get_CmuVoltChaFuncArr
        Rte_Call_Asw_Swc_Cmu_Get_HeatFilmTempVld_flg: implemented-entry=Rte_Call_Asw_Swc_Cmu_Get_HeatFilmTempVld_flg
        Rte_Call_Asw_Swc_Cmu_Get_HeatFilmTemp_C: implemented-entry=Rte_Call_Asw_Swc_Cmu_Get_HeatFilmTemp_C
        Rte_Call_Asw_Swc_Cmu_Get_StackVoltVld_flg: implemented-entry=Rte_Call_Asw_Swc_Cmu_Get_StackVoltVld_flg
        Rte_Call_Asw_Swc_Cmu_Get_StackVolt_V: implemented-entry=Rte_Call_Asw_Swc_Cmu_Get_StackVolt_V
        Rte_Call_Asw_Swc_Cmu_Set_CellBalCmd_flg: implemented-entry=Rte_Call_Asw_Swc_Cmu_Set_CellBalCmd_flg
        Rte_Call_Asw_Swc_RPort_ComM_UserRequest_GetCurrentComMode: implemented-entry=Rte_Call_Asw_Swc_RPort_ComM_UserRequest_GetCurrentComMode
        Rte_Call_Asw_Swc_RPort_EcuM_ShutdownTarget_SelectShutdownTarget: implemented-entry=Rte_Call_Asw_Swc_RPort_EcuM_ShutdownTarget_SelectShutdownTarget
        Rte_Call_Asw_Swc_RPort_NVDataBlock1_SetRamBlockStatus: implemented-entry=Rte_Call_Asw_Swc_RPort_NVDataBlock1_SetRamBlockStatus
        Rte_Call_Asw_Swc_RPort_NVDataBlock1_WriteBlock: implemented-entry=Rte_Call_Asw_Swc_RPort_NVDataBlock1_WriteBlock
        Rte_Call_Asw_Swc_Rtc_DisableRTCWakeup_flg: implemented-entry=Rte_Call_Asw_Swc_Rtc_DisableRTCWakeup_flg
        Rte_Call_Asw_Swc_Rtc_ReadRTCTime: implemented-entry=Rte_Call_Asw_Swc_Rtc_ReadRTCTime
        Rte_Call_Asw_Swc_Rtc_SetSleepTime_Min: implemented-entry=Rte_Call_Asw_Swc_Rtc_SetSleepTime_Min
        Rte_Call_Asw_Swc_Rtc_WriteRTCTime: implemented-entry=Rte_Call_Asw_Swc_Rtc_WriteRTCTime
        Rte_Call_NvM_NVDataBlock1_Finished_JobFinished: implemented-entry=Rte_Call_NvM_NVDataBlock1_Finished_JobFinished
        Rte_Call_WdgM_SWC_RPort_AliveSupervision_Asw_5ms_CheckpointReached: implemented-entry=Rte_Call_WdgM_SWC_RPort_AliveSupervision_Asw_5ms_CheckpointReached
        Rte_Call_WdgM_SWC_RPort_AliveSupervision_Bsw_1000ms_CheckpointReached: implemented-entry=Rte_Call_WdgM_SWC_RPort_AliveSupervision_Bsw_1000ms_CheckpointReached
        Rte_Call_WdgM_SWC_RPort_AliveSupervision_Bsw_100ms_CheckpointReached: implemented-entry=Rte_Call_WdgM_SWC_RPort_AliveSupervision_Bsw_100ms_CheckpointReached
        Rte_Call_WdgM_SWC_RPort_AliveSupervision_Bsw_10ms_CheckpointReached: implemented-entry=Rte_Call_WdgM_SWC_RPort_AliveSupervision_Bsw_10ms_CheckpointReached
        Rte_Call_WdgM_SWC_RPort_AliveSupervision_Bsw_20ms_CheckpointReached: implemented-entry=Rte_Call_WdgM_SWC_RPort_AliveSupervision_Bsw_20ms_CheckpointReached
        Rte_Call_WdgM_SWC_RPort_AliveSupervision_Bsw_50ms_CheckpointReached: implemented-entry=Rte_Call_WdgM_SWC_RPort_AliveSupervision_Bsw_50ms_CheckpointReached
        Rte_Call_WdgM_SWC_RPort_AliveSupervision_Bsw_5ms_CheckpointReached: implemented-entry=Rte_Call_WdgM_SWC_RPort_AliveSupervision_Bsw_5ms_CheckpointReached
        Rte_DecrementWaitingCount: implemented-entry=Rte_DecrementWaitingCount
        Rte_GetCurrentTaskIndex: implemented-entry=Rte_GetCurrentTaskIndex
        Rte_MainFunction: implemented-entry=Rte_MainFunction
        Rte_ReadQueue: implemented-entry=Rte_ReadQueue
        Rte_Read_Asw_Swc_CCS_CHG_CCS_SPN3081_U_Out: implemented-entry=Rte_Read_Asw_Swc_CCS_CHG_CCS_SPN3081_U_Out
        Rte_Read_Asw_Swc_CCS_CHG_CCS_SPN3082_I_Out: implemented-entry=Rte_Read_Asw_Swc_CCS_CHG_CCS_SPN3082_I_Out
        Rte_Read_Asw_Swc_CCS_CHG_CCS_SPN3083_Time_Charged: implemented-entry=Rte_Read_Asw_Swc_CCS_CHG_CCS_SPN3083_Time_Charged
        Rte_Read_Asw_Swc_CCS_CHG_CCS_SPN3929_Chg_enable: implemented-entry=Rte_Read_Asw_Swc_CCS_CHG_CCS_SPN3929_Chg_enable
        Rte_Read_Asw_Swc_CEM_CHG_CEM_SPN3921_Timeout_BRM: implemented-entry=Rte_Read_Asw_Swc_CEM_CHG_CEM_SPN3921_Timeout_BRM
        Rte_Read_Asw_Swc_CEM_CHG_CEM_SPN3922_Timeout_BCP: implemented-entry=Rte_Read_Asw_Swc_CEM_CHG_CEM_SPN3922_Timeout_BCP
        Rte_Read_Asw_Swc_CEM_CHG_CEM_SPN3923_Timeout_BRO: implemented-entry=Rte_Read_Asw_Swc_CEM_CHG_CEM_SPN3923_Timeout_BRO
        Rte_Read_Asw_Swc_CEM_CHG_CEM_SPN3924_Timeout_BCS: implemented-entry=Rte_Read_Asw_Swc_CEM_CHG_CEM_SPN3924_Timeout_BCS
        Rte_Read_Asw_Swc_CEM_CHG_CEM_SPN3925_Timeout_BCL: implemented-entry=Rte_Read_Asw_Swc_CEM_CHG_CEM_SPN3925_Timeout_BCL
        Rte_Read_Asw_Swc_CEM_CHG_CEM_SPN3926_Timeout_BST: implemented-entry=Rte_Read_Asw_Swc_CEM_CHG_CEM_SPN3926_Timeout_BST
        Rte_Read_Asw_Swc_CEM_CHG_CEM_SPN3927_Timeout_BSD: implemented-entry=Rte_Read_Asw_Swc_CEM_CHG_CEM_SPN3927_Timeout_BSD
        Rte_Read_Asw_Swc_CEM_CHG_CEM_other: implemented-entry=Rte_Read_Asw_Swc_CEM_CHG_CEM_other
        Rte_Read_Asw_Swc_CHM_CHG_CHM_SPN2600_Comm_Ver: implemented-entry=Rte_Read_Asw_Swc_CHM_CHG_CHM_SPN2600_Comm_Ver
        Rte_Read_Asw_Swc_CML_CHG_CML_SPN2824_U_Max_Out: implemented-entry=Rte_Read_Asw_Swc_CML_CHG_CML_SPN2824_U_Max_Out
        Rte_Read_Asw_Swc_CML_CHG_CML_SPN2825_U_Min_Out: implemented-entry=Rte_Read_Asw_Swc_CML_CHG_CML_SPN2825_U_Min_Out
        Rte_Read_Asw_Swc_CML_CHG_CML_SPN2826_I_Max_Out: implemented-entry=Rte_Read_Asw_Swc_CML_CHG_CML_SPN2826_I_Max_Out
        Rte_Read_Asw_Swc_CML_CHG_CML_SPN2827_I_Min_Out: implemented-entry=Rte_Read_Asw_Swc_CML_CHG_CML_SPN2827_I_Min_Out
        Rte_Read_Asw_Swc_CRM_CHG_CRM_SPN2560_Ack: implemented-entry=Rte_Read_Asw_Swc_CRM_CHG_CRM_SPN2560_Ack
        Rte_Read_Asw_Swc_CRM_CHG_CRM_SPN2561_CHG_Index: implemented-entry=Rte_Read_Asw_Swc_CRM_CHG_CRM_SPN2561_CHG_Index
        Rte_Read_Asw_Swc_CRM_CHG_CRM_SPN2562_CHG_Loc: implemented-entry=Rte_Read_Asw_Swc_CRM_CHG_CRM_SPN2562_CHG_Loc
        Rte_Read_Asw_Swc_CRO_CHG_CRO_SPN2830_CHG_Ready: implemented-entry=Rte_Read_Asw_Swc_CRO_CHG_CRO_SPN2830_CHG_Ready
        Rte_Read_Asw_Swc_CSD_CHG_CSD_SPN3611_Time_Charged: implemented-entry=Rte_Read_Asw_Swc_CSD_CHG_CSD_SPN3611_Time_Charged
        Rte_Read_Asw_Swc_CSD_CHG_CSD_SPN3612_E_Out: implemented-entry=Rte_Read_Asw_Swc_CSD_CHG_CSD_SPN3612_E_Out
        Rte_Read_Asw_Swc_CSD_CHG_CSD_SPN3613_CHG_Index: implemented-entry=Rte_Read_Asw_Swc_CSD_CHG_CSD_SPN3613_CHG_Index
        Rte_Read_Asw_Swc_CST_CHG_CST_SPN3521_Stop_Reason_Auto: implemented-entry=Rte_Read_Asw_Swc_CST_CHG_CST_SPN3521_Stop_Reason_Auto
        Rte_Read_Asw_Swc_CST_CHG_CST_SPN3521_Stop_Reason_BMSStop: implemented-entry=Rte_Read_Asw_Swc_CST_CHG_CST_SPN3521_Stop_Reason_BMSStop
        Rte_Read_Asw_Swc_CST_CHG_CST_SPN3521_Stop_Reason_Fault: implemented-entry=Rte_Read_Asw_Swc_CST_CHG_CST_SPN3521_Stop_Reason_Fault
        Rte_Read_Asw_Swc_CST_CHG_CST_SPN3521_Stop_Reason_Manual: implemented-entry=Rte_Read_Asw_Swc_CST_CHG_CST_SPN3521_Stop_Reason_Manual
        Rte_Read_Asw_Swc_CST_CHG_CST_SPN3522_Stop_Fault_CHGCnnt: implemented-entry=Rte_Read_Asw_Swc_CST_CHG_CST_SPN3522_Stop_Fault_CHGCnnt
        Rte_Read_Asw_Swc_CST_CHG_CST_SPN3522_Stop_Fault_Deliver: implemented-entry=Rte_Read_Asw_Swc_CST_CHG_CST_SPN3522_Stop_Fault_Deliver
        Rte_Read_Asw_Swc_CST_CHG_CST_SPN3522_Stop_Fault_EmerStop: implemented-entry=Rte_Read_Asw_Swc_CST_CHG_CST_SPN3522_Stop_Fault_EmerStop
        Rte_Read_Asw_Swc_CST_CHG_CST_SPN3522_Stop_Fault_Other: implemented-entry=Rte_Read_Asw_Swc_CST_CHG_CST_SPN3522_Stop_Fault_Other
        Rte_Read_Asw_Swc_CST_CHG_CST_SPN3522_Stop_Fault_T_CHG: implemented-entry=Rte_Read_Asw_Swc_CST_CHG_CST_SPN3522_Stop_Fault_T_CHG
        Rte_Read_Asw_Swc_CST_CHG_CST_SPN3522_Stop_Fault_T_Inter: implemented-entry=Rte_Read_Asw_Swc_CST_CHG_CST_SPN3522_Stop_Fault_T_Inter
        Rte_Read_Asw_Swc_CST_CHG_CST_SPN3523_Stop_Fault_Mismatch: implemented-entry=Rte_Read_Asw_Swc_CST_CHG_CST_SPN3523_Stop_Fault_Mismatch
        Rte_Read_Asw_Swc_CST_CHG_CST_SPN3523_Stop_Fault_U: implemented-entry=Rte_Read_Asw_Swc_CST_CHG_CST_SPN3523_Stop_Fault_U
        Rte_Read_Asw_Swc_CTS_CHG_CTS_SPN2823_SYNC_Day: implemented-entry=Rte_Read_Asw_Swc_CTS_CHG_CTS_SPN2823_SYNC_Day
        Rte_Read_Asw_Swc_CTS_CHG_CTS_SPN2823_SYNC_DayTen: implemented-entry=Rte_Read_Asw_Swc_CTS_CHG_CTS_SPN2823_SYNC_DayTen
        Rte_Read_Asw_Swc_CTS_CHG_CTS_SPN2823_SYNC_Hour: implemented-entry=Rte_Read_Asw_Swc_CTS_CHG_CTS_SPN2823_SYNC_Hour
        Rte_Read_Asw_Swc_CTS_CHG_CTS_SPN2823_SYNC_HourTen: implemented-entry=Rte_Read_Asw_Swc_CTS_CHG_CTS_SPN2823_SYNC_HourTen
        Rte_Read_Asw_Swc_CTS_CHG_CTS_SPN2823_SYNC_Minute: implemented-entry=Rte_Read_Asw_Swc_CTS_CHG_CTS_SPN2823_SYNC_Minute
        Rte_Read_Asw_Swc_CTS_CHG_CTS_SPN2823_SYNC_MinuteTen: implemented-entry=Rte_Read_Asw_Swc_CTS_CHG_CTS_SPN2823_SYNC_MinuteTen
        Rte_Read_Asw_Swc_CTS_CHG_CTS_SPN2823_SYNC_Month: implemented-entry=Rte_Read_Asw_Swc_CTS_CHG_CTS_SPN2823_SYNC_Month
        Rte_Read_Asw_Swc_CTS_CHG_CTS_SPN2823_SYNC_MonthTen: implemented-entry=Rte_Read_Asw_Swc_CTS_CHG_CTS_SPN2823_SYNC_MonthTen
        Rte_Read_Asw_Swc_CTS_CHG_CTS_SPN2823_SYNC_Second: implemented-entry=Rte_Read_Asw_Swc_CTS_CHG_CTS_SPN2823_SYNC_Second
        Rte_Read_Asw_Swc_CTS_CHG_CTS_SPN2823_SYNC_SecondTen: implemented-entry=Rte_Read_Asw_Swc_CTS_CHG_CTS_SPN2823_SYNC_SecondTen
        Rte_Read_Asw_Swc_CTS_CHG_CTS_SPN2823_SYNC_Year: implemented-entry=Rte_Read_Asw_Swc_CTS_CHG_CTS_SPN2823_SYNC_Year
        Rte_Read_Asw_Swc_CTS_CHG_CTS_SPN2823_SYNC_YearHundred: implemented-entry=Rte_Read_Asw_Swc_CTS_CHG_CTS_SPN2823_SYNC_YearHundred
        Rte_Read_Asw_Swc_CTS_CHG_CTS_SPN2823_SYNC_YearTen: implemented-entry=Rte_Read_Asw_Swc_CTS_CHG_CTS_SPN2823_SYNC_YearTen
        Rte_Read_Asw_Swc_CTS_CHG_CTS_SPN2823_SYNC_YearThousand: implemented-entry=Rte_Read_Asw_Swc_CTS_CHG_CTS_SPN2823_SYNC_YearThousand
        Rte_Read_Asw_Swc_ChargeValue_CC2VoltVld_flg: implemented-entry=Rte_Read_Asw_Swc_ChargeValue_CC2VoltVld_flg
        Rte_Read_Asw_Swc_ChargeValue_CC2Volt_V: implemented-entry=Rte_Read_Asw_Swc_ChargeValue_CC2Volt_V
        Rte_Read_Asw_Swc_ChargeValue_CCResVld_flg: implemented-entry=Rte_Read_Asw_Swc_ChargeValue_CCResVld_flg
        Rte_Read_Asw_Swc_ChargeValue_CCRes_ohm: implemented-entry=Rte_Read_Asw_Swc_ChargeValue_CCRes_ohm
        Rte_Read_Asw_Swc_ChargeValue_CPDutyVld_flg: implemented-entry=Rte_Read_Asw_Swc_ChargeValue_CPDutyVld_flg
        Rte_Read_Asw_Swc_ChargeValue_CPDuty_pct: implemented-entry=Rte_Read_Asw_Swc_ChargeValue_CPDuty_pct
        Rte_Read_Asw_Swc_ChargeValue_CPFrqVld_flg: implemented-entry=Rte_Read_Asw_Swc_ChargeValue_CPFrqVld_flg
        Rte_Read_Asw_Swc_ChargeValue_CPFrq_Hz: implemented-entry=Rte_Read_Asw_Swc_ChargeValue_CPFrq_Hz
        Rte_Read_Asw_Swc_ChargeValue_CPVoltVld_flg: implemented-entry=Rte_Read_Asw_Swc_ChargeValue_CPVoltVld_flg
        Rte_Read_Asw_Swc_ChargeValue_CPVolt_V: implemented-entry=Rte_Read_Asw_Swc_ChargeValue_CPVolt_V
        Rte_Read_Asw_Swc_ChargeValue_DCWakeupVoltVld_flg: implemented-entry=Rte_Read_Asw_Swc_ChargeValue_DCWakeupVoltVld_flg
        Rte_Read_Asw_Swc_ChargeValue_DCWakeupVolt_V: implemented-entry=Rte_Read_Asw_Swc_ChargeValue_DCWakeupVolt_V
        Rte_Read_Asw_Swc_ChargeValue_ELockDiagVoltVld_flg: implemented-entry=Rte_Read_Asw_Swc_ChargeValue_ELockDiagVoltVld_flg
        Rte_Read_Asw_Swc_ChargeValue_ELockDiagVolt_V: implemented-entry=Rte_Read_Asw_Swc_ChargeValue_ELockDiagVolt_V
        Rte_Read_Asw_Swc_ChargeValue_LampCcHDiagVoltVld_flg: implemented-entry=Rte_Read_Asw_Swc_ChargeValue_LampCcHDiagVoltVld_flg
        Rte_Read_Asw_Swc_ChargeValue_LampCcHDiagVolt_V: implemented-entry=Rte_Read_Asw_Swc_ChargeValue_LampCcHDiagVolt_V
        Rte_Read_Asw_Swc_ChargeValue_LampChgHDiagVoltVld_flg: implemented-entry=Rte_Read_Asw_Swc_ChargeValue_LampChgHDiagVoltVld_flg
        Rte_Read_Asw_Swc_ChargeValue_LampChgHDiagVolt_V: implemented-entry=Rte_Read_Asw_Swc_ChargeValue_LampChgHDiagVolt_V
        Rte_Read_Asw_Swc_CmuValue_BalOpenLoadDiagStatus_flg: implemented-entry=Rte_Read_Asw_Swc_CmuValue_BalOpenLoadDiagStatus_flg
        Rte_Read_Asw_Swc_CmuValue_CMUPwrDiagVoltVld_flg: implemented-entry=Rte_Read_Asw_Swc_CmuValue_CMUPwrDiagVoltVld_flg
        Rte_Read_Asw_Swc_CmuValue_CMUPwrDiagVolt_V: implemented-entry=Rte_Read_Asw_Swc_CmuValue_CMUPwrDiagVolt_V
        Rte_Read_Asw_Swc_CmuValue_CellLeakageDiagStatus_flg: implemented-entry=Rte_Read_Asw_Swc_CmuValue_CellLeakageDiagStatus_flg
        Rte_Read_Asw_Swc_CmuValue_ChanelFuncDiagStatus_flg: implemented-entry=Rte_Read_Asw_Swc_CmuValue_ChanelFuncDiagStatus_flg
        Rte_Read_Asw_Swc_CmuValue_CmuReCfgStatus_flg: implemented-entry=Rte_Read_Asw_Swc_CmuValue_CmuReCfgStatus_flg
        Rte_Read_Asw_Swc_CmuValue_CtxOpenDiagStatus_flg: implemented-entry=Rte_Read_Asw_Swc_CmuValue_CtxOpenDiagStatus_flg
        Rte_Read_Asw_Swc_CmuValue_GpioOTUTFuncDiagStatus_flg: implemented-entry=Rte_Read_Asw_Swc_CmuValue_GpioOTUTFuncDiagStatus_flg
        Rte_Read_Asw_Swc_CmuValue_GpioxOpenDiagStatus_flg: implemented-entry=Rte_Read_Asw_Swc_CmuValue_GpioxOpenDiagStatus_flg
        Rte_Read_Asw_Swc_CmuValue_InCMUHWAlarmPWMDutyVld_flg: implemented-entry=Rte_Read_Asw_Swc_CmuValue_InCMUHWAlarmPWMDutyVld_flg
        Rte_Read_Asw_Swc_CmuValue_InCMUHWAlarmPWMDuty_pct: implemented-entry=Rte_Read_Asw_Swc_CmuValue_InCMUHWAlarmPWMDuty_pct
        Rte_Read_Asw_Swc_CmuValue_InCMUHWAlarmPWMFeqVld_flg: implemented-entry=Rte_Read_Asw_Swc_CmuValue_InCMUHWAlarmPWMFeqVld_flg
        Rte_Read_Asw_Swc_CmuValue_InCMUHWAlarmPWMFeq_Hz: implemented-entry=Rte_Read_Asw_Swc_CmuValue_InCMUHWAlarmPWMFeq_Hz
        Rte_Read_Asw_Swc_CrashValue_CrashPWMDutyVld_flg: implemented-entry=Rte_Read_Asw_Swc_CrashValue_CrashPWMDutyVld_flg
        Rte_Read_Asw_Swc_CrashValue_CrashPWMDuty_pct: implemented-entry=Rte_Read_Asw_Swc_CrashValue_CrashPWMDuty_pct
        Rte_Read_Asw_Swc_CrashValue_CrashPWMFrqVld_flg: implemented-entry=Rte_Read_Asw_Swc_CrashValue_CrashPWMFrqVld_flg
        Rte_Read_Asw_Swc_CrashValue_CrashPWMFrq_Hz: implemented-entry=Rte_Read_Asw_Swc_CrashValue_CrashPWMFrq_Hz
        Rte_Read_Asw_Swc_CurrValue_HallCH1RedVoltVld_flg: implemented-entry=Rte_Read_Asw_Swc_CurrValue_HallCH1RedVoltVld_flg
        Rte_Read_Asw_Swc_CurrValue_HallCH1RedVolt_V: implemented-entry=Rte_Read_Asw_Swc_CurrValue_HallCH1RedVolt_V
        Rte_Read_Asw_Swc_CurrValue_HallCH1VoltVld_flg: implemented-entry=Rte_Read_Asw_Swc_CurrValue_HallCH1VoltVld_flg
        Rte_Read_Asw_Swc_CurrValue_HallCH1Volt_V: implemented-entry=Rte_Read_Asw_Swc_CurrValue_HallCH1Volt_V
        Rte_Read_Asw_Swc_CurrValue_HallCH2RedVoltVld_flg: implemented-entry=Rte_Read_Asw_Swc_CurrValue_HallCH2RedVoltVld_flg
        Rte_Read_Asw_Swc_CurrValue_HallCH2RedVolt_V: implemented-entry=Rte_Read_Asw_Swc_CurrValue_HallCH2RedVolt_V
        Rte_Read_Asw_Swc_CurrValue_HallCH2VoltVld_flg: implemented-entry=Rte_Read_Asw_Swc_CurrValue_HallCH2VoltVld_flg
        Rte_Read_Asw_Swc_CurrValue_HallCH2Volt_V: implemented-entry=Rte_Read_Asw_Swc_CurrValue_HallCH2Volt_V
        Rte_Read_Asw_Swc_CurrValue_HallSpyVoltVld_flg: implemented-entry=Rte_Read_Asw_Swc_CurrValue_HallSpyVoltVld_flg
        Rte_Read_Asw_Swc_CurrValue_HallSpyVolt_V: implemented-entry=Rte_Read_Asw_Swc_CurrValue_HallSpyVolt_V
        Rte_Read_Asw_Swc_CurrValue_PackCurrRedVld_flg: implemented-entry=Rte_Read_Asw_Swc_CurrValue_PackCurrRedVld_flg
        Rte_Read_Asw_Swc_CurrValue_PackCurrRed_A: implemented-entry=Rte_Read_Asw_Swc_CurrValue_PackCurrRed_A
        Rte_Read_Asw_Swc_CurrValue_PackCurrVld_flg: implemented-entry=Rte_Read_Asw_Swc_CurrValue_PackCurrVld_flg
        Rte_Read_Asw_Swc_CurrValue_PackCurr_A: implemented-entry=Rte_Read_Asw_Swc_CurrValue_PackCurr_A
        Rte_Read_Asw_Swc_DCDC_303h_CDU_HVILWarning: implemented-entry=Rte_Read_Asw_Swc_DCDC_303h_CDU_HVILWarning
        Rte_Read_Asw_Swc_DCDC_303h_I_LDC_In: implemented-entry=Rte_Read_Asw_Swc_DCDC_303h_I_LDC_In
        Rte_Read_Asw_Swc_HighVoltValue_P1CheckVoltVld_flg: implemented-entry=Rte_Read_Asw_Swc_HighVoltValue_P1CheckVoltVld_flg
        Rte_Read_Asw_Swc_HighVoltValue_P1CheckVolt_V: implemented-entry=Rte_Read_Asw_Swc_HighVoltValue_P1CheckVolt_V
        Rte_Read_Asw_Swc_HighVoltValue_P2CheckVoltVld_flg: implemented-entry=Rte_Read_Asw_Swc_HighVoltValue_P2CheckVoltVld_flg
        Rte_Read_Asw_Swc_HighVoltValue_P2CheckVolt_V: implemented-entry=Rte_Read_Asw_Swc_HighVoltValue_P2CheckVolt_V
        Rte_Read_Asw_Swc_HighVoltValue_P3CheckVoltVld_flg: implemented-entry=Rte_Read_Asw_Swc_HighVoltValue_P3CheckVoltVld_flg
        Rte_Read_Asw_Swc_HighVoltValue_P3CheckVolt_V: implemented-entry=Rte_Read_Asw_Swc_HighVoltValue_P3CheckVolt_V
        Rte_Read_Asw_Swc_HighVoltValue_PackVoltVld_flg: implemented-entry=Rte_Read_Asw_Swc_HighVoltValue_PackVoltVld_flg
        Rte_Read_Asw_Swc_HighVoltValue_PackVolt_V: implemented-entry=Rte_Read_Asw_Swc_HighVoltValue_PackVolt_V
        Rte_Read_Asw_Swc_HighVoltValue_PreChgCheckRedVoltVld_flg: implemented-entry=Rte_Read_Asw_Swc_HighVoltValue_PreChgCheckRedVoltVld_flg
        Rte_Read_Asw_Swc_HighVoltValue_PreChgCheckRedVolt_V: implemented-entry=Rte_Read_Asw_Swc_HighVoltValue_PreChgCheckRedVolt_V
        Rte_Read_Asw_Swc_HighVoltValue_PreChgCheckVoltVld_flg: implemented-entry=Rte_Read_Asw_Swc_HighVoltValue_PreChgCheckVoltVld_flg
        Rte_Read_Asw_Swc_HighVoltValue_PreChgCheckVolt_V: implemented-entry=Rte_Read_Asw_Swc_HighVoltValue_PreChgCheckVolt_V
        Rte_Read_Asw_Swc_HvilValue_HVILHighVoltVld_flg: implemented-entry=Rte_Read_Asw_Swc_HvilValue_HVILHighVoltVld_flg
        Rte_Read_Asw_Swc_HvilValue_HVILHighVolt_V: implemented-entry=Rte_Read_Asw_Swc_HvilValue_HVILHighVolt_V
        Rte_Read_Asw_Swc_HvilValue_HVILLowVoltVld_flg: implemented-entry=Rte_Read_Asw_Swc_HvilValue_HVILLowVoltVld_flg
        Rte_Read_Asw_Swc_HvilValue_HVILLowVolt_V: implemented-entry=Rte_Read_Asw_Swc_HvilValue_HVILLowVolt_V
        Rte_Read_Asw_Swc_HvilValue_InHVILPWMDutyVld_flg: implemented-entry=Rte_Read_Asw_Swc_HvilValue_InHVILPWMDutyVld_flg
        Rte_Read_Asw_Swc_HvilValue_InHVILPWMDuty_pct: implemented-entry=Rte_Read_Asw_Swc_HvilValue_InHVILPWMDuty_pct
        Rte_Read_Asw_Swc_HvilValue_InHVILPWMFrqVld_flg: implemented-entry=Rte_Read_Asw_Swc_HvilValue_InHVILPWMFrqVld_flg
        Rte_Read_Asw_Swc_HvilValue_InHVILPWMFrq_Hz: implemented-entry=Rte_Read_Asw_Swc_HvilValue_InHVILPWMFrq_Hz
        Rte_Read_Asw_Swc_IsoValue_HVIsoNegVoltVld_flg: implemented-entry=Rte_Read_Asw_Swc_IsoValue_HVIsoNegVoltVld_flg
        Rte_Read_Asw_Swc_IsoValue_HVIsoNegVolt_V: implemented-entry=Rte_Read_Asw_Swc_IsoValue_HVIsoNegVolt_V
        Rte_Read_Asw_Swc_IsoValue_HVIsoPosVoltVld_flg: implemented-entry=Rte_Read_Asw_Swc_IsoValue_HVIsoPosVoltVld_flg
        Rte_Read_Asw_Swc_IsoValue_HVIsoPosVolt_V: implemented-entry=Rte_Read_Asw_Swc_IsoValue_HVIsoPosVolt_V
        Rte_Read_Asw_Swc_McuValue_BSWInitFinish_flg: implemented-entry=Rte_Read_Asw_Swc_McuValue_BSWInitFinish_flg
        Rte_Read_Asw_Swc_OBC_604h_OBCChgCurrent: implemented-entry=Rte_Read_Asw_Swc_OBC_604h_OBCChgCurrent
        Rte_Read_Asw_Swc_OBC_604h_OBCChgVolt: implemented-entry=Rte_Read_Asw_Swc_OBC_604h_OBCChgVolt
        Rte_Read_Asw_Swc_OBC_604h_OBCCurrentFltCode: implemented-entry=Rte_Read_Asw_Swc_OBC_604h_OBCCurrentFltCode
        Rte_Read_Asw_Swc_OBC_604h_OBCHistoryFltCode: implemented-entry=Rte_Read_Asw_Swc_OBC_604h_OBCHistoryFltCode
        Rte_Read_Asw_Swc_OBC_604h_OBCMaxChrgCurrent: implemented-entry=Rte_Read_Asw_Swc_OBC_604h_OBCMaxChrgCurrent
        Rte_Read_Asw_Swc_OBC_604h_OBCMaxChrgVoltage: implemented-entry=Rte_Read_Asw_Swc_OBC_604h_OBCMaxChrgVoltage
        Rte_Read_Asw_Swc_OBC_604h_OBCStatus: implemented-entry=Rte_Read_Asw_Swc_OBC_604h_OBCStatus
        Rte_Read_Asw_Swc_PEU_0B4h_V_DC: implemented-entry=Rte_Read_Asw_Swc_PEU_0B4h_V_DC
        Rte_Read_Asw_Swc_PEU_0B4h_V_DCValidity: implemented-entry=Rte_Read_Asw_Swc_PEU_0B4h_V_DCValidity
        Rte_Read_Asw_Swc_PEU_18Bh_InvADCCrnt: implemented-entry=Rte_Read_Asw_Swc_PEU_18Bh_InvADCCrnt
        Rte_Read_Asw_Swc_PEU_18Bh_InvADCCrntV: implemented-entry=Rte_Read_Asw_Swc_PEU_18Bh_InvADCCrntV
        Rte_Read_Asw_Swc_PowerValue_BmuPullupSwitchDiag_flg: implemented-entry=Rte_Read_Asw_Swc_PowerValue_BmuPullupSwitchDiag_flg
        Rte_Read_Asw_Swc_PowerValue_BmuPullupVoltVld_flg: implemented-entry=Rte_Read_Asw_Swc_PowerValue_BmuPullupVoltVld_flg
        Rte_Read_Asw_Swc_PowerValue_BmuPullupVolt_V: implemented-entry=Rte_Read_Asw_Swc_PowerValue_BmuPullupVolt_V
        Rte_Read_Asw_Swc_PowerValue_KL15VoltVld_flg: implemented-entry=Rte_Read_Asw_Swc_PowerValue_KL15VoltVld_flg
        Rte_Read_Asw_Swc_PowerValue_KL15Volt_V: implemented-entry=Rte_Read_Asw_Swc_PowerValue_KL15Volt_V
        Rte_Read_Asw_Swc_PowerValue_KL30VoltVld_flg: implemented-entry=Rte_Read_Asw_Swc_PowerValue_KL30VoltVld_flg
        Rte_Read_Asw_Swc_PowerValue_KL30Volt_V: implemented-entry=Rte_Read_Asw_Swc_PowerValue_KL30Volt_V
        Rte_Read_Asw_Swc_PowerValue_KPowertVoltVld_flg: implemented-entry=Rte_Read_Asw_Swc_PowerValue_KPowertVoltVld_flg
        Rte_Read_Asw_Swc_PowerValue_KPowertVolt_V: implemented-entry=Rte_Read_Asw_Swc_PowerValue_KPowertVolt_V
        Rte_Read_Asw_Swc_PowerValue_ResWakeUp1HVoltVld_flg: implemented-entry=Rte_Read_Asw_Swc_PowerValue_ResWakeUp1HVoltVld_flg
        Rte_Read_Asw_Swc_PowerValue_ResWakeUp1HVolt_V: implemented-entry=Rte_Read_Asw_Swc_PowerValue_ResWakeUp1HVolt_V
        Rte_Read_Asw_Swc_PowerValue_ResWakeUp2HVoltVld_flg: implemented-entry=Rte_Read_Asw_Swc_PowerValue_ResWakeUp2HVoltVld_flg
        Rte_Read_Asw_Swc_PowerValue_ResWakeUp2HVolt_V: implemented-entry=Rte_Read_Asw_Swc_PowerValue_ResWakeUp2HVolt_V
        Rte_Read_Asw_Swc_PowerValue_ResWakeUp3LVoltVld_flg: implemented-entry=Rte_Read_Asw_Swc_PowerValue_ResWakeUp3LVoltVld_flg
        Rte_Read_Asw_Swc_PowerValue_ResWakeUp3LVolt_V: implemented-entry=Rte_Read_Asw_Swc_PowerValue_ResWakeUp3LVolt_V
        Rte_Read_Asw_Swc_RelayValue_GlobalHsideDiagVoltVld_flg: implemented-entry=Rte_Read_Asw_Swc_RelayValue_GlobalHsideDiagVoltVld_flg
        Rte_Read_Asw_Swc_RelayValue_GlobalHsideDiagVolt_V: implemented-entry=Rte_Read_Asw_Swc_RelayValue_GlobalHsideDiagVolt_V
        Rte_Read_Asw_Swc_RelayValue_GlobalHsideDriverVoltVld_flg: implemented-entry=Rte_Read_Asw_Swc_RelayValue_GlobalHsideDriverVoltVld_flg
        Rte_Read_Asw_Swc_RelayValue_GlobalHsideDriverVolt_V: implemented-entry=Rte_Read_Asw_Swc_RelayValue_GlobalHsideDriverVolt_V
        Rte_Read_Asw_Swc_RelayValue_K1CtrDriverVoltVld_flg: implemented-entry=Rte_Read_Asw_Swc_RelayValue_K1CtrDriverVoltVld_flg
        Rte_Read_Asw_Swc_RelayValue_K1CtrDriverVolt_V: implemented-entry=Rte_Read_Asw_Swc_RelayValue_K1CtrDriverVolt_V
        Rte_Read_Asw_Swc_RelayValue_K2CtrDriverVoltVld_flg: implemented-entry=Rte_Read_Asw_Swc_RelayValue_K2CtrDriverVoltVld_flg
        Rte_Read_Asw_Swc_RelayValue_K2CtrDriverVolt_V: implemented-entry=Rte_Read_Asw_Swc_RelayValue_K2CtrDriverVolt_V
        Rte_Read_Asw_Swc_RelayValue_K3CtrDriverVoltVld_flg: implemented-entry=Rte_Read_Asw_Swc_RelayValue_K3CtrDriverVoltVld_flg
        Rte_Read_Asw_Swc_RelayValue_K3CtrDriverVolt_V: implemented-entry=Rte_Read_Asw_Swc_RelayValue_K3CtrDriverVolt_V
        Rte_Read_Asw_Swc_RelayValue_K4CtrDriverVoltVld_flg: implemented-entry=Rte_Read_Asw_Swc_RelayValue_K4CtrDriverVoltVld_flg
        Rte_Read_Asw_Swc_RelayValue_K4CtrDriverVolt_V: implemented-entry=Rte_Read_Asw_Swc_RelayValue_K4CtrDriverVolt_V
        Rte_Read_Asw_Swc_RelayValue_K5CtrDriverVoltVld_flg: implemented-entry=Rte_Read_Asw_Swc_RelayValue_K5CtrDriverVoltVld_flg
        Rte_Read_Asw_Swc_RelayValue_K5CtrDriverVolt_V: implemented-entry=Rte_Read_Asw_Swc_RelayValue_K5CtrDriverVolt_V
        Rte_Read_Asw_Swc_RelayValue_K6CtrDriverVoltVld_flg: implemented-entry=Rte_Read_Asw_Swc_RelayValue_K6CtrDriverVoltVld_flg
        Rte_Read_Asw_Swc_RelayValue_K6CtrDriverVolt_V: implemented-entry=Rte_Read_Asw_Swc_RelayValue_K6CtrDriverVolt_V
        Rte_Read_Asw_Swc_RelayValue_KnCtrDriverVoltVld_flg: implemented-entry=Rte_Read_Asw_Swc_RelayValue_KnCtrDriverVoltVld_flg
        Rte_Read_Asw_Swc_RelayValue_KnCtrDriverVolt_V: implemented-entry=Rte_Read_Asw_Swc_RelayValue_KnCtrDriverVolt_V
        Rte_Read_Asw_Swc_RelayValue_KnchgEnOutState_flg: implemented-entry=Rte_Read_Asw_Swc_RelayValue_KnchgEnOutState_flg
        Rte_Read_Asw_Swc_RelayValue_KnchgEnStateVld_flg: implemented-entry=Rte_Read_Asw_Swc_RelayValue_KnchgEnStateVld_flg
        Rte_Read_Asw_Swc_RelayValue_KpCtrDriverVoltVld_flg: implemented-entry=Rte_Read_Asw_Swc_RelayValue_KpCtrDriverVoltVld_flg
        Rte_Read_Asw_Swc_RelayValue_KpCtrDriverVolt_V: implemented-entry=Rte_Read_Asw_Swc_RelayValue_KpCtrDriverVolt_V
        Rte_Read_Asw_Swc_RelayValue_KpEnOutState_flg: implemented-entry=Rte_Read_Asw_Swc_RelayValue_KpEnOutState_flg
        Rte_Read_Asw_Swc_RelayValue_KpEnStateVld_flg: implemented-entry=Rte_Read_Asw_Swc_RelayValue_KpEnStateVld_flg
        Rte_Read_Asw_Swc_RsvValue_InRsvPWMDutyVld_flg: implemented-entry=Rte_Read_Asw_Swc_RsvValue_InRsvPWMDutyVld_flg
        Rte_Read_Asw_Swc_RsvValue_InRsvPWMDuty_pct: implemented-entry=Rte_Read_Asw_Swc_RsvValue_InRsvPWMDuty_pct
        Rte_Read_Asw_Swc_RsvValue_InRsvPWMFrqVld_flg: implemented-entry=Rte_Read_Asw_Swc_RsvValue_InRsvPWMFrqVld_flg
        Rte_Read_Asw_Swc_RsvValue_InRsvPWMFrq_Hz: implemented-entry=Rte_Read_Asw_Swc_RsvValue_InRsvPWMFrq_Hz
        Rte_Read_Asw_Swc_RsvValue_RsvAD1VoltVld_flg: implemented-entry=Rte_Read_Asw_Swc_RsvValue_RsvAD1VoltVld_flg
        Rte_Read_Asw_Swc_RsvValue_RsvAD1Volt_V: implemented-entry=Rte_Read_Asw_Swc_RsvValue_RsvAD1Volt_V
        Rte_Read_Asw_Swc_RsvValue_RsvAD2VoltVld_flg: implemented-entry=Rte_Read_Asw_Swc_RsvValue_RsvAD2VoltVld_flg
        Rte_Read_Asw_Swc_RsvValue_RsvAD2Volt_V: implemented-entry=Rte_Read_Asw_Swc_RsvValue_RsvAD2Volt_V
        Rte_Read_Asw_Swc_RsvValue_RsvAD3VoltVld_flg: implemented-entry=Rte_Read_Asw_Swc_RsvValue_RsvAD3VoltVld_flg
        Rte_Read_Asw_Swc_RsvValue_RsvAD3Volt_V: implemented-entry=Rte_Read_Asw_Swc_RsvValue_RsvAD3Volt_V
        Rte_Read_Asw_Swc_RsvValue_RsvAD4VoltVld_flg: implemented-entry=Rte_Read_Asw_Swc_RsvValue_RsvAD4VoltVld_flg
        Rte_Read_Asw_Swc_RsvValue_RsvAD4Volt_V: implemented-entry=Rte_Read_Asw_Swc_RsvValue_RsvAD4Volt_V
        Rte_Read_Asw_Swc_RsvValue_RsvAD5VoltVld_flg: implemented-entry=Rte_Read_Asw_Swc_RsvValue_RsvAD5VoltVld_flg
        Rte_Read_Asw_Swc_RsvValue_RsvAD5Volt_V: implemented-entry=Rte_Read_Asw_Swc_RsvValue_RsvAD5Volt_V
        Rte_Read_Asw_Swc_SbcValue_BMULastPwrDownState: implemented-entry=Rte_Read_Asw_Swc_SbcValue_BMULastPwrDownState
        Rte_Read_Asw_Swc_SbcValue_BmuSbcCanTRSt_flg: implemented-entry=Rte_Read_Asw_Swc_SbcValue_BmuSbcCanTRSt_flg
        Rte_Read_Asw_Swc_SbcValue_BmuSbcRstbPinSt_flg: implemented-entry=Rte_Read_Asw_Swc_SbcValue_BmuSbcRstbPinSt_flg
        Rte_Read_Asw_Swc_SbcValue_BmuSbcVauxOV_flg: implemented-entry=Rte_Read_Asw_Swc_SbcValue_BmuSbcVauxOV_flg
        Rte_Read_Asw_Swc_SbcValue_BmuSbcVauxUV_flg: implemented-entry=Rte_Read_Asw_Swc_SbcValue_BmuSbcVauxUV_flg
        Rte_Read_Asw_Swc_SbcValue_BmuSbcVcanOV_flg: implemented-entry=Rte_Read_Asw_Swc_SbcValue_BmuSbcVcanOV_flg
        Rte_Read_Asw_Swc_SbcValue_BmuSbcVcanUV_flg: implemented-entry=Rte_Read_Asw_Swc_SbcValue_BmuSbcVcanUV_flg
        Rte_Read_Asw_Swc_SbcValue_BmuSbcVccaOV_flg: implemented-entry=Rte_Read_Asw_Swc_SbcValue_BmuSbcVccaOV_flg
        Rte_Read_Asw_Swc_SbcValue_BmuSbcVccaUV_flg: implemented-entry=Rte_Read_Asw_Swc_SbcValue_BmuSbcVccaUV_flg
        Rte_Read_Asw_Swc_SbcValue_BmuSbcVcoreOV_flg: implemented-entry=Rte_Read_Asw_Swc_SbcValue_BmuSbcVcoreOV_flg
        Rte_Read_Asw_Swc_SbcValue_BmuSbcVpreOV_flg: implemented-entry=Rte_Read_Asw_Swc_SbcValue_BmuSbcVpreOV_flg
        Rte_Read_Asw_Swc_SbcValue_BmuSbcVpreUV_flg: implemented-entry=Rte_Read_Asw_Swc_SbcValue_BmuSbcVpreUV_flg
        Rte_Read_Asw_Swc_SbcValue_BmuSbxVcoreUV_flg: implemented-entry=Rte_Read_Asw_Swc_SbcValue_BmuSbxVcoreUV_flg
        Rte_Read_Asw_Swc_SbcValue_CANWakeupState_flg: implemented-entry=Rte_Read_Asw_Swc_SbcValue_CANWakeupState_flg
        Rte_Read_Asw_Swc_SbcValue_KL15WakeupState_flg: implemented-entry=Rte_Read_Asw_Swc_SbcValue_KL15WakeupState_flg
        Rte_Read_Asw_Swc_SbcValue_RTCWakeupState_flg: implemented-entry=Rte_Read_Asw_Swc_SbcValue_RTCWakeupState_flg
        Rte_Read_Asw_Swc_SbcValue_SBCWakeupP{1..3}State_flg: implemented-entry=Rte_Read_Asw_Swc_SbcValue_SBCWakeupP{1..3}State_flg
        Rte_Read_Asw_Swc_ThermalValue_BmuTemp1NtcVld_flg: implemented-entry=Rte_Read_Asw_Swc_ThermalValue_BmuTemp1NtcVld_flg
        Rte_Read_Asw_Swc_ThermalValue_BmuTemp1Ntc_Ohm: implemented-entry=Rte_Read_Asw_Swc_ThermalValue_BmuTemp1Ntc_Ohm
        Rte_Read_Asw_Swc_ThermalValue_BmuTemp2NtcVld_flg: implemented-entry=Rte_Read_Asw_Swc_ThermalValue_BmuTemp2NtcVld_flg
        Rte_Read_Asw_Swc_ThermalValue_BmuTemp2Ntc_Ohm: implemented-entry=Rte_Read_Asw_Swc_ThermalValue_BmuTemp2Ntc_Ohm
        Rte_Read_Asw_Swc_ThermalValue_BmuTemp3NtcVld_flg: implemented-entry=Rte_Read_Asw_Swc_ThermalValue_BmuTemp3NtcVld_flg
        Rte_Read_Asw_Swc_ThermalValue_BmuTemp3Ntc_Ohm: implemented-entry=Rte_Read_Asw_Swc_ThermalValue_BmuTemp3Ntc_Ohm
        Rte_Read_Asw_Swc_ThermalValue_BmuTemp4NtcVld_flg: implemented-entry=Rte_Read_Asw_Swc_ThermalValue_BmuTemp4NtcVld_flg
        Rte_Read_Asw_Swc_ThermalValue_BmuTemp4Ntc_Ohm: implemented-entry=Rte_Read_Asw_Swc_ThermalValue_BmuTemp4Ntc_Ohm
        Rte_Read_Asw_Swc_ThermalValue_BmuTemp5NtcVld_flg: implemented-entry=Rte_Read_Asw_Swc_ThermalValue_BmuTemp5NtcVld_flg
        Rte_Read_Asw_Swc_ThermalValue_BmuTemp5Ntc_Ohm: implemented-entry=Rte_Read_Asw_Swc_ThermalValue_BmuTemp5Ntc_Ohm
        Rte_Read_Asw_Swc_ThermalValue_BmuTemp6NtcVld_flg: implemented-entry=Rte_Read_Asw_Swc_ThermalValue_BmuTemp6NtcVld_flg
        Rte_Read_Asw_Swc_ThermalValue_BmuTemp6Ntc_Ohm: implemented-entry=Rte_Read_Asw_Swc_ThermalValue_BmuTemp6Ntc_Ohm
        Rte_Read_Asw_Swc_ThermalValue_BmuTemp7NtcVld_flg: implemented-entry=Rte_Read_Asw_Swc_ThermalValue_BmuTemp7NtcVld_flg
        Rte_Read_Asw_Swc_ThermalValue_BmuTemp7Ntc_Ohm: implemented-entry=Rte_Read_Asw_Swc_ThermalValue_BmuTemp7Ntc_Ohm
        Rte_Read_Asw_Swc_ThermalValue_InCoolPumpPWMDutyVld_flg: implemented-entry=Rte_Read_Asw_Swc_ThermalValue_InCoolPumpPWMDutyVld_flg
        Rte_Read_Asw_Swc_ThermalValue_InCoolPumpPWMDuty_Pct: implemented-entry=Rte_Read_Asw_Swc_ThermalValue_InCoolPumpPWMDuty_Pct
        Rte_Read_Asw_Swc_ThermalValue_InCoolPumpPWMFrqVld_flg: implemented-entry=Rte_Read_Asw_Swc_ThermalValue_InCoolPumpPWMFrqVld_flg
        Rte_Read_Asw_Swc_ThermalValue_InCoolPumpPWMFrq_Hz: implemented-entry=Rte_Read_Asw_Swc_ThermalValue_InCoolPumpPWMFrq_Hz
        Rte_Read_Asw_Swc_ThermalValue_InFanPWMDutyVld_flg: implemented-entry=Rte_Read_Asw_Swc_ThermalValue_InFanPWMDutyVld_flg
        Rte_Read_Asw_Swc_ThermalValue_InFanPWMDuty_Pct: implemented-entry=Rte_Read_Asw_Swc_ThermalValue_InFanPWMDuty_Pct
        Rte_Read_Asw_Swc_ThermalValue_InFanPWMFrqVld_flg: implemented-entry=Rte_Read_Asw_Swc_ThermalValue_InFanPWMFrqVld_flg
        Rte_Read_Asw_Swc_ThermalValue_InFanPWMFrq_Hz: implemented-entry=Rte_Read_Asw_Swc_ThermalValue_InFanPWMFrq_Hz
        Rte_Read_Asw_Swc_ThermalValue_ValveDiagVoltVld_flg: implemented-entry=Rte_Read_Asw_Swc_ThermalValue_ValveDiagVoltVld_flg
        Rte_Read_Asw_Swc_ThermalValue_ValveDiagVolt_V: implemented-entry=Rte_Read_Asw_Swc_ThermalValue_ValveDiagVolt_V
        Rte_Read_Asw_Swc_VCU_1E3h_CheckSum_1E3h: implemented-entry=Rte_Read_Asw_Swc_VCU_1E3h_CheckSum_1E3h
        Rte_Read_Asw_Swc_VCU_1E3h_ChrgrStatPTHVCntctOpnrAlwd: implemented-entry=Rte_Read_Asw_Swc_VCU_1E3h_ChrgrStatPTHVCntctOpnrAlwd
        Rte_Read_Asw_Swc_VCU_1E3h_ChrgrStatPTHVCntctrClsAlwd: implemented-entry=Rte_Read_Asw_Swc_VCU_1E3h_ChrgrStatPTHVCntctrClsAlwd
        Rte_Read_Asw_Swc_VCU_1E3h_PTHVCntctrReq: implemented-entry=Rte_Read_Asw_Swc_VCU_1E3h_PTHVCntctrReq
        Rte_Read_Asw_Swc_VCU_1E3h_RollingCounter_1E3h: implemented-entry=Rte_Read_Asw_Swc_VCU_1E3h_RollingCounter_1E3h
        Rte_Read_Asw_Swc_VCU_353h_VehSpdAvgDrvn: implemented-entry=Rte_Read_Asw_Swc_VCU_353h_VehSpdAvgDrvn
        Rte_Read_Asw_Swc_VCU_353h_VehSpdAvgDrvnV: implemented-entry=Rte_Read_Asw_Swc_VCU_353h_VehSpdAvgDrvnV
        Rte_Read_Asw_Swc_VCU_ABS_23Ch_CheckSum_23Ch: implemented-entry=Rte_Read_Asw_Swc_VCU_ABS_23Ch_CheckSum_23Ch
        Rte_Read_Asw_Swc_VCU_ABS_23Ch_MessageCounter_23Ch: implemented-entry=Rte_Read_Asw_Swc_VCU_ABS_23Ch_MessageCounter_23Ch
        Rte_Read_Asw_Swc_VCU_ABS_23Ch_VehicleSpeed: implemented-entry=Rte_Read_Asw_Swc_VCU_ABS_23Ch_VehicleSpeed
        Rte_Read_Asw_Swc_VCU_ABS_23Ch_VehicleSpeedStatus: implemented-entry=Rte_Read_Asw_Swc_VCU_ABS_23Ch_VehicleSpeedStatus
        Rte_Read_Asw_Swc_VCU_BCM_1F1h_SysOpnlMd: implemented-entry=Rte_Read_Asw_Swc_VCU_BCM_1F1h_SysOpnlMd
        Rte_Read_Asw_Swc_VCU_BCM_1F1h_SysPwrMd: implemented-entry=Rte_Read_Asw_Swc_VCU_BCM_1F1h_SysPwrMd
        Rte_Read_Asw_Swc_VCU_BCM_1F1h_SysVol: implemented-entry=Rte_Read_Asw_Swc_VCU_BCM_1F1h_SysVol
        Rte_Read_Asw_Swc_VCU_BCM_1F1h_SysVolMd: implemented-entry=Rte_Read_Asw_Swc_VCU_BCM_1F1h_SysVolMd
        Rte_Read_Asw_Swc_VCU_BCM_1F1h_SysVolMdV: implemented-entry=Rte_Read_Asw_Swc_VCU_BCM_1F1h_SysVolMdV
        Rte_Read_Asw_Swc_VCU_BCM_1F1h_SysVolV: implemented-entry=Rte_Read_Asw_Swc_VCU_BCM_1F1h_SysVolV
        Rte_Read_Asw_Swc_VCU_HCM_55Fh_FrontCmprElctrCrnt: implemented-entry=Rte_Read_Asw_Swc_VCU_HCM_55Fh_FrontCmprElctrCrnt
        Rte_Read_Asw_Swc_VCU_HCM_55Fh_FrontCompStatFdbck: implemented-entry=Rte_Read_Asw_Swc_VCU_HCM_55Fh_FrontCompStatFdbck
        Rte_Read_Asw_Swc_VCU_HCM_55Fh_FrontPTCElctrCrnt: implemented-entry=Rte_Read_Asw_Swc_VCU_HCM_55Fh_FrontPTCElctrCrnt
        Rte_Read_Asw_Swc_VCU_HCM_55Fh_FrontPTCStatFdbck: implemented-entry=Rte_Read_Asw_Swc_VCU_HCM_55Fh_FrontPTCStatFdbck
        Rte_Read_Asw_Swc_VCU_IPK_1F2h_SysBPM: implemented-entry=Rte_Read_Asw_Swc_VCU_IPK_1F2h_SysBPM
        Rte_Read_Asw_Swc_VCU_IPK_1F2h_SysBPMEnbd: implemented-entry=Rte_Read_Asw_Swc_VCU_IPK_1F2h_SysBPMEnbd
        Rte_Read_Asw_Swc_VCU_IPK_362h_HighPreVehOdo: implemented-entry=Rte_Read_Asw_Swc_VCU_IPK_362h_HighPreVehOdo
        Rte_Read_Asw_Swc_VCU_IPK_362h_HighPreVehOdoV: implemented-entry=Rte_Read_Asw_Swc_VCU_IPK_362h_HighPreVehOdoV
        Rte_Read_Asw_Swc_VCU_SRS_163h_RollingCounter: implemented-entry=Rte_Read_Asw_Swc_VCU_SRS_163h_RollingCounter
        Rte_Read_Asw_Swc_VCU_SRS_163h_SRSCheckSum: implemented-entry=Rte_Read_Asw_Swc_VCU_SRS_163h_SRSCheckSum
        Rte_Read_Asw_Swc_VCU_SRS_163h_VehCrshTyp: implemented-entry=Rte_Read_Asw_Swc_VCU_SRS_163h_VehCrshTyp
        Rte_Read_BswM_RP_BswMArbitration_BswM_MRP_SwcModeRequest_VDP_uint16: implemented-entry=Rte_Read_BswM_RP_BswMArbitration_BswM_MRP_SwcModeRequest_VDP_uint16
        Rte_Read_Cmu_Cdd_CmuCmd_BalOpenLoadDiagCmd_flg: implemented-entry=Rte_Read_Cmu_Cdd_CmuCmd_BalOpenLoadDiagCmd_flg
        Rte_Read_Cmu_Cdd_CmuCmd_CMUPwrCmd_flg: implemented-entry=Rte_Read_Cmu_Cdd_CmuCmd_CMUPwrCmd_flg
        Rte_Read_Cmu_Cdd_CmuCmd_CellLeakageDiagCmd_flg: implemented-entry=Rte_Read_Cmu_Cdd_CmuCmd_CellLeakageDiagCmd_flg
        Rte_Read_Cmu_Cdd_CmuCmd_CellMeasCmd_flg: implemented-entry=Rte_Read_Cmu_Cdd_CmuCmd_CellMeasCmd_flg
        Rte_Read_Cmu_Cdd_CmuCmd_ChanelFuncDiagCmd_flg: implemented-entry=Rte_Read_Cmu_Cdd_CmuCmd_ChanelFuncDiagCmd_flg
        Rte_Read_Cmu_Cdd_CmuCmd_CmuClrFaultPin_flg: implemented-entry=Rte_Read_Cmu_Cdd_CmuCmd_CmuClrFaultPin_flg
        Rte_Read_Cmu_Cdd_CmuCmd_CmuReCfg_flg: implemented-entry=Rte_Read_Cmu_Cdd_CmuCmd_CmuReCfg_flg
        Rte_Read_Cmu_Cdd_CmuCmd_CtxOpenDiagCmd_flg: implemented-entry=Rte_Read_Cmu_Cdd_CmuCmd_CtxOpenDiagCmd_flg
        Rte_Read_Cmu_Cdd_CmuCmd_GpioOTUTFuncDiagCmd_flg: implemented-entry=Rte_Read_Cmu_Cdd_CmuCmd_GpioOTUTFuncDiagCmd_flg
        Rte_Read_Cmu_Cdd_CmuCmd_GpioxOpenDiagCmd_flg: implemented-entry=Rte_Read_Cmu_Cdd_CmuCmd_GpioxOpenDiagCmd_flg
        Rte_Read_Cmu_Cdd_CmuCmd_OutCMUHWAlarmPWMDuty_Pct: implemented-entry=Rte_Read_Cmu_Cdd_CmuCmd_OutCMUHWAlarmPWMDuty_Pct
        Rte_Read_IoHwAb_ChargeCmd_ACS2Cmd_flg: implemented-entry=Rte_Read_IoHwAb_ChargeCmd_ACS2Cmd_flg
        Rte_Read_IoHwAb_ChargeCmd_ELockCtrlCmd_enum: implemented-entry=Rte_Read_IoHwAb_ChargeCmd_ELockCtrlCmd_enum
        Rte_Read_IoHwAb_ChargeCmd_ELockSel0Cmd_flg: implemented-entry=Rte_Read_IoHwAb_ChargeCmd_ELockSel0Cmd_flg
        Rte_Read_IoHwAb_ChargeCmd_LampCcHCmd_flg: implemented-entry=Rte_Read_IoHwAb_ChargeCmd_LampCcHCmd_flg
        Rte_Read_IoHwAb_ChargeCmd_LampChgHCmd_flg: implemented-entry=Rte_Read_IoHwAb_ChargeCmd_LampChgHCmd_flg
        Rte_Read_IoHwAb_FblCmd_FBLForbid_flg: implemented-entry=Rte_Read_IoHwAb_FblCmd_FBLForbid_flg
        Rte_Read_IoHwAb_HighVoltCmd_PackVoltMeasCmd_flg: implemented-entry=Rte_Read_IoHwAb_HighVoltCmd_PackVoltMeasCmd_flg
        Rte_Read_IoHwAb_HvilCmd_OutHVILPWMDuty_Pct: implemented-entry=Rte_Read_IoHwAb_HvilCmd_OutHVILPWMDuty_Pct
        Rte_Read_IoHwAb_IsoCmd_HVIsoNegMosCmd_flg: implemented-entry=Rte_Read_IoHwAb_IsoCmd_HVIsoNegMosCmd_flg
        Rte_Read_IoHwAb_IsoCmd_HVIsoPosMosCmd_flg: implemented-entry=Rte_Read_IoHwAb_IsoCmd_HVIsoPosMosCmd_flg
        Rte_Read_IoHwAb_McuCmd_RadyToSleep_flg: implemented-entry=Rte_Read_IoHwAb_McuCmd_RadyToSleep_flg
        Rte_Read_IoHwAb_RelayCmd_GlobalHCtrCmd_flg: implemented-entry=Rte_Read_IoHwAb_RelayCmd_GlobalHCtrCmd_flg
        Rte_Read_IoHwAb_RelayCmd_K{1..6}CtrCmd_flg: implemented-entry=Rte_Read_IoHwAb_RelayCmd_K{1..6}CtrCmd_flg
        Rte_Read_IoHwAb_RelayCmd_KnCtrlCmd_flg: implemented-entry=Rte_Read_IoHwAb_RelayCmd_KnCtrlCmd_flg
        Rte_Read_IoHwAb_RelayCmd_KpCtrlCmd_flg: implemented-entry=Rte_Read_IoHwAb_RelayCmd_KpCtrlCmd_flg
        Rte_Read_IoHwAb_ThermalCmd_OutCoolPumpPWMDuty_Pct: implemented-entry=Rte_Read_IoHwAb_ThermalCmd_OutCoolPumpPWMDuty_Pct
        Rte_Read_IoHwAb_ThermalCmd_OutFanPWMDuty_Pct: implemented-entry=Rte_Read_IoHwAb_ThermalCmd_OutFanPWMDuty_Pct
        Rte_Read_IoHwAb_ThermalCmd_ValveEn_flg: implemented-entry=Rte_Read_IoHwAb_ThermalCmd_ValveEn_flg
        Rte_Read_Sbc_Cdd_SbcCmd_CANWakeupEnable_flg: implemented-entry=Rte_Read_Sbc_Cdd_SbcCmd_CANWakeupEnable_flg
        Rte_SetEvent: implemented-entry=Rte_SetEvent
        Rte_Start: implemented-entry=Rte_Start
        Rte_Stop: implemented-entry=Rte_Stop
        Rte_SwitchAck_WdgM_globalMode_currentMode: implemented-entry=Rte_SwitchAck_WdgM_globalMode_currentMode
        Rte_SwitchAck_WdgM_mode_WdgMAliveSupervisedEntity_Asw_5ms_currentMode: implemented-entry=Rte_SwitchAck_WdgM_mode_WdgMAliveSupervisedEntity_Asw_5ms_currentMode
        Rte_SwitchAck_WdgM_mode_WdgMAliveSupervisedEntity_Bsw_1000ms_currentMode: implemented-entry=Rte_SwitchAck_WdgM_mode_WdgMAliveSupervisedEntity_Bsw_1000ms_currentMode
        Rte_SwitchAck_WdgM_mode_WdgMAliveSupervisedEntity_Bsw_100ms_currentMode: implemented-entry=Rte_SwitchAck_WdgM_mode_WdgMAliveSupervisedEntity_Bsw_100ms_currentMode
        Rte_SwitchAck_WdgM_mode_WdgMAliveSupervisedEntity_Bsw_10ms_currentMode: implemented-entry=Rte_SwitchAck_WdgM_mode_WdgMAliveSupervisedEntity_Bsw_10ms_currentMode
        Rte_SwitchAck_WdgM_mode_WdgMAliveSupervisedEntity_Bsw_20ms_currentMode: implemented-entry=Rte_SwitchAck_WdgM_mode_WdgMAliveSupervisedEntity_Bsw_20ms_currentMode
        Rte_SwitchAck_WdgM_mode_WdgMAliveSupervisedEntity_Bsw_50ms_currentMode: implemented-entry=Rte_SwitchAck_WdgM_mode_WdgMAliveSupervisedEntity_Bsw_50ms_currentMode
        Rte_SwitchAck_WdgM_mode_WdgMAliveSupervisedEntity_Bsw_5ms_currentMode: implemented-entry=Rte_SwitchAck_WdgM_mode_WdgMAliveSupervisedEntity_Bsw_5ms_currentMode
        Rte_Switch_ComM_UM_ComMUser_Can_Network_0_Channel_currentMode: implemented-entry=Rte_Switch_ComM_UM_ComMUser_Can_Network_0_Channel_currentMode
        Rte_Switch_WdgM_globalMode_currentMode: implemented-entry=Rte_Switch_WdgM_globalMode_currentMode
        Rte_Switch_WdgM_mode_WdgMAliveSupervisedEntity_Asw_5ms_currentMode: implemented-entry=Rte_Switch_WdgM_mode_WdgMAliveSupervisedEntity_Asw_5ms_currentMode
        Rte_Switch_WdgM_mode_WdgMAliveSupervisedEntity_Bsw_1000ms_currentMode: implemented-entry=Rte_Switch_WdgM_mode_WdgMAliveSupervisedEntity_Bsw_1000ms_currentMode
        Rte_Switch_WdgM_mode_WdgMAliveSupervisedEntity_Bsw_100ms_currentMode: implemented-entry=Rte_Switch_WdgM_mode_WdgMAliveSupervisedEntity_Bsw_100ms_currentMode
        Rte_Switch_WdgM_mode_WdgMAliveSupervisedEntity_Bsw_10ms_currentMode: implemented-entry=Rte_Switch_WdgM_mode_WdgMAliveSupervisedEntity_Bsw_10ms_currentMode
        Rte_Switch_WdgM_mode_WdgMAliveSupervisedEntity_Bsw_20ms_currentMode: implemented-entry=Rte_Switch_WdgM_mode_WdgMAliveSupervisedEntity_Bsw_20ms_currentMode
        Rte_Switch_WdgM_mode_WdgMAliveSupervisedEntity_Bsw_50ms_currentMode: implemented-entry=Rte_Switch_WdgM_mode_WdgMAliveSupervisedEntity_Bsw_50ms_currentMode
        Rte_Switch_WdgM_mode_WdgMAliveSupervisedEntity_Bsw_5ms_currentMode: implemented-entry=Rte_Switch_WdgM_mode_WdgMAliveSupervisedEntity_Bsw_5ms_currentMode
        Rte_WaitWithTimeout: implemented-entry=Rte_WaitWithTimeout
        Rte_WriteQueue: implemented-entry=Rte_WriteQueue
        Rte_Write_Asw_Swc_BCL_BCU_BCL_SPN3072_U_Req: implemented-entry=Rte_Write_Asw_Swc_BCL_BCU_BCL_SPN3072_U_Req
        Rte_Write_Asw_Swc_BCL_BCU_BCL_SPN3073_I_Req: implemented-entry=Rte_Write_Asw_Swc_BCL_BCU_BCL_SPN3073_I_Req
        Rte_Write_Asw_Swc_BCL_BCU_BCL_SPN3074_ChgMode: implemented-entry=Rte_Write_Asw_Swc_BCL_BCU_BCL_SPN3074_ChgMode
        Rte_Write_Asw_Swc_BCP_BCU_BCP_SPN2816_Ucell_Max_Permit: implemented-entry=Rte_Write_Asw_Swc_BCP_BCU_BCP_SPN2816_Ucell_Max_Permit
        Rte_Write_Asw_Swc_BCP_BCU_BCP_SPN2817_I_Max_Permit: implemented-entry=Rte_Write_Asw_Swc_BCP_BCU_BCP_SPN2817_I_Max_Permit
        Rte_Write_Asw_Swc_BCP_BCU_BCP_SPN2818_kWh_Nom: implemented-entry=Rte_Write_Asw_Swc_BCP_BCU_BCP_SPN2818_kWh_Nom
        Rte_Write_Asw_Swc_BCP_BCU_BCP_SPN2819_U_Max_Permit: implemented-entry=Rte_Write_Asw_Swc_BCP_BCU_BCP_SPN2819_U_Max_Permit
        Rte_Write_Asw_Swc_BCP_BCU_BCP_SPN2820_T_Max_Permit: implemented-entry=Rte_Write_Asw_Swc_BCP_BCU_BCP_SPN2820_T_Max_Permit
        Rte_Write_Asw_Swc_BCP_BCU_BCP_SPN2821_SOC: implemented-entry=Rte_Write_Asw_Swc_BCP_BCU_BCP_SPN2821_SOC
        Rte_Write_Asw_Swc_BCP_BCU_BCP_SPN2822_U: implemented-entry=Rte_Write_Asw_Swc_BCP_BCU_BCP_SPN2822_U
        Rte_Write_Asw_Swc_BCS_BCU_BCS_SPN3075_U_Mea: implemented-entry=Rte_Write_Asw_Swc_BCS_BCU_BCS_SPN3075_U_Mea
        Rte_Write_Asw_Swc_BCS_BCU_BCS_SPN3076_I_Mea: implemented-entry=Rte_Write_Asw_Swc_BCS_BCU_BCS_SPN3076_I_Mea
        Rte_Write_Asw_Swc_BCS_BCU_BCS_SPN3077_Ucell_Max: implemented-entry=Rte_Write_Asw_Swc_BCS_BCU_BCS_SPN3077_Ucell_Max
        Rte_Write_Asw_Swc_BCS_BCU_BCS_SPN3077_Ucell_Max_Grp: implemented-entry=Rte_Write_Asw_Swc_BCS_BCU_BCS_SPN3077_Ucell_Max_Grp
        Rte_Write_Asw_Swc_BCS_BCU_BCS_SPN3078_SOC: implemented-entry=Rte_Write_Asw_Swc_BCS_BCU_BCS_SPN3078_SOC
        Rte_Write_Asw_Swc_BCS_BCU_BCS_SPN3079_Time_Remain: implemented-entry=Rte_Write_Asw_Swc_BCS_BCU_BCS_SPN3079_Time_Remain
        Rte_Write_Asw_Swc_BEM_BCU_BEM_SPN3901_Timeout_SPN2560_0x00: implemented-entry=Rte_Write_Asw_Swc_BEM_BCU_BEM_SPN3901_Timeout_SPN2560_0x00
        Rte_Write_Asw_Swc_BEM_BCU_BEM_SPN3902_Timeout_SPN2560_0xAA: implemented-entry=Rte_Write_Asw_Swc_BEM_BCU_BEM_SPN3902_Timeout_SPN2560_0xAA
        Rte_Write_Asw_Swc_BEM_BCU_BEM_SPN3903_Timeout_CTS_CML: implemented-entry=Rte_Write_Asw_Swc_BEM_BCU_BEM_SPN3903_Timeout_CTS_CML
        Rte_Write_Asw_Swc_BEM_BCU_BEM_SPN3904_Timeout_CRO: implemented-entry=Rte_Write_Asw_Swc_BEM_BCU_BEM_SPN3904_Timeout_CRO
        Rte_Write_Asw_Swc_BEM_BCU_BEM_SPN3905_Timeout_CCS: implemented-entry=Rte_Write_Asw_Swc_BEM_BCU_BEM_SPN3905_Timeout_CCS
        Rte_Write_Asw_Swc_BEM_BCU_BEM_SPN3906_Timeout_CST: implemented-entry=Rte_Write_Asw_Swc_BEM_BCU_BEM_SPN3906_Timeout_CST
        Rte_Write_Asw_Swc_BEM_BCU_BEM_SPN3907_Timeout_CSD: implemented-entry=Rte_Write_Asw_Swc_BEM_BCU_BEM_SPN3907_Timeout_CSD
        Rte_Write_Asw_Swc_BEM_BCU_BEM_other: implemented-entry=Rte_Write_Asw_Swc_BEM_BCU_BEM_other
        Rte_Write_Asw_Swc_BHM_BCU_BHM_SPN2601_Ubat_Max_Permit: implemented-entry=Rte_Write_Asw_Swc_BHM_BCU_BHM_SPN2601_Ubat_Max_Permit
        Rte_Write_Asw_Swc_BMS_1D8h_BMSlightReq: implemented-entry=Rte_Write_Asw_Swc_BMS_1D8h_BMSlightReq
        Rte_Write_Asw_Swc_BMS_1D8h_ChrgrStatPTHVCntctrReq: implemented-entry=Rte_Write_Asw_Swc_BMS_1D8h_ChrgrStatPTHVCntctrReq
        Rte_Write_Asw_Swc_BMS_1D8h_HVBatFltSevrtyStat: implemented-entry=Rte_Write_Asw_Swc_BMS_1D8h_HVBatFltSevrtyStat
        Rte_Write_Asw_Swc_BMS_1D8h_HVBatPrcdCrnt: implemented-entry=Rte_Write_Asw_Swc_BMS_1D8h_HVBatPrcdCrnt
        Rte_Write_Asw_Swc_BMS_1D8h_HVBatPrcdCrntV: implemented-entry=Rte_Write_Asw_Swc_BMS_1D8h_HVBatPrcdCrntV
        Rte_Write_Asw_Swc_BMS_1D8h_HVCntctrStat: implemented-entry=Rte_Write_Asw_Swc_BMS_1D8h_HVCntctrStat
        Rte_Write_Asw_Swc_BMS_1D8h_HVCntctrStatARC: implemented-entry=Rte_Write_Asw_Swc_BMS_1D8h_HVCntctrStatARC
        Rte_Write_Asw_Swc_BMS_329h_CellTempMes{1..7}: implemented-entry=Rte_Write_Asw_Swc_BMS_329h_CellTempMes{1..7}
        Rte_Write_Asw_Swc_BMS_329h_MesCellTempNumIndex: implemented-entry=Rte_Write_Asw_Swc_BMS_329h_MesCellTempNumIndex
        Rte_Write_Asw_Swc_BMS_32Ah_Mes1CellBalState: implemented-entry=Rte_Write_Asw_Swc_BMS_32Ah_Mes1CellBalState
        Rte_Write_Asw_Swc_BMS_32Ah_Mes1CellVolt: implemented-entry=Rte_Write_Asw_Swc_BMS_32Ah_Mes1CellVolt
        Rte_Write_Asw_Swc_BMS_32Ah_Mes2CellBalState: implemented-entry=Rte_Write_Asw_Swc_BMS_32Ah_Mes2CellBalState
        Rte_Write_Asw_Swc_BMS_32Ah_Mes2CellVolt: implemented-entry=Rte_Write_Asw_Swc_BMS_32Ah_Mes2CellVolt
        Rte_Write_Asw_Swc_BMS_32Ah_Mes3CellBalState: implemented-entry=Rte_Write_Asw_Swc_BMS_32Ah_Mes3CellBalState
        Rte_Write_Asw_Swc_BMS_32Ah_Mes3CellVolt: implemented-entry=Rte_Write_Asw_Swc_BMS_32Ah_Mes3CellVolt
        Rte_Write_Asw_Swc_BMS_32Ah_MesCellVoltNumIndex: implemented-entry=Rte_Write_Asw_Swc_BMS_32Ah_MesCellVoltNumIndex
        Rte_Write_Asw_Swc_BMS_3D7h_HVBatPackPrcdVltg: implemented-entry=Rte_Write_Asw_Swc_BMS_3D7h_HVBatPackPrcdVltg
        Rte_Write_Asw_Swc_BMS_3D7h_HVBatPackPrcdVltgV: implemented-entry=Rte_Write_Asw_Swc_BMS_3D7h_HVBatPackPrcdVltgV
        Rte_Write_Asw_Swc_BMS_3DAh_BMSChecksum_3DAh: implemented-entry=Rte_Write_Asw_Swc_BMS_3DAh_BMSChecksum_3DAh
        Rte_Write_Asw_Swc_BMS_3DAh_ChrgPeakTimeFactor: implemented-entry=Rte_Write_Asw_Swc_BMS_3DAh_ChrgPeakTimeFactor
        Rte_Write_Asw_Swc_BMS_3DAh_HVBCP_CrnkChrgPwrV: implemented-entry=Rte_Write_Asw_Swc_BMS_3DAh_HVBCP_CrnkChrgPwrV
        Rte_Write_Asw_Swc_BMS_3DAh_HVBCP_LngTrmChrgPwr: implemented-entry=Rte_Write_Asw_Swc_BMS_3DAh_HVBCP_LngTrmChrgPwr
        Rte_Write_Asw_Swc_BMS_3DAh_HVBCP_ShrtTrmChrgPwr: implemented-entry=Rte_Write_Asw_Swc_BMS_3DAh_HVBCP_ShrtTrmChrgPwr
        Rte_Write_Asw_Swc_BMS_3DBh_BMSChecksum_3DBh: implemented-entry=Rte_Write_Asw_Swc_BMS_3DBh_BMSChecksum_3DBh
        Rte_Write_Asw_Swc_BMS_3DBh_DischrgPeakTimeFactor: implemented-entry=Rte_Write_Asw_Swc_BMS_3DBh_DischrgPeakTimeFactor
        Rte_Write_Asw_Swc_BMS_3DBh_HVBDP_CrnkDischrgPwrV: implemented-entry=Rte_Write_Asw_Swc_BMS_3DBh_HVBDP_CrnkDischrgPwrV
        Rte_Write_Asw_Swc_BMS_3DBh_HVBDP_LngTrmDischrgPwr: implemented-entry=Rte_Write_Asw_Swc_BMS_3DBh_HVBDP_LngTrmDischrgPwr
        Rte_Write_Asw_Swc_BMS_3DBh_HVBDP_ShrtTrmDischrgPwr: implemented-entry=Rte_Write_Asw_Swc_BMS_3DBh_HVBDP_ShrtTrmDischrgPwr
        Rte_Write_Asw_Swc_BMS_501h_BMSCelConsistencyWarning: implemented-entry=Rte_Write_Asw_Swc_BMS_501h_BMSCelConsistencyWarning
        Rte_Write_Asw_Swc_BMS_501h_BMSVolHighWarning: implemented-entry=Rte_Write_Asw_Swc_BMS_501h_BMSVolHighWarning
        Rte_Write_Asw_Swc_BMS_501h_CellOvWarning: implemented-entry=Rte_Write_Asw_Swc_BMS_501h_CellOvWarning
        Rte_Write_Asw_Swc_BMS_501h_CellUvWarning: implemented-entry=Rte_Write_Asw_Swc_BMS_501h_CellUvWarning
        Rte_Write_Asw_Swc_BMS_501h_EnergyConsumptionPer: implemented-entry=Rte_Write_Asw_Swc_BMS_501h_EnergyConsumptionPer
        Rte_Write_Asw_Swc_BMS_501h_HVILWarning: implemented-entry=Rte_Write_Asw_Swc_BMS_501h_HVILWarning
        Rte_Write_Asw_Swc_BMS_501h_HVIsoWarning: implemented-entry=Rte_Write_Asw_Swc_BMS_501h_HVIsoWarning
        Rte_Write_Asw_Swc_BMS_501h_PackOvWarning: implemented-entry=Rte_Write_Asw_Swc_BMS_501h_PackOvWarning
        Rte_Write_Asw_Swc_BMS_501h_PackUvWarning: implemented-entry=Rte_Write_Asw_Swc_BMS_501h_PackUvWarning
        Rte_Write_Asw_Swc_BMS_501h_PwrBatPackMismatchWarning: implemented-entry=Rte_Write_Asw_Swc_BMS_501h_PwrBatPackMismatchWarning
        Rte_Write_Asw_Swc_BMS_501h_RestEnergy: implemented-entry=Rte_Write_Asw_Swc_BMS_501h_RestEnergy
        Rte_Write_Asw_Swc_BMS_501h_SOCFastChgWarning: implemented-entry=Rte_Write_Asw_Swc_BMS_501h_SOCFastChgWarning
        Rte_Write_Asw_Swc_BMS_501h_SOCHighWarning: implemented-entry=Rte_Write_Asw_Swc_BMS_501h_SOCHighWarning
        Rte_Write_Asw_Swc_BMS_501h_SOCLowWarning: implemented-entry=Rte_Write_Asw_Swc_BMS_501h_SOCLowWarning
        Rte_Write_Asw_Swc_BMS_501h_TempDiffWarning: implemented-entry=Rte_Write_Asw_Swc_BMS_501h_TempDiffWarning
        Rte_Write_Asw_Swc_BMS_501h_TempHighWarning: implemented-entry=Rte_Write_Asw_Swc_BMS_501h_TempHighWarning
        Rte_Write_Asw_Swc_BMS_501h_ThermalAlarm: implemented-entry=Rte_Write_Asw_Swc_BMS_501h_ThermalAlarm
        Rte_Write_Asw_Swc_BMS_501h_ThermalAlarmV: implemented-entry=Rte_Write_Asw_Swc_BMS_501h_ThermalAlarmV
        Rte_Write_Asw_Swc_BMS_503h_BMSCellQuantity: implemented-entry=Rte_Write_Asw_Swc_BMS_503h_BMSCellQuantity
        Rte_Write_Asw_Swc_BMS_503h_BMSTempProbeQuantity: implemented-entry=Rte_Write_Asw_Swc_BMS_503h_BMSTempProbeQuantity
        Rte_Write_Asw_Swc_BMS_503h_HVIsoValue: implemented-entry=Rte_Write_Asw_Swc_BMS_503h_HVIsoValue
        Rte_Write_Asw_Swc_BMS_503h_RealSOC: implemented-entry=Rte_Write_Asw_Swc_BMS_503h_RealSOC
        Rte_Write_Asw_Swc_BMS_509h_CurRechgEnergyStorSysIndex: implemented-entry=Rte_Write_Asw_Swc_BMS_509h_CurRechgEnergyStorSysIndex
        Rte_Write_Asw_Swc_BMS_509h_RechgEnergyStorSysCode{1..6}: implemented-entry=Rte_Write_Asw_Swc_BMS_509h_RechgEnergyStorSysCode{1..6}
        Rte_Write_Asw_Swc_BMS_509h_RechgEnergyStorSysCodeIndex: implemented-entry=Rte_Write_Asw_Swc_BMS_509h_RechgEnergyStorSysCodeIndex
        Rte_Write_Asw_Swc_BMS_509h_RechgEnergyStorSysCodeLength: implemented-entry=Rte_Write_Asw_Swc_BMS_509h_RechgEnergyStorSysCodeLength
        Rte_Write_Asw_Swc_BMS_509h_RechgEnergyStorSysNumb: implemented-entry=Rte_Write_Asw_Swc_BMS_509h_RechgEnergyStorSysNumb
        Rte_Write_Asw_Swc_BMS_594h_HVBatPackAccVltg: implemented-entry=Rte_Write_Asw_Swc_BMS_594h_HVBatPackAccVltg
        Rte_Write_Asw_Swc_BMS_594h_HVBatPackAccVltgV: implemented-entry=Rte_Write_Asw_Swc_BMS_594h_HVBatPackAccVltgV
        Rte_Write_Asw_Swc_BMS_594h_MaxCellVoltNumb: implemented-entry=Rte_Write_Asw_Swc_BMS_594h_MaxCellVoltNumb
        Rte_Write_Asw_Swc_BMS_594h_MaxClVlt: implemented-entry=Rte_Write_Asw_Swc_BMS_594h_MaxClVlt
        Rte_Write_Asw_Swc_BMS_594h_MinCellVoltNumb: implemented-entry=Rte_Write_Asw_Swc_BMS_594h_MinCellVoltNumb
        Rte_Write_Asw_Swc_BMS_594h_MinClVlt: implemented-entry=Rte_Write_Asw_Swc_BMS_594h_MinClVlt
        Rte_Write_Asw_Swc_BMS_596h_MaxBatTmp: implemented-entry=Rte_Write_Asw_Swc_BMS_596h_MaxBatTmp
        Rte_Write_Asw_Swc_BMS_596h_MaxCellTempNumb: implemented-entry=Rte_Write_Asw_Swc_BMS_596h_MaxCellTempNumb
        Rte_Write_Asw_Swc_BMS_596h_MinBatTmp: implemented-entry=Rte_Write_Asw_Swc_BMS_596h_MinBatTmp
        Rte_Write_Asw_Swc_BMS_596h_MinCellTempNumb: implemented-entry=Rte_Write_Asw_Swc_BMS_596h_MinCellTempNumb
        Rte_Write_Asw_Swc_BMS_598h_BMSChrgStatus: implemented-entry=Rte_Write_Asw_Swc_BMS_598h_BMSChrgStatus
        Rte_Write_Asw_Swc_BMS_598h_BatLf: implemented-entry=Rte_Write_Asw_Swc_BMS_598h_BatLf
        Rte_Write_Asw_Swc_BMS_598h_ChrgPlugStatus: implemented-entry=Rte_Write_Asw_Swc_BMS_598h_ChrgPlugStatus
        Rte_Write_Asw_Swc_BMS_598h_HVSystemStatus: implemented-entry=Rte_Write_Asw_Swc_BMS_598h_HVSystemStatus
        Rte_Write_Asw_Swc_BMS_598h_PreChrgUnitRdy: implemented-entry=Rte_Write_Asw_Swc_BMS_598h_PreChrgUnitRdy
        Rte_Write_Asw_Swc_BMS_598h_TotalBatteryCap: implemented-entry=Rte_Write_Asw_Swc_BMS_598h_TotalBatteryCap
        Rte_Write_Asw_Swc_BMS_603h_ACChrgCurrRq: implemented-entry=Rte_Write_Asw_Swc_BMS_603h_ACChrgCurrRq
        Rte_Write_Asw_Swc_BMS_603h_ACChrgFault: implemented-entry=Rte_Write_Asw_Swc_BMS_603h_ACChrgFault
        Rte_Write_Asw_Swc_BMS_603h_ACChrgMode: implemented-entry=Rte_Write_Asw_Swc_BMS_603h_ACChrgMode
        Rte_Write_Asw_Swc_BMS_603h_ACChrgVoltRq: implemented-entry=Rte_Write_Asw_Swc_BMS_603h_ACChrgVoltRq
        Rte_Write_Asw_Swc_BMS_603h_CCVaule: implemented-entry=Rte_Write_Asw_Swc_BMS_603h_CCVaule
        Rte_Write_Asw_Swc_BMS_603h_CPVaule: implemented-entry=Rte_Write_Asw_Swc_BMS_603h_CPVaule
        Rte_Write_Asw_Swc_BMS_603h_S2_Status: implemented-entry=Rte_Write_Asw_Swc_BMS_603h_S2_Status
        Rte_Write_Asw_Swc_BMS_605h_ChargingVoltage: implemented-entry=Rte_Write_Asw_Swc_BMS_605h_ChargingVoltage
        Rte_Write_Asw_Swc_BMS_605h_FullChargeRemainingTime: implemented-entry=Rte_Write_Asw_Swc_BMS_605h_FullChargeRemainingTime
        Rte_Write_Asw_Swc_BMS_605h_RequestChargeCurrent: implemented-entry=Rte_Write_Asw_Swc_BMS_605h_RequestChargeCurrent
        Rte_Write_Asw_Swc_BMS_606h_BEM_CCS: implemented-entry=Rte_Write_Asw_Swc_BMS_606h_BEM_CCS
        Rte_Write_Asw_Swc_BMS_606h_BEM_CML: implemented-entry=Rte_Write_Asw_Swc_BMS_606h_BEM_CML
        Rte_Write_Asw_Swc_BMS_606h_BEM_CRM00: implemented-entry=Rte_Write_Asw_Swc_BMS_606h_BEM_CRM00
        Rte_Write_Asw_Swc_BMS_606h_BEM_CRMAA: implemented-entry=Rte_Write_Asw_Swc_BMS_606h_BEM_CRMAA
        Rte_Write_Asw_Swc_BMS_606h_BEM_CRO: implemented-entry=Rte_Write_Asw_Swc_BMS_606h_BEM_CRO
        Rte_Write_Asw_Swc_BMS_606h_BEM_CSD: implemented-entry=Rte_Write_Asw_Swc_BMS_606h_BEM_CSD
        Rte_Write_Asw_Swc_BMS_606h_BEM_CST: implemented-entry=Rte_Write_Asw_Swc_BMS_606h_BEM_CST
        Rte_Write_Asw_Swc_BMS_606h_BEM_Other: implemented-entry=Rte_Write_Asw_Swc_BMS_606h_BEM_Other
        Rte_Write_Asw_Swc_BMS_606h_BMSStopChargeFaultCode{1..8}: implemented-entry=Rte_Write_Asw_Swc_BMS_606h_BMSStopChargeFaultCode{1..8}
        Rte_Write_Asw_Swc_BMS_606h_CEM_BCL: implemented-entry=Rte_Write_Asw_Swc_BMS_606h_CEM_BCL
        Rte_Write_Asw_Swc_BMS_606h_CEM_BCP: implemented-entry=Rte_Write_Asw_Swc_BMS_606h_CEM_BCP
        Rte_Write_Asw_Swc_BMS_606h_CEM_BCS: implemented-entry=Rte_Write_Asw_Swc_BMS_606h_CEM_BCS
        Rte_Write_Asw_Swc_BMS_606h_CEM_BRM: implemented-entry=Rte_Write_Asw_Swc_BMS_606h_CEM_BRM
        Rte_Write_Asw_Swc_BMS_606h_CEM_BRO: implemented-entry=Rte_Write_Asw_Swc_BMS_606h_CEM_BRO
        Rte_Write_Asw_Swc_BMS_606h_CEM_BSD: implemented-entry=Rte_Write_Asw_Swc_BMS_606h_CEM_BSD
        Rte_Write_Asw_Swc_BMS_606h_CEM_BST: implemented-entry=Rte_Write_Asw_Swc_BMS_606h_CEM_BST
        Rte_Write_Asw_Swc_BMS_606h_CEM_Other: implemented-entry=Rte_Write_Asw_Swc_BMS_606h_CEM_Other
        Rte_Write_Asw_Swc_BMS_606h_CHGStopChargeFaultCode{1..8}: implemented-entry=Rte_Write_Asw_Swc_BMS_606h_CHGStopChargeFaultCode{1..8}
        Rte_Write_Asw_Swc_BMS_606h_StopChargingReson: implemented-entry=Rte_Write_Asw_Swc_BMS_606h_StopChargingReson
        Rte_Write_Asw_Swc_BMS_795h_BMSDTCFailureTypeByte: implemented-entry=Rte_Write_Asw_Swc_BMS_795h_BMSDTCFailureTypeByte
        Rte_Write_Asw_Swc_BMS_795h_BMSDTCHighByte: implemented-entry=Rte_Write_Asw_Swc_BMS_795h_BMSDTCHighByte
        Rte_Write_Asw_Swc_BMS_795h_BMSDTCLowByte: implemented-entry=Rte_Write_Asw_Swc_BMS_795h_BMSDTCLowByte
        Rte_Write_Asw_Swc_BMS_795h_BMSDTCSeriousLevel: implemented-entry=Rte_Write_Asw_Swc_BMS_795h_BMSDTCSeriousLevel
        Rte_Write_Asw_Swc_BMS_795h_BMSDTCStatus: implemented-entry=Rte_Write_Asw_Swc_BMS_795h_BMSDTCStatus
        Rte_Write_Asw_Swc_BMS_795h_BMSDTCType: implemented-entry=Rte_Write_Asw_Swc_BMS_795h_BMSDTCType
        Rte_Write_Asw_Swc_BRM_BCU_BRM_SPN2565_Ver: implemented-entry=Rte_Write_Asw_Swc_BRM_BCU_BRM_SPN2565_Ver
        Rte_Write_Asw_Swc_BRM_BCU_BRM_SPN2566_Bat_Type: implemented-entry=Rte_Write_Asw_Swc_BRM_BCU_BRM_SPN2566_Bat_Type
        Rte_Write_Asw_Swc_BRM_BCU_BRM_SPN2567_Cap_Nom: implemented-entry=Rte_Write_Asw_Swc_BRM_BCU_BRM_SPN2567_Cap_Nom
        Rte_Write_Asw_Swc_BRM_BCU_BRM_SPN2568_U_Nom: implemented-entry=Rte_Write_Asw_Swc_BRM_BCU_BRM_SPN2568_U_Nom
        Rte_Write_Asw_Swc_BRM_BCU_BRM_SPN2569_BatFactory: implemented-entry=Rte_Write_Asw_Swc_BRM_BCU_BRM_SPN2569_BatFactory
        Rte_Write_Asw_Swc_BRM_BCU_BRM_SPN2570_PackSN: implemented-entry=Rte_Write_Asw_Swc_BRM_BCU_BRM_SPN2570_PackSN
        Rte_Write_Asw_Swc_BRM_BCU_BRM_SPN2571_PackDay: implemented-entry=Rte_Write_Asw_Swc_BRM_BCU_BRM_SPN2571_PackDay
        Rte_Write_Asw_Swc_BRM_BCU_BRM_SPN2571_PackMonth: implemented-entry=Rte_Write_Asw_Swc_BRM_BCU_BRM_SPN2571_PackMonth
        Rte_Write_Asw_Swc_BRM_BCU_BRM_SPN2571_PackYear: implemented-entry=Rte_Write_Asw_Swc_BRM_BCU_BRM_SPN2571_PackYear
        Rte_Write_Asw_Swc_BRM_BCU_BRM_SPN2572_PackChgCnt: implemented-entry=Rte_Write_Asw_Swc_BRM_BCU_BRM_SPN2572_PackChgCnt
        Rte_Write_Asw_Swc_BRM_BCU_BRM_SPN2573_PackRight: implemented-entry=Rte_Write_Asw_Swc_BRM_BCU_BRM_SPN2573_PackRight
        Rte_Write_Asw_Swc_BRM_BCU_BRM_SPN2574_BMSSW_Reserved: implemented-entry=Rte_Write_Asw_Swc_BRM_BCU_BRM_SPN2574_BMSSW_Reserved
        Rte_Write_Asw_Swc_BRM_BCU_BRM_SPN2575_VIN1: implemented-entry=Rte_Write_Asw_Swc_BRM_BCU_BRM_SPN2575_VIN1
        Rte_Write_Asw_Swc_BRM_BCU_BRM_SPN2575_VIN{10..17}: implemented-entry=Rte_Write_Asw_Swc_BRM_BCU_BRM_SPN2575_VIN{10..17}
        Rte_Write_Asw_Swc_BRM_BCU_BRM_SPN2575_VIN{2..9}: implemented-entry=Rte_Write_Asw_Swc_BRM_BCU_BRM_SPN2575_VIN{2..9}
        Rte_Write_Asw_Swc_BRM_BCU_BRM_SPN2576_BMSVer_Day: implemented-entry=Rte_Write_Asw_Swc_BRM_BCU_BRM_SPN2576_BMSVer_Day
        Rte_Write_Asw_Swc_BRM_BCU_BRM_SPN2576_BMSVer_Month: implemented-entry=Rte_Write_Asw_Swc_BRM_BCU_BRM_SPN2576_BMSVer_Month
        Rte_Write_Asw_Swc_BRM_BCU_BRM_SPN2576_BMSVer_Reserver: implemented-entry=Rte_Write_Asw_Swc_BRM_BCU_BRM_SPN2576_BMSVer_Reserver
        Rte_Write_Asw_Swc_BRM_BCU_BRM_SPN2576_BMSVer_Version: implemented-entry=Rte_Write_Asw_Swc_BRM_BCU_BRM_SPN2576_BMSVer_Version
        Rte_Write_Asw_Swc_BRM_BCU_BRM_SPN2576_BMSVer_Year: implemented-entry=Rte_Write_Asw_Swc_BRM_BCU_BRM_SPN2576_BMSVer_Year
        Rte_Write_Asw_Swc_BRO_BCU_BRO_SPN2829_BCU_Ready: implemented-entry=Rte_Write_Asw_Swc_BRO_BCU_BRO_SPN2829_BCU_Ready
        Rte_Write_Asw_Swc_BSD_BCU_BSD_SPN3601_SOC_Final: implemented-entry=Rte_Write_Asw_Swc_BSD_BCU_BSD_SPN3601_SOC_Final
        Rte_Write_Asw_Swc_BSD_BCU_BSD_SPN3602_Ucell_Min: implemented-entry=Rte_Write_Asw_Swc_BSD_BCU_BSD_SPN3602_Ucell_Min
        Rte_Write_Asw_Swc_BSD_BCU_BSD_SPN3603_Ucell_Max: implemented-entry=Rte_Write_Asw_Swc_BSD_BCU_BSD_SPN3603_Ucell_Max
        Rte_Write_Asw_Swc_BSD_BCU_BSD_SPN3604_T_Min: implemented-entry=Rte_Write_Asw_Swc_BSD_BCU_BSD_SPN3604_T_Min
        Rte_Write_Asw_Swc_BSD_BCU_BSD_SPN3605_T_Max: implemented-entry=Rte_Write_Asw_Swc_BSD_BCU_BSD_SPN3605_T_Max
        Rte_Write_Asw_Swc_BSM_BCU_BSM_SPN3085_Ucell_Max_Index: implemented-entry=Rte_Write_Asw_Swc_BSM_BCU_BSM_SPN3085_Ucell_Max_Index
        Rte_Write_Asw_Swc_BSM_BCU_BSM_SPN3086_T_Max: implemented-entry=Rte_Write_Asw_Swc_BSM_BCU_BSM_SPN3086_T_Max
        Rte_Write_Asw_Swc_BSM_BCU_BSM_SPN3087_T_Max_Index: implemented-entry=Rte_Write_Asw_Swc_BSM_BCU_BSM_SPN3087_T_Max_Index
        Rte_Write_Asw_Swc_BSM_BCU_BSM_SPN3088_T_Min: implemented-entry=Rte_Write_Asw_Swc_BSM_BCU_BSM_SPN3088_T_Min
        Rte_Write_Asw_Swc_BSM_BCU_BSM_SPN3089_T_Min_Index: implemented-entry=Rte_Write_Asw_Swc_BSM_BCU_BSM_SPN3089_T_Min_Index
        Rte_Write_Asw_Swc_BSM_BCU_BSM_SPN3090_Ucell_Warn: implemented-entry=Rte_Write_Asw_Swc_BSM_BCU_BSM_SPN3090_Ucell_Warn
        Rte_Write_Asw_Swc_BSM_BCU_BSM_SPN3091_SOC_Warn: implemented-entry=Rte_Write_Asw_Swc_BSM_BCU_BSM_SPN3091_SOC_Warn
        Rte_Write_Asw_Swc_BSM_BCU_BSM_SPN3092_I_Warn: implemented-entry=Rte_Write_Asw_Swc_BSM_BCU_BSM_SPN3092_I_Warn
        Rte_Write_Asw_Swc_BSM_BCU_BSM_SPN3093_T_Warn: implemented-entry=Rte_Write_Asw_Swc_BSM_BCU_BSM_SPN3093_T_Warn
        Rte_Write_Asw_Swc_BSM_BCU_BSM_SPN3094_Iso_State: implemented-entry=Rte_Write_Asw_Swc_BSM_BCU_BSM_SPN3094_Iso_State
        Rte_Write_Asw_Swc_BSM_BCU_BSM_SPN3095_OutConnector_State: implemented-entry=Rte_Write_Asw_Swc_BSM_BCU_BSM_SPN3095_OutConnector_State
        Rte_Write_Asw_Swc_BSM_BCU_BSM_SPN3096_Chg_Enable: implemented-entry=Rte_Write_Asw_Swc_BSM_BCU_BSM_SPN3096_Chg_Enable
        Rte_Write_Asw_Swc_BST_BCU_BST_SPN3511_Stop_Reason_CHGStop: implemented-entry=Rte_Write_Asw_Swc_BST_BCU_BST_SPN3511_Stop_Reason_CHGStop
        Rte_Write_Asw_Swc_BST_BCU_BST_SPN3511_Stop_Reason_SOC: implemented-entry=Rte_Write_Asw_Swc_BST_BCU_BST_SPN3511_Stop_Reason_SOC
        Rte_Write_Asw_Swc_BST_BCU_BST_SPN3511_Stop_Reason_U: implemented-entry=Rte_Write_Asw_Swc_BST_BCU_BST_SPN3511_Stop_Reason_U
        Rte_Write_Asw_Swc_BST_BCU_BST_SPN3511_Stop_Reason_Ucell: implemented-entry=Rte_Write_Asw_Swc_BST_BCU_BST_SPN3511_Stop_Reason_Ucell
        Rte_Write_Asw_Swc_BST_BCU_BST_SPN3512_Stop_Fault_BCUcompo: implemented-entry=Rte_Write_Asw_Swc_BST_BCU_BST_SPN3512_Stop_Fault_BCUcompo
        Rte_Write_Asw_Swc_BST_BCU_BST_SPN3512_Stop_Fault_CC2: implemented-entry=Rte_Write_Asw_Swc_BST_BCU_BST_SPN3512_Stop_Fault_CC2
        Rte_Write_Asw_Swc_BST_BCU_BST_SPN3512_Stop_Fault_ChgCnnt: implemented-entry=Rte_Write_Asw_Swc_BST_BCU_BST_SPN3512_Stop_Fault_ChgCnnt
        Rte_Write_Asw_Swc_BST_BCU_BST_SPN3512_Stop_Fault_HVRelay: implemented-entry=Rte_Write_Asw_Swc_BST_BCU_BST_SPN3512_Stop_Fault_HVRelay
        Rte_Write_Asw_Swc_BST_BCU_BST_SPN3512_Stop_Fault_Iso: implemented-entry=Rte_Write_Asw_Swc_BST_BCU_BST_SPN3512_Stop_Fault_Iso
        Rte_Write_Asw_Swc_BST_BCU_BST_SPN3512_Stop_Fault_Other: implemented-entry=Rte_Write_Asw_Swc_BST_BCU_BST_SPN3512_Stop_Fault_Other
        Rte_Write_Asw_Swc_BST_BCU_BST_SPN3512_Stop_Fault_OutCnnt: implemented-entry=Rte_Write_Asw_Swc_BST_BCU_BST_SPN3512_Stop_Fault_OutCnnt
        Rte_Write_Asw_Swc_BST_BCU_BST_SPN3512_Stop_Fault_T: implemented-entry=Rte_Write_Asw_Swc_BST_BCU_BST_SPN3512_Stop_Fault_T
        Rte_Write_Asw_Swc_BST_BCU_BST_SPN3513_Stop_Fault_I: implemented-entry=Rte_Write_Asw_Swc_BST_BCU_BST_SPN3513_Stop_Fault_I
        Rte_Write_Asw_Swc_BST_BCU_BST_SPN3513_Stop_Fault_U: implemented-entry=Rte_Write_Asw_Swc_BST_BCU_BST_SPN3513_Stop_Fault_U
        Rte_Write_Asw_Swc_ChargeCmd_ACS2Cmd_flg: implemented-entry=Rte_Write_Asw_Swc_ChargeCmd_ACS2Cmd_flg
        Rte_Write_Asw_Swc_ChargeCmd_ELockCtrlCmd_enum: implemented-entry=Rte_Write_Asw_Swc_ChargeCmd_ELockCtrlCmd_enum
        Rte_Write_Asw_Swc_ChargeCmd_ELockSel0Cmd_flg: implemented-entry=Rte_Write_Asw_Swc_ChargeCmd_ELockSel0Cmd_flg
        Rte_Write_Asw_Swc_ChargeCmd_LampCcHCmd_flg: implemented-entry=Rte_Write_Asw_Swc_ChargeCmd_LampCcHCmd_flg
        Rte_Write_Asw_Swc_ChargeCmd_LampChgHCmd_flg: implemented-entry=Rte_Write_Asw_Swc_ChargeCmd_LampChgHCmd_flg
        Rte_Write_Asw_Swc_CmuCmd_BalOpenLoadDiagCmd_flg: implemented-entry=Rte_Write_Asw_Swc_CmuCmd_BalOpenLoadDiagCmd_flg
        Rte_Write_Asw_Swc_CmuCmd_CMUPwrCmd_flg: implemented-entry=Rte_Write_Asw_Swc_CmuCmd_CMUPwrCmd_flg
        Rte_Write_Asw_Swc_CmuCmd_CellLeakageDiagCmd_flg: implemented-entry=Rte_Write_Asw_Swc_CmuCmd_CellLeakageDiagCmd_flg
        Rte_Write_Asw_Swc_CmuCmd_CellMeasCmd_flg: implemented-entry=Rte_Write_Asw_Swc_CmuCmd_CellMeasCmd_flg
        Rte_Write_Asw_Swc_CmuCmd_ChanelFuncDiagCmd_flg: implemented-entry=Rte_Write_Asw_Swc_CmuCmd_ChanelFuncDiagCmd_flg
        Rte_Write_Asw_Swc_CmuCmd_CmuClrFaultPin_flg: implemented-entry=Rte_Write_Asw_Swc_CmuCmd_CmuClrFaultPin_flg
        Rte_Write_Asw_Swc_CmuCmd_CmuReCfg_flg: implemented-entry=Rte_Write_Asw_Swc_CmuCmd_CmuReCfg_flg
        Rte_Write_Asw_Swc_CmuCmd_CtxOpenDiagCmd_flg: implemented-entry=Rte_Write_Asw_Swc_CmuCmd_CtxOpenDiagCmd_flg
        Rte_Write_Asw_Swc_CmuCmd_GpioOTUTFuncDiagCmd_flg: implemented-entry=Rte_Write_Asw_Swc_CmuCmd_GpioOTUTFuncDiagCmd_flg
        Rte_Write_Asw_Swc_CmuCmd_GpioxOpenDiagCmd_flg: implemented-entry=Rte_Write_Asw_Swc_CmuCmd_GpioxOpenDiagCmd_flg
        Rte_Write_Asw_Swc_CmuCmd_OutCMUHWAlarmPWMDuty_Pct: implemented-entry=Rte_Write_Asw_Swc_CmuCmd_OutCMUHWAlarmPWMDuty_Pct
        Rte_Write_Asw_Swc_FblCmd_FBLForbid_flg: implemented-entry=Rte_Write_Asw_Swc_FblCmd_FBLForbid_flg
        Rte_Write_Asw_Swc_HighVoltCmd_PackVoltMeasCmd_flg: implemented-entry=Rte_Write_Asw_Swc_HighVoltCmd_PackVoltMeasCmd_flg
        Rte_Write_Asw_Swc_HvilCmd_OutHVILPWMDuty_Pct: implemented-entry=Rte_Write_Asw_Swc_HvilCmd_OutHVILPWMDuty_Pct
        Rte_Write_Asw_Swc_IsoCmd_HVIsoNegMosCmd_flg: implemented-entry=Rte_Write_Asw_Swc_IsoCmd_HVIsoNegMosCmd_flg
        Rte_Write_Asw_Swc_IsoCmd_HVIsoPosMosCmd_flg: implemented-entry=Rte_Write_Asw_Swc_IsoCmd_HVIsoPosMosCmd_flg
        Rte_Write_Asw_Swc_McuCmd_RadyToSleep_flg: implemented-entry=Rte_Write_Asw_Swc_McuCmd_RadyToSleep_flg
        Rte_Write_Asw_Swc_PPort_BswMArbitration_BswM_MRP_SwcModeRequest_VDP_uint16: implemented-entry=Rte_Write_Asw_Swc_PPort_BswMArbitration_BswM_MRP_SwcModeRequest_VDP_uint16
        Rte_Write_Asw_Swc_RelayCmd_GlobalHCtrCmd_flg: implemented-entry=Rte_Write_Asw_Swc_RelayCmd_GlobalHCtrCmd_flg
        Rte_Write_Asw_Swc_RelayCmd_K{1..6}CtrCmd_flg: implemented-entry=Rte_Write_Asw_Swc_RelayCmd_K{1..6}CtrCmd_flg
        Rte_Write_Asw_Swc_RelayCmd_KnCtrlCmd_flg: implemented-entry=Rte_Write_Asw_Swc_RelayCmd_KnCtrlCmd_flg
        Rte_Write_Asw_Swc_RelayCmd_KpCtrlCmd_flg: implemented-entry=Rte_Write_Asw_Swc_RelayCmd_KpCtrlCmd_flg
        Rte_Write_Asw_Swc_SbcCmd_CANWakeupEnable_flg: implemented-entry=Rte_Write_Asw_Swc_SbcCmd_CANWakeupEnable_flg
        Rte_Write_Asw_Swc_ThermalCmd_OutCoolPumpPWMDuty_Pct: implemented-entry=Rte_Write_Asw_Swc_ThermalCmd_OutCoolPumpPWMDuty_Pct
        Rte_Write_Asw_Swc_ThermalCmd_OutFanPWMDuty_Pct: implemented-entry=Rte_Write_Asw_Swc_ThermalCmd_OutFanPWMDuty_Pct
        Rte_Write_Asw_Swc_ThermalCmd_ValveEn_flg: implemented-entry=Rte_Write_Asw_Swc_ThermalCmd_ValveEn_flg
        Rte_Write_Cmu_Cdd_CmuValue_BalOpenLoadDiagStatus_flg: implemented-entry=Rte_Write_Cmu_Cdd_CmuValue_BalOpenLoadDiagStatus_flg
        Rte_Write_Cmu_Cdd_CmuValue_CMUPwrDiagVoltVld_flg: implemented-entry=Rte_Write_Cmu_Cdd_CmuValue_CMUPwrDiagVoltVld_flg
        Rte_Write_Cmu_Cdd_CmuValue_CMUPwrDiagVolt_V: implemented-entry=Rte_Write_Cmu_Cdd_CmuValue_CMUPwrDiagVolt_V
        Rte_Write_Cmu_Cdd_CmuValue_CellLeakageDiagStatus_flg: implemented-entry=Rte_Write_Cmu_Cdd_CmuValue_CellLeakageDiagStatus_flg
        Rte_Write_Cmu_Cdd_CmuValue_ChanelFuncDiagStatus_flg: implemented-entry=Rte_Write_Cmu_Cdd_CmuValue_ChanelFuncDiagStatus_flg
        Rte_Write_Cmu_Cdd_CmuValue_CmuReCfgStatus_flg: implemented-entry=Rte_Write_Cmu_Cdd_CmuValue_CmuReCfgStatus_flg
        Rte_Write_Cmu_Cdd_CmuValue_CtxOpenDiagStatus_flg: implemented-entry=Rte_Write_Cmu_Cdd_CmuValue_CtxOpenDiagStatus_flg
        Rte_Write_Cmu_Cdd_CmuValue_GpioOTUTFuncDiagStatus_flg: implemented-entry=Rte_Write_Cmu_Cdd_CmuValue_GpioOTUTFuncDiagStatus_flg
        Rte_Write_Cmu_Cdd_CmuValue_GpioxOpenDiagStatus_flg: implemented-entry=Rte_Write_Cmu_Cdd_CmuValue_GpioxOpenDiagStatus_flg
        Rte_Write_Cmu_Cdd_CmuValue_InCMUHWAlarmPWMDutyVld_flg: implemented-entry=Rte_Write_Cmu_Cdd_CmuValue_InCMUHWAlarmPWMDutyVld_flg
        Rte_Write_Cmu_Cdd_CmuValue_InCMUHWAlarmPWMDuty_pct: implemented-entry=Rte_Write_Cmu_Cdd_CmuValue_InCMUHWAlarmPWMDuty_pct
        Rte_Write_Cmu_Cdd_CmuValue_InCMUHWAlarmPWMFeqVld_flg: implemented-entry=Rte_Write_Cmu_Cdd_CmuValue_InCMUHWAlarmPWMFeqVld_flg
        Rte_Write_Cmu_Cdd_CmuValue_InCMUHWAlarmPWMFeq_Hz: implemented-entry=Rte_Write_Cmu_Cdd_CmuValue_InCMUHWAlarmPWMFeq_Hz
        Rte_Write_IoHwAb_ChargeValue_CC2VoltVld_flg: implemented-entry=Rte_Write_IoHwAb_ChargeValue_CC2VoltVld_flg
        Rte_Write_IoHwAb_ChargeValue_CC2Volt_V: implemented-entry=Rte_Write_IoHwAb_ChargeValue_CC2Volt_V
        Rte_Write_IoHwAb_ChargeValue_CCResVld_flg: implemented-entry=Rte_Write_IoHwAb_ChargeValue_CCResVld_flg
        Rte_Write_IoHwAb_ChargeValue_CCRes_ohm: implemented-entry=Rte_Write_IoHwAb_ChargeValue_CCRes_ohm
        Rte_Write_IoHwAb_ChargeValue_CPDutyVld_flg: implemented-entry=Rte_Write_IoHwAb_ChargeValue_CPDutyVld_flg
        Rte_Write_IoHwAb_ChargeValue_CPDuty_pct: implemented-entry=Rte_Write_IoHwAb_ChargeValue_CPDuty_pct
        Rte_Write_IoHwAb_ChargeValue_CPFrqVld_flg: implemented-entry=Rte_Write_IoHwAb_ChargeValue_CPFrqVld_flg
        Rte_Write_IoHwAb_ChargeValue_CPFrq_Hz: implemented-entry=Rte_Write_IoHwAb_ChargeValue_CPFrq_Hz
        Rte_Write_IoHwAb_ChargeValue_CPVoltVld_flg: implemented-entry=Rte_Write_IoHwAb_ChargeValue_CPVoltVld_flg
        Rte_Write_IoHwAb_ChargeValue_CPVolt_V: implemented-entry=Rte_Write_IoHwAb_ChargeValue_CPVolt_V
        Rte_Write_IoHwAb_ChargeValue_DCWakeupVoltVld_flg: implemented-entry=Rte_Write_IoHwAb_ChargeValue_DCWakeupVoltVld_flg
        Rte_Write_IoHwAb_ChargeValue_DCWakeupVolt_V: implemented-entry=Rte_Write_IoHwAb_ChargeValue_DCWakeupVolt_V
        Rte_Write_IoHwAb_ChargeValue_ELockDiagVoltVld_flg: implemented-entry=Rte_Write_IoHwAb_ChargeValue_ELockDiagVoltVld_flg
        Rte_Write_IoHwAb_ChargeValue_ELockDiagVolt_V: implemented-entry=Rte_Write_IoHwAb_ChargeValue_ELockDiagVolt_V
        Rte_Write_IoHwAb_ChargeValue_LampCcHDiagVoltVld_flg: implemented-entry=Rte_Write_IoHwAb_ChargeValue_LampCcHDiagVoltVld_flg
        Rte_Write_IoHwAb_ChargeValue_LampCcHDiagVolt_V: implemented-entry=Rte_Write_IoHwAb_ChargeValue_LampCcHDiagVolt_V
        Rte_Write_IoHwAb_ChargeValue_LampChgHDiagVoltVld_flg: implemented-entry=Rte_Write_IoHwAb_ChargeValue_LampChgHDiagVoltVld_flg
        Rte_Write_IoHwAb_ChargeValue_LampChgHDiagVolt_V: implemented-entry=Rte_Write_IoHwAb_ChargeValue_LampChgHDiagVolt_V
        Rte_Write_IoHwAb_CrashValue_CrashPWMDutyVld_flg: implemented-entry=Rte_Write_IoHwAb_CrashValue_CrashPWMDutyVld_flg
        Rte_Write_IoHwAb_CrashValue_CrashPWMDuty_pct: implemented-entry=Rte_Write_IoHwAb_CrashValue_CrashPWMDuty_pct
        Rte_Write_IoHwAb_CrashValue_CrashPWMFrqVld_flg: implemented-entry=Rte_Write_IoHwAb_CrashValue_CrashPWMFrqVld_flg
        Rte_Write_IoHwAb_CrashValue_CrashPWMFrq_Hz: implemented-entry=Rte_Write_IoHwAb_CrashValue_CrashPWMFrq_Hz
        Rte_Write_IoHwAb_CurrValue_HallCH1RedVoltVld_flg: implemented-entry=Rte_Write_IoHwAb_CurrValue_HallCH1RedVoltVld_flg
        Rte_Write_IoHwAb_CurrValue_HallCH1RedVolt_V: implemented-entry=Rte_Write_IoHwAb_CurrValue_HallCH1RedVolt_V
        Rte_Write_IoHwAb_CurrValue_HallCH1VoltVld_flg: implemented-entry=Rte_Write_IoHwAb_CurrValue_HallCH1VoltVld_flg
        Rte_Write_IoHwAb_CurrValue_HallCH1Volt_V: implemented-entry=Rte_Write_IoHwAb_CurrValue_HallCH1Volt_V
        Rte_Write_IoHwAb_CurrValue_HallCH2RedVoltVld_flg: implemented-entry=Rte_Write_IoHwAb_CurrValue_HallCH2RedVoltVld_flg
        Rte_Write_IoHwAb_CurrValue_HallCH2RedVolt_V: implemented-entry=Rte_Write_IoHwAb_CurrValue_HallCH2RedVolt_V
        Rte_Write_IoHwAb_CurrValue_HallCH2VoltVld_flg: implemented-entry=Rte_Write_IoHwAb_CurrValue_HallCH2VoltVld_flg
        Rte_Write_IoHwAb_CurrValue_HallCH2Volt_V: implemented-entry=Rte_Write_IoHwAb_CurrValue_HallCH2Volt_V
        Rte_Write_IoHwAb_CurrValue_HallSpyVoltVld_flg: implemented-entry=Rte_Write_IoHwAb_CurrValue_HallSpyVoltVld_flg
        Rte_Write_IoHwAb_CurrValue_HallSpyVolt_V: implemented-entry=Rte_Write_IoHwAb_CurrValue_HallSpyVolt_V
        Rte_Write_IoHwAb_CurrValue_PackCurrRedVld_flg: implemented-entry=Rte_Write_IoHwAb_CurrValue_PackCurrRedVld_flg
        Rte_Write_IoHwAb_CurrValue_PackCurrRed_A: implemented-entry=Rte_Write_IoHwAb_CurrValue_PackCurrRed_A
        Rte_Write_IoHwAb_CurrValue_PackCurrVld_flg: implemented-entry=Rte_Write_IoHwAb_CurrValue_PackCurrVld_flg
        Rte_Write_IoHwAb_CurrValue_PackCurr_A: implemented-entry=Rte_Write_IoHwAb_CurrValue_PackCurr_A
        Rte_Write_IoHwAb_HighVoltValue_P1CheckVoltVld_flg: implemented-entry=Rte_Write_IoHwAb_HighVoltValue_P1CheckVoltVld_flg
        Rte_Write_IoHwAb_HighVoltValue_P1CheckVolt_V: implemented-entry=Rte_Write_IoHwAb_HighVoltValue_P1CheckVolt_V
        Rte_Write_IoHwAb_HighVoltValue_P2CheckVoltVld_flg: implemented-entry=Rte_Write_IoHwAb_HighVoltValue_P2CheckVoltVld_flg
        Rte_Write_IoHwAb_HighVoltValue_P2CheckVolt_V: implemented-entry=Rte_Write_IoHwAb_HighVoltValue_P2CheckVolt_V
        Rte_Write_IoHwAb_HighVoltValue_P3CheckVoltVld_flg: implemented-entry=Rte_Write_IoHwAb_HighVoltValue_P3CheckVoltVld_flg
        Rte_Write_IoHwAb_HighVoltValue_P3CheckVolt_V: implemented-entry=Rte_Write_IoHwAb_HighVoltValue_P3CheckVolt_V
        Rte_Write_IoHwAb_HighVoltValue_PackVoltVld_flg: implemented-entry=Rte_Write_IoHwAb_HighVoltValue_PackVoltVld_flg
        Rte_Write_IoHwAb_HighVoltValue_PackVolt_V: implemented-entry=Rte_Write_IoHwAb_HighVoltValue_PackVolt_V
        Rte_Write_IoHwAb_HighVoltValue_PreChgCheckRedVoltVld_flg: implemented-entry=Rte_Write_IoHwAb_HighVoltValue_PreChgCheckRedVoltVld_flg
        Rte_Write_IoHwAb_HighVoltValue_PreChgCheckRedVolt_V: implemented-entry=Rte_Write_IoHwAb_HighVoltValue_PreChgCheckRedVolt_V
        Rte_Write_IoHwAb_HighVoltValue_PreChgCheckVoltVld_flg: implemented-entry=Rte_Write_IoHwAb_HighVoltValue_PreChgCheckVoltVld_flg
        Rte_Write_IoHwAb_HighVoltValue_PreChgCheckVolt_V: implemented-entry=Rte_Write_IoHwAb_HighVoltValue_PreChgCheckVolt_V
        Rte_Write_IoHwAb_HvilValue_HVILHighVoltVld_flg: implemented-entry=Rte_Write_IoHwAb_HvilValue_HVILHighVoltVld_flg
        Rte_Write_IoHwAb_HvilValue_HVILHighVolt_V: implemented-entry=Rte_Write_IoHwAb_HvilValue_HVILHighVolt_V
        Rte_Write_IoHwAb_HvilValue_HVILLowVoltVld_flg: implemented-entry=Rte_Write_IoHwAb_HvilValue_HVILLowVoltVld_flg
        Rte_Write_IoHwAb_HvilValue_HVILLowVolt_V: implemented-entry=Rte_Write_IoHwAb_HvilValue_HVILLowVolt_V
        Rte_Write_IoHwAb_HvilValue_InHVILPWMDutyVld_flg: implemented-entry=Rte_Write_IoHwAb_HvilValue_InHVILPWMDutyVld_flg
        Rte_Write_IoHwAb_HvilValue_InHVILPWMDuty_pct: implemented-entry=Rte_Write_IoHwAb_HvilValue_InHVILPWMDuty_pct
        Rte_Write_IoHwAb_HvilValue_InHVILPWMFrqVld_flg: implemented-entry=Rte_Write_IoHwAb_HvilValue_InHVILPWMFrqVld_flg
        Rte_Write_IoHwAb_HvilValue_InHVILPWMFrq_Hz: implemented-entry=Rte_Write_IoHwAb_HvilValue_InHVILPWMFrq_Hz
        Rte_Write_IoHwAb_IsoValue_HVIsoNegVoltVld_flg: implemented-entry=Rte_Write_IoHwAb_IsoValue_HVIsoNegVoltVld_flg
        Rte_Write_IoHwAb_IsoValue_HVIsoNegVolt_V: implemented-entry=Rte_Write_IoHwAb_IsoValue_HVIsoNegVolt_V
        Rte_Write_IoHwAb_IsoValue_HVIsoPosVoltVld_flg: implemented-entry=Rte_Write_IoHwAb_IsoValue_HVIsoPosVoltVld_flg
        Rte_Write_IoHwAb_IsoValue_HVIsoPosVolt_V: implemented-entry=Rte_Write_IoHwAb_IsoValue_HVIsoPosVolt_V
        Rte_Write_IoHwAb_McuValue_BSWInitFinish_flg: implemented-entry=Rte_Write_IoHwAb_McuValue_BSWInitFinish_flg
        Rte_Write_IoHwAb_PowerValue_BmuPullupSwitchDiag_flg: implemented-entry=Rte_Write_IoHwAb_PowerValue_BmuPullupSwitchDiag_flg
        Rte_Write_IoHwAb_PowerValue_BmuPullupVoltVld_flg: implemented-entry=Rte_Write_IoHwAb_PowerValue_BmuPullupVoltVld_flg
        Rte_Write_IoHwAb_PowerValue_BmuPullupVolt_V: implemented-entry=Rte_Write_IoHwAb_PowerValue_BmuPullupVolt_V
        Rte_Write_IoHwAb_PowerValue_KL15VoltVld_flg: implemented-entry=Rte_Write_IoHwAb_PowerValue_KL15VoltVld_flg
        Rte_Write_IoHwAb_PowerValue_KL15Volt_V: implemented-entry=Rte_Write_IoHwAb_PowerValue_KL15Volt_V
        Rte_Write_IoHwAb_PowerValue_KL30VoltVld_flg: implemented-entry=Rte_Write_IoHwAb_PowerValue_KL30VoltVld_flg
        Rte_Write_IoHwAb_PowerValue_KL30Volt_V: implemented-entry=Rte_Write_IoHwAb_PowerValue_KL30Volt_V
        Rte_Write_IoHwAb_PowerValue_KPowertVoltVld_flg: implemented-entry=Rte_Write_IoHwAb_PowerValue_KPowertVoltVld_flg
        Rte_Write_IoHwAb_PowerValue_KPowertVolt_V: implemented-entry=Rte_Write_IoHwAb_PowerValue_KPowertVolt_V
        Rte_Write_IoHwAb_PowerValue_ResWakeUp1HVoltVld_flg: implemented-entry=Rte_Write_IoHwAb_PowerValue_ResWakeUp1HVoltVld_flg
        Rte_Write_IoHwAb_PowerValue_ResWakeUp1HVolt_V: implemented-entry=Rte_Write_IoHwAb_PowerValue_ResWakeUp1HVolt_V
        Rte_Write_IoHwAb_PowerValue_ResWakeUp2HVoltVld_flg: implemented-entry=Rte_Write_IoHwAb_PowerValue_ResWakeUp2HVoltVld_flg
        Rte_Write_IoHwAb_PowerValue_ResWakeUp2HVolt_V: implemented-entry=Rte_Write_IoHwAb_PowerValue_ResWakeUp2HVolt_V
        Rte_Write_IoHwAb_PowerValue_ResWakeUp3LVoltVld_flg: implemented-entry=Rte_Write_IoHwAb_PowerValue_ResWakeUp3LVoltVld_flg
        Rte_Write_IoHwAb_PowerValue_ResWakeUp3LVolt_V: implemented-entry=Rte_Write_IoHwAb_PowerValue_ResWakeUp3LVolt_V
        Rte_Write_IoHwAb_RelayValue_GlobalHsideDiagVoltVld_flg: implemented-entry=Rte_Write_IoHwAb_RelayValue_GlobalHsideDiagVoltVld_flg
        Rte_Write_IoHwAb_RelayValue_GlobalHsideDiagVolt_V: implemented-entry=Rte_Write_IoHwAb_RelayValue_GlobalHsideDiagVolt_V
        Rte_Write_IoHwAb_RelayValue_GlobalHsideDriverVoltVld_flg: implemented-entry=Rte_Write_IoHwAb_RelayValue_GlobalHsideDriverVoltVld_flg
        Rte_Write_IoHwAb_RelayValue_GlobalHsideDriverVolt_V: implemented-entry=Rte_Write_IoHwAb_RelayValue_GlobalHsideDriverVolt_V
        Rte_Write_IoHwAb_RelayValue_K1CtrDriverVoltVld_flg: implemented-entry=Rte_Write_IoHwAb_RelayValue_K1CtrDriverVoltVld_flg
        Rte_Write_IoHwAb_RelayValue_K1CtrDriverVolt_V: implemented-entry=Rte_Write_IoHwAb_RelayValue_K1CtrDriverVolt_V
        Rte_Write_IoHwAb_RelayValue_K2CtrDriverVoltVld_flg: implemented-entry=Rte_Write_IoHwAb_RelayValue_K2CtrDriverVoltVld_flg
        Rte_Write_IoHwAb_RelayValue_K2CtrDriverVolt_V: implemented-entry=Rte_Write_IoHwAb_RelayValue_K2CtrDriverVolt_V
        Rte_Write_IoHwAb_RelayValue_K3CtrDriverVoltVld_flg: implemented-entry=Rte_Write_IoHwAb_RelayValue_K3CtrDriverVoltVld_flg
        Rte_Write_IoHwAb_RelayValue_K3CtrDriverVolt_V: implemented-entry=Rte_Write_IoHwAb_RelayValue_K3CtrDriverVolt_V
        Rte_Write_IoHwAb_RelayValue_K4CtrDriverVoltVld_flg: implemented-entry=Rte_Write_IoHwAb_RelayValue_K4CtrDriverVoltVld_flg
        Rte_Write_IoHwAb_RelayValue_K4CtrDriverVolt_V: implemented-entry=Rte_Write_IoHwAb_RelayValue_K4CtrDriverVolt_V
        Rte_Write_IoHwAb_RelayValue_K5CtrDriverVoltVld_flg: implemented-entry=Rte_Write_IoHwAb_RelayValue_K5CtrDriverVoltVld_flg
        Rte_Write_IoHwAb_RelayValue_K5CtrDriverVolt_V: implemented-entry=Rte_Write_IoHwAb_RelayValue_K5CtrDriverVolt_V
        Rte_Write_IoHwAb_RelayValue_K6CtrDriverVoltVld_flg: implemented-entry=Rte_Write_IoHwAb_RelayValue_K6CtrDriverVoltVld_flg
        Rte_Write_IoHwAb_RelayValue_K6CtrDriverVolt_V: implemented-entry=Rte_Write_IoHwAb_RelayValue_K6CtrDriverVolt_V
        Rte_Write_IoHwAb_RelayValue_KnCtrDriverVoltVld_flg: implemented-entry=Rte_Write_IoHwAb_RelayValue_KnCtrDriverVoltVld_flg
        Rte_Write_IoHwAb_RelayValue_KnCtrDriverVolt_V: implemented-entry=Rte_Write_IoHwAb_RelayValue_KnCtrDriverVolt_V
        Rte_Write_IoHwAb_RelayValue_KnchgEnOutState_flg: implemented-entry=Rte_Write_IoHwAb_RelayValue_KnchgEnOutState_flg
        Rte_Write_IoHwAb_RelayValue_KnchgEnStateVld_flg: implemented-entry=Rte_Write_IoHwAb_RelayValue_KnchgEnStateVld_flg
        Rte_Write_IoHwAb_RelayValue_KpCtrDriverVoltVld_flg: implemented-entry=Rte_Write_IoHwAb_RelayValue_KpCtrDriverVoltVld_flg
        Rte_Write_IoHwAb_RelayValue_KpCtrDriverVolt_V: implemented-entry=Rte_Write_IoHwAb_RelayValue_KpCtrDriverVolt_V
        Rte_Write_IoHwAb_RelayValue_KpEnOutState_flg: implemented-entry=Rte_Write_IoHwAb_RelayValue_KpEnOutState_flg
        Rte_Write_IoHwAb_RelayValue_KpEnStateVld_flg: implemented-entry=Rte_Write_IoHwAb_RelayValue_KpEnStateVld_flg
        Rte_Write_IoHwAb_RsvValue_InRsvPWMDutyVld_flg: implemented-entry=Rte_Write_IoHwAb_RsvValue_InRsvPWMDutyVld_flg
        Rte_Write_IoHwAb_RsvValue_InRsvPWMDuty_pct: implemented-entry=Rte_Write_IoHwAb_RsvValue_InRsvPWMDuty_pct
        Rte_Write_IoHwAb_RsvValue_InRsvPWMFrqVld_flg: implemented-entry=Rte_Write_IoHwAb_RsvValue_InRsvPWMFrqVld_flg
        Rte_Write_IoHwAb_RsvValue_InRsvPWMFrq_Hz: implemented-entry=Rte_Write_IoHwAb_RsvValue_InRsvPWMFrq_Hz
        Rte_Write_IoHwAb_RsvValue_RsvAD1VoltVld_flg: implemented-entry=Rte_Write_IoHwAb_RsvValue_RsvAD1VoltVld_flg
        Rte_Write_IoHwAb_RsvValue_RsvAD1Volt_V: implemented-entry=Rte_Write_IoHwAb_RsvValue_RsvAD1Volt_V
        Rte_Write_IoHwAb_RsvValue_RsvAD2VoltVld_flg: implemented-entry=Rte_Write_IoHwAb_RsvValue_RsvAD2VoltVld_flg
        Rte_Write_IoHwAb_RsvValue_RsvAD2Volt_V: implemented-entry=Rte_Write_IoHwAb_RsvValue_RsvAD2Volt_V
        Rte_Write_IoHwAb_RsvValue_RsvAD3VoltVld_flg: implemented-entry=Rte_Write_IoHwAb_RsvValue_RsvAD3VoltVld_flg
        Rte_Write_IoHwAb_RsvValue_RsvAD3Volt_V: implemented-entry=Rte_Write_IoHwAb_RsvValue_RsvAD3Volt_V
        Rte_Write_IoHwAb_RsvValue_RsvAD4VoltVld_flg: implemented-entry=Rte_Write_IoHwAb_RsvValue_RsvAD4VoltVld_flg
        Rte_Write_IoHwAb_RsvValue_RsvAD4Volt_V: implemented-entry=Rte_Write_IoHwAb_RsvValue_RsvAD4Volt_V
        Rte_Write_IoHwAb_RsvValue_RsvAD5VoltVld_flg: implemented-entry=Rte_Write_IoHwAb_RsvValue_RsvAD5VoltVld_flg
        Rte_Write_IoHwAb_RsvValue_RsvAD5Volt_V: implemented-entry=Rte_Write_IoHwAb_RsvValue_RsvAD5Volt_V
        Rte_Write_IoHwAb_SbcValue_BMULastPwrDownState: implemented-entry=Rte_Write_IoHwAb_SbcValue_BMULastPwrDownState
        Rte_Write_IoHwAb_SbcValue_BmuSbcCanTRSt_flg: implemented-entry=Rte_Write_IoHwAb_SbcValue_BmuSbcCanTRSt_flg
        Rte_Write_IoHwAb_SbcValue_BmuSbcRstbPinSt_flg: implemented-entry=Rte_Write_IoHwAb_SbcValue_BmuSbcRstbPinSt_flg
        Rte_Write_IoHwAb_SbcValue_BmuSbcVauxOV_flg: implemented-entry=Rte_Write_IoHwAb_SbcValue_BmuSbcVauxOV_flg
        Rte_Write_IoHwAb_SbcValue_BmuSbcVauxUV_flg: implemented-entry=Rte_Write_IoHwAb_SbcValue_BmuSbcVauxUV_flg
        Rte_Write_IoHwAb_SbcValue_BmuSbcVcanOV_flg: implemented-entry=Rte_Write_IoHwAb_SbcValue_BmuSbcVcanOV_flg
        Rte_Write_IoHwAb_SbcValue_BmuSbcVcanUV_flg: implemented-entry=Rte_Write_IoHwAb_SbcValue_BmuSbcVcanUV_flg
        Rte_Write_IoHwAb_SbcValue_BmuSbcVccaOV_flg: implemented-entry=Rte_Write_IoHwAb_SbcValue_BmuSbcVccaOV_flg
        Rte_Write_IoHwAb_SbcValue_BmuSbcVccaUV_flg: implemented-entry=Rte_Write_IoHwAb_SbcValue_BmuSbcVccaUV_flg
        Rte_Write_IoHwAb_SbcValue_BmuSbcVcoreOV_flg: implemented-entry=Rte_Write_IoHwAb_SbcValue_BmuSbcVcoreOV_flg
        Rte_Write_IoHwAb_SbcValue_BmuSbcVpreOV_flg: implemented-entry=Rte_Write_IoHwAb_SbcValue_BmuSbcVpreOV_flg
        Rte_Write_IoHwAb_SbcValue_BmuSbcVpreUV_flg: implemented-entry=Rte_Write_IoHwAb_SbcValue_BmuSbcVpreUV_flg
        Rte_Write_IoHwAb_SbcValue_BmuSbxVcoreUV_flg: implemented-entry=Rte_Write_IoHwAb_SbcValue_BmuSbxVcoreUV_flg
        Rte_Write_IoHwAb_SbcValue_CANWakeupState_flg: implemented-entry=Rte_Write_IoHwAb_SbcValue_CANWakeupState_flg
        Rte_Write_IoHwAb_SbcValue_KL15WakeupState_flg: implemented-entry=Rte_Write_IoHwAb_SbcValue_KL15WakeupState_flg
        Rte_Write_IoHwAb_SbcValue_RTCWakeupState_flg: implemented-entry=Rte_Write_IoHwAb_SbcValue_RTCWakeupState_flg
        Rte_Write_IoHwAb_SbcValue_SBCWakeupP{1..3}State_flg: implemented-entry=Rte_Write_IoHwAb_SbcValue_SBCWakeupP{1..3}State_flg
        Rte_Write_IoHwAb_ThermalValue_BmuTemp1NtcVld_flg: implemented-entry=Rte_Write_IoHwAb_ThermalValue_BmuTemp1NtcVld_flg
        Rte_Write_IoHwAb_ThermalValue_BmuTemp1Ntc_Ohm: implemented-entry=Rte_Write_IoHwAb_ThermalValue_BmuTemp1Ntc_Ohm
        Rte_Write_IoHwAb_ThermalValue_BmuTemp2NtcVld_flg: implemented-entry=Rte_Write_IoHwAb_ThermalValue_BmuTemp2NtcVld_flg
        Rte_Write_IoHwAb_ThermalValue_BmuTemp2Ntc_Ohm: implemented-entry=Rte_Write_IoHwAb_ThermalValue_BmuTemp2Ntc_Ohm
        Rte_Write_IoHwAb_ThermalValue_BmuTemp3NtcVld_flg: implemented-entry=Rte_Write_IoHwAb_ThermalValue_BmuTemp3NtcVld_flg
        Rte_Write_IoHwAb_ThermalValue_BmuTemp3Ntc_Ohm: implemented-entry=Rte_Write_IoHwAb_ThermalValue_BmuTemp3Ntc_Ohm
        Rte_Write_IoHwAb_ThermalValue_BmuTemp4NtcVld_flg: implemented-entry=Rte_Write_IoHwAb_ThermalValue_BmuTemp4NtcVld_flg
        Rte_Write_IoHwAb_ThermalValue_BmuTemp4Ntc_Ohm: implemented-entry=Rte_Write_IoHwAb_ThermalValue_BmuTemp4Ntc_Ohm
        Rte_Write_IoHwAb_ThermalValue_BmuTemp5NtcVld_flg: implemented-entry=Rte_Write_IoHwAb_ThermalValue_BmuTemp5NtcVld_flg
        Rte_Write_IoHwAb_ThermalValue_BmuTemp5Ntc_Ohm: implemented-entry=Rte_Write_IoHwAb_ThermalValue_BmuTemp5Ntc_Ohm
        Rte_Write_IoHwAb_ThermalValue_BmuTemp6NtcVld_flg: implemented-entry=Rte_Write_IoHwAb_ThermalValue_BmuTemp6NtcVld_flg
        Rte_Write_IoHwAb_ThermalValue_BmuTemp6Ntc_Ohm: implemented-entry=Rte_Write_IoHwAb_ThermalValue_BmuTemp6Ntc_Ohm
        Rte_Write_IoHwAb_ThermalValue_BmuTemp7NtcVld_flg: implemented-entry=Rte_Write_IoHwAb_ThermalValue_BmuTemp7NtcVld_flg
        Rte_Write_IoHwAb_ThermalValue_BmuTemp7Ntc_Ohm: implemented-entry=Rte_Write_IoHwAb_ThermalValue_BmuTemp7Ntc_Ohm
        Rte_Write_IoHwAb_ThermalValue_InCoolPumpPWMDutyVld_flg: implemented-entry=Rte_Write_IoHwAb_ThermalValue_InCoolPumpPWMDutyVld_flg
        Rte_Write_IoHwAb_ThermalValue_InCoolPumpPWMDuty_Pct: implemented-entry=Rte_Write_IoHwAb_ThermalValue_InCoolPumpPWMDuty_Pct
        Rte_Write_IoHwAb_ThermalValue_InCoolPumpPWMFrqVld_flg: implemented-entry=Rte_Write_IoHwAb_ThermalValue_InCoolPumpPWMFrqVld_flg
        Rte_Write_IoHwAb_ThermalValue_InCoolPumpPWMFrq_Hz: implemented-entry=Rte_Write_IoHwAb_ThermalValue_InCoolPumpPWMFrq_Hz
        Rte_Write_IoHwAb_ThermalValue_InFanPWMDutyVld_flg: implemented-entry=Rte_Write_IoHwAb_ThermalValue_InFanPWMDutyVld_flg
        Rte_Write_IoHwAb_ThermalValue_InFanPWMDuty_Pct: implemented-entry=Rte_Write_IoHwAb_ThermalValue_InFanPWMDuty_Pct
        Rte_Write_IoHwAb_ThermalValue_InFanPWMFrqVld_flg: implemented-entry=Rte_Write_IoHwAb_ThermalValue_InFanPWMFrqVld_flg
        Rte_Write_IoHwAb_ThermalValue_InFanPWMFrq_Hz: implemented-entry=Rte_Write_IoHwAb_ThermalValue_InFanPWMFrq_Hz
        Rte_Write_IoHwAb_ThermalValue_ValveDiagVoltVld_flg: implemented-entry=Rte_Write_IoHwAb_ThermalValue_ValveDiagVoltVld_flg
        Rte_Write_IoHwAb_ThermalValue_ValveDiagVolt_V: implemented-entry=Rte_Write_IoHwAb_ThermalValue_ValveDiagVolt_V
        Rte_Write_Sbc_Cdd_SbcValue_BMULastPwrDownState: implemented-entry=Rte_Write_Sbc_Cdd_SbcValue_BMULastPwrDownState
        Rte_Write_Sbc_Cdd_SbcValue_BmuSbcCanTRSt_flg: implemented-entry=Rte_Write_Sbc_Cdd_SbcValue_BmuSbcCanTRSt_flg
        Rte_Write_Sbc_Cdd_SbcValue_BmuSbcRstbPinSt_flg: implemented-entry=Rte_Write_Sbc_Cdd_SbcValue_BmuSbcRstbPinSt_flg
        Rte_Write_Sbc_Cdd_SbcValue_BmuSbcVauxOV_flg: implemented-entry=Rte_Write_Sbc_Cdd_SbcValue_BmuSbcVauxOV_flg
        Rte_Write_Sbc_Cdd_SbcValue_BmuSbcVauxUV_flg: implemented-entry=Rte_Write_Sbc_Cdd_SbcValue_BmuSbcVauxUV_flg
        Rte_Write_Sbc_Cdd_SbcValue_BmuSbcVcanOV_flg: implemented-entry=Rte_Write_Sbc_Cdd_SbcValue_BmuSbcVcanOV_flg
        Rte_Write_Sbc_Cdd_SbcValue_BmuSbcVcanUV_flg: implemented-entry=Rte_Write_Sbc_Cdd_SbcValue_BmuSbcVcanUV_flg
        Rte_Write_Sbc_Cdd_SbcValue_BmuSbcVccaOV_flg: implemented-entry=Rte_Write_Sbc_Cdd_SbcValue_BmuSbcVccaOV_flg
        Rte_Write_Sbc_Cdd_SbcValue_BmuSbcVccaUV_flg: implemented-entry=Rte_Write_Sbc_Cdd_SbcValue_BmuSbcVccaUV_flg
        Rte_Write_Sbc_Cdd_SbcValue_BmuSbcVcoreOV_flg: implemented-entry=Rte_Write_Sbc_Cdd_SbcValue_BmuSbcVcoreOV_flg
        Rte_Write_Sbc_Cdd_SbcValue_BmuSbcVpreOV_flg: implemented-entry=Rte_Write_Sbc_Cdd_SbcValue_BmuSbcVpreOV_flg
        Rte_Write_Sbc_Cdd_SbcValue_BmuSbcVpreUV_flg: implemented-entry=Rte_Write_Sbc_Cdd_SbcValue_BmuSbcVpreUV_flg
        Rte_Write_Sbc_Cdd_SbcValue_BmuSbxVcoreUV_flg: implemented-entry=Rte_Write_Sbc_Cdd_SbcValue_BmuSbxVcoreUV_flg
        Rte_Write_Sbc_Cdd_SbcValue_CANWakeupState_flg: implemented-entry=Rte_Write_Sbc_Cdd_SbcValue_CANWakeupState_flg
        Rte_Write_Sbc_Cdd_SbcValue_KL15WakeupState_flg: implemented-entry=Rte_Write_Sbc_Cdd_SbcValue_KL15WakeupState_flg
        Rte_Write_Sbc_Cdd_SbcValue_RTCWakeupState_flg: implemented-entry=Rte_Write_Sbc_Cdd_SbcValue_RTCWakeupState_flg
        Rte_Write_Sbc_Cdd_SbcValue_SBCWakeupP{1..3}State_flg: implemented-entry=Rte_Write_Sbc_Cdd_SbcValue_SBCWakeupP{1..3}State_flg
        Rte_memcpy: implemented-entry=Rte_memcpy
        SchM_Deinit: implemented-entry=SchM_Deinit
        SchM_IModeInit: implemented-entry=SchM_IModeInit
        SchM_Init: implemented-entry=SchM_Init
        SchM_Mode_BswM_MDGR_BswM_MRP_BswM_MDG: implemented-entry=SchM_Mode_BswM_MDGR_BswM_MRP_BswM_MDG
        SchM_Mode_WdgM_Current_WdgMSupervisionCycle: implemented-entry=SchM_Mode_WdgM_Current_WdgMSupervisionCycle
        SchM_Switch_BswM_MDGP_AUTOSAR_BswM_ModeDeclarationGroups_MDG_ECUM_STATE: implemented-entry=SchM_Switch_BswM_MDGP_AUTOSAR_BswM_ModeDeclarationGroups_MDG_ECUM_STATE
