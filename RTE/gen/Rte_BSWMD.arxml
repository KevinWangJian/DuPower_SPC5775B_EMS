[part 2 of 2: packages /AUTOSAR_Rte/BswModuleEntrys to /AUTOSAR_Rte/SwAddrMethods]
AUTOSAR XML (schema 4-2-2)
package /AUTOSAR_Rte/BswModuleEntrys
  823 x bsw module entry:
    Rte_ActivateRE: call-type=REGULAR
    Rte_Call_Asw_Swc_Cmu_Get_CMUPCBTempVld_flg: call-type=REGULAR
    Rte_Call_Asw_Swc_Cmu_Get_CMUPCBTemp_C: call-type=REGULAR
    Rte_Call_Asw_Swc_Cmu_Get_CellBalState_flg: call-type=REGULAR
    Rte_Call_Asw_Swc_Cmu_Get_CellTempVld_flg: call-type=REGULAR
    Rte_Call_Asw_Swc_Cmu_Get_CellTemp_C: call-type=REGULAR
    Rte_Call_Asw_Swc_Cmu_Get_CellVoltVld_flg: call-type=REGULAR
    Rte_Call_Asw_Swc_Cmu_Get_CellVolt_mV: call-type=REGULAR
    Rte_Call_Asw_Swc_Cmu_Get_CmuCbOpenFltArr: call-type=REGULAR
    Rte_Call_Asw_Swc_Cmu_Get_CmuCbShortFltArr: call-type=REGULAR
    Rte_Call_Asw_Swc_Cmu_Get_CmuCellTermLeakArr: call-type=REGULAR
    Rte_Call_Asw_Swc_Cmu_Get_CmuCtOpenFltArr: call-type=REGULAR
    Rte_Call_Asw_Swc_Cmu_Get_CmuFaultState1: call-type=REGULAR
    Rte_Call_Asw_Swc_Cmu_Get_CmuFaultState2: call-type=REGULAR
    Rte_Call_Asw_Swc_Cmu_Get_CmuGpioOTFuncArr: call-type=REGULAR
    Rte_Call_Asw_Swc_Cmu_Get_CmuGpioUTFuncArr: call-type=REGULAR
    Rte_Call_Asw_Swc_Cmu_Get_CmuGpioxOpenArr: call-type=REGULAR
    Rte_Call_Asw_Swc_Cmu_Get_CmuOVFuncArr: call-type=REGULAR
    Rte_Call_Asw_Swc_Cmu_Get_CmuUVFuncArr: call-type=REGULAR
    Rte_Call_Asw_Swc_Cmu_Get_CmuVoltChaFuncArr: call-type=REGULAR
    Rte_Call_Asw_Swc_Cmu_Get_HeatFilmTempVld_flg: call-type=REGULAR
    Rte_Call_Asw_Swc_Cmu_Get_HeatFilmTemp_C: call-type=REGULAR
    Rte_Call_Asw_Swc_Cmu_Get_StackVoltVld_flg: call-type=REGULAR
    Rte_Call_Asw_Swc_Cmu_Get_StackVolt_V: call-type=REGULAR
    Rte_Call_Asw_Swc_Cmu_Set_CellBalCmd_flg: call-type=REGULAR
    Rte_Call_Asw_Swc_RPort_ComM_UserRequest_GetCurrentComMode: call-type=REGULAR
    Rte_Call_Asw_Swc_RPort_EcuM_ShutdownTarget_SelectShutdownTarget: call-type=REGULAR
    Rte_Call_Asw_Swc_RPort_NVDataBlock1_SetRamBlockStatus: call-type=REGULAR
    Rte_Call_Asw_Swc_RPort_NVDataBlock1_WriteBlock: call-type=REGULAR
    Rte_Call_Asw_Swc_Rtc_DisableRTCWakeup_flg: call-type=REGULAR
    Rte_Call_Asw_Swc_Rtc_ReadRTCTime: call-type=REGULAR
    Rte_Call_Asw_Swc_Rtc_SetSleepTime_Min: call-type=REGULAR
    Rte_Call_Asw_Swc_Rtc_WriteRTCTime: call-type=REGULAR
    Rte_Call_NvM_NVDataBlock1_Finished_JobFinished: call-type=REGULAR
    Rte_Call_WdgM_SWC_RPort_AliveSupervision_Asw_5ms_CheckpointReached: call-type=REGULAR
    Rte_Call_WdgM_SWC_RPort_AliveSupervision_Bsw_1000ms_CheckpointReached: call-type=REGULAR
    Rte_Call_WdgM_SWC_RPort_AliveSupervision_Bsw_100ms_CheckpointReached: call-type=REGULAR
    Rte_Call_WdgM_SWC_RPort_AliveSupervision_Bsw_10ms_CheckpointReached: call-type=REGULAR
    Rte_Call_WdgM_SWC_RPort_AliveSupervision_Bsw_20ms_CheckpointReached: call-type=REGULAR
    Rte_Call_WdgM_SWC_RPort_AliveSupervision_Bsw_50ms_CheckpointReached: call-type=REGULAR
    Rte_Call_WdgM_SWC_RPort_AliveSupervision_Bsw_5ms_CheckpointReached: call-type=REGULAR
    Rte_DecrementWaitingCount: call-type=REGULAR
    Rte_GetCurrentTaskIndex: call-type=REGULAR
    Rte_MainFunction: call-type=REGULAR
    Rte_ReadQueue: call-type=REGULAR
    Rte_Read_Asw_Swc_CCS_CHG_CCS_SPN3081_U_Out: call-type=REGULAR
    Rte_Read_Asw_Swc_CCS_CHG_CCS_SPN3082_I_Out: call-type=REGULAR
    Rte_Read_Asw_Swc_CCS_CHG_CCS_SPN3083_Time_Charged: call-type=REGULAR
    Rte_Read_Asw_Swc_CCS_CHG_CCS_SPN3929_Chg_enable: call-type=REGULAR
    Rte_Read_Asw_Swc_CEM_CHG_CEM_SPN3921_Timeout_BRM: call-type=REGULAR
    Rte_Read_Asw_Swc_CEM_CHG_CEM_SPN3922_Timeout_BCP: call-type=REGULAR
    Rte_Read_Asw_Swc_CEM_CHG_CEM_SPN3923_Timeout_BRO: call-type=REGULAR
    Rte_Read_Asw_Swc_CEM_CHG_CEM_SPN3924_Timeout_BCS: call-type=REGULAR
    Rte_Read_Asw_Swc_CEM_CHG_CEM_SPN3925_Timeout_BCL: call-type=REGULAR
    Rte_Read_Asw_Swc_CEM_CHG_CEM_SPN3926_Timeout_BST: call-type=REGULAR
    Rte_Read_Asw_Swc_CEM_CHG_CEM_SPN3927_Timeout_BSD: call-type=REGULAR
    Rte_Read_Asw_Swc_CEM_CHG_CEM_other: call-type=REGULAR
    Rte_Read_Asw_Swc_CHM_CHG_CHM_SPN2600_Comm_Ver: call-type=REGULAR
    Rte_Read_Asw_Swc_CML_CHG_CML_SPN2824_U_Max_Out: call-type=REGULAR
    Rte_Read_Asw_Swc_CML_CHG_CML_SPN2825_U_Min_Out: call-type=REGULAR
    Rte_Read_Asw_Swc_CML_CHG_CML_SPN2826_I_Max_Out: call-type=REGULAR
    Rte_Read_Asw_Swc_CML_CHG_CML_SPN2827_I_Min_Out: call-type=REGULAR
    Rte_Read_Asw_Swc_CRM_CHG_CRM_SPN2560_Ack: call-type=REGULAR
    Rte_Read_Asw_Swc_CRM_CHG_CRM_SPN2561_CHG_Index: call-type=REGULAR
    Rte_Read_Asw_Swc_CRM_CHG_CRM_SPN2562_CHG_Loc: call-type=REGULAR
    Rte_Read_Asw_Swc_CRO_CHG_CRO_SPN2830_CHG_Ready: call-type=REGULAR
    Rte_Read_Asw_Swc_CSD_CHG_CSD_SPN3611_Time_Charged: call-type=REGULAR
    Rte_Read_Asw_Swc_CSD_CHG_CSD_SPN3612_E_Out: call-type=REGULAR
    Rte_Read_Asw_Swc_CSD_CHG_CSD_SPN3613_CHG_Index: call-type=REGULAR
    Rte_Read_Asw_Swc_CST_CHG_CST_SPN3521_Stop_Reason_Auto: call-type=REGULAR
    Rte_Read_Asw_Swc_CST_CHG_CST_SPN3521_Stop_Reason_BMSStop: call-type=REGULAR
    Rte_Read_Asw_Swc_CST_CHG_CST_SPN3521_Stop_Reason_Fault: call-type=REGULAR
    Rte_Read_Asw_Swc_CST_CHG_CST_SPN3521_Stop_Reason_Manual: call-type=REGULAR
    Rte_Read_Asw_Swc_CST_CHG_CST_SPN3522_Stop_Fault_CHGCnnt: call-type=REGULAR
    Rte_Read_Asw_Swc_CST_CHG_CST_SPN3522_Stop_Fault_Deliver: call-type=REGULAR
    Rte_Read_Asw_Swc_CST_CHG_CST_SPN3522_Stop_Fault_EmerStop: call-type=REGULAR
    Rte_Read_Asw_Swc_CST_CHG_CST_SPN3522_Stop_Fault_Other: call-type=REGULAR
    Rte_Read_Asw_Swc_CST_CHG_CST_SPN3522_Stop_Fault_T_CHG: call-type=REGULAR
    Rte_Read_Asw_Swc_CST_CHG_CST_SPN3522_Stop_Fault_T_Inter: call-type=REGULAR
    Rte_Read_Asw_Swc_CST_CHG_CST_SPN3523_Stop_Fault_Mismatch: call-type=REGULAR
    Rte_Read_Asw_Swc_CST_CHG_CST_SPN3523_Stop_Fault_U: call-type=REGULAR
    Rte_Read_Asw_Swc_CTS_CHG_CTS_SPN2823_SYNC_Day: call-type=REGULAR
    Rte_Read_Asw_Swc_CTS_CHG_CTS_SPN2823_SYNC_DayTen: call-type=REGULAR
    Rte_Read_Asw_Swc_CTS_CHG_CTS_SPN2823_SYNC_Hour: call-type=REGULAR
    Rte_Read_Asw_Swc_CTS_CHG_CTS_SPN2823_SYNC_HourTen: call-type=REGULAR
    Rte_Read_Asw_Swc_CTS_CHG_CTS_SPN2823_SYNC_Minute: call-type=REGULAR
    Rte_Read_Asw_Swc_CTS_CHG_CTS_SPN2823_SYNC_MinuteTen: call-type=REGULAR
    Rte_Read_Asw_Swc_CTS_CHG_CTS_SPN2823_SYNC_Month: call-type=REGULAR
    Rte_Read_Asw_Swc_CTS_CHG_CTS_SPN2823_SYNC_MonthTen: call-type=REGULAR
    Rte_Read_Asw_Swc_CTS_CHG_CTS_SPN2823_SYNC_Second: call-type=REGULAR
    Rte_Read_Asw_Swc_CTS_CHG_CTS_SPN2823_SYNC_SecondTen: call-type=REGULAR
    Rte_Read_Asw_Swc_CTS_CHG_CTS_SPN2823_SYNC_Year: call-type=REGULAR
    Rte_Read_Asw_Swc_CTS_CHG_CTS_SPN2823_SYNC_YearHundred: call-type=REGULAR
    Rte_Read_Asw_Swc_CTS_CHG_CTS_SPN2823_SYNC_YearTen: call-type=REGULAR
    Rte_Read_Asw_Swc_CTS_CHG_CTS_SPN2823_SYNC_YearThousand: call-type=REGULAR
    Rte_Read_Asw_Swc_ChargeValue_CC2VoltVld_flg: call-type=REGULAR
    Rte_Read_Asw_Swc_ChargeValue_CC2Volt_V: call-type=REGULAR
    Rte_Read_Asw_Swc_ChargeValue_CCResVld_flg: call-type=REGULAR
    Rte_Read_Asw_Swc_ChargeValue_CCRes_ohm: call-type=REGULAR
    Rte_Read_Asw_Swc_ChargeValue_CPDutyVld_flg: call-type=REGULAR
    Rte_Read_Asw_Swc_ChargeValue_CPDuty_pct: call-type=REGULAR
    Rte_Read_Asw_Swc_ChargeValue_CPFrqVld_flg: call-type=REGULAR
    Rte_Read_Asw_Swc_ChargeValue_CPFrq_Hz: call-type=REGULAR
    Rte_Read_Asw_Swc_ChargeValue_CPVoltVld_flg: call-type=REGULAR
    Rte_Read_Asw_Swc_ChargeValue_CPVolt_V: call-type=REGULAR
    Rte_Read_Asw_Swc_ChargeValue_DCWakeupVoltVld_flg: call-type=REGULAR
    Rte_Read_Asw_Swc_ChargeValue_DCWakeupVolt_V: call-type=REGULAR
    Rte_Read_Asw_Swc_ChargeValue_ELockDiagVoltVld_flg: call-type=REGULAR
    Rte_Read_Asw_Swc_ChargeValue_ELockDiagVolt_V: call-type=REGULAR
    Rte_Read_Asw_Swc_ChargeValue_LampCcHDiagVoltVld_flg: call-type=REGULAR
    Rte_Read_Asw_Swc_ChargeValue_LampCcHDiagVolt_V: call-type=REGULAR
    Rte_Read_Asw_Swc_ChargeValue_LampChgHDiagVoltVld_flg: call-type=REGULAR
    Rte_Read_Asw_Swc_ChargeValue_LampChgHDiagVolt_V: call-type=REGULAR
    Rte_Read_Asw_Swc_CmuValue_BalOpenLoadDiagStatus_flg: call-type=REGULAR
    Rte_Read_Asw_Swc_CmuValue_CMUPwrDiagVoltVld_flg: call-type=REGULAR
    Rte_Read_Asw_Swc_CmuValue_CMUPwrDiagVolt_V: call-type=REGULAR
    Rte_Read_Asw_Swc_CmuValue_CellLeakageDiagStatus_flg: call-type=REGULAR
    Rte_Read_Asw_Swc_CmuValue_ChanelFuncDiagStatus_flg: call-type=REGULAR
    Rte_Read_Asw_Swc_CmuValue_CmuReCfgStatus_flg: call-type=REGULAR
    Rte_Read_Asw_Swc_CmuValue_CtxOpenDiagStatus_flg: call-type=REGULAR
    Rte_Read_Asw_Swc_CmuValue_GpioOTUTFuncDiagStatus_flg: call-type=REGULAR
    Rte_Read_Asw_Swc_CmuValue_GpioxOpenDiagStatus_flg: call-type=REGULAR
    Rte_Read_Asw_Swc_CmuValue_InCMUHWAlarmPWMDutyVld_flg: call-type=REGULAR
    Rte_Read_Asw_Swc_CmuValue_InCMUHWAlarmPWMDuty_pct: call-type=REGULAR
    Rte_Read_Asw_Swc_CmuValue_InCMUHWAlarmPWMFeqVld_flg: call-type=REGULAR
    Rte_Read_Asw_Swc_CmuValue_InCMUHWAlarmPWMFeq_Hz: call-type=REGULAR
    Rte_Read_Asw_Swc_CrashValue_CrashPWMDutyVld_flg: call-type=REGULAR
    Rte_Read_Asw_Swc_CrashValue_CrashPWMDuty_pct: call-type=REGULAR
    Rte_Read_Asw_Swc_CrashValue_CrashPWMFrqVld_flg: call-type=REGULAR
    Rte_Read_Asw_Swc_CrashValue_CrashPWMFrq_Hz: call-type=REGULAR
    Rte_Read_Asw_Swc_CurrValue_HallCH1RedVoltVld_flg: call-type=REGULAR
    Rte_Read_Asw_Swc_CurrValue_HallCH1RedVolt_V: call-type=REGULAR
    Rte_Read_Asw_Swc_CurrValue_HallCH1VoltVld_flg: call-type=REGULAR
    Rte_Read_Asw_Swc_CurrValue_HallCH1Volt_V: call-type=REGULAR
    Rte_Read_Asw_Swc_CurrValue_HallCH2RedVoltVld_flg: call-type=REGULAR
    Rte_Read_Asw_Swc_CurrValue_HallCH2RedVolt_V: call-type=REGULAR
    Rte_Read_Asw_Swc_CurrValue_HallCH2VoltVld_flg: call-type=REGULAR
    Rte_Read_Asw_Swc_CurrValue_HallCH2Volt_V: call-type=REGULAR
    Rte_Read_Asw_Swc_CurrValue_HallSpyVoltVld_flg: call-type=REGULAR
    Rte_Read_Asw_Swc_CurrValue_HallSpyVolt_V: call-type=REGULAR
    Rte_Read_Asw_Swc_CurrValue_PackCurrRedVld_flg: call-type=REGULAR
    Rte_Read_Asw_Swc_CurrValue_PackCurrRed_A: call-type=REGULAR
    Rte_Read_Asw_Swc_CurrValue_PackCurrVld_flg: call-type=REGULAR
    Rte_Read_Asw_Swc_CurrValue_PackCurr_A: call-type=REGULAR
    Rte_Read_Asw_Swc_DCDC_303h_CDU_HVILWarning: call-type=REGULAR
    Rte_Read_Asw_Swc_DCDC_303h_I_LDC_In: call-type=REGULAR
    Rte_Read_Asw_Swc_HighVoltValue_P1CheckVoltVld_flg: call-type=REGULAR
    Rte_Read_Asw_Swc_HighVoltValue_P1CheckVolt_V: call-type=REGULAR
    Rte_Read_Asw_Swc_HighVoltValue_P2CheckVoltVld_flg: call-type=REGULAR
    Rte_Read_Asw_Swc_HighVoltValue_P2CheckVolt_V: call-type=REGULAR
    Rte_Read_Asw_Swc_HighVoltValue_P3CheckVoltVld_flg: call-type=REGULAR
    Rte_Read_Asw_Swc_HighVoltValue_P3CheckVolt_V: call-type=REGULAR
    Rte_Read_Asw_Swc_HighVoltValue_PackVoltVld_flg: call-type=REGULAR
    Rte_Read_Asw_Swc_HighVoltValue_PackVolt_V: call-type=REGULAR
    Rte_Read_Asw_Swc_HighVoltValue_PreChgCheckRedVoltVld_flg: call-type=REGULAR
    Rte_Read_Asw_Swc_HighVoltValue_PreChgCheckRedVolt_V: call-type=REGULAR
    Rte_Read_Asw_Swc_HighVoltValue_PreChgCheckVoltVld_flg: call-type=REGULAR
    Rte_Read_Asw_Swc_HighVoltValue_PreChgCheckVolt_V: call-type=REGULAR
    Rte_Read_Asw_Swc_HvilValue_HVILHighVoltVld_flg: call-type=REGULAR
    Rte_Read_Asw_Swc_HvilValue_HVILHighVolt_V: call-type=REGULAR
    Rte_Read_Asw_Swc_HvilValue_HVILLowVoltVld_flg: call-type=REGULAR
    Rte_Read_Asw_Swc_HvilValue_HVILLowVolt_V: call-type=REGULAR
    Rte_Read_Asw_Swc_HvilValue_InHVILPWMDutyVld_flg: call-type=REGULAR
    Rte_Read_Asw_Swc_HvilValue_InHVILPWMDuty_pct: call-type=REGULAR
    Rte_Read_Asw_Swc_HvilValue_InHVILPWMFrqVld_flg: call-type=REGULAR
    Rte_Read_Asw_Swc_HvilValue_InHVILPWMFrq_Hz: call-type=REGULAR
    Rte_Read_Asw_Swc_IsoValue_HVIsoNegVoltVld_flg: call-type=REGULAR
    Rte_Read_Asw_Swc_IsoValue_HVIsoNegVolt_V: call-type=REGULAR
    Rte_Read_Asw_Swc_IsoValue_HVIsoPosVoltVld_flg: call-type=REGULAR
    Rte_Read_Asw_Swc_IsoValue_HVIsoPosVolt_V: call-type=REGULAR
    Rte_Read_Asw_Swc_McuValue_BSWInitFinish_flg: call-type=REGULAR
    Rte_Read_Asw_Swc_OBC_604h_OBCChgCurrent: call-type=REGULAR
    Rte_Read_Asw_Swc_OBC_604h_OBCChgVolt: call-type=REGULAR
    Rte_Read_Asw_Swc_OBC_604h_OBCCurrentFltCode: call-type=REGULAR
    Rte_Read_Asw_Swc_OBC_604h_OBCHistoryFltCode: call-type=REGULAR
    Rte_Read_Asw_Swc_OBC_604h_OBCMaxChrgCurrent: call-type=REGULAR
    Rte_Read_Asw_Swc_OBC_604h_OBCMaxChrgVoltage: call-type=REGULAR
    Rte_Read_Asw_Swc_OBC_604h_OBCStatus: call-type=REGULAR
    Rte_Read_Asw_Swc_PEU_0B4h_V_DC: call-type=REGULAR
    Rte_Read_Asw_Swc_PEU_0B4h_V_DCValidity: call-type=REGULAR
    Rte_Read_Asw_Swc_PEU_18Bh_InvADCCrnt: call-type=REGULAR
    Rte_Read_Asw_Swc_PEU_18Bh_InvADCCrntV: call-type=REGULAR
    Rte_Read_Asw_Swc_PowerValue_BmuPullupSwitchDiag_flg: call-type=REGULAR
    Rte_Read_Asw_Swc_PowerValue_BmuPullupVoltVld_flg: call-type=REGULAR
    Rte_Read_Asw_Swc_PowerValue_BmuPullupVolt_V: call-type=REGULAR
    Rte_Read_Asw_Swc_PowerValue_KL15VoltVld_flg: call-type=REGULAR
    Rte_Read_Asw_Swc_PowerValue_KL15Volt_V: call-type=REGULAR
    Rte_Read_Asw_Swc_PowerValue_KL30VoltVld_flg: call-type=REGULAR
    Rte_Read_Asw_Swc_PowerValue_KL30Volt_V: call-type=REGULAR
    Rte_Read_Asw_Swc_PowerValue_KPowertVoltVld_flg: call-type=REGULAR
    Rte_Read_Asw_Swc_PowerValue_KPowertVolt_V: call-type=REGULAR
    Rte_Read_Asw_Swc_PowerValue_ResWakeUp1HVoltVld_flg: call-type=REGULAR
    Rte_Read_Asw_Swc_PowerValue_ResWakeUp1HVolt_V: call-type=REGULAR
    Rte_Read_Asw_Swc_PowerValue_ResWakeUp2HVoltVld_flg: call-type=REGULAR
    Rte_Read_Asw_Swc_PowerValue_ResWakeUp2HVolt_V: call-type=REGULAR
    Rte_Read_Asw_Swc_PowerValue_ResWakeUp3LVoltVld_flg: call-type=REGULAR
    Rte_Read_Asw_Swc_PowerValue_ResWakeUp3LVolt_V: call-type=REGULAR
    Rte_Read_Asw_Swc_RelayValue_GlobalHsideDiagVoltVld_flg: call-type=REGULAR
    Rte_Read_Asw_Swc_RelayValue_GlobalHsideDiagVolt_V: call-type=REGULAR
    Rte_Read_Asw_Swc_RelayValue_GlobalHsideDriverVoltVld_flg: call-type=REGULAR
    Rte_Read_Asw_Swc_RelayValue_GlobalHsideDriverVolt_V: call-type=REGULAR
    Rte_Read_Asw_Swc_RelayValue_K1CtrDriverVoltVld_flg: call-type=REGULAR
    Rte_Read_Asw_Swc_RelayValue_K1CtrDriverVolt_V: call-type=REGULAR
    Rte_Read_Asw_Swc_RelayValue_K2CtrDriverVoltVld_flg: call-type=REGULAR
    Rte_Read_Asw_Swc_RelayValue_K2CtrDriverVolt_V: call-type=REGULAR
    Rte_Read_Asw_Swc_RelayValue_K3CtrDriverVoltVld_flg: call-type=REGULAR
    Rte_Read_Asw_Swc_RelayValue_K3CtrDriverVolt_V: call-type=REGULAR
    Rte_Read_Asw_Swc_RelayValue_K4CtrDriverVoltVld_flg: call-type=REGULAR
    Rte_Read_Asw_Swc_RelayValue_K4CtrDriverVolt_V: call-type=REGULAR
    Rte_Read_Asw_Swc_RelayValue_K5CtrDriverVoltVld_flg: call-type=REGULAR
    Rte_Read_Asw_Swc_RelayValue_K5CtrDriverVolt_V: call-type=REGULAR
    Rte_Read_Asw_Swc_RelayValue_K6CtrDriverVoltVld_flg: call-type=REGULAR
    Rte_Read_Asw_Swc_RelayValue_K6CtrDriverVolt_V: call-type=REGULAR
    Rte_Read_Asw_Swc_RelayValue_KnCtrDriverVoltVld_flg: call-type=REGULAR
    Rte_Read_Asw_Swc_RelayValue_KnCtrDriverVolt_V: call-type=REGULAR
    Rte_Read_Asw_Swc_RelayValue_KnchgEnOutState_flg: call-type=REGULAR
    Rte_Read_Asw_Swc_RelayValue_KnchgEnStateVld_flg: call-type=REGULAR
    Rte_Read_Asw_Swc_RelayValue_KpCtrDriverVoltVld_flg: call-type=REGULAR
    Rte_Read_Asw_Swc_RelayValue_KpCtrDriverVolt_V: call-type=REGULAR
    Rte_Read_Asw_Swc_RelayValue_KpEnOutState_flg: call-type=REGULAR
    Rte_Read_Asw_Swc_RelayValue_KpEnStateVld_flg: call-type=REGULAR
    Rte_Read_Asw_Swc_RsvValue_InRsvPWMDutyVld_flg: call-type=REGULAR
    Rte_Read_Asw_Swc_RsvValue_InRsvPWMDuty_pct: call-type=REGULAR
    Rte_Read_Asw_Swc_RsvValue_InRsvPWMFrqVld_flg: call-type=REGULAR
    Rte_Read_Asw_Swc_RsvValue_InRsvPWMFrq_Hz: call-type=REGULAR
    Rte_Read_Asw_Swc_RsvValue_RsvAD1VoltVld_flg: call-type=REGULAR
    Rte_Read_Asw_Swc_RsvValue_RsvAD1Volt_V: call-type=REGULAR
    Rte_Read_Asw_Swc_RsvValue_RsvAD2VoltVld_flg: call-type=REGULAR
    Rte_Read_Asw_Swc_RsvValue_RsvAD2Volt_V: call-type=REGULAR
    Rte_Read_Asw_Swc_RsvValue_RsvAD3VoltVld_flg: call-type=REGULAR
    Rte_Read_Asw_Swc_RsvValue_RsvAD3Volt_V: call-type=REGULAR
    Rte_Read_Asw_Swc_RsvValue_RsvAD4VoltVld_flg: call-type=REGULAR
    Rte_Read_Asw_Swc_RsvValue_RsvAD4Volt_V: call-type=REGULAR
    Rte_Read_Asw_Swc_RsvValue_RsvAD5VoltVld_flg: call-type=REGULAR
    Rte_Read_Asw_Swc_RsvValue_RsvAD5Volt_V: call-type=REGULAR
    Rte_Read_Asw_Swc_SbcValue_BMULastPwrDownState: call-type=REGULAR
    Rte_Read_Asw_Swc_SbcValue_BmuSbcCanTRSt_flg: call-type=REGULAR
    Rte_Read_Asw_Swc_SbcValue_BmuSbcRstbPinSt_flg: call-type=REGULAR
    Rte_Read_Asw_Swc_SbcValue_BmuSbcVauxOV_flg: call-type=REGULAR
    Rte_Read_Asw_Swc_SbcValue_BmuSbcVauxUV_flg: call-type=REGULAR
    Rte_Read_Asw_Swc_SbcValue_BmuSbcVcanOV_flg: call-type=REGULAR
    Rte_Read_Asw_Swc_SbcValue_BmuSbcVcanUV_flg: call-type=REGULAR
    Rte_Read_Asw_Swc_SbcValue_BmuSbcVccaOV_flg: call-type=REGULAR
    Rte_Read_Asw_Swc_SbcValue_BmuSbcVccaUV_flg: call-type=REGULAR
    Rte_Read_Asw_Swc_SbcValue_BmuSbcVcoreOV_flg: call-type=REGULAR
    Rte_Read_Asw_Swc_SbcValue_BmuSbcVpreOV_flg: call-type=REGULAR
    Rte_Read_Asw_Swc_SbcValue_BmuSbcVpreUV_flg: call-type=REGULAR
    Rte_Read_Asw_Swc_SbcValue_BmuSbxVcoreUV_flg: call-type=REGULAR
    Rte_Read_Asw_Swc_SbcValue_CANWakeupState_flg: call-type=REGULAR
    Rte_Read_Asw_Swc_SbcValue_KL15WakeupState_flg: call-type=REGULAR
    Rte_Read_Asw_Swc_SbcValue_RTCWakeupState_flg: call-type=REGULAR
    Rte_Read_Asw_Swc_SbcValue_SBCWakeupP{1..3}State_flg: call-type=REGULAR
    Rte_Read_Asw_Swc_ThermalValue_BmuTemp1NtcVld_flg: call-type=REGULAR
    Rte_Read_Asw_Swc_ThermalValue_BmuTemp1Ntc_Ohm: call-type=REGULAR
    Rte_Read_Asw_Swc_ThermalValue_BmuTemp2NtcVld_flg: call-type=REGULAR
    Rte_Read_Asw_Swc_ThermalValue_BmuTemp2Ntc_Ohm: call-type=REGULAR
    Rte_Read_Asw_Swc_ThermalValue_BmuTemp3NtcVld_flg: call-type=REGULAR
    Rte_Read_Asw_Swc_ThermalValue_BmuTemp3Ntc_Ohm: call-type=REGULAR
    Rte_Read_Asw_Swc_ThermalValue_BmuTemp4NtcVld_flg: call-type=REGULAR
    Rte_Read_Asw_Swc_ThermalValue_BmuTemp4Ntc_Ohm: call-type=REGULAR
    Rte_Read_Asw_Swc_ThermalValue_BmuTemp5NtcVld_flg: call-type=REGULAR
    Rte_Read_Asw_Swc_ThermalValue_BmuTemp5Ntc_Ohm: call-type=REGULAR
    Rte_Read_Asw_Swc_ThermalValue_BmuTemp6NtcVld_flg: call-type=REGULAR
    Rte_Read_Asw_Swc_ThermalValue_BmuTemp6Ntc_Ohm: call-type=REGULAR
    Rte_Read_Asw_Swc_ThermalValue_BmuTemp7NtcVld_flg: call-type=REGULAR
    Rte_Read_Asw_Swc_ThermalValue_BmuTemp7Ntc_Ohm: call-type=REGULAR
    Rte_Read_Asw_Swc_ThermalValue_InCoolPumpPWMDutyVld_flg: call-type=REGULAR
    Rte_Read_Asw_Swc_ThermalValue_InCoolPumpPWMDuty_Pct: call-type=REGULAR
    Rte_Read_Asw_Swc_ThermalValue_InCoolPumpPWMFrqVld_flg: call-type=REGULAR
    Rte_Read_Asw_Swc_ThermalValue_InCoolPumpPWMFrq_Hz: call-type=REGULAR
    Rte_Read_Asw_Swc_ThermalValue_InFanPWMDutyVld_flg: call-type=REGULAR
    Rte_Read_Asw_Swc_ThermalValue_InFanPWMDuty_Pct: call-type=REGULAR
    Rte_Read_Asw_Swc_ThermalValue_InFanPWMFrqVld_flg: call-type=REGULAR
    Rte_Read_Asw_Swc_ThermalValue_InFanPWMFrq_Hz: call-type=REGULAR
    Rte_Read_Asw_Swc_ThermalValue_ValveDiagVoltVld_flg: call-type=REGULAR
    Rte_Read_Asw_Swc_ThermalValue_ValveDiagVolt_V: call-type=REGULAR
    Rte_Read_Asw_Swc_VCU_1E3h_CheckSum_1E3h: call-type=REGULAR
    Rte_Read_Asw_Swc_VCU_1E3h_ChrgrStatPTHVCntctOpnrAlwd: call-type=REGULAR
    Rte_Read_Asw_Swc_VCU_1E3h_ChrgrStatPTHVCntctrClsAlwd: call-type=REGULAR
    Rte_Read_Asw_Swc_VCU_1E3h_PTHVCntctrReq: call-type=REGULAR
    Rte_Read_Asw_Swc_VCU_1E3h_RollingCounter_1E3h: call-type=REGULAR
    Rte_Read_Asw_Swc_VCU_353h_VehSpdAvgDrvn: call-type=REGULAR
    Rte_Read_Asw_Swc_VCU_353h_VehSpdAvgDrvnV: call-type=REGULAR
    Rte_Read_Asw_Swc_VCU_ABS_23Ch_CheckSum_23Ch: call-type=REGULAR
    Rte_Read_Asw_Swc_VCU_ABS_23Ch_MessageCounter_23Ch: call-type=REGULAR
    Rte_Read_Asw_Swc_VCU_ABS_23Ch_VehicleSpeed: call-type=REGULAR
    Rte_Read_Asw_Swc_VCU_ABS_23Ch_VehicleSpeedStatus: call-type=REGULAR
    Rte_Read_Asw_Swc_VCU_BCM_1F1h_SysOpnlMd: call-type=REGULAR
    Rte_Read_Asw_Swc_VCU_BCM_1F1h_SysPwrMd: call-type=REGULAR
    Rte_Read_Asw_Swc_VCU_BCM_1F1h_SysVol: call-type=REGULAR
    Rte_Read_Asw_Swc_VCU_BCM_1F1h_SysVolMd: call-type=REGULAR
    Rte_Read_Asw_Swc_VCU_BCM_1F1h_SysVolMdV: call-type=REGULAR
    Rte_Read_Asw_Swc_VCU_BCM_1F1h_SysVolV: call-type=REGULAR
    Rte_Read_Asw_Swc_VCU_HCM_55Fh_FrontCmprElctrCrnt: call-type=REGULAR
    Rte_Read_Asw_Swc_VCU_HCM_55Fh_FrontCompStatFdbck: call-type=REGULAR
    Rte_Read_Asw_Swc_VCU_HCM_55Fh_FrontPTCElctrCrnt: call-type=REGULAR
    Rte_Read_Asw_Swc_VCU_HCM_55Fh_FrontPTCStatFdbck: call-type=REGULAR
    Rte_Read_Asw_Swc_VCU_IPK_1F2h_SysBPM: call-type=REGULAR
    Rte_Read_Asw_Swc_VCU_IPK_1F2h_SysBPMEnbd: call-type=REGULAR
    Rte_Read_Asw_Swc_VCU_IPK_362h_HighPreVehOdo: call-type=REGULAR
    Rte_Read_Asw_Swc_VCU_IPK_362h_HighPreVehOdoV: call-type=REGULAR
    Rte_Read_Asw_Swc_VCU_SRS_163h_RollingCounter: call-type=REGULAR
    Rte_Read_Asw_Swc_VCU_SRS_163h_SRSCheckSum: call-type=REGULAR
    Rte_Read_Asw_Swc_VCU_SRS_163h_VehCrshTyp: call-type=REGULAR
    Rte_Read_BswM_RP_BswMArbitration_BswM_MRP_SwcModeRequest_VDP_uint16: call-type=REGULAR
    Rte_Read_Cmu_Cdd_CmuCmd_BalOpenLoadDiagCmd_flg: call-type=REGULAR
    Rte_Read_Cmu_Cdd_CmuCmd_CMUPwrCmd_flg: call-type=REGULAR
    Rte_Read_Cmu_Cdd_CmuCmd_CellLeakageDiagCmd_flg: call-type=REGULAR
    Rte_Read_Cmu_Cdd_CmuCmd_CellMeasCmd_flg: call-type=REGULAR
    Rte_Read_Cmu_Cdd_CmuCmd_ChanelFuncDiagCmd_flg: call-type=REGULAR
    Rte_Read_Cmu_Cdd_CmuCmd_CmuClrFaultPin_flg: call-type=REGULAR
    Rte_Read_Cmu_Cdd_CmuCmd_CmuReCfg_flg: call-type=REGULAR
    Rte_Read_Cmu_Cdd_CmuCmd_CtxOpenDiagCmd_flg: call-type=REGULAR
    Rte_Read_Cmu_Cdd_CmuCmd_GpioOTUTFuncDiagCmd_flg: call-type=REGULAR
    Rte_Read_Cmu_Cdd_CmuCmd_GpioxOpenDiagCmd_flg: call-type=REGULAR
    Rte_Read_Cmu_Cdd_CmuCmd_OutCMUHWAlarmPWMDuty_Pct: call-type=REGULAR
    Rte_Read_IoHwAb_ChargeCmd_ACS2Cmd_flg: call-type=REGULAR
    Rte_Read_IoHwAb_ChargeCmd_ELockCtrlCmd_enum: call-type=REGULAR
    Rte_Read_IoHwAb_ChargeCmd_ELockSel0Cmd_flg: call-type=REGULAR
    Rte_Read_IoHwAb_ChargeCmd_LampCcHCmd_flg: call-type=REGULAR
    Rte_Read_IoHwAb_ChargeCmd_LampChgHCmd_flg: call-type=REGULAR
    Rte_Read_IoHwAb_FblCmd_FBLForbid_flg: call-type=REGULAR
    Rte_Read_IoHwAb_HighVoltCmd_PackVoltMeasCmd_flg: call-type=REGULAR
    Rte_Read_IoHwAb_HvilCmd_OutHVILPWMDuty_Pct: call-type=REGULAR
    Rte_Read_IoHwAb_IsoCmd_HVIsoNegMosCmd_flg: call-type=REGULAR
    Rte_Read_IoHwAb_IsoCmd_HVIsoPosMosCmd_flg: call-type=REGULAR
    Rte_Read_IoHwAb_McuCmd_RadyToSleep_flg: call-type=REGULAR
    Rte_Read_IoHwAb_RelayCmd_GlobalHCtrCmd_flg: call-type=REGULAR
    Rte_Read_IoHwAb_RelayCmd_K{1..6}CtrCmd_flg: call-type=REGULAR
    Rte_Read_IoHwAb_RelayCmd_KnCtrlCmd_flg: call-type=REGULAR
    Rte_Read_IoHwAb_RelayCmd_KpCtrlCmd_flg: call-type=REGULAR
    Rte_Read_IoHwAb_ThermalCmd_OutCoolPumpPWMDuty_Pct: call-type=REGULAR
    Rte_Read_IoHwAb_ThermalCmd_OutFanPWMDuty_Pct: call-type=REGULAR
    Rte_Read_IoHwAb_ThermalCmd_ValveEn_flg: call-type=REGULAR
    Rte_Read_Sbc_Cdd_SbcCmd_CANWakeupEnable_flg: call-type=REGULAR
    Rte_SetEvent: call-type=REGULAR
    Rte_Start: call-type=REGULAR
    Rte_StartHook_Return: call-type=CALLBACK
    Rte_StartHook_Start: call-type=CALLBACK
    Rte_Stop: call-type=REGULAR
    Rte_StopHook_Return: call-type=CALLBACK
    Rte_StopHook_Start: call-type=CALLBACK
    Rte_SwitchAck_WdgM_globalMode_currentMode: call-type=REGULAR
    Rte_SwitchAck_WdgM_mode_WdgMAliveSupervisedEntity_Asw_5ms_currentMode: call-type=REGULAR
    Rte_SwitchAck_WdgM_mode_WdgMAliveSupervisedEntity_Bsw_1000ms_currentMode: call-type=REGULAR
    Rte_SwitchAck_WdgM_mode_WdgMAliveSupervisedEntity_Bsw_100ms_currentMode: call-type=REGULAR
    Rte_SwitchAck_WdgM_mode_WdgMAliveSupervisedEntity_Bsw_10ms_currentMode: call-type=REGULAR
    Rte_SwitchAck_WdgM_mode_WdgMAliveSupervisedEntity_Bsw_20ms_currentMode: call-type=REGULAR
    Rte_SwitchAck_WdgM_mode_WdgMAliveSupervisedEntity_Bsw_50ms_currentMode: call-type=REGULAR
    Rte_SwitchAck_WdgM_mode_WdgMAliveSupervisedEntity_Bsw_5ms_currentMode: call-type=REGULAR
    Rte_Switch_ComM_UM_ComMUser_Can_Network_0_Channel_currentMode: call-type=REGULAR
    Rte_Switch_WdgM_globalMode_currentMode: call-type=REGULAR
    Rte_Switch_WdgM_mode_WdgMAliveSupervisedEntity_Asw_5ms_currentMode: call-type=REGULAR
    Rte_Switch_WdgM_mode_WdgMAliveSupervisedEntity_Bsw_1000ms_currentMode: call-type=REGULAR
    Rte_Switch_WdgM_mode_WdgMAliveSupervisedEntity_Bsw_100ms_currentMode: call-type=REGULAR
    Rte_Switch_WdgM_mode_WdgMAliveSupervisedEntity_Bsw_10ms_currentMode: call-type=REGULAR
    Rte_Switch_WdgM_mode_WdgMAliveSupervisedEntity_Bsw_20ms_currentMode: call-type=REGULAR
    Rte_Switch_WdgM_mode_WdgMAliveSupervisedEntity_Bsw_50ms_currentMode: call-type=REGULAR
    Rte_Switch_WdgM_mode_WdgMAliveSupervisedEntity_Bsw_5ms_currentMode: call-type=REGULAR
    Rte_Task_Activate: call-type=CALLBACK
    Rte_WaitWithTimeout: call-type=REGULAR
    Rte_WriteQueue: call-type=REGULAR
    Rte_Write_Asw_Swc_BCL_BCU_BCL_SPN3072_U_Req: call-type=REGULAR
    Rte_Write_Asw_Swc_BCL_BCU_BCL_SPN3073_I_Req: call-type=REGULAR
    Rte_Write_Asw_Swc_BCL_BCU_BCL_SPN3074_ChgMode: call-type=REGULAR
    Rte_Write_Asw_Swc_BCP_BCU_BCP_SPN2816_Ucell_Max_Permit: call-type=REGULAR
    Rte_Write_Asw_Swc_BCP_BCU_BCP_SPN2817_I_Max_Permit: call-type=REGULAR
    Rte_Write_Asw_Swc_BCP_BCU_BCP_SPN2818_kWh_Nom: call-type=REGULAR
    Rte_Write_Asw_Swc_BCP_BCU_BCP_SPN2819_U_Max_Permit: call-type=REGULAR
    Rte_Write_Asw_Swc_BCP_BCU_BCP_SPN2820_T_Max_Permit: call-type=REGULAR
    Rte_Write_Asw_Swc_BCP_BCU_BCP_SPN2821_SOC: call-type=REGULAR
    Rte_Write_Asw_Swc_BCP_BCU_BCP_SPN2822_U: call-type=REGULAR
    Rte_Write_Asw_Swc_BCS_BCU_BCS_SPN3075_U_Mea: call-type=REGULAR
    Rte_Write_Asw_Swc_BCS_BCU_BCS_SPN3076_I_Mea: call-type=REGULAR
    Rte_Write_Asw_Swc_BCS_BCU_BCS_SPN3077_Ucell_Max: call-type=REGULAR
    Rte_Write_Asw_Swc_BCS_BCU_BCS_SPN3077_Ucell_Max_Grp: call-type=REGULAR
    Rte_Write_Asw_Swc_BCS_BCU_BCS_SPN3078_SOC: call-type=REGULAR
    Rte_Write_Asw_Swc_BCS_BCU_BCS_SPN3079_Time_Remain: call-type=REGULAR
    Rte_Write_Asw_Swc_BEM_BCU_BEM_SPN3901_Timeout_SPN2560_0x00: call-type=REGULAR
    Rte_Write_Asw_Swc_BEM_BCU_BEM_SPN3902_Timeout_SPN2560_0xAA: call-type=REGULAR
    Rte_Write_Asw_Swc_BEM_BCU_BEM_SPN3903_Timeout_CTS_CML: call-type=REGULAR
    Rte_Write_Asw_Swc_BEM_BCU_BEM_SPN3904_Timeout_CRO: call-type=REGULAR
    Rte_Write_Asw_Swc_BEM_BCU_BEM_SPN3905_Timeout_CCS: call-type=REGULAR
    Rte_Write_Asw_Swc_BEM_BCU_BEM_SPN3906_Timeout_CST: call-type=REGULAR
    Rte_Write_Asw_Swc_BEM_BCU_BEM_SPN3907_Timeout_CSD: call-type=REGULAR
    Rte_Write_Asw_Swc_BEM_BCU_BEM_other: call-type=REGULAR
    Rte_Write_Asw_Swc_BHM_BCU_BHM_SPN2601_Ubat_Max_Permit: call-type=REGULAR
    Rte_Write_Asw_Swc_BMS_1D8h_BMSlightReq: call-type=REGULAR
    Rte_Write_Asw_Swc_BMS_1D8h_ChrgrStatPTHVCntctrReq: call-type=REGULAR
    Rte_Write_Asw_Swc_BMS_1D8h_HVBatFltSevrtyStat: call-type=REGULAR
    Rte_Write_Asw_Swc_BMS_1D8h_HVBatPrcdCrnt: call-type=REGULAR
    Rte_Write_Asw_Swc_BMS_1D8h_HVBatPrcdCrntV: call-type=REGULAR
    Rte_Write_Asw_Swc_BMS_1D8h_HVCntctrStat: call-type=REGULAR
    Rte_Write_Asw_Swc_BMS_1D8h_HVCntctrStatARC: call-type=REGULAR
    Rte_Write_Asw_Swc_BMS_329h_CellTempMes{1..7}: call-type=REGULAR
    Rte_Write_Asw_Swc_BMS_329h_MesCellTempNumIndex: call-type=REGULAR
    Rte_Write_Asw_Swc_BMS_32Ah_Mes1CellBalState: call-type=REGULAR
    Rte_Write_Asw_Swc_BMS_32Ah_Mes1CellVolt: call-type=REGULAR
    Rte_Write_Asw_Swc_BMS_32Ah_Mes2CellBalState: call-type=REGULAR
    Rte_Write_Asw_Swc_BMS_32Ah_Mes2CellVolt: call-type=REGULAR
    Rte_Write_Asw_Swc_BMS_32Ah_Mes3CellBalState: call-type=REGULAR
    Rte_Write_Asw_Swc_BMS_32Ah_Mes3CellVolt: call-type=REGULAR
    Rte_Write_Asw_Swc_BMS_32Ah_MesCellVoltNumIndex: call-type=REGULAR
    Rte_Write_Asw_Swc_BMS_3D7h_HVBatPackPrcdVltg: call-type=REGULAR
    Rte_Write_Asw_Swc_BMS_3D7h_HVBatPackPrcdVltgV: call-type=REGULAR
    Rte_Write_Asw_Swc_BMS_3DAh_BMSChecksum_3DAh: call-type=REGULAR
    Rte_Write_Asw_Swc_BMS_3DAh_ChrgPeakTimeFactor: call-type=REGULAR
    Rte_Write_Asw_Swc_BMS_3DAh_HVBCP_CrnkChrgPwrV: call-type=REGULAR
    Rte_Write_Asw_Swc_BMS_3DAh_HVBCP_LngTrmChrgPwr: call-type=REGULAR
    Rte_Write_Asw_Swc_BMS_3DAh_HVBCP_ShrtTrmChrgPwr: call-type=REGULAR
    Rte_Write_Asw_Swc_BMS_3DBh_BMSChecksum_3DBh: call-type=REGULAR
    Rte_Write_Asw_Swc_BMS_3DBh_DischrgPeakTimeFactor: call-type=REGULAR
    Rte_Write_Asw_Swc_BMS_3DBh_HVBDP_CrnkDischrgPwrV: call-type=REGULAR
    Rte_Write_Asw_Swc_BMS_3DBh_HVBDP_LngTrmDischrgPwr: call-type=REGULAR
    Rte_Write_Asw_Swc_BMS_3DBh_HVBDP_ShrtTrmDischrgPwr: call-type=REGULAR
    Rte_Write_Asw_Swc_BMS_501h_BMSCelConsistencyWarning: call-type=REGULAR
    Rte_Write_Asw_Swc_BMS_501h_BMSVolHighWarning: call-type=REGULAR
    Rte_Write_Asw_Swc_BMS_501h_CellOvWarning: call-type=REGULAR
    Rte_Write_Asw_Swc_BMS_501h_CellUvWarning: call-type=REGULAR
    Rte_Write_Asw_Swc_BMS_501h_EnergyConsumptionPer: call-type=REGULAR
    Rte_Write_Asw_Swc_BMS_501h_HVILWarning: call-type=REGULAR
    Rte_Write_Asw_Swc_BMS_501h_HVIsoWarning: call-type=REGULAR
    Rte_Write_Asw_Swc_BMS_501h_PackOvWarning: call-type=REGULAR
    Rte_Write_Asw_Swc_BMS_501h_PackUvWarning: call-type=REGULAR
    Rte_Write_Asw_Swc_BMS_501h_PwrBatPackMismatchWarning: call-type=REGULAR
    Rte_Write_Asw_Swc_BMS_501h_RestEnergy: call-type=REGULAR
    Rte_Write_Asw_Swc_BMS_501h_SOCFastChgWarning: call-type=REGULAR
    Rte_Write_Asw_Swc_BMS_501h_SOCHighWarning: call-type=REGULAR
    Rte_Write_Asw_Swc_BMS_501h_SOCLowWarning: call-type=REGULAR
    Rte_Write_Asw_Swc_BMS_501h_TempDiffWarning: call-type=REGULAR
    Rte_Write_Asw_Swc_BMS_501h_TempHighWarning: call-type=REGULAR
    Rte_Write_Asw_Swc_BMS_501h_ThermalAlarm: call-type=REGULAR
    Rte_Write_Asw_Swc_BMS_501h_ThermalAlarmV: call-type=REGULAR
    Rte_Write_Asw_Swc_BMS_503h_BMSCellQuantity: call-type=REGULAR
    Rte_Write_Asw_Swc_BMS_503h_BMSTempProbeQuantity: call-type=REGULAR
    Rte_Write_Asw_Swc_BMS_503h_HVIsoValue: call-type=REGULAR
    Rte_Write_Asw_Swc_BMS_503h_RealSOC: call-type=REGULAR
    Rte_Write_Asw_Swc_BMS_509h_CurRechgEnergyStorSysIndex: call-type=REGULAR
    Rte_Write_Asw_Swc_BMS_509h_RechgEnergyStorSysCode{1..6}: call-type=REGULAR
    Rte_Write_Asw_Swc_BMS_509h_RechgEnergyStorSysCodeIndex: call-type=REGULAR
    Rte_Write_Asw_Swc_BMS_509h_RechgEnergyStorSysCodeLength: call-type=REGULAR
    Rte_Write_Asw_Swc_BMS_509h_RechgEnergyStorSysNumb: call-type=REGULAR
    Rte_Write_Asw_Swc_BMS_594h_HVBatPackAccVltg: call-type=REGULAR
    Rte_Write_Asw_Swc_BMS_594h_HVBatPackAccVltgV: call-type=REGULAR
    Rte_Write_Asw_Swc_BMS_594h_MaxCellVoltNumb: call-type=REGULAR
    Rte_Write_Asw_Swc_BMS_594h_MaxClVlt: call-type=REGULAR
    Rte_Write_Asw_Swc_BMS_594h_MinCellVoltNumb: call-type=REGULAR
    Rte_Write_Asw_Swc_BMS_594h_MinClVlt: call-type=REGULAR
    Rte_Write_Asw_Swc_BMS_596h_MaxBatTmp: call-type=REGULAR
    Rte_Write_Asw_Swc_BMS_596h_MaxCellTempNumb: call-type=REGULAR
    Rte_Write_Asw_Swc_BMS_596h_MinBatTmp: call-type=REGULAR
    Rte_Write_Asw_Swc_BMS_596h_MinCellTempNumb: call-type=REGULAR
    Rte_Write_Asw_Swc_BMS_598h_BMSChrgStatus: call-type=REGULAR
    Rte_Write_Asw_Swc_BMS_598h_BatLf: call-type=REGULAR
    Rte_Write_Asw_Swc_BMS_598h_ChrgPlugStatus: call-type=REGULAR
    Rte_Write_Asw_Swc_BMS_598h_HVSystemStatus: call-type=REGULAR
    Rte_Write_Asw_Swc_BMS_598h_PreChrgUnitRdy: call-type=REGULAR
    Rte_Write_Asw_Swc_BMS_598h_TotalBatteryCap: call-type=REGULAR
    Rte_Write_Asw_Swc_BMS_603h_ACChrgCurrRq: call-type=REGULAR
    Rte_Write_Asw_Swc_BMS_603h_ACChrgFault: call-type=REGULAR
    Rte_Write_Asw_Swc_BMS_603h_ACChrgMode: call-type=REGULAR
    Rte_Write_Asw_Swc_BMS_603h_ACChrgVoltRq: call-type=REGULAR
    Rte_Write_Asw_Swc_BMS_603h_CCVaule: call-type=REGULAR
    Rte_Write_Asw_Swc_BMS_603h_CPVaule: call-type=REGULAR
    Rte_Write_Asw_Swc_BMS_603h_S2_Status: call-type=REGULAR
    Rte_Write_Asw_Swc_BMS_605h_ChargingVoltage: call-type=REGULAR
    Rte_Write_Asw_Swc_BMS_605h_FullChargeRemainingTime: call-type=REGULAR
    Rte_Write_Asw_Swc_BMS_605h_RequestChargeCurrent: call-type=REGULAR
    Rte_Write_Asw_Swc_BMS_606h_BEM_CCS: call-type=REGULAR
    Rte_Write_Asw_Swc_BMS_606h_BEM_CML: call-type=REGULAR
    Rte_Write_Asw_Swc_BMS_606h_BEM_CRM00: call-type=REGULAR
    Rte_Write_Asw_Swc_BMS_606h_BEM_CRMAA: call-type=REGULAR
    Rte_Write_Asw_Swc_BMS_606h_BEM_CRO: call-type=REGULAR
    Rte_Write_Asw_Swc_BMS_606h_BEM_CSD: call-type=REGULAR
    Rte_Write_Asw_Swc_BMS_606h_BEM_CST: call-type=REGULAR
    Rte_Write_Asw_Swc_BMS_606h_BEM_Other: call-type=REGULAR
    Rte_Write_Asw_Swc_BMS_606h_BMSStopChargeFaultCode{1..8}: call-type=REGULAR
    Rte_Write_Asw_Swc_BMS_606h_CEM_BCL: call-type=REGULAR
    Rte_Write_Asw_Swc_BMS_606h_CEM_BCP: call-type=REGULAR
    Rte_Write_Asw_Swc_BMS_606h_CEM_BCS: call-type=REGULAR
    Rte_Write_Asw_Swc_BMS_606h_CEM_BRM: call-type=REGULAR
    Rte_Write_Asw_Swc_BMS_606h_CEM_BRO: call-type=REGULAR
    Rte_Write_Asw_Swc_BMS_606h_CEM_BSD: call-type=REGULAR
    Rte_Write_Asw_Swc_BMS_606h_CEM_BST: call-type=REGULAR
    Rte_Write_Asw_Swc_BMS_606h_CEM_Other: call-type=REGULAR
    Rte_Write_Asw_Swc_BMS_606h_CHGStopChargeFaultCode{1..8}: call-type=REGULAR
    Rte_Write_Asw_Swc_BMS_606h_StopChargingReson: call-type=REGULAR
    Rte_Write_Asw_Swc_BMS_795h_BMSDTCFailureTypeByte: call-type=REGULAR
    Rte_Write_Asw_Swc_BMS_795h_BMSDTCHighByte: call-type=REGULAR
    Rte_Write_Asw_Swc_BMS_795h_BMSDTCLowByte: call-type=REGULAR
    Rte_Write_Asw_Swc_BMS_795h_BMSDTCSeriousLevel: call-type=REGULAR
    Rte_Write_Asw_Swc_BMS_795h_BMSDTCStatus: call-type=REGULAR
    Rte_Write_Asw_Swc_BMS_795h_BMSDTCType: call-type=REGULAR
    Rte_Write_Asw_Swc_BRM_BCU_BRM_SPN2565_Ver: call-type=REGULAR
    Rte_Write_Asw_Swc_BRM_BCU_BRM_SPN2566_Bat_Type: call-type=REGULAR
    Rte_Write_Asw_Swc_BRM_BCU_BRM_SPN2567_Cap_Nom: call-type=REGULAR
    Rte_Write_Asw_Swc_BRM_BCU_BRM_SPN2568_U_Nom: call-type=REGULAR
    Rte_Write_Asw_Swc_BRM_BCU_BRM_SPN2569_BatFactory: call-type=REGULAR
    Rte_Write_Asw_Swc_BRM_BCU_BRM_SPN2570_PackSN: call-type=REGULAR
    Rte_Write_Asw_Swc_BRM_BCU_BRM_SPN2571_PackDay: call-type=REGULAR
    Rte_Write_Asw_Swc_BRM_BCU_BRM_SPN2571_PackMonth: call-type=REGULAR
    Rte_Write_Asw_Swc_BRM_BCU_BRM_SPN2571_PackYear: call-type=REGULAR
    Rte_Write_Asw_Swc_BRM_BCU_BRM_SPN2572_PackChgCnt: call-type=REGULAR
    Rte_Write_Asw_Swc_BRM_BCU_BRM_SPN2573_PackRight: call-type=REGULAR
    Rte_Write_Asw_Swc_BRM_BCU_BRM_SPN2574_BMSSW_Reserved: call-type=REGULAR
    Rte_Write_Asw_Swc_BRM_BCU_BRM_SPN2575_VIN1: call-type=REGULAR
    Rte_Write_Asw_Swc_BRM_BCU_BRM_SPN2575_VIN{10..17}: call-type=REGULAR
    Rte_Write_Asw_Swc_BRM_BCU_BRM_SPN2575_VIN{2..9}: call-type=REGULAR
    Rte_Write_Asw_Swc_BRM_BCU_BRM_SPN2576_BMSVer_Day: call-type=REGULAR
    Rte_Write_Asw_Swc_BRM_BCU_BRM_SPN2576_BMSVer_Month: call-type=REGULAR
    Rte_Write_Asw_Swc_BRM_BCU_BRM_SPN2576_BMSVer_Reserver: call-type=REGULAR
    Rte_Write_Asw_Swc_BRM_BCU_BRM_SPN2576_BMSVer_Version: call-type=REGULAR
    Rte_Write_Asw_Swc_BRM_BCU_BRM_SPN2576_BMSVer_Year: call-type=REGULAR
    Rte_Write_Asw_Swc_BRO_BCU_BRO_SPN2829_BCU_Ready: call-type=REGULAR
    Rte_Write_Asw_Swc_BSD_BCU_BSD_SPN3601_SOC_Final: call-type=REGULAR
    Rte_Write_Asw_Swc_BSD_BCU_BSD_SPN3602_Ucell_Min: call-type=REGULAR
    Rte_Write_Asw_Swc_BSD_BCU_BSD_SPN3603_Ucell_Max: call-type=REGULAR
    Rte_Write_Asw_Swc_BSD_BCU_BSD_SPN3604_T_Min: call-type=REGULAR
    Rte_Write_Asw_Swc_BSD_BCU_BSD_SPN3605_T_Max: call-type=REGULAR
    Rte_Write_Asw_Swc_BSM_BCU_BSM_SPN3085_Ucell_Max_Index: call-type=REGULAR
    Rte_Write_Asw_Swc_BSM_BCU_BSM_SPN3086_T_Max: call-type=REGULAR
    Rte_Write_Asw_Swc_BSM_BCU_BSM_SPN3087_T_Max_Index: call-type=REGULAR
    Rte_Write_Asw_Swc_BSM_BCU_BSM_SPN3088_T_Min: call-type=REGULAR
    Rte_Write_Asw_Swc_BSM_BCU_BSM_SPN3089_T_Min_Index: call-type=REGULAR
    Rte_Write_Asw_Swc_BSM_BCU_BSM_SPN3090_Ucell_Warn: call-type=REGULAR
    Rte_Write_Asw_Swc_BSM_BCU_BSM_SPN3091_SOC_Warn: call-type=REGULAR
    Rte_Write_Asw_Swc_BSM_BCU_BSM_SPN3092_I_Warn: call-type=REGULAR
    Rte_Write_Asw_Swc_BSM_BCU_BSM_SPN3093_T_Warn: call-type=REGULAR
    Rte_Write_Asw_Swc_BSM_BCU_BSM_SPN3094_Iso_State: call-type=REGULAR
    Rte_Write_Asw_Swc_BSM_BCU_BSM_SPN3095_OutConnector_State: call-type=REGULAR
    Rte_Write_Asw_Swc_BSM_BCU_BSM_SPN3096_Chg_Enable: call-type=REGULAR
    Rte_Write_Asw_Swc_BST_BCU_BST_SPN3511_Stop_Reason_CHGStop: call-type=REGULAR
    Rte_Write_Asw_Swc_BST_BCU_BST_SPN3511_Stop_Reason_SOC: call-type=REGULAR
    Rte_Write_Asw_Swc_BST_BCU_BST_SPN3511_Stop_Reason_U: call-type=REGULAR
    Rte_Write_Asw_Swc_BST_BCU_BST_SPN3511_Stop_Reason_Ucell: call-type=REGULAR
    Rte_Write_Asw_Swc_BST_BCU_BST_SPN3512_Stop_Fault_BCUcompo: call-type=REGULAR
    Rte_Write_Asw_Swc_BST_BCU_BST_SPN3512_Stop_Fault_CC2: call-type=REGULAR
    Rte_Write_Asw_Swc_BST_BCU_BST_SPN3512_Stop_Fault_ChgCnnt: call-type=REGULAR
    Rte_Write_Asw_Swc_BST_BCU_BST_SPN3512_Stop_Fault_HVRelay: call-type=REGULAR
    Rte_Write_Asw_Swc_BST_BCU_BST_SPN3512_Stop_Fault_Iso: call-type=REGULAR
    Rte_Write_Asw_Swc_BST_BCU_BST_SPN3512_Stop_Fault_Other: call-type=REGULAR
    Rte_Write_Asw_Swc_BST_BCU_BST_SPN3512_Stop_Fault_OutCnnt: call-type=REGULAR
    Rte_Write_Asw_Swc_BST_BCU_BST_SPN3512_Stop_Fault_T: call-type=REGULAR
    Rte_Write_Asw_Swc_BST_BCU_BST_SPN3513_Stop_Fault_I: call-type=REGULAR
    Rte_Write_Asw_Swc_BST_BCU_BST_SPN3513_Stop_Fault_U: call-type=REGULAR
    Rte_Write_Asw_Swc_ChargeCmd_ACS2Cmd_flg: call-type=REGULAR
    Rte_Write_Asw_Swc_ChargeCmd_ELockCtrlCmd_enum: call-type=REGULAR
    Rte_Write_Asw_Swc_ChargeCmd_ELockSel0Cmd_flg: call-type=REGULAR
    Rte_Write_Asw_Swc_ChargeCmd_LampCcHCmd_flg: call-type=REGULAR
    Rte_Write_Asw_Swc_ChargeCmd_LampChgHCmd_flg: call-type=REGULAR
    Rte_Write_Asw_Swc_CmuCmd_BalOpenLoadDiagCmd_flg: call-type=REGULAR
    Rte_Write_Asw_Swc_CmuCmd_CMUPwrCmd_flg: call-type=REGULAR
    Rte_Write_Asw_Swc_CmuCmd_CellLeakageDiagCmd_flg: call-type=REGULAR
    Rte_Write_Asw_Swc_CmuCmd_CellMeasCmd_flg: call-type=REGULAR
    Rte_Write_Asw_Swc_CmuCmd_ChanelFuncDiagCmd_flg: call-type=REGULAR
    Rte_Write_Asw_Swc_CmuCmd_CmuClrFaultPin_flg: call-type=REGULAR
    Rte_Write_Asw_Swc_CmuCmd_CmuReCfg_flg: call-type=REGULAR
    Rte_Write_Asw_Swc_CmuCmd_CtxOpenDiagCmd_flg: call-type=REGULAR
    Rte_Write_Asw_Swc_CmuCmd_GpioOTUTFuncDiagCmd_flg: call-type=REGULAR
    Rte_Write_Asw_Swc_CmuCmd_GpioxOpenDiagCmd_flg: call-type=REGULAR
    Rte_Write_Asw_Swc_CmuCmd_OutCMUHWAlarmPWMDuty_Pct: call-type=REGULAR
    Rte_Write_Asw_Swc_FblCmd_FBLForbid_flg: call-type=REGULAR
    Rte_Write_Asw_Swc_HighVoltCmd_PackVoltMeasCmd_flg: call-type=REGULAR
    Rte_Write_Asw_Swc_HvilCmd_OutHVILPWMDuty_Pct: call-type=REGULAR
    Rte_Write_Asw_Swc_IsoCmd_HVIsoNegMosCmd_flg: call-type=REGULAR
    Rte_Write_Asw_Swc_IsoCmd_HVIsoPosMosCmd_flg: call-type=REGULAR
    Rte_Write_Asw_Swc_McuCmd_RadyToSleep_flg: call-type=REGULAR
    Rte_Write_Asw_Swc_PPort_BswMArbitration_BswM_MRP_SwcModeRequest_VDP_uint16: call-type=REGULAR
    Rte_Write_Asw_Swc_RelayCmd_GlobalHCtrCmd_flg: call-type=REGULAR
    Rte_Write_Asw_Swc_RelayCmd_K{1..6}CtrCmd_flg: call-type=REGULAR
    Rte_Write_Asw_Swc_RelayCmd_KnCtrlCmd_flg: call-type=REGULAR
    Rte_Write_Asw_Swc_RelayCmd_KpCtrlCmd_flg: call-type=REGULAR
    Rte_Write_Asw_Swc_SbcCmd_CANWakeupEnable_flg: call-type=REGULAR
    Rte_Write_Asw_Swc_ThermalCmd_OutCoolPumpPWMDuty_Pct: call-type=REGULAR
    Rte_Write_Asw_Swc_ThermalCmd_OutFanPWMDuty_Pct: call-type=REGULAR
    Rte_Write_Asw_Swc_ThermalCmd_ValveEn_flg: call-type=REGULAR
    Rte_Write_Cmu_Cdd_CmuValue_BalOpenLoadDiagStatus_flg: call-type=REGULAR
    Rte_Write_Cmu_Cdd_CmuValue_CMUPwrDiagVoltVld_flg: call-type=REGULAR
    Rte_Write_Cmu_Cdd_CmuValue_CMUPwrDiagVolt_V: call-type=REGULAR
    Rte_Write_Cmu_Cdd_CmuValue_CellLeakageDiagStatus_flg: call-type=REGULAR
    Rte_Write_Cmu_Cdd_CmuValue_ChanelFuncDiagStatus_flg: call-type=REGULAR
    Rte_Write_Cmu_Cdd_CmuValue_CmuReCfgStatus_flg: call-type=REGULAR
    Rte_Write_Cmu_Cdd_CmuValue_CtxOpenDiagStatus_flg: call-type=REGULAR
    Rte_Write_Cmu_Cdd_CmuValue_GpioOTUTFuncDiagStatus_flg: call-type=REGULAR
    Rte_Write_Cmu_Cdd_CmuValue_GpioxOpenDiagStatus_flg: call-type=REGULAR
    Rte_Write_Cmu_Cdd_CmuValue_InCMUHWAlarmPWMDutyVld_flg: call-type=REGULAR
    Rte_Write_Cmu_Cdd_CmuValue_InCMUHWAlarmPWMDuty_pct: call-type=REGULAR
    Rte_Write_Cmu_Cdd_CmuValue_InCMUHWAlarmPWMFeqVld_flg: call-type=REGULAR
    Rte_Write_Cmu_Cdd_CmuValue_InCMUHWAlarmPWMFeq_Hz: call-type=REGULAR
    Rte_Write_IoHwAb_ChargeValue_CC2VoltVld_flg: call-type=REGULAR
    Rte_Write_IoHwAb_ChargeValue_CC2Volt_V: call-type=REGULAR
    Rte_Write_IoHwAb_ChargeValue_CCResVld_flg: call-type=REGULAR
    Rte_Write_IoHwAb_ChargeValue_CCRes_ohm: call-type=REGULAR
    Rte_Write_IoHwAb_ChargeValue_CPDutyVld_flg: call-type=REGULAR
    Rte_Write_IoHwAb_ChargeValue_CPDuty_pct: call-type=REGULAR
    Rte_Write_IoHwAb_ChargeValue_CPFrqVld_flg: call-type=REGULAR
    Rte_Write_IoHwAb_ChargeValue_CPFrq_Hz: call-type=REGULAR
    Rte_Write_IoHwAb_ChargeValue_CPVoltVld_flg: call-type=REGULAR
    Rte_Write_IoHwAb_ChargeValue_CPVolt_V: call-type=REGULAR
    Rte_Write_IoHwAb_ChargeValue_DCWakeupVoltVld_flg: call-type=REGULAR
    Rte_Write_IoHwAb_ChargeValue_DCWakeupVolt_V: call-type=REGULAR
    Rte_Write_IoHwAb_ChargeValue_ELockDiagVoltVld_flg: call-type=REGULAR
    Rte_Write_IoHwAb_ChargeValue_ELockDiagVolt_V: call-type=REGULAR
    Rte_Write_IoHwAb_ChargeValue_LampCcHDiagVoltVld_flg: call-type=REGULAR
    Rte_Write_IoHwAb_ChargeValue_LampCcHDiagVolt_V: call-type=REGULAR
    Rte_Write_IoHwAb_ChargeValue_LampChgHDiagVoltVld_flg: call-type=REGULAR
    Rte_Write_IoHwAb_ChargeValue_LampChgHDiagVolt_V: call-type=REGULAR
    Rte_Write_IoHwAb_CrashValue_CrashPWMDutyVld_flg: call-type=REGULAR
    Rte_Write_IoHwAb_CrashValue_CrashPWMDuty_pct: call-type=REGULAR
    Rte_Write_IoHwAb_CrashValue_CrashPWMFrqVld_flg: call-type=REGULAR
    Rte_Write_IoHwAb_CrashValue_CrashPWMFrq_Hz: call-type=REGULAR
    Rte_Write_IoHwAb_CurrValue_HallCH1RedVoltVld_flg: call-type=REGULAR
    Rte_Write_IoHwAb_CurrValue_HallCH1RedVolt_V: call-type=REGULAR
    Rte_Write_IoHwAb_CurrValue_HallCH1VoltVld_flg: call-type=REGULAR
    Rte_Write_IoHwAb_CurrValue_HallCH1Volt_V: call-type=REGULAR
    Rte_Write_IoHwAb_CurrValue_HallCH2RedVoltVld_flg: call-type=REGULAR
    Rte_Write_IoHwAb_CurrValue_HallCH2RedVolt_V: call-type=REGULAR
    Rte_Write_IoHwAb_CurrValue_HallCH2VoltVld_flg: call-type=REGULAR
    Rte_Write_IoHwAb_CurrValue_HallCH2Volt_V: call-type=REGULAR
    Rte_Write_IoHwAb_CurrValue_HallSpyVoltVld_flg: call-type=REGULAR
    Rte_Write_IoHwAb_CurrValue_HallSpyVolt_V: call-type=REGULAR
    Rte_Write_IoHwAb_CurrValue_PackCurrRedVld_flg: call-type=REGULAR
    Rte_Write_IoHwAb_CurrValue_PackCurrRed_A: call-type=REGULAR
    Rte_Write_IoHwAb_CurrValue_PackCurrVld_flg: call-type=REGULAR
    Rte_Write_IoHwAb_CurrValue_PackCurr_A: call-type=REGULAR
    Rte_Write_IoHwAb_HighVoltValue_P1CheckVoltVld_flg: call-type=REGULAR
    Rte_Write_IoHwAb_HighVoltValue_P1CheckVolt_V: call-type=REGULAR
    Rte_Write_IoHwAb_HighVoltValue_P2CheckVoltVld_flg: call-type=REGULAR
    Rte_Write_IoHwAb_HighVoltValue_P2CheckVolt_V: call-type=REGULAR
    Rte_Write_IoHwAb_HighVoltValue_P3CheckVoltVld_flg: call-type=REGULAR
    Rte_Write_IoHwAb_HighVoltValue_P3CheckVolt_V: call-type=REGULAR
    Rte_Write_IoHwAb_HighVoltValue_PackVoltVld_flg: call-type=REGULAR
    Rte_Write_IoHwAb_HighVoltValue_PackVolt_V: call-type=REGULAR
    Rte_Write_IoHwAb_HighVoltValue_PreChgCheckRedVoltVld_flg: call-type=REGULAR
    Rte_Write_IoHwAb_HighVoltValue_PreChgCheckRedVolt_V: call-type=REGULAR
    Rte_Write_IoHwAb_HighVoltValue_PreChgCheckVoltVld_flg: call-type=REGULAR
    Rte_Write_IoHwAb_HighVoltValue_PreChgCheckVolt_V: call-type=REGULAR
    Rte_Write_IoHwAb_HvilValue_HVILHighVoltVld_flg: call-type=REGULAR
    Rte_Write_IoHwAb_HvilValue_HVILHighVolt_V: call-type=REGULAR
    Rte_Write_IoHwAb_HvilValue_HVILLowVoltVld_flg: call-type=REGULAR
    Rte_Write_IoHwAb_HvilValue_HVILLowVolt_V: call-type=REGULAR
    Rte_Write_IoHwAb_HvilValue_InHVILPWMDutyVld_flg: call-type=REGULAR
    Rte_Write_IoHwAb_HvilValue_InHVILPWMDuty_pct: call-type=REGULAR
    Rte_Write_IoHwAb_HvilValue_InHVILPWMFrqVld_flg: call-type=REGULAR
    Rte_Write_IoHwAb_HvilValue_InHVILPWMFrq_Hz: call-type=REGULAR
    Rte_Write_IoHwAb_IsoValue_HVIsoNegVoltVld_flg: call-type=REGULAR
    Rte_Write_IoHwAb_IsoValue_HVIsoNegVolt_V: call-type=REGULAR
    Rte_Write_IoHwAb_IsoValue_HVIsoPosVoltVld_flg: call-type=REGULAR
    Rte_Write_IoHwAb_IsoValue_HVIsoPosVolt_V: call-type=REGULAR
    Rte_Write_IoHwAb_McuValue_BSWInitFinish_flg: call-type=REGULAR
    Rte_Write_IoHwAb_PowerValue_BmuPullupSwitchDiag_flg: call-type=REGULAR
    Rte_Write_IoHwAb_PowerValue_BmuPullupVoltVld_flg: call-type=REGULAR
    Rte_Write_IoHwAb_PowerValue_BmuPullupVolt_V: call-type=REGULAR
    Rte_Write_IoHwAb_PowerValue_KL15VoltVld_flg: call-type=REGULAR
    Rte_Write_IoHwAb_PowerValue_KL15Volt_V: call-type=REGULAR
    Rte_Write_IoHwAb_PowerValue_KL30VoltVld_flg: call-type=REGULAR
    Rte_Write_IoHwAb_PowerValue_KL30Volt_V: call-type=REGULAR
    Rte_Write_IoHwAb_PowerValue_KPowertVoltVld_flg: call-type=REGULAR
    Rte_Write_IoHwAb_PowerValue_KPowertVolt_V: call-type=REGULAR
    Rte_Write_IoHwAb_PowerValue_ResWakeUp1HVoltVld_flg: call-type=REGULAR
    Rte_Write_IoHwAb_PowerValue_ResWakeUp1HVolt_V: call-type=REGULAR
    Rte_Write_IoHwAb_PowerValue_ResWakeUp2HVoltVld_flg: call-type=REGULAR
    Rte_Write_IoHwAb_PowerValue_ResWakeUp2HVolt_V: call-type=REGULAR
    Rte_Write_IoHwAb_PowerValue_ResWakeUp3LVoltVld_flg: call-type=REGULAR
    Rte_Write_IoHwAb_PowerValue_ResWakeUp3LVolt_V: call-type=REGULAR
    Rte_Write_IoHwAb_RelayValue_GlobalHsideDiagVoltVld_flg: call-type=REGULAR
    Rte_Write_IoHwAb_RelayValue_GlobalHsideDiagVolt_V: call-type=REGULAR
    Rte_Write_IoHwAb_RelayValue_GlobalHsideDriverVoltVld_flg: call-type=REGULAR
    Rte_Write_IoHwAb_RelayValue_GlobalHsideDriverVolt_V: call-type=REGULAR
    Rte_Write_IoHwAb_RelayValue_K1CtrDriverVoltVld_flg: call-type=REGULAR
    Rte_Write_IoHwAb_RelayValue_K1CtrDriverVolt_V: call-type=REGULAR
    Rte_Write_IoHwAb_RelayValue_K2CtrDriverVoltVld_flg: call-type=REGULAR
    Rte_Write_IoHwAb_RelayValue_K2CtrDriverVolt_V: call-type=REGULAR
    Rte_Write_IoHwAb_RelayValue_K3CtrDriverVoltVld_flg: call-type=REGULAR
    Rte_Write_IoHwAb_RelayValue_K3CtrDriverVolt_V: call-type=REGULAR
    Rte_Write_IoHwAb_RelayValue_K4CtrDriverVoltVld_flg: call-type=REGULAR
    Rte_Write_IoHwAb_RelayValue_K4CtrDriverVolt_V: call-type=REGULAR
    Rte_Write_IoHwAb_RelayValue_K5CtrDriverVoltVld_flg: call-type=REGULAR
    Rte_Write_IoHwAb_RelayValue_K5CtrDriverVolt_V: call-type=REGULAR
    Rte_Write_IoHwAb_RelayValue_K6CtrDriverVoltVld_flg: call-type=REGULAR
    Rte_Write_IoHwAb_RelayValue_K6CtrDriverVolt_V: call-type=REGULAR
    Rte_Write_IoHwAb_RelayValue_KnCtrDriverVoltVld_flg: call-type=REGULAR
    Rte_Write_IoHwAb_RelayValue_KnCtrDriverVolt_V: call-type=REGULAR
    Rte_Write_IoHwAb_RelayValue_KnchgEnOutState_flg: call-type=REGULAR
    Rte_Write_IoHwAb_RelayValue_KnchgEnStateVld_flg: call-type=REGULAR
    Rte_Write_IoHwAb_RelayValue_KpCtrDriverVoltVld_flg: call-type=REGULAR
    Rte_Write_IoHwAb_RelayValue_KpCtrDriverVolt_V: call-type=REGULAR
    Rte_Write_IoHwAb_RelayValue_KpEnOutState_flg: call-type=REGULAR
    Rte_Write_IoHwAb_RelayValue_KpEnStateVld_flg: call-type=REGULAR
    Rte_Write_IoHwAb_RsvValue_InRsvPWMDutyVld_flg: call-type=REGULAR
    Rte_Write_IoHwAb_RsvValue_InRsvPWMDuty_pct: call-type=REGULAR
    Rte_Write_IoHwAb_RsvValue_InRsvPWMFrqVld_flg: call-type=REGULAR
    Rte_Write_IoHwAb_RsvValue_InRsvPWMFrq_Hz: call-type=REGULAR
    Rte_Write_IoHwAb_RsvValue_RsvAD1VoltVld_flg: call-type=REGULAR
    Rte_Write_IoHwAb_RsvValue_RsvAD1Volt_V: call-type=REGULAR
    Rte_Write_IoHwAb_RsvValue_RsvAD2VoltVld_flg: call-type=REGULAR
    Rte_Write_IoHwAb_RsvValue_RsvAD2Volt_V: call-type=REGULAR
    Rte_Write_IoHwAb_RsvValue_RsvAD3VoltVld_flg: call-type=REGULAR
    Rte_Write_IoHwAb_RsvValue_RsvAD3Volt_V: call-type=REGULAR
    Rte_Write_IoHwAb_RsvValue_RsvAD4VoltVld_flg: call-type=REGULAR
    Rte_Write_IoHwAb_RsvValue_RsvAD4Volt_V: call-type=REGULAR
    Rte_Write_IoHwAb_RsvValue_RsvAD5VoltVld_flg: call-type=REGULAR
    Rte_Write_IoHwAb_RsvValue_RsvAD5Volt_V: call-type=REGULAR
    Rte_Write_IoHwAb_SbcValue_BMULastPwrDownState: call-type=REGULAR
    Rte_Write_IoHwAb_SbcValue_BmuSbcCanTRSt_flg: call-type=REGULAR
    Rte_Write_IoHwAb_SbcValue_BmuSbcRstbPinSt_flg: call-type=REGULAR
    Rte_Write_IoHwAb_SbcValue_BmuSbcVauxOV_flg: call-type=REGULAR
    Rte_Write_IoHwAb_SbcValue_BmuSbcVauxUV_flg: call-type=REGULAR
    Rte_Write_IoHwAb_SbcValue_BmuSbcVcanOV_flg: call-type=REGULAR
    Rte_Write_IoHwAb_SbcValue_BmuSbcVcanUV_flg: call-type=REGULAR
    Rte_Write_IoHwAb_SbcValue_BmuSbcVccaOV_flg: call-type=REGULAR
    Rte_Write_IoHwAb_SbcValue_BmuSbcVccaUV_flg: call-type=REGULAR
    Rte_Write_IoHwAb_SbcValue_BmuSbcVcoreOV_flg: call-type=REGULAR
    Rte_Write_IoHwAb_SbcValue_BmuSbcVpreOV_flg: call-type=REGULAR
    Rte_Write_IoHwAb_SbcValue_BmuSbcVpreUV_flg: call-type=REGULAR
    Rte_Write_IoHwAb_SbcValue_BmuSbxVcoreUV_flg: call-type=REGULAR
    Rte_Write_IoHwAb_SbcValue_CANWakeupState_flg: call-type=REGULAR
    Rte_Write_IoHwAb_SbcValue_KL15WakeupState_flg: call-type=REGULAR
    Rte_Write_IoHwAb_SbcValue_RTCWakeupState_flg: call-type=REGULAR
    Rte_Write_IoHwAb_SbcValue_SBCWakeupP{1..3}State_flg: call-type=REGULAR
    Rte_Write_IoHwAb_ThermalValue_BmuTemp1NtcVld_flg: call-type=REGULAR
    Rte_Write_IoHwAb_ThermalValue_BmuTemp1Ntc_Ohm: call-type=REGULAR
    Rte_Write_IoHwAb_ThermalValue_BmuTemp2NtcVld_flg: call-type=REGULAR
    Rte_Write_IoHwAb_ThermalValue_BmuTemp2Ntc_Ohm: call-type=REGULAR
    Rte_Write_IoHwAb_ThermalValue_BmuTemp3NtcVld_flg: call-type=REGULAR
    Rte_Write_IoHwAb_ThermalValue_BmuTemp3Ntc_Ohm: call-type=REGULAR
    Rte_Write_IoHwAb_ThermalValue_BmuTemp4NtcVld_flg: call-type=REGULAR
    Rte_Write_IoHwAb_ThermalValue_BmuTemp4Ntc_Ohm: call-type=REGULAR
    Rte_Write_IoHwAb_ThermalValue_BmuTemp5NtcVld_flg: call-type=REGULAR
    Rte_Write_IoHwAb_ThermalValue_BmuTemp5Ntc_Ohm: call-type=REGULAR
    Rte_Write_IoHwAb_ThermalValue_BmuTemp6NtcVld_flg: call-type=REGULAR
    Rte_Write_IoHwAb_ThermalValue_BmuTemp6Ntc_Ohm: call-type=REGULAR
    Rte_Write_IoHwAb_ThermalValue_BmuTemp7NtcVld_flg: call-type=REGULAR
    Rte_Write_IoHwAb_ThermalValue_BmuTemp7Ntc_Ohm: call-type=REGULAR
    Rte_Write_IoHwAb_ThermalValue_InCoolPumpPWMDutyVld_flg: call-type=REGULAR
    Rte_Write_IoHwAb_ThermalValue_InCoolPumpPWMDuty_Pct: call-type=REGULAR
    Rte_Write_IoHwAb_ThermalValue_InCoolPumpPWMFrqVld_flg: call-type=REGULAR
    Rte_Write_IoHwAb_ThermalValue_InCoolPumpPWMFrq_Hz: call-type=REGULAR
    Rte_Write_IoHwAb_ThermalValue_InFanPWMDutyVld_flg: call-type=REGULAR
    Rte_Write_IoHwAb_ThermalValue_InFanPWMDuty_Pct: call-type=REGULAR
    Rte_Write_IoHwAb_ThermalValue_InFanPWMFrqVld_flg: call-type=REGULAR
    Rte_Write_IoHwAb_ThermalValue_InFanPWMFrq_Hz: call-type=REGULAR
    Rte_Write_IoHwAb_ThermalValue_ValveDiagVoltVld_flg: call-type=REGULAR
    Rte_Write_IoHwAb_ThermalValue_ValveDiagVolt_V: call-type=REGULAR
    Rte_Write_Sbc_Cdd_SbcValue_BMULastPwrDownState: call-type=REGULAR
    Rte_Write_Sbc_Cdd_SbcValue_BmuSbcCanTRSt_flg: call-type=REGULAR
    Rte_Write_Sbc_Cdd_SbcValue_BmuSbcRstbPinSt_flg: call-type=REGULAR
    Rte_Write_Sbc_Cdd_SbcValue_BmuSbcVauxOV_flg: call-type=REGULAR
    Rte_Write_Sbc_Cdd_SbcValue_BmuSbcVauxUV_flg: call-type=REGULAR
    Rte_Write_Sbc_Cdd_SbcValue_BmuSbcVcanOV_flg: call-type=REGULAR
    Rte_Write_Sbc_Cdd_SbcValue_BmuSbcVcanUV_flg: call-type=REGULAR
    Rte_Write_Sbc_Cdd_SbcValue_BmuSbcVccaOV_flg: call-type=REGULAR
    Rte_Write_Sbc_Cdd_SbcValue_BmuSbcVccaUV_flg: call-type=REGULAR
    Rte_Write_Sbc_Cdd_SbcValue_BmuSbcVcoreOV_flg: call-type=REGULAR
    Rte_Write_Sbc_Cdd_SbcValue_BmuSbcVpreOV_flg: call-type=REGULAR
    Rte_Write_Sbc_Cdd_SbcValue_BmuSbcVpreUV_flg: call-type=REGULAR
    Rte_Write_Sbc_Cdd_SbcValue_BmuSbxVcoreUV_flg: call-type=REGULAR
    Rte_Write_Sbc_Cdd_SbcValue_CANWakeupState_flg: call-type=REGULAR
    Rte_Write_Sbc_Cdd_SbcValue_KL15WakeupState_flg: call-type=REGULAR
    Rte_Write_Sbc_Cdd_SbcValue_RTCWakeupState_flg: call-type=REGULAR
    Rte_Write_Sbc_Cdd_SbcValue_SBCWakeupP{1..3}State_flg: call-type=REGULAR
    Rte_memcpy: call-type=REGULAR
    SchM_Deinit: call-type=REGULAR
    SchM_IModeInit: call-type=REGULAR
    SchM_Init: call-type=REGULAR
    SchM_Mode_BswM_MDGR_BswM_MRP_BswM_MDG: call-type=REGULAR
    SchM_Mode_WdgM_Current_WdgMSupervisionCycle: call-type=REGULAR
    SchM_Switch_BswM_MDGP_AUTOSAR_BswM_ModeDeclarationGroups_MDG_ECUM_STATE: call-type=REGULAR
package /AUTOSAR_Rte/BswImplementations
  bsw implementation Rte: programming-language=C, sw-version=0.0.0, used-code-generator=ETAS RTEGen, ar-release-version=4.0.0, behavior=RteInternalBehavior
    generated-artifacts:
      100 x dependency on artifact:
        ASW_OsTask_10ms_c: artifact-descriptor={short-label=ASW_OsTask_10ms_c, category=SWSRC, domain=AUTOSAR}
        ASW_OsTask_10ms_h: artifact-descriptor={short-label=ASW_OsTask_10ms_h, category=SWHDR, domain=AUTOSAR}
        ASW_OsTask_5ms_c: artifact-descriptor={short-label=ASW_OsTask_5ms_c, category=SWSRC, domain=AUTOSAR}
        ASW_OsTask_5ms_h: artifact-descriptor={short-label=ASW_OsTask_5ms_h, category=SWHDR, domain=AUTOSAR}
        Asw_Swc_MemMap_h: artifact-descriptor={short-label=Asw_Swc_MemMap_h, category=SWHDR, domain=AUTOSAR}
        BSW_OsTask_1000ms_c: artifact-descriptor={short-label=BSW_OsTask_1000ms_c, category=SWSRC, domain=AUTOSAR}
        BSW_OsTask_1000ms_h: artifact-descriptor={short-label=BSW_OsTask_1000ms_h, category=SWHDR, domain=AUTOSAR}
        BSW_OsTask_100ms_c: artifact-descriptor={short-label=BSW_OsTask_100ms_c, category=SWSRC, domain=AUTOSAR}
        BSW_OsTask_100ms_h: artifact-descriptor={short-label=BSW_OsTask_100ms_h, category=SWHDR, domain=AUTOSAR}
        BSW_OsTask_10ms_c: artifact-descriptor={short-label=BSW_OsTask_10ms_c, category=SWSRC, domain=AUTOSAR}
        BSW_OsTask_10ms_h: artifact-descriptor={short-label=BSW_OsTask_10ms_h, category=SWHDR, domain=AUTOSAR}
        BSW_OsTask_1ms_c: artifact-descriptor={short-label=BSW_OsTask_1ms_c, category=SWSRC, domain=AUTOSAR}
        BSW_OsTask_1ms_h: artifact-descriptor={short-label=BSW_OsTask_1ms_h, category=SWHDR, domain=AUTOSAR}
        BSW_OsTask_20ms_c: artifact-descriptor={short-label=BSW_OsTask_20ms_c, category=SWSRC, domain=AUTOSAR}
        BSW_OsTask_20ms_h: artifact-descriptor={short-label=BSW_OsTask_20ms_h, category=SWHDR, domain=AUTOSAR}
        BSW_OsTask_2ms_c: artifact-descriptor={short-label=BSW_OsTask_2ms_c, category=SWSRC, domain=AUTOSAR}
        BSW_OsTask_2ms_h: artifact-descriptor={short-label=BSW_OsTask_2ms_h, category=SWHDR, domain=AUTOSAR}
        BSW_OsTask_50ms_c: artifact-descriptor={short-label=BSW_OsTask_50ms_c, category=SWSRC, domain=AUTOSAR}
        BSW_OsTask_50ms_h: artifact-descriptor={short-label=BSW_OsTask_50ms_h, category=SWHDR, domain=AUTOSAR}
        BSW_OsTask_5ms_c: artifact-descriptor={short-label=BSW_OsTask_5ms_c, category=SWSRC, domain=AUTOSAR}
        BSW_OsTask_5ms_h: artifact-descriptor={short-label=BSW_OsTask_5ms_h, category=SWHDR, domain=AUTOSAR}
        BSW_OsTask_SwcRequest_c: artifact-descriptor={short-label=BSW_OsTask_SwcRequest_c, category=SWSRC, domain=AUTOSAR}
        BSW_OsTask_SwcRequest_h: artifact-descriptor={short-label=BSW_OsTask_SwcRequest_h, category=SWHDR, domain=AUTOSAR}
        BswM_MemMap_h: artifact-descriptor={short-label=BswM_MemMap_h, category=SWHDR, domain=AUTOSAR}
        Cmu_Cdd_MemMap_h: artifact-descriptor={short-label=Cmu_Cdd_MemMap_h, category=SWHDR, domain=AUTOSAR}
        Com_h: artifact-descriptor={short-label=Com_h, category=SWHDR, domain=AUTOSAR}
        ComM_MemMap_h: artifact-descriptor={short-label=ComM_MemMap_h, category=SWHDR, domain=AUTOSAR}
        Det_MemMap_h: artifact-descriptor={short-label=Det_MemMap_h, category=SWHDR, domain=AUTOSAR}
        EcuM_MemMap_h: artifact-descriptor={short-label=EcuM_MemMap_h, category=SWHDR, domain=AUTOSAR}
        IoHwAb_MemMap_h: artifact-descriptor={short-label=IoHwAb_MemMap_h, category=SWHDR, domain=AUTOSAR}
        Ioc_h: artifact-descriptor={short-label=Ioc_h, category=SWHDR, domain=AUTOSAR}
        NvM_h: artifact-descriptor={short-label=NvM_h, category=SWHDR, domain=AUTOSAR}
        NvM_MemMap_h: artifact-descriptor={short-label=NvM_MemMap_h, category=SWHDR, domain=AUTOSAR}
        Os_h: artifact-descriptor={short-label=Os_h, category=SWHDR, domain=AUTOSAR}
        Rte_c: artifact-descriptor={short-label=Rte_c, category=SWSRC, domain=AUTOSAR}
        Rte_h: artifact-descriptor={short-label=Rte_h, category=SWHDR, domain=AUTOSAR}
        Rte_Asw_Swc_h: artifact-descriptor={short-label=Rte_Asw_Swc_h, category=SWHDR, domain=AUTOSAR}
        Rte_Asw_Swc_Type_h: artifact-descriptor={short-label=Rte_Asw_Swc_Type_h, category=SWHDR, domain=AUTOSAR}
        Rte_BswM_h: artifact-descriptor={short-label=Rte_BswM_h, category=SWHDR, domain=AUTOSAR}
        Rte_BswM_Type_h: artifact-descriptor={short-label=Rte_BswM_Type_h, category=SWHDR, domain=AUTOSAR}
        Rte_Cbk_h: artifact-descriptor={short-label=Rte_Cbk_h, category=SWHDR, domain=AUTOSAR}
        Rte_Cfg_h: artifact-descriptor={short-label=Rte_Cfg_h, category=SWHDR, domain=AUTOSAR}
        Rte_Cmu_Cdd_h: artifact-descriptor={short-label=Rte_Cmu_Cdd_h, category=SWHDR, domain=AUTOSAR}
        Rte_Cmu_Cdd_Type_h: artifact-descriptor={short-label=Rte_Cmu_Cdd_Type_h, category=SWHDR, domain=AUTOSAR}
        Rte_ComM_h: artifact-descriptor={short-label=Rte_ComM_h, category=SWHDR, domain=AUTOSAR}
        Rte_ComM_Type_h: artifact-descriptor={short-label=Rte_ComM_Type_h, category=SWHDR, domain=AUTOSAR}
        Rte_Const_h: artifact-descriptor={short-label=Rte_Const_h, category=SWHDR, domain=AUTOSAR}
        Rte_DataHandleType_h: artifact-descriptor={short-label=Rte_DataHandleType_h, category=SWHDR, domain=AUTOSAR}
        Rte_Det_h: artifact-descriptor={short-label=Rte_Det_h, category=SWHDR, domain=AUTOSAR}
        Rte_Det_Type_h: artifact-descriptor={short-label=Rte_Det_Type_h, category=SWHDR, domain=AUTOSAR}
        Rte_EcuM_h: artifact-descriptor={short-label=Rte_EcuM_h, category=SWHDR, domain=AUTOSAR}
        Rte_EcuM_Type_h: artifact-descriptor={short-label=Rte_EcuM_Type_h, category=SWHDR, domain=AUTOSAR}
        Rte_Hook_h: artifact-descriptor={short-label=Rte_Hook_h, category=SWHDR, domain=AUTOSAR}
        Rte_Intl_h: artifact-descriptor={short-label=Rte_Intl_h, category=SWHDR, domain=AUTOSAR}
        Rte_IoHwAb_h: artifact-descriptor={short-label=Rte_IoHwAb_h, category=SWHDR, domain=AUTOSAR}
        Rte_IoHwAb_Type_h: artifact-descriptor={short-label=Rte_IoHwAb_Type_h, category=SWHDR, domain=AUTOSAR}
        Rte_Lib_c: artifact-descriptor={short-label=Rte_Lib_c, category=SWSRC, domain=AUTOSAR}
        Rte_Main_h: artifact-descriptor={short-label=Rte_Main_h, category=SWHDR, domain=AUTOSAR}
        Rte_MemMap_h: artifact-descriptor={short-label=Rte_MemMap_h, category=SWHDR, domain=AUTOSAR}
        Rte_NvM_h: artifact-descriptor={short-label=Rte_NvM_h, category=SWHDR, domain=AUTOSAR}
        Rte_NvM_Type_h: artifact-descriptor={short-label=Rte_NvM_Type_h, category=SWHDR, domain=AUTOSAR}
        Rte_Sbc_Cdd_h: artifact-descriptor={short-label=Rte_Sbc_Cdd_h, category=SWHDR, domain=AUTOSAR}
        Rte_Sbc_Cdd_Type_h: artifact-descriptor={short-label=Rte_Sbc_Cdd_Type_h, category=SWHDR, domain=AUTOSAR}
        Rte_Type_h: artifact-descriptor={short-label=Rte_Type_h, category=SWHDR, domain=AUTOSAR}
        Rte_WdgM_h: artifact-descriptor={short-label=Rte_WdgM_h, category=SWHDR, domain=AUTOSAR}
        Rte_WdgM_SWC_h: artifact-descriptor={short-label=Rte_WdgM_SWC_h, category=SWHDR, domain=AUTOSAR}
        Rte_WdgM_SWC_Type_h: artifact-descriptor={short-label=Rte_WdgM_SWC_Type_h, category=SWHDR, domain=AUTOSAR}
        Rte_WdgM_Type_h: artifact-descriptor={short-label=Rte_WdgM_Type_h, category=SWHDR, domain=AUTOSAR}
        Rte_Xcp_SWC_h: artifact-descriptor={short-label=Rte_Xcp_SWC_h, category=SWHDR, domain=AUTOSAR}
        Rte_Xcp_SWC_Type_h: artifact-descriptor={short-label=Rte_Xcp_SWC_Type_h, category=SWHDR, domain=AUTOSAR}
        Sbc_Cdd_MemMap_h: artifact-descriptor={short-label=Sbc_Cdd_MemMap_h, category=SWHDR, domain=AUTOSAR}
        SchM_BswM_h: artifact-descriptor={short-label=SchM_BswM_h, category=SWHDR, domain=AUTOSAR}
        SchM_BswM_Type_h: artifact-descriptor={short-label=SchM_BswM_Type_h, category=SWHDR, domain=AUTOSAR}
        SchM_CanIf_h: artifact-descriptor={short-label=SchM_CanIf_h, category=SWHDR, domain=AUTOSAR}
        SchM_CanIf_Type_h: artifact-descriptor={short-label=SchM_CanIf_Type_h, category=SWHDR, domain=AUTOSAR}
        SchM_CanSM_h: artifact-descriptor={short-label=SchM_CanSM_h, category=SWHDR, domain=AUTOSAR}
        SchM_CanSM_Type_h: artifact-descriptor={short-label=SchM_CanSM_Type_h, category=SWHDR, domain=AUTOSAR}
        SchM_Com_h: artifact-descriptor={short-label=SchM_Com_h, category=SWHDR, domain=AUTOSAR}
        SchM_ComM_h: artifact-descriptor={short-label=SchM_ComM_h, category=SWHDR, domain=AUTOSAR}
        SchM_ComM_Type_h: artifact-descriptor={short-label=SchM_ComM_Type_h, category=SWHDR, domain=AUTOSAR}
        SchM_Com_Type_h: artifact-descriptor={short-label=SchM_Com_Type_h, category=SWHDR, domain=AUTOSAR}
        SchM_EcuM_h: artifact-descriptor={short-label=SchM_EcuM_h, category=SWHDR, domain=AUTOSAR}
        SchM_EcuM_Type_h: artifact-descriptor={short-label=SchM_EcuM_Type_h, category=SWHDR, domain=AUTOSAR}
        SchM_J1939Tp_h: artifact-descriptor={short-label=SchM_J1939Tp_h, category=SWHDR, domain=AUTOSAR}
        SchM_J1939Tp_Type_h: artifact-descriptor={short-label=SchM_J1939Tp_Type_h, category=SWHDR, domain=AUTOSAR}
        SchM_MemIf_h: artifact-descriptor={short-label=SchM_MemIf_h, category=SWHDR, domain=AUTOSAR}
        SchM_MemIf_Type_h: artifact-descriptor={short-label=SchM_MemIf_Type_h, category=SWHDR, domain=AUTOSAR}
        SchM_NvM_h: artifact-descriptor={short-label=SchM_NvM_h, category=SWHDR, domain=AUTOSAR}
        SchM_NvM_Type_h: artifact-descriptor={short-label=SchM_NvM_Type_h, category=SWHDR, domain=AUTOSAR}
        SchM_Os_h: artifact-descriptor={short-label=SchM_Os_h, category=SWHDR, domain=AUTOSAR}
        SchM_Os_Type_h: artifact-descriptor={short-label=SchM_Os_Type_h, category=SWHDR, domain=AUTOSAR}
        SchM_PduR_h: artifact-descriptor={short-label=SchM_PduR_h, category=SWHDR, domain=AUTOSAR}
        SchM_PduR_Type_h: artifact-descriptor={short-label=SchM_PduR_Type_h, category=SWHDR, domain=AUTOSAR}
        SchM_WdgM_h: artifact-descriptor={short-label=SchM_WdgM_h, category=SWHDR, domain=AUTOSAR}
        SchM_WdgM_Type_h: artifact-descriptor={short-label=SchM_WdgM_Type_h, category=SWHDR, domain=AUTOSAR}
        SchM_Xcp_h: artifact-descriptor={short-label=SchM_Xcp_h, category=SWHDR, domain=AUTOSAR}
        SchM_Xcp_Type_h: artifact-descriptor={short-label=SchM_Xcp_Type_h, category=SWHDR, domain=AUTOSAR}
        WdgM_MemMap_h: artifact-descriptor={short-label=WdgM_MemMap_h, category=SWHDR, domain=AUTOSAR}
        WdgM_SWC_MemMap_h: artifact-descriptor={short-label=WdgM_SWC_MemMap_h, category=SWHDR, domain=AUTOSAR}
        Xcp_SWC_MemMap_h: artifact-descriptor={short-label=Xcp_SWC_MemMap_h, category=SWHDR, domain=AUTOSAR}
    resource consumption ResConsumption
      8 x memory section:
        CODE: executable-entity=[Rte_ActivateRE, Rte_COMCbk_CCS_SPN3081_U_Out, Rte_COMCbk_CCS_SPN3082_I_Out, Rte_COMCbk_CCS_SPN3083_Time_Charged, Rte_COMCbk_CCS_SPN3929_Chg_enable, Rte_COMCbk_CDU_HVILWarning, Rte_COMCbk_CEM_SPN3921_Timeout_BRM, Rte_COMCbk_CEM_SPN3922_Timeout_BCP, Rte_COMCbk_CEM_SPN3923_Timeout_BRO, Rte_COMCbk_CEM_SPN3924_Timeout_BCS, Rte_COMCbk_CEM_SPN3925_Timeout_BCL, Rte_COMCbk_CEM_SPN3926_Timeout_BST, Rte_COMCbk_CEM_SPN3927_Timeout_BSD, Rte_COMCbk_CEM_other, Rte_COMCbk_CHM_SPN2600_Comm_Ver, Rte_COMCbk_CML_SPN2824_U_Max_Out, Rte_COMCbk_CML_SPN2825_U_Min_Out, Rte_COMCbk_CML_SPN2826_I_Max_Out, Rte_COMCbk_CML_SPN2827_I_Min_Out, Rte_COMCbk_CRM_SPN2560_Ack, Rte_COMCbk_CRM_SPN2561_CHG_Index, Rte_COMCbk_CRM_SPN2562_CHG_Loc, Rte_COMCbk_CRO_SPN2830_CHG_Ready, Rte_COMCbk_CSD_SPN3611_Time_Charged, Rte_COMCbk_CSD_SPN3612_E_Out, Rte_COMCbk_CSD_SPN3613_CHG_Index, Rte_COMCbk_CST_SPN3521_Stop_Reason_Auto, Rte_COMCbk_CST_SPN3521_Stop_Reason_BMSStop, Rte_COMCbk_CST_SPN3521_Stop_Reason_Fault, Rte_COMCbk_CST_SPN3521_Stop_Reason_Manual, Rte_COMCbk_CST_SPN3522_Stop_Fault_CHGCnnt, Rte_COMCbk_CST_SPN3522_Stop_Fault_Deliver, Rte_COMCbk_CST_SPN3522_Stop_Fault_EmerStop, Rte_COMCbk_CST_SPN3522_Stop_Fault_Other, Rte_COMCbk_CST_SPN3522_Stop_Fault_T_CHG, Rte_COMCbk_CST_SPN3522_Stop_Fault_T_Inter, Rte_COMCbk_CST_SPN3523_Stop_Fault_Mismatch, Rte_COMCbk_CST_SPN3523_Stop_Fault_U, Rte_COMCbk_CTS_SPN2823_SYNC_Day, Rte_COMCbk_CTS_SPN2823_SYNC_DayTen, Rte_COMCbk_CTS_SPN2823_SYNC_Hour, Rte_COMCbk_CTS_SPN2823_SYNC_HourTen, Rte_COMCbk_CTS_SPN2823_SYNC_Minute, Rte_COMCbk_CTS_SPN2823_SYNC_MinuteTen, Rte_COMCbk_CTS_SPN2823_SYNC_Month, Rte_COMCbk_CTS_SPN2823_SYNC_MonthTen, Rte_COMCbk_CTS_SPN2823_SYNC_Second, Rte_COMCbk_CTS_SPN2823_SYNC_SecondTen, Rte_COMCbk_CTS_SPN2823_SYNC_Year, Rte_COMCbk_CTS_SPN2823_SYNC_YearHundred, Rte_COMCbk_CTS_SPN2823_SYNC_YearTen, Rte_COMCbk_CTS_SPN2823_SYNC_YearThousand, Rte_COMCbk_CheckSum_1E3h, Rte_COMCbk_CheckSum_23Ch, Rte_COMCbk_ChrgrStatPTHVCntctOpnrAlwd, Rte_COMCbk_ChrgrStatPTHVCntctrClsAlwd, Rte_COMCbk_FrontCmprElctrCrnt, Rte_COMCbk_FrontCompStatFdbck, Rte_COMCbk_FrontPTCElctrCrnt, Rte_COMCbk_FrontPTCStatFdbck, Rte_COMCbk_HighPreVehOdo, Rte_COMCbk_HighPreVehOdoV, Rte_COMCbk_I_LDC_In, Rte_COMCbk_InvADCCrnt, Rte_COMCbk_InvADCCrntV, Rte_COMCbk_MessageCounter_23Ch, Rte_COMCbk_OBCChgCurrent, Rte_COMCbk_OBCChgVolt, Rte_COMCbk_OBCCurrentFltCode, Rte_COMCbk_OBCHistoryFltCode, Rte_COMCbk_OBCMaxChrgCurrent, Rte_COMCbk_OBCMaxChrgVoltage, Rte_COMCbk_OBCStatus, Rte_COMCbk_PTHVCntctrReq, Rte_COMCbk_RollingCounter, Rte_COMCbk_RollingCounter_1E3h, Rte_COMCbk_SRSCheckSum, Rte_COMCbk_SysBPM, Rte_COMCbk_SysBPMEnbd, Rte_COMCbk_SysOpnlMd, Rte_COMCbk_SysPwrMd, Rte_COMCbk_SysVol, Rte_COMCbk_SysVolMd, Rte_COMCbk_SysVolMdV, Rte_COMCbk_SysVolV, Rte_COMCbk_V_DC, Rte_COMCbk_V_DCValidity, Rte_COMCbk_VehCrshTyp, Rte_COMCbk_VehSpdAvgDrvn, Rte_COMCbk_VehSpdAvgDrvnV, Rte_COMCbk_VehicleSpeed, Rte_COMCbk_VehicleSpeedStatus, Rte_Call_Asw_Swc_Cmu_Get_CMUPCBTempVld_flg, Rte_Call_Asw_Swc_Cmu_Get_CMUPCBTemp_C, Rte_Call_Asw_Swc_Cmu_Get_CellBalState_flg, Rte_Call_Asw_Swc_Cmu_Get_CellTempVld_flg, Rte_Call_Asw_Swc_Cmu_Get_CellTemp_C, Rte_Call_Asw_Swc_Cmu_Get_CellVoltVld_flg, Rte_Call_Asw_Swc_Cmu_Get_CellVolt_mV, Rte_Call_Asw_Swc_Cmu_Get_CmuCbOpenFltArr, Rte_Call_Asw_Swc_Cmu_Get_CmuCbShortFltArr, Rte_Call_Asw_Swc_Cmu_Get_CmuCellTermLeakArr, Rte_Call_Asw_Swc_Cmu_Get_CmuCtOpenFltArr, Rte_Call_Asw_Swc_Cmu_Get_CmuFaultState1, Rte_Call_Asw_Swc_Cmu_Get_CmuFaultState2, Rte_Call_Asw_Swc_Cmu_Get_CmuGpioOTFuncArr, Rte_Call_Asw_Swc_Cmu_Get_CmuGpioUTFuncArr, Rte_Call_Asw_Swc_Cmu_Get_CmuGpioxOpenArr, Rte_Call_Asw_Swc_Cmu_Get_CmuOVFuncArr, Rte_Call_Asw_Swc_Cmu_Get_CmuUVFuncArr, Rte_Call_Asw_Swc_Cmu_Get_CmuVoltChaFuncArr, Rte_Call_Asw_Swc_Cmu_Get_HeatFilmTempVld_flg, Rte_Call_Asw_Swc_Cmu_Get_HeatFilmTemp_C, Rte_Call_Asw_Swc_Cmu_Get_StackVoltVld_flg, Rte_Call_Asw_Swc_Cmu_Get_StackVolt_V, Rte_Call_Asw_Swc_Cmu_Set_CellBalCmd_flg, Rte_Call_Asw_Swc_RPort_ComM_UserRequest_GetCurrentComMode, Rte_Call_Asw_Swc_RPort_EcuM_ShutdownTarget_SelectShutdownTarget, Rte_Call_Asw_Swc_RPort_NVDataBlock1_SetRamBlockStatus, Rte_Call_Asw_Swc_RPort_NVDataBlock1_WriteBlock, Rte_Call_Asw_Swc_Rtc_DisableRTCWakeup_flg, Rte_Call_Asw_Swc_Rtc_ReadRTCTime, Rte_Call_Asw_Swc_Rtc_SetSleepTime_Min, Rte_Call_Asw_Swc_Rtc_WriteRTCTime, Rte_Call_NvM_NVDataBlock1_Finished_JobFinished, Rte_Call_WdgM_SWC_RPort_AliveSupervision_Asw_5ms_CheckpointReached, Rte_Call_WdgM_SWC_RPort_AliveSupervision_Bsw_1000ms_CheckpointReached, Rte_Call_WdgM_SWC_RPort_AliveSupervision_Bsw_100ms_CheckpointReached, Rte_Call_WdgM_SWC_RPort_AliveSupervision_Bsw_10ms_CheckpointReached, Rte_Call_WdgM_SWC_RPort_AliveSupervision_Bsw_20ms_CheckpointReached, Rte_Call_WdgM_SWC_RPort_AliveSupervision_Bsw_50ms_CheckpointReached, Rte_Call_WdgM_SWC_RPort_AliveSupervision_Bsw_5ms_CheckpointReached, Rte_DecrementWaitingCount, Rte_GetCurrentTaskIndex, Rte_MainFunction, Rte_ReadQueue, Rte_Read_Asw_Swc_CCS_CHG_CCS_SPN3081_U_Out, Rte_Read_Asw_Swc_CCS_CHG_CCS_SPN3082_I_Out, Rte_Read_Asw_Swc_CCS_CHG_CCS_SPN3083_Time_Charged, Rte_Read_Asw_Swc_CCS_CHG_CCS_SPN3929_Chg_enable, Rte_Read_Asw_Swc_CEM_CHG_CEM_SPN3921_Timeout_BRM, Rte_Read_Asw_Swc_CEM_CHG_CEM_SPN3922_Timeout_BCP, Rte_Read_Asw_Swc_CEM_CHG_CEM_SPN3923_Timeout_BRO, Rte_Read_Asw_Swc_CEM_CHG_CEM_SPN3924_Timeout_BCS, Rte_Read_Asw_Swc_CEM_CHG_CEM_SPN3925_Timeout_BCL, Rte_Read_Asw_Swc_CEM_CHG_CEM_SPN3926_Timeout_BST, Rte_Read_Asw_Swc_CEM_CHG_CEM_SPN3927_Timeout_BSD, Rte_Read_Asw_Swc_CEM_CHG_CEM_other, Rte_Read_Asw_Swc_CHM_CHG_CHM_SPN2600_Comm_Ver, Rte_Read_Asw_Swc_CML_CHG_CML_SPN2824_U_Max_Out, Rte_Read_Asw_Swc_CML_CHG_CML_SPN2825_U_Min_Out, Rte_Read_Asw_Swc_CML_CHG_CML_SPN2826_I_Max_Out, Rte_Read_Asw_Swc_CML_CHG_CML_SPN2827_I_Min_Out, Rte_Read_Asw_Swc_CRM_CHG_CRM_SPN2560_Ack, Rte_Read_Asw_Swc_CRM_CHG_CRM_SPN2561_CHG_Index, Rte_Read_Asw_Swc_CRM_CHG_CRM_SPN2562_CHG_Loc, Rte_Read_Asw_Swc_CRO_CHG_CRO_SPN2830_CHG_Ready, Rte_Read_Asw_Swc_CSD_CHG_CSD_SPN3611_Time_Charged, Rte_Read_Asw_Swc_CSD_CHG_CSD_SPN3612_E_Out, Rte_Read_Asw_Swc_CSD_CHG_CSD_SPN3613_CHG_Index, Rte_Read_Asw_Swc_CST_CHG_CST_SPN3521_Stop_Reason_Auto, Rte_Read_Asw_Swc_CST_CHG_CST_SPN3521_Stop_Reason_BMSStop, Rte_Read_Asw_Swc_CST_CHG_CST_SPN3521_Stop_Reason_Fault, Rte_Read_Asw_Swc_CST_CHG_CST_SPN3521_Stop_Reason_Manual, Rte_Read_Asw_Swc_CST_CHG_CST_SPN3522_Stop_Fault_CHGCnnt, Rte_Read_Asw_Swc_CST_CHG_CST_SPN3522_Stop_Fault_Deliver, Rte_Read_Asw_Swc_CST_CHG_CST_SPN3522_Stop_Fault_EmerStop, Rte_Read_Asw_Swc_CST_CHG_CST_SPN3522_Stop_Fault_Other, Rte_Read_Asw_Swc_CST_CHG_CST_SPN3522_Stop_Fault_T_CHG, Rte_Read_Asw_Swc_CST_CHG_CST_SPN3522_Stop_Fault_T_Inter, Rte_Read_Asw_Swc_CST_CHG_CST_SPN3523_Stop_Fault_Mismatch, Rte_Read_Asw_Swc_CST_CHG_CST_SPN3523_Stop_Fault_U, Rte_Read_Asw_Swc_CTS_CHG_CTS_SPN2823_SYNC_Day, Rte_Read_Asw_Swc_CTS_CHG_CTS_SPN2823_SYNC_DayTen, Rte_Read_Asw_Swc_CTS_CHG_CTS_SPN2823_SYNC_Hour, Rte_Read_Asw_Swc_CTS_CHG_CTS_SPN2823_SYNC_HourTen, Rte_Read_Asw_Swc_CTS_CHG_CTS_SPN2823_SYNC_Minute, Rte_Read_Asw_Swc_CTS_CHG_CTS_SPN2823_SYNC_MinuteTen, Rte_Read_Asw_Swc_CTS_CHG_CTS_SPN2823_SYNC_Month, Rte_Read_Asw_Swc_CTS_CHG_CTS_SPN2823_SYNC_MonthTen, Rte_Read_Asw_Swc_CTS_CHG_CTS_SPN2823_SYNC_Second, Rte_Read_Asw_Swc_CTS_CHG_CTS_SPN2823_SYNC_SecondTen, Rte_Read_Asw_Swc_CTS_CHG_CTS_SPN2823_SYNC_Year, Rte_Read_Asw_Swc_CTS_CHG_CTS_SPN2823_SYNC_YearHundred, Rte_Read_Asw_Swc_CTS_CHG_CTS_SPN2823_SYNC_YearTen, Rte_Read_Asw_Swc_CTS_CHG_CTS_SPN2823_SYNC_YearThousand, Rte_Read_Asw_Swc_ChargeValue_CC2VoltVld_flg, Rte_Read_Asw_Swc_ChargeValue_CC2Volt_V, Rte_Read_Asw_Swc_ChargeValue_CCResVld_flg, Rte_Read_Asw_Swc_ChargeValue_CCRes_ohm, Rte_Read_Asw_Swc_ChargeValue_CPDutyVld_flg, Rte_Read_Asw_Swc_ChargeValue_CPDuty_pct, Rte_Read_Asw_Swc_ChargeValue_CPFrqVld_flg, Rte_Read_Asw_Swc_ChargeValue_CPFrq_Hz, Rte_Read_Asw_Swc_ChargeValue_CPVoltVld_flg, Rte_Read_Asw_Swc_ChargeValue_CPVolt_V, Rte_Read_Asw_Swc_ChargeValue_DCWakeupVoltVld_flg, Rte_Read_Asw_Swc_ChargeValue_DCWakeupVolt_V, Rte_Read_Asw_Swc_ChargeValue_ELockDiagVoltVld_flg, Rte_Read_Asw_Swc_ChargeValue_ELockDiagVolt_V, Rte_Read_Asw_Swc_ChargeValue_LampCcHDiagVoltVld_flg, Rte_Read_Asw_Swc_ChargeValue_LampCcHDiagVolt_V, Rte_Read_Asw_Swc_ChargeValue_LampChgHDiagVoltVld_flg, Rte_Read_Asw_Swc_ChargeValue_LampChgHDiagVolt_V, Rte_Read_Asw_Swc_CmuValue_BalOpenLoadDiagStatus_flg, Rte_Read_Asw_Swc_CmuValue_CMUPwrDiagVoltVld_flg, Rte_Read_Asw_Swc_CmuValue_CMUPwrDiagVolt_V, Rte_Read_Asw_Swc_CmuValue_CellLeakageDiagStatus_flg, Rte_Read_Asw_Swc_CmuValue_ChanelFuncDiagStatus_flg, Rte_Read_Asw_Swc_CmuValue_CmuReCfgStatus_flg, Rte_Read_Asw_Swc_CmuValue_CtxOpenDiagStatus_flg, Rte_Read_Asw_Swc_CmuValue_GpioOTUTFuncDiagStatus_flg, Rte_Read_Asw_Swc_CmuValue_GpioxOpenDiagStatus_flg, Rte_Read_Asw_Swc_CmuValue_InCMUHWAlarmPWMDutyVld_flg, Rte_Read_Asw_Swc_CmuValue_InCMUHWAlarmPWMDuty_pct, Rte_Read_Asw_Swc_CmuValue_InCMUHWAlarmPWMFeqVld_flg, Rte_Read_Asw_Swc_CmuValue_InCMUHWAlarmPWMFeq_Hz, Rte_Read_Asw_Swc_CrashValue_CrashPWMDutyVld_flg, Rte_Read_Asw_Swc_CrashValue_CrashPWMDuty_pct, Rte_Read_Asw_Swc_CrashValue_CrashPWMFrqVld_flg, Rte_Read_Asw_Swc_CrashValue_CrashPWMFrq_Hz, Rte_Read_Asw_Swc_CurrValue_HallCH1RedVoltVld_flg, Rte_Read_Asw_Swc_CurrValue_HallCH1RedVolt_V, Rte_Read_Asw_Swc_CurrValue_HallCH1VoltVld_flg, Rte_Read_Asw_Swc_CurrValue_HallCH1Volt_V, Rte_Read_Asw_Swc_CurrValue_HallCH2RedVoltVld_flg, Rte_Read_Asw_Swc_CurrValue_HallCH2RedVolt_V, Rte_Read_Asw_Swc_CurrValue_HallCH2VoltVld_flg, Rte_Read_Asw_Swc_CurrValue_HallCH2Volt_V, Rte_Read_Asw_Swc_CurrValue_HallSpyVoltVld_flg, Rte_Read_Asw_Swc_CurrValue_HallSpyVolt_V, Rte_Read_Asw_Swc_CurrValue_PackCurrRedVld_flg, Rte_Read_Asw_Swc_CurrValue_PackCurrRed_A, Rte_Read_Asw_Swc_CurrValue_PackCurrVld_flg, Rte_Read_Asw_Swc_CurrValue_PackCurr_A, Rte_Read_Asw_Swc_DCDC_303h_CDU_HVILWarning, Rte_Read_Asw_Swc_DCDC_303h_I_LDC_In, Rte_Read_Asw_Swc_HighVoltValue_P1CheckVoltVld_flg, Rte_Read_Asw_Swc_HighVoltValue_P1CheckVolt_V, Rte_Read_Asw_Swc_HighVoltValue_P2CheckVoltVld_flg, Rte_Read_Asw_Swc_HighVoltValue_P2CheckVolt_V, Rte_Read_Asw_Swc_HighVoltValue_P3CheckVoltVld_flg, Rte_Read_Asw_Swc_HighVoltValue_P3CheckVolt_V, Rte_Read_Asw_Swc_HighVoltValue_PackVoltVld_flg, Rte_Read_Asw_Swc_HighVoltValue_PackVolt_V, Rte_Read_Asw_Swc_HighVoltValue_PreChgCheckRedVoltVld_flg, Rte_Read_Asw_Swc_HighVoltValue_PreChgCheckRedVolt_V, Rte_Read_Asw_Swc_HighVoltValue_PreChgCheckVoltVld_flg, Rte_Read_Asw_Swc_HighVoltValue_PreChgCheckVolt_V, Rte_Read_Asw_Swc_HvilValue_HVILHighVoltVld_flg, Rte_Read_Asw_Swc_HvilValue_HVILHighVolt_V, Rte_Read_Asw_Swc_HvilValue_HVILLowVoltVld_flg, Rte_Read_Asw_Swc_HvilValue_HVILLowVolt_V, Rte_Read_Asw_Swc_HvilValue_InHVILPWMDutyVld_flg, Rte_Read_Asw_Swc_HvilValue_InHVILPWMDuty_pct, Rte_Read_Asw_Swc_HvilValue_InHVILPWMFrqVld_flg, Rte_Read_Asw_Swc_HvilValue_InHVILPWMFrq_Hz, Rte_Read_Asw_Swc_IsoValue_HVIsoNegVoltVld_flg, Rte_Read_Asw_Swc_IsoValue_HVIsoNegVolt_V, Rte_Read_Asw_Swc_IsoValue_HVIsoPosVoltVld_flg, Rte_Read_Asw_Swc_IsoValue_HVIsoPosVolt_V, Rte_Read_Asw_Swc_McuValue_BSWInitFinish_flg, Rte_Read_Asw_Swc_OBC_604h_OBCChgCurrent, Rte_Read_Asw_Swc_OBC_604h_OBCChgVolt, Rte_Read_Asw_Swc_OBC_604h_OBCCurrentFltCode, Rte_Read_Asw_Swc_OBC_604h_OBCHistoryFltCode, Rte_Read_Asw_Swc_OBC_604h_OBCMaxChrgCurrent, Rte_Read_Asw_Swc_OBC_604h_OBCMaxChrgVoltage, Rte_Read_Asw_Swc_OBC_604h_OBCStatus, Rte_Read_Asw_Swc_PEU_0B4h_V_DC, Rte_Read_Asw_Swc_PEU_0B4h_V_DCValidity, Rte_Read_Asw_Swc_PEU_18Bh_InvADCCrnt, Rte_Read_Asw_Swc_PEU_18Bh_InvADCCrntV, Rte_Read_Asw_Swc_PowerValue_BmuPullupSwitchDiag_flg, Rte_Read_Asw_Swc_PowerValue_BmuPullupVoltVld_flg, Rte_Read_Asw_Swc_PowerValue_BmuPullupVolt_V, Rte_Read_Asw_Swc_PowerValue_KL15VoltVld_flg, Rte_Read_Asw_Swc_PowerValue_KL15Volt_V, Rte_Read_Asw_Swc_PowerValue_KL30VoltVld_flg, Rte_Read_Asw_Swc_PowerValue_KL30Volt_V, Rte_Read_Asw_Swc_PowerValue_KPowertVoltVld_flg, Rte_Read_Asw_Swc_PowerValue_KPowertVolt_V, Rte_Read_Asw_Swc_PowerValue_ResWakeUp1HVoltVld_flg, Rte_Read_Asw_Swc_PowerValue_ResWakeUp1HVolt_V, Rte_Read_Asw_Swc_PowerValue_ResWakeUp2HVoltVld_flg, Rte_Read_Asw_Swc_PowerValue_ResWakeUp2HVolt_V, Rte_Read_Asw_Swc_PowerValue_ResWakeUp3LVoltVld_flg, Rte_Read_Asw_Swc_PowerValue_ResWakeUp3LVolt_V, Rte_Read_Asw_Swc_RelayValue_GlobalHsideDiagVoltVld_flg, Rte_Read_Asw_Swc_RelayValue_GlobalHsideDiagVolt_V, Rte_Read_Asw_Swc_RelayValue_GlobalHsideDriverVoltVld_flg, Rte_Read_Asw_Swc_RelayValue_GlobalHsideDriverVolt_V, Rte_Read_Asw_Swc_RelayValue_K1CtrDriverVoltVld_flg, Rte_Read_Asw_Swc_RelayValue_K1CtrDriverVolt_V, Rte_Read_Asw_Swc_RelayValue_K2CtrDriverVoltVld_flg, Rte_Read_Asw_Swc_RelayValue_K2CtrDriverVolt_V, Rte_Read_Asw_Swc_RelayValue_K3CtrDriverVoltVld_flg, Rte_Read_Asw_Swc_RelayValue_K3CtrDriverVolt_V, Rte_Read_Asw_Swc_RelayValue_K4CtrDriverVoltVld_flg, Rte_Read_Asw_Swc_RelayValue_K4CtrDriverVolt_V, Rte_Read_Asw_Swc_RelayValue_K5CtrDriverVoltVld_flg, Rte_Read_Asw_Swc_RelayValue_K5CtrDriverVolt_V, Rte_Read_Asw_Swc_RelayValue_K6CtrDriverVoltVld_flg, Rte_Read_Asw_Swc_RelayValue_K6CtrDriverVolt_V, Rte_Read_Asw_Swc_RelayValue_KnCtrDriverVoltVld_flg, Rte_Read_Asw_Swc_RelayValue_KnCtrDriverVolt_V, Rte_Read_Asw_Swc_RelayValue_KnchgEnOutState_flg, Rte_Read_Asw_Swc_RelayValue_KnchgEnStateVld_flg, Rte_Read_Asw_Swc_RelayValue_KpCtrDriverVoltVld_flg, Rte_Read_Asw_Swc_RelayValue_KpCtrDriverVolt_V, Rte_Read_Asw_Swc_RelayValue_KpEnOutState_flg, Rte_Read_Asw_Swc_RelayValue_KpEnStateVld_flg, Rte_Read_Asw_Swc_RsvValue_InRsvPWMDutyVld_flg, Rte_Read_Asw_Swc_RsvValue_InRsvPWMDuty_pct, Rte_Read_Asw_Swc_RsvValue_InRsvPWMFrqVld_flg, Rte_Read_Asw_Swc_RsvValue_InRsvPWMFrq_Hz, Rte_Read_Asw_Swc_RsvValue_RsvAD1VoltVld_flg, Rte_Read_Asw_Swc_RsvValue_RsvAD1Volt_V, Rte_Read_Asw_Swc_RsvValue_RsvAD2VoltVld_flg, Rte_Read_Asw_Swc_RsvValue_RsvAD2Volt_V, Rte_Read_Asw_Swc_RsvValue_RsvAD3VoltVld_flg, Rte_Read_Asw_Swc_RsvValue_RsvAD3Volt_V, Rte_Read_Asw_Swc_RsvValue_RsvAD4VoltVld_flg, Rte_Read_Asw_Swc_RsvValue_RsvAD4Volt_V, Rte_Read_Asw_Swc_RsvValue_RsvAD5VoltVld_flg, Rte_Read_Asw_Swc_RsvValue_RsvAD5Volt_V, Rte_Read_Asw_Swc_SbcValue_BMULastPwrDownState, Rte_Read_Asw_Swc_SbcValue_BmuSbcCanTRSt_flg, Rte_Read_Asw_Swc_SbcValue_BmuSbcRstbPinSt_flg, Rte_Read_Asw_Swc_SbcValue_BmuSbcVauxOV_flg, Rte_Read_Asw_Swc_SbcValue_BmuSbcVauxUV_flg, Rte_Read_Asw_Swc_SbcValue_BmuSbcVcanOV_flg, Rte_Read_Asw_Swc_SbcValue_BmuSbcVcanUV_flg, Rte_Read_Asw_Swc_SbcValue_BmuSbcVccaOV_flg, Rte_Read_Asw_Swc_SbcValue_BmuSbcVccaUV_flg, Rte_Read_Asw_Swc_SbcValue_BmuSbcVcoreOV_flg, Rte_Read_Asw_Swc_SbcValue_BmuSbcVpreOV_flg, Rte_Read_Asw_Swc_SbcValue_BmuSbcVpreUV_flg, Rte_Read_Asw_Swc_SbcValue_BmuSbxVcoreUV_flg, Rte_Read_Asw_Swc_SbcValue_CANWakeupState_flg, Rte_Read_Asw_Swc_SbcValue_KL15WakeupState_flg, Rte_Read_Asw_Swc_SbcValue_RTCWakeupState_flg, Rte_Read_Asw_Swc_SbcValue_SBCWakeupP1State_flg, Rte_Read_Asw_Swc_SbcValue_SBCWakeupP2State_flg, Rte_Read_Asw_Swc_SbcValue_SBCWakeupP3State_flg, Rte_Read_Asw_Swc_ThermalValue_BmuTemp1NtcVld_flg, Rte_Read_Asw_Swc_ThermalValue_BmuTemp1Ntc_Ohm, Rte_Read_Asw_Swc_ThermalValue_BmuTemp2NtcVld_flg, Rte_Read_Asw_Swc_ThermalValue_BmuTemp2Ntc_Ohm, Rte_Read_Asw_Swc_ThermalValue_BmuTemp3NtcVld_flg, Rte_Read_Asw_Swc_ThermalValue_BmuTemp3Ntc_Ohm, Rte_Read_Asw_Swc_ThermalValue_BmuTemp4NtcVld_flg, Rte_Read_Asw_Swc_ThermalValue_BmuTemp4Ntc_Ohm, Rte_Read_Asw_Swc_ThermalValue_BmuTemp5NtcVld_flg, Rte_Read_Asw_Swc_ThermalValue_BmuTemp5Ntc_Ohm, Rte_Read_Asw_Swc_ThermalValue_BmuTemp6NtcVld_flg, Rte_Read_Asw_Swc_ThermalValue_BmuTemp6Ntc_Ohm, Rte_Read_Asw_Swc_ThermalValue_BmuTemp7NtcVld_flg, Rte_Read_Asw_Swc_ThermalValue_BmuTemp7Ntc_Ohm, Rte_Read_Asw_Swc_ThermalValue_InCoolPumpPWMDutyVld_flg, Rte_Read_Asw_Swc_ThermalValue_InCoolPumpPWMDuty_Pct, Rte_Read_Asw_Swc_ThermalValue_InCoolPumpPWMFrqVld_flg, Rte_Read_Asw_Swc_ThermalValue_InCoolPumpPWMFrq_Hz, Rte_Read_Asw_Swc_ThermalValue_InFanPWMDutyVld_flg, Rte_Read_Asw_Swc_ThermalValue_InFanPWMDuty_Pct, Rte_Read_Asw_Swc_ThermalValue_InFanPWMFrqVld_flg, Rte_Read_Asw_Swc_ThermalValue_InFanPWMFrq_Hz, Rte_Read_Asw_Swc_ThermalValue_ValveDiagVoltVld_flg, Rte_Read_Asw_Swc_ThermalValue_ValveDiagVolt_V, Rte_Read_Asw_Swc_VCU_1E3h_CheckSum_1E3h, Rte_Read_Asw_Swc_VCU_1E3h_ChrgrStatPTHVCntctOpnrAlwd, Rte_Read_Asw_Swc_VCU_1E3h_ChrgrStatPTHVCntctrClsAlwd, Rte_Read_Asw_Swc_VCU_1E3h_PTHVCntctrReq, Rte_Read_Asw_Swc_VCU_1E3h_RollingCounter_1E3h, Rte_Read_Asw_Swc_VCU_353h_VehSpdAvgDrvn, Rte_Read_Asw_Swc_VCU_353h_VehSpdAvgDrvnV, Rte_Read_Asw_Swc_VCU_ABS_23Ch_CheckSum_23Ch, Rte_Read_Asw_Swc_VCU_ABS_23Ch_MessageCounter_23Ch, Rte_Read_Asw_Swc_VCU_ABS_23Ch_VehicleSpeed, Rte_Read_Asw_Swc_VCU_ABS_23Ch_VehicleSpeedStatus, Rte_Read_Asw_Swc_VCU_BCM_1F1h_SysOpnlMd, Rte_Read_Asw_Swc_VCU_BCM_1F1h_SysPwrMd, Rte_Read_Asw_Swc_VCU_BCM_1F1h_SysVol, Rte_Read_Asw_Swc_VCU_BCM_1F1h_SysVolMd, Rte_Read_Asw_Swc_VCU_BCM_1F1h_SysVolMdV, Rte_Read_Asw_Swc_VCU_BCM_1F1h_SysVolV, Rte_Read_Asw_Swc_VCU_HCM_55Fh_FrontCmprElctrCrnt, Rte_Read_Asw_Swc_VCU_HCM_55Fh_FrontCompStatFdbck, Rte_Read_Asw_Swc_VCU_HCM_55Fh_FrontPTCElctrCrnt, Rte_Read_Asw_Swc_VCU_HCM_55Fh_FrontPTCStatFdbck, Rte_Read_Asw_Swc_VCU_IPK_1F2h_SysBPM, Rte_Read_Asw_Swc_VCU_IPK_1F2h_SysBPMEnbd, Rte_Read_Asw_Swc_VCU_IPK_362h_HighPreVehOdo, Rte_Read_Asw_Swc_VCU_IPK_362h_HighPreVehOdoV, Rte_Read_Asw_Swc_VCU_SRS_163h_RollingCounter, Rte_Read_Asw_Swc_VCU_SRS_163h_SRSCheckSum, Rte_Read_Asw_Swc_VCU_SRS_163h_VehCrshTyp, Rte_Read_BswM_RP_BswMArbitration_BswM_MRP_SwcModeRequest_VDP_uint16, Rte_Read_Cmu_Cdd_CmuCmd_BalOpenLoadDiagCmd_flg, Rte_Read_Cmu_Cdd_CmuCmd_CMUPwrCmd_flg, Rte_Read_Cmu_Cdd_CmuCmd_CellLeakageDiagCmd_flg, Rte_Read_Cmu_Cdd_CmuCmd_CellMeasCmd_flg, Rte_Read_Cmu_Cdd_CmuCmd_ChanelFuncDiagCmd_flg, Rte_Read_Cmu_Cdd_CmuCmd_CmuClrFaultPin_flg, Rte_Read_Cmu_Cdd_CmuCmd_CmuReCfg_flg, Rte_Read_Cmu_Cdd_CmuCmd_CtxOpenDiagCmd_flg, Rte_Read_Cmu_Cdd_CmuCmd_GpioOTUTFuncDiagCmd_flg, Rte_Read_Cmu_Cdd_CmuCmd_GpioxOpenDiagCmd_flg, Rte_Read_Cmu_Cdd_CmuCmd_OutCMUHWAlarmPWMDuty_Pct, Rte_Read_IoHwAb_ChargeCmd_ACS2Cmd_flg, Rte_Read_IoHwAb_ChargeCmd_ELockCtrlCmd_enum, Rte_Read_IoHwAb_ChargeCmd_ELockSel0Cmd_flg, Rte_Read_IoHwAb_ChargeCmd_LampCcHCmd_flg, Rte_Read_IoHwAb_ChargeCmd_LampChgHCmd_flg, Rte_Read_IoHwAb_FblCmd_FBLForbid_flg, Rte_Read_IoHwAb_HighVoltCmd_PackVoltMeasCmd_flg, Rte_Read_IoHwAb_HvilCmd_OutHVILPWMDuty_Pct, Rte_Read_IoHwAb_IsoCmd_HVIsoNegMosCmd_flg, Rte_Read_IoHwAb_IsoCmd_HVIsoPosMosCmd_flg, Rte_Read_IoHwAb_McuCmd_RadyToSleep_flg, Rte_Read_IoHwAb_RelayCmd_GlobalHCtrCmd_flg, Rte_Read_IoHwAb_RelayCmd_K1CtrCmd_flg, Rte_Read_IoHwAb_RelayCmd_K2CtrCmd_flg, Rte_Read_IoHwAb_RelayCmd_K3CtrCmd_flg, Rte_Read_IoHwAb_RelayCmd_K4CtrCmd_flg, Rte_Read_IoHwAb_RelayCmd_K5CtrCmd_flg, Rte_Read_IoHwAb_RelayCmd_K6CtrCmd_flg, Rte_Read_IoHwAb_RelayCmd_KnCtrlCmd_flg, Rte_Read_IoHwAb_RelayCmd_KpCtrlCmd_flg, Rte_Read_IoHwAb_ThermalCmd_OutCoolPumpPWMDuty_Pct, Rte_Read_IoHwAb_ThermalCmd_OutFanPWMDuty_Pct, Rte_Read_IoHwAb_ThermalCmd_ValveEn_flg, Rte_Read_Sbc_Cdd_SbcCmd_CANWakeupEnable_flg, Rte_SetEvent, Rte_Start, Rte_Stop, Rte_SwitchAck_WdgM_globalMode_currentMode, Rte_SwitchAck_WdgM_mode_WdgMAliveSupervisedEntity_Asw_5ms_currentMode, Rte_SwitchAck_WdgM_mode_WdgMAliveSupervisedEntity_Bsw_1000ms_currentMode, Rte_SwitchAck_WdgM_mode_WdgMAliveSupervisedEntity_Bsw_100ms_currentMode, Rte_SwitchAck_WdgM_mode_WdgMAliveSupervisedEntity_Bsw_10ms_currentMode, Rte_SwitchAck_WdgM_mode_WdgMAliveSupervisedEntity_Bsw_20ms_currentMode, Rte_SwitchAck_WdgM_mode_WdgMAliveSupervisedEntity_Bsw_50ms_currentMode, Rte_SwitchAck_WdgM_mode_WdgMAliveSupervisedEntity_Bsw_5ms_currentMode, Rte_Switch_ComM_UM_ComMUser_Can_Network_0_Channel_currentMode, Rte_Switch_WdgM_globalMode_currentMode, Rte_Switch_WdgM_mode_WdgMAliveSupervisedEntity_Asw_5ms_currentMode, Rte_Switch_WdgM_mode_WdgMAliveSupervisedEntity_Bsw_1000ms_currentMode, Rte_Switch_WdgM_mode_WdgMAliveSupervisedEntity_Bsw_100ms_currentMode, Rte_Switch_WdgM_mode_WdgMAliveSupervisedEntity_Bsw_10ms_currentMode, Rte_Switch_WdgM_mode_WdgMAliveSupervisedEntity_Bsw_20ms_currentMode, Rte_Switch_WdgM_mode_WdgMAliveSupervisedEntity_Bsw_50ms_currentMode, Rte_Switch_WdgM_mode_WdgMAliveSupervisedEntity_Bsw_5ms_currentMode, Rte_WaitWithTimeout, Rte_WriteQueue, Rte_Write_Asw_Swc_BCL_BCU_BCL_SPN3072_U_Req, Rte_Write_Asw_Swc_BCL_BCU_BCL_SPN3073_I_Req, Rte_Write_Asw_Swc_BCL_BCU_BCL_SPN3074_ChgMode, Rte_Write_Asw_Swc_BCP_BCU_BCP_SPN2816_Ucell_Max_Permit, Rte_Write_Asw_Swc_BCP_BCU_BCP_SPN2817_I_Max_Permit, Rte_Write_Asw_Swc_BCP_BCU_BCP_SPN2818_kWh_Nom, Rte_Write_Asw_Swc_BCP_BCU_BCP_SPN2819_U_Max_Permit, Rte_Write_Asw_Swc_BCP_BCU_BCP_SPN2820_T_Max_Permit, Rte_Write_Asw_Swc_BCP_BCU_BCP_SPN2821_SOC, Rte_Write_Asw_Swc_BCP_BCU_BCP_SPN2822_U, Rte_Write_Asw_Swc_BCS_BCU_BCS_SPN3075_U_Mea, Rte_Write_Asw_Swc_BCS_BCU_BCS_SPN3076_I_Mea, Rte_Write_Asw_Swc_BCS_BCU_BCS_SPN3077_Ucell_Max, Rte_Write_Asw_Swc_BCS_BCU_BCS_SPN3077_Ucell_Max_Grp, Rte_Write_Asw_Swc_BCS_BCU_BCS_SPN3078_SOC, Rte_Write_Asw_Swc_BCS_BCU_BCS_SPN3079_Time_Remain, Rte_Write_Asw_Swc_BEM_BCU_BEM_SPN3901_Timeout_SPN2560_0x00, Rte_Write_Asw_Swc_BEM_BCU_BEM_SPN3902_Timeout_SPN2560_0xAA, Rte_Write_Asw_Swc_BEM_BCU_BEM_SPN3903_Timeout_CTS_CML, Rte_Write_Asw_Swc_BEM_BCU_BEM_SPN3904_Timeout_CRO, Rte_Write_Asw_Swc_BEM_BCU_BEM_SPN3905_Timeout_CCS, Rte_Write_Asw_Swc_BEM_BCU_BEM_SPN3906_Timeout_CST, Rte_Write_Asw_Swc_BEM_BCU_BEM_SPN3907_Timeout_CSD, Rte_Write_Asw_Swc_BEM_BCU_BEM_other, Rte_Write_Asw_Swc_BHM_BCU_BHM_SPN2601_Ubat_Max_Permit, Rte_Write_Asw_Swc_BMS_1D8h_BMSlightReq, Rte_Write_Asw_Swc_BMS_1D8h_ChrgrStatPTHVCntctrReq, Rte_Write_Asw_Swc_BMS_1D8h_HVBatFltSevrtyStat, Rte_Write_Asw_Swc_BMS_1D8h_HVBatPrcdCrnt, Rte_Write_Asw_Swc_BMS_1D8h_HVBatPrcdCrntV, Rte_Write_Asw_Swc_BMS_1D8h_HVCntctrStat, Rte_Write_Asw_Swc_BMS_1D8h_HVCntctrStatARC, Rte_Write_Asw_Swc_BMS_329h_CellTempMes1, Rte_Write_Asw_Swc_BMS_329h_CellTempMes2, Rte_Write_Asw_Swc_BMS_329h_CellTempMes3, Rte_Write_Asw_Swc_BMS_329h_CellTempMes4, Rte_Write_Asw_Swc_BMS_329h_CellTempMes5, Rte_Write_Asw_Swc_BMS_329h_CellTempMes6, Rte_Write_Asw_Swc_BMS_329h_CellTempMes7, Rte_Write_Asw_Swc_BMS_329h_MesCellTempNumIndex, Rte_Write_Asw_Swc_BMS_32Ah_Mes1CellBalState, Rte_Write_Asw_Swc_BMS_32Ah_Mes1CellVolt, Rte_Write_Asw_Swc_BMS_32Ah_Mes2CellBalState, Rte_Write_Asw_Swc_BMS_32Ah_Mes2CellVolt, Rte_Write_Asw_Swc_BMS_32Ah_Mes3CellBalState, Rte_Write_Asw_Swc_BMS_32Ah_Mes3CellVolt, Rte_Write_Asw_Swc_BMS_32Ah_MesCellVoltNumIndex, Rte_Write_Asw_Swc_BMS_3D7h_HVBatPackPrcdVltg, Rte_Write_Asw_Swc_BMS_3D7h_HVBatPackPrcdVltgV, Rte_Write_Asw_Swc_BMS_3DAh_BMSChecksum_3DAh, Rte_Write_Asw_Swc_BMS_3DAh_ChrgPeakTimeFactor, Rte_Write_Asw_Swc_BMS_3DAh_HVBCP_CrnkChrgPwrV, Rte_Write_Asw_Swc_BMS_3DAh_HVBCP_LngTrmChrgPwr, Rte_Write_Asw_Swc_BMS_3DAh_HVBCP_ShrtTrmChrgPwr, Rte_Write_Asw_Swc_BMS_3DBh_BMSChecksum_3DBh, Rte_Write_Asw_Swc_BMS_3DBh_DischrgPeakTimeFactor, Rte_Write_Asw_Swc_BMS_3DBh_HVBDP_CrnkDischrgPwrV, Rte_Write_Asw_Swc_BMS_3DBh_HVBDP_LngTrmDischrgPwr, Rte_Write_Asw_Swc_BMS_3DBh_HVBDP_ShrtTrmDischrgPwr, Rte_Write_Asw_Swc_BMS_501h_BMSCelConsistencyWarning, Rte_Write_Asw_Swc_BMS_501h_BMSVolHighWarning, Rte_Write_Asw_Swc_BMS_501h_CellOvWarning, Rte_Write_Asw_Swc_BMS_501h_CellUvWarning, Rte_Write_Asw_Swc_BMS_501h_EnergyConsumptionPer, Rte_Write_Asw_Swc_BMS_501h_HVILWarning, Rte_Write_Asw_Swc_BMS_501h_HVIsoWarning, Rte_Write_Asw_Swc_BMS_501h_PackOvWarning, Rte_Write_Asw_Swc_BMS_501h_PackUvWarning, Rte_Write_Asw_Swc_BMS_501h_PwrBatPackMismatchWarning, Rte_Write_Asw_Swc_BMS_501h_RestEnergy, Rte_Write_Asw_Swc_BMS_501h_SOCFastChgWarning, Rte_Write_Asw_Swc_BMS_501h_SOCHighWarning, Rte_Write_Asw_Swc_BMS_501h_SOCLowWarning, Rte_Write_Asw_Swc_BMS_501h_TempDiffWarning, Rte_Write_Asw_Swc_BMS_501h_TempHighWarning, Rte_Write_Asw_Swc_BMS_501h_ThermalAlarm, Rte_Write_Asw_Swc_BMS_501h_ThermalAlarmV, Rte_Write_Asw_Swc_BMS_503h_BMSCellQuantity, Rte_Write_Asw_Swc_BMS_503h_BMSTempProbeQuantity, Rte_Write_Asw_Swc_BMS_503h_HVIsoValue, Rte_Write_Asw_Swc_BMS_503h_RealSOC, Rte_Write_Asw_Swc_BMS_509h_CurRechgEnergyStorSysIndex, Rte_Write_Asw_Swc_BMS_509h_RechgEnergyStorSysCode1, Rte_Write_Asw_Swc_BMS_509h_RechgEnergyStorSysCode2, Rte_Write_Asw_Swc_BMS_509h_RechgEnergyStorSysCode3, Rte_Write_Asw_Swc_BMS_509h_RechgEnergyStorSysCode4, Rte_Write_Asw_Swc_BMS_509h_RechgEnergyStorSysCode5, Rte_Write_Asw_Swc_BMS_509h_RechgEnergyStorSysCode6, Rte_Write_Asw_Swc_BMS_509h_RechgEnergyStorSysCodeIndex, Rte_Write_Asw_Swc_BMS_509h_RechgEnergyStorSysCodeLength, Rte_Write_Asw_Swc_BMS_509h_RechgEnergyStorSysNumb, Rte_Write_Asw_Swc_BMS_594h_HVBatPackAccVltg, Rte_Write_Asw_Swc_BMS_594h_HVBatPackAccVltgV, Rte_Write_Asw_Swc_BMS_594h_MaxCellVoltNumb, Rte_Write_Asw_Swc_BMS_594h_MaxClVlt, Rte_Write_Asw_Swc_BMS_594h_MinCellVoltNumb, Rte_Write_Asw_Swc_BMS_594h_MinClVlt, Rte_Write_Asw_Swc_BMS_596h_MaxBatTmp, Rte_Write_Asw_Swc_BMS_596h_MaxCellTempNumb, Rte_Write_Asw_Swc_BMS_596h_MinBatTmp, Rte_Write_Asw_Swc_BMS_596h_MinCellTempNumb, Rte_Write_Asw_Swc_BMS_598h_BMSChrgStatus, Rte_Write_Asw_Swc_BMS_598h_BatLf, Rte_Write_Asw_Swc_BMS_598h_ChrgPlugStatus, Rte_Write_Asw_Swc_BMS_598h_HVSystemStatus, Rte_Write_Asw_Swc_BMS_598h_PreChrgUnitRdy, Rte_Write_Asw_Swc_BMS_598h_TotalBatteryCap, Rte_Write_Asw_Swc_BMS_603h_ACChrgCurrRq, Rte_Write_Asw_Swc_BMS_603h_ACChrgFault, Rte_Write_Asw_Swc_BMS_603h_ACChrgMode, Rte_Write_Asw_Swc_BMS_603h_ACChrgVoltRq, Rte_Write_Asw_Swc_BMS_603h_CCVaule, Rte_Write_Asw_Swc_BMS_603h_CPVaule, Rte_Write_Asw_Swc_BMS_603h_S2_Status, Rte_Write_Asw_Swc_BMS_605h_ChargingVoltage, Rte_Write_Asw_Swc_BMS_605h_FullChargeRemainingTime, Rte_Write_Asw_Swc_BMS_605h_RequestChargeCurrent, Rte_Write_Asw_Swc_BMS_606h_BEM_CCS, Rte_Write_Asw_Swc_BMS_606h_BEM_CML, Rte_Write_Asw_Swc_BMS_606h_BEM_CRM00, Rte_Write_Asw_Swc_BMS_606h_BEM_CRMAA, Rte_Write_Asw_Swc_BMS_606h_BEM_CRO, Rte_Write_Asw_Swc_BMS_606h_BEM_CSD, Rte_Write_Asw_Swc_BMS_606h_BEM_CST, Rte_Write_Asw_Swc_BMS_606h_BEM_Other, Rte_Write_Asw_Swc_BMS_606h_BMSStopChargeFaultCode1, Rte_Write_Asw_Swc_BMS_606h_BMSStopChargeFaultCode2, Rte_Write_Asw_Swc_BMS_606h_BMSStopChargeFaultCode3, Rte_Write_Asw_Swc_BMS_606h_BMSStopChargeFaultCode4, Rte_Write_Asw_Swc_BMS_606h_BMSStopChargeFaultCode5, Rte_Write_Asw_Swc_BMS_606h_BMSStopChargeFaultCode6, Rte_Write_Asw_Swc_BMS_606h_BMSStopChargeFaultCode7, Rte_Write_Asw_Swc_BMS_606h_BMSStopChargeFaultCode8, Rte_Write_Asw_Swc_BMS_606h_CEM_BCL, Rte_Write_Asw_Swc_BMS_606h_CEM_BCP, Rte_Write_Asw_Swc_BMS_606h_CEM_BCS, Rte_Write_Asw_Swc_BMS_606h_CEM_BRM, Rte_Write_Asw_Swc_BMS_606h_CEM_BRO, Rte_Write_Asw_Swc_BMS_606h_CEM_BSD, Rte_Write_Asw_Swc_BMS_606h_CEM_BST, Rte_Write_Asw_Swc_BMS_606h_CEM_Other, Rte_Write_Asw_Swc_BMS_606h_CHGStopChargeFaultCode1, Rte_Write_Asw_Swc_BMS_606h_CHGStopChargeFaultCode2, Rte_Write_Asw_Swc_BMS_606h_CHGStopChargeFaultCode3, Rte_Write_Asw_Swc_BMS_606h_CHGStopChargeFaultCode4, Rte_Write_Asw_Swc_BMS_606h_CHGStopChargeFaultCode5, Rte_Write_Asw_Swc_BMS_606h_CHGStopChargeFaultCode6, Rte_Write_Asw_Swc_BMS_606h_CHGStopChargeFaultCode7, Rte_Write_Asw_Swc_BMS_606h_CHGStopChargeFaultCode8, Rte_Write_Asw_Swc_BMS_606h_StopChargingReson, Rte_Write_Asw_Swc_BMS_795h_BMSDTCFailureTypeByte, Rte_Write_Asw_Swc_BMS_795h_BMSDTCHighByte, Rte_Write_Asw_Swc_BMS_795h_BMSDTCLowByte, Rte_Write_Asw_Swc_BMS_795h_BMSDTCSeriousLevel, Rte_Write_Asw_Swc_BMS_795h_BMSDTCStatus, Rte_Write_Asw_Swc_BMS_795h_BMSDTCType, Rte_Write_Asw_Swc_BRM_BCU_BRM_SPN2565_Ver, Rte_Write_Asw_Swc_BRM_BCU_BRM_SPN2566_Bat_Type, Rte_Write_Asw_Swc_BRM_BCU_BRM_SPN2567_Cap_Nom, Rte_Write_Asw_Swc_BRM_BCU_BRM_SPN2568_U_Nom, Rte_Write_Asw_Swc_BRM_BCU_BRM_SPN2569_BatFactory, Rte_Write_Asw_Swc_BRM_BCU_BRM_SPN2570_PackSN, Rte_Write_Asw_Swc_BRM_BCU_BRM_SPN2571_PackDay, Rte_Write_Asw_Swc_BRM_BCU_BRM_SPN2571_PackMonth, Rte_Write_Asw_Swc_BRM_BCU_BRM_SPN2571_PackYear, Rte_Write_Asw_Swc_BRM_BCU_BRM_SPN2572_PackChgCnt, Rte_Write_Asw_Swc_BRM_BCU_BRM_SPN2573_PackRight, Rte_Write_Asw_Swc_BRM_BCU_BRM_SPN2574_BMSSW_Reserved, Rte_Write_Asw_Swc_BRM_BCU_BRM_SPN2575_VIN1, Rte_Write_Asw_Swc_BRM_BCU_BRM_SPN2575_VIN10, Rte_Write_Asw_Swc_BRM_BCU_BRM_SPN2575_VIN11, Rte_Write_Asw_Swc_BRM_BCU_BRM_SPN2575_VIN12, Rte_Write_Asw_Swc_BRM_BCU_BRM_SPN2575_VIN13, Rte_Write_Asw_Swc_BRM_BCU_BRM_SPN2575_VIN14, Rte_Write_Asw_Swc_BRM_BCU_BRM_SPN2575_VIN15, Rte_Write_Asw_Swc_BRM_BCU_BRM_SPN2575_VIN16, Rte_Write_Asw_Swc_BRM_BCU_BRM_SPN2575_VIN17, Rte_Write_Asw_Swc_BRM_BCU_BRM_SPN2575_VIN2, Rte_Write_Asw_Swc_BRM_BCU_BRM_SPN2575_VIN3, Rte_Write_Asw_Swc_BRM_BCU_BRM_SPN2575_VIN4, Rte_Write_Asw_Swc_BRM_BCU_BRM_SPN2575_VIN5, Rte_Write_Asw_Swc_BRM_BCU_BRM_SPN2575_VIN6, Rte_Write_Asw_Swc_BRM_BCU_BRM_SPN2575_VIN7, Rte_Write_Asw_Swc_BRM_BCU_BRM_SPN2575_VIN8, Rte_Write_Asw_Swc_BRM_BCU_BRM_SPN2575_VIN9, Rte_Write_Asw_Swc_BRM_BCU_BRM_SPN2576_BMSVer_Day, Rte_Write_Asw_Swc_BRM_BCU_BRM_SPN2576_BMSVer_Month, Rte_Write_Asw_Swc_BRM_BCU_BRM_SPN2576_BMSVer_Reserver, Rte_Write_Asw_Swc_BRM_BCU_BRM_SPN2576_BMSVer_Version, Rte_Write_Asw_Swc_BRM_BCU_BRM_SPN2576_BMSVer_Year, Rte_Write_Asw_Swc_BRO_BCU_BRO_SPN2829_BCU_Ready, Rte_Write_Asw_Swc_BSD_BCU_BSD_SPN3601_SOC_Final, Rte_Write_Asw_Swc_BSD_BCU_BSD_SPN3602_Ucell_Min, Rte_Write_Asw_Swc_BSD_BCU_BSD_SPN3603_Ucell_Max, Rte_Write_Asw_Swc_BSD_BCU_BSD_SPN3604_T_Min, Rte_Write_Asw_Swc_BSD_BCU_BSD_SPN3605_T_Max, Rte_Write_Asw_Swc_BSM_BCU_BSM_SPN3085_Ucell_Max_Index, Rte_Write_Asw_Swc_BSM_BCU_BSM_SPN3086_T_Max, Rte_Write_Asw_Swc_BSM_BCU_BSM_SPN3087_T_Max_Index, Rte_Write_Asw_Swc_BSM_BCU_BSM_SPN3088_T_Min, Rte_Write_Asw_Swc_BSM_BCU_BSM_SPN3089_T_Min_Index, Rte_Write_Asw_Swc_BSM_BCU_BSM_SPN3090_Ucell_Warn, Rte_Write_Asw_Swc_BSM_BCU_BSM_SPN3091_SOC_Warn, Rte_Write_Asw_Swc_BSM_BCU_BSM_SPN3092_I_Warn, Rte_Write_Asw_Swc_BSM_BCU_BSM_SPN3093_T_Warn, Rte_Write_Asw_Swc_BSM_BCU_BSM_SPN3094_Iso_State, Rte_Write_Asw_Swc_BSM_BCU_BSM_SPN3095_OutConnector_State, Rte_Write_Asw_Swc_BSM_BCU_BSM_SPN3096_Chg_Enable, Rte_Write_Asw_Swc_BST_BCU_BST_SPN3511_Stop_Reason_CHGStop, Rte_Write_Asw_Swc_BST_BCU_BST_SPN3511_Stop_Reason_SOC, Rte_Write_Asw_Swc_BST_BCU_BST_SPN3511_Stop_Reason_U, Rte_Write_Asw_Swc_BST_BCU_BST_SPN3511_Stop_Reason_Ucell, Rte_Write_Asw_Swc_BST_BCU_BST_SPN3512_Stop_Fault_BCUcompo, Rte_Write_Asw_Swc_BST_BCU_BST_SPN3512_Stop_Fault_CC2, Rte_Write_Asw_Swc_BST_BCU_BST_SPN3512_Stop_Fault_ChgCnnt, Rte_Write_Asw_Swc_BST_BCU_BST_SPN3512_Stop_Fault_HVRelay, Rte_Write_Asw_Swc_BST_BCU_BST_SPN3512_Stop_Fault_Iso, Rte_Write_Asw_Swc_BST_BCU_BST_SPN3512_Stop_Fault_Other, Rte_Write_Asw_Swc_BST_BCU_BST_SPN3512_Stop_Fault_OutCnnt, Rte_Write_Asw_Swc_BST_BCU_BST_SPN3512_Stop_Fault_T, Rte_Write_Asw_Swc_BST_BCU_BST_SPN3513_Stop_Fault_I, Rte_Write_Asw_Swc_BST_BCU_BST_SPN3513_Stop_Fault_U, Rte_Write_Asw_Swc_ChargeCmd_ACS2Cmd_flg, Rte_Write_Asw_Swc_ChargeCmd_ELockCtrlCmd_enum, Rte_Write_Asw_Swc_ChargeCmd_ELockSel0Cmd_flg, Rte_Write_Asw_Swc_ChargeCmd_LampCcHCmd_flg, Rte_Write_Asw_Swc_ChargeCmd_LampChgHCmd_flg, Rte_Write_Asw_Swc_CmuCmd_BalOpenLoadDiagCmd_flg, Rte_Write_Asw_Swc_CmuCmd_CMUPwrCmd_flg, Rte_Write_Asw_Swc_CmuCmd_CellLeakageDiagCmd_flg, Rte_Write_Asw_Swc_CmuCmd_CellMeasCmd_flg, Rte_Write_Asw_Swc_CmuCmd_ChanelFuncDiagCmd_flg, Rte_Write_Asw_Swc_CmuCmd_CmuClrFaultPin_flg, Rte_Write_Asw_Swc_CmuCmd_CmuReCfg_flg, Rte_Write_Asw_Swc_CmuCmd_CtxOpenDiagCmd_flg, Rte_Write_Asw_Swc_CmuCmd_GpioOTUTFuncDiagCmd_flg, Rte_Write_Asw_Swc_CmuCmd_GpioxOpenDiagCmd_flg, Rte_Write_Asw_Swc_CmuCmd_OutCMUHWAlarmPWMDuty_Pct, Rte_Write_Asw_Swc_FblCmd_FBLForbid_flg, Rte_Write_Asw_Swc_HighVoltCmd_PackVoltMeasCmd_flg, Rte_Write_Asw_Swc_HvilCmd_OutHVILPWMDuty_Pct, Rte_Write_Asw_Swc_IsoCmd_HVIsoNegMosCmd_flg, Rte_Write_Asw_Swc_IsoCmd_HVIsoPosMosCmd_flg, Rte_Write_Asw_Swc_McuCmd_RadyToSleep_flg, Rte_Write_Asw_Swc_PPort_BswMArbitration_BswM_MRP_SwcModeRequest_VDP_uint16, Rte_Write_Asw_Swc_RelayCmd_GlobalHCtrCmd_flg, Rte_Write_Asw_Swc_RelayCmd_K1CtrCmd_flg, Rte_Write_Asw_Swc_RelayCmd_K2CtrCmd_flg, Rte_Write_Asw_Swc_RelayCmd_K3CtrCmd_flg, Rte_Write_Asw_Swc_RelayCmd_K4CtrCmd_flg, Rte_Write_Asw_Swc_RelayCmd_K5CtrCmd_flg, Rte_Write_Asw_Swc_RelayCmd_K6CtrCmd_flg, Rte_Write_Asw_Swc_RelayCmd_KnCtrlCmd_flg, Rte_Write_Asw_Swc_RelayCmd_KpCtrlCmd_flg, Rte_Write_Asw_Swc_SbcCmd_CANWakeupEnable_flg, Rte_Write_Asw_Swc_ThermalCmd_OutCoolPumpPWMDuty_Pct, Rte_Write_Asw_Swc_ThermalCmd_OutFanPWMDuty_Pct, Rte_Write_Asw_Swc_ThermalCmd_ValveEn_flg, Rte_Write_Cmu_Cdd_CmuValue_BalOpenLoadDiagStatus_flg, Rte_Write_Cmu_Cdd_CmuValue_CMUPwrDiagVoltVld_flg, Rte_Write_Cmu_Cdd_CmuValue_CMUPwrDiagVolt_V, Rte_Write_Cmu_Cdd_CmuValue_CellLeakageDiagStatus_flg, Rte_Write_Cmu_Cdd_CmuValue_ChanelFuncDiagStatus_flg, Rte_Write_Cmu_Cdd_CmuValue_CmuReCfgStatus_flg, Rte_Write_Cmu_Cdd_CmuValue_CtxOpenDiagStatus_flg, Rte_Write_Cmu_Cdd_CmuValue_GpioOTUTFuncDiagStatus_flg, Rte_Write_Cmu_Cdd_CmuValue_GpioxOpenDiagStatus_flg, Rte_Write_Cmu_Cdd_CmuValue_InCMUHWAlarmPWMDutyVld_flg, Rte_Write_Cmu_Cdd_CmuValue_InCMUHWAlarmPWMDuty_pct, Rte_Write_Cmu_Cdd_CmuValue_InCMUHWAlarmPWMFeqVld_flg, Rte_Write_Cmu_Cdd_CmuValue_InCMUHWAlarmPWMFeq_Hz, Rte_Write_IoHwAb_ChargeValue_CC2VoltVld_flg, Rte_Write_IoHwAb_ChargeValue_CC2Volt_V, Rte_Write_IoHwAb_ChargeValue_CCResVld_flg, Rte_Write_IoHwAb_ChargeValue_CCRes_ohm, Rte_Write_IoHwAb_ChargeValue_CPDutyVld_flg, Rte_Write_IoHwAb_ChargeValue_CPDuty_pct, Rte_Write_IoHwAb_ChargeValue_CPFrqVld_flg, Rte_Write_IoHwAb_ChargeValue_CPFrq_Hz, Rte_Write_IoHwAb_ChargeValue_CPVoltVld_flg, Rte_Write_IoHwAb_ChargeValue_CPVolt_V, Rte_Write_IoHwAb_ChargeValue_DCWakeupVoltVld_flg, Rte_Write_IoHwAb_ChargeValue_DCWakeupVolt_V, Rte_Write_IoHwAb_ChargeValue_ELockDiagVoltVld_flg, Rte_Write_IoHwAb_ChargeValue_ELockDiagVolt_V, Rte_Write_IoHwAb_ChargeValue_LampCcHDiagVoltVld_flg, Rte_Write_IoHwAb_ChargeValue_LampCcHDiagVolt_V, Rte_Write_IoHwAb_ChargeValue_LampChgHDiagVoltVld_flg, Rte_Write_IoHwAb_ChargeValue_LampChgHDiagVolt_V, Rte_Write_IoHwAb_CrashValue_CrashPWMDutyVld_flg, Rte_Write_IoHwAb_CrashValue_CrashPWMDuty_pct, Rte_Write_IoHwAb_CrashValue_CrashPWMFrqVld_flg, Rte_Write_IoHwAb_CrashValue_CrashPWMFrq_Hz, Rte_Write_IoHwAb_CurrValue_HallCH1RedVoltVld_flg, Rte_Write_IoHwAb_CurrValue_HallCH1RedVolt_V, Rte_Write_IoHwAb_CurrValue_HallCH1VoltVld_flg, Rte_Write_IoHwAb_CurrValue_HallCH1Volt_V, Rte_Write_IoHwAb_CurrValue_HallCH2RedVoltVld_flg, Rte_Write_IoHwAb_CurrValue_HallCH2RedVolt_V, Rte_Write_IoHwAb_CurrValue_HallCH2VoltVld_flg, Rte_Write_IoHwAb_CurrValue_HallCH2Volt_V, Rte_Write_IoHwAb_CurrValue_HallSpyVoltVld_flg, Rte_Write_IoHwAb_CurrValue_HallSpyVolt_V, Rte_Write_IoHwAb_CurrValue_PackCurrRedVld_flg, Rte_Write_IoHwAb_CurrValue_PackCurrRed_A, Rte_Write_IoHwAb_CurrValue_PackCurrVld_flg, Rte_Write_IoHwAb_CurrValue_PackCurr_A, Rte_Write_IoHwAb_HighVoltValue_P1CheckVoltVld_flg, Rte_Write_IoHwAb_HighVoltValue_P1CheckVolt_V, Rte_Write_IoHwAb_HighVoltValue_P2CheckVoltVld_flg, Rte_Write_IoHwAb_HighVoltValue_P2CheckVolt_V, Rte_Write_IoHwAb_HighVoltValue_P3CheckVoltVld_flg, Rte_Write_IoHwAb_HighVoltValue_P3CheckVolt_V, Rte_Write_IoHwAb_HighVoltValue_PackVoltVld_flg, Rte_Write_IoHwAb_HighVoltValue_PackVolt_V, Rte_Write_IoHwAb_HighVoltValue_PreChgCheckRedVoltVld_flg, Rte_Write_IoHwAb_HighVoltValue_PreChgCheckRedVolt_V, Rte_Write_IoHwAb_HighVoltValue_PreChgCheckVoltVld_flg, Rte_Write_IoHwAb_HighVoltValue_PreChgCheckVolt_V, Rte_Write_IoHwAb_HvilValue_HVILHighVoltVld_flg, Rte_Write_IoHwAb_HvilValue_HVILHighVolt_V, Rte_Write_IoHwAb_HvilValue_HVILLowVoltVld_flg, Rte_Write_IoHwAb_HvilValue_HVILLowVolt_V, Rte_Write_IoHwAb_HvilValue_InHVILPWMDutyVld_flg, Rte_Write_IoHwAb_HvilValue_InHVILPWMDuty_pct, Rte_Write_IoHwAb_HvilValue_InHVILPWMFrqVld_flg, Rte_Write_IoHwAb_HvilValue_InHVILPWMFrq_Hz, Rte_Write_IoHwAb_IsoValue_HVIsoNegVoltVld_flg, Rte_Write_IoHwAb_IsoValue_HVIsoNegVolt_V, Rte_Write_IoHwAb_IsoValue_HVIsoPosVoltVld_flg, Rte_Write_IoHwAb_IsoValue_HVIsoPosVolt_V, Rte_Write_IoHwAb_McuValue_BSWInitFinish_flg, Rte_Write_IoHwAb_PowerValue_BmuPullupSwitchDiag_flg, Rte_Write_IoHwAb_PowerValue_BmuPullupVoltVld_flg, Rte_Write_IoHwAb_PowerValue_BmuPullupVolt_V, Rte_Write_IoHwAb_PowerValue_KL15VoltVld_flg, Rte_Write_IoHwAb_PowerValue_KL15Volt_V, Rte_Write_IoHwAb_PowerValue_KL30VoltVld_flg, Rte_Write_IoHwAb_PowerValue_KL30Volt_V, Rte_Write_IoHwAb_PowerValue_KPowertVoltVld_flg, Rte_Write_IoHwAb_PowerValue_KPowertVolt_V, Rte_Write_IoHwAb_PowerValue_ResWakeUp1HVoltVld_flg, Rte_Write_IoHwAb_PowerValue_ResWakeUp1HVolt_V, Rte_Write_IoHwAb_PowerValue_ResWakeUp2HVoltVld_flg, Rte_Write_IoHwAb_PowerValue_ResWakeUp2HVolt_V, Rte_Write_IoHwAb_PowerValue_ResWakeUp3LVoltVld_flg, Rte_Write_IoHwAb_PowerValue_ResWakeUp3LVolt_V, Rte_Write_IoHwAb_RelayValue_GlobalHsideDiagVoltVld_flg, Rte_Write_IoHwAb_RelayValue_GlobalHsideDiagVolt_V, Rte_Write_IoHwAb_RelayValue_GlobalHsideDriverVoltVld_flg, Rte_Write_IoHwAb_RelayValue_GlobalHsideDriverVolt_V, Rte_Write_IoHwAb_RelayValue_K1CtrDriverVoltVld_flg, Rte_Write_IoHwAb_RelayValue_K1CtrDriverVolt_V, Rte_Write_IoHwAb_RelayValue_K2CtrDriverVoltVld_flg, Rte_Write_IoHwAb_RelayValue_K2CtrDriverVolt_V, Rte_Write_IoHwAb_RelayValue_K3CtrDriverVoltVld_flg, Rte_Write_IoHwAb_RelayValue_K3CtrDriverVolt_V, Rte_Write_IoHwAb_RelayValue_K4CtrDriverVoltVld_flg, Rte_Write_IoHwAb_RelayValue_K4CtrDriverVolt_V, Rte_Write_IoHwAb_RelayValue_K5CtrDriverVoltVld_flg, Rte_Write_IoHwAb_RelayValue_K5CtrDriverVolt_V, Rte_Write_IoHwAb_RelayValue_K6CtrDriverVoltVld_flg, Rte_Write_IoHwAb_RelayValue_K6CtrDriverVolt_V, Rte_Write_IoHwAb_RelayValue_KnCtrDriverVoltVld_flg, Rte_Write_IoHwAb_RelayValue_KnCtrDriverVolt_V, Rte_Write_IoHwAb_RelayValue_KnchgEnOutState_flg, Rte_Write_IoHwAb_RelayValue_KnchgEnStateVld_flg, Rte_Write_IoHwAb_RelayValue_KpCtrDriverVoltVld_flg, Rte_Write_IoHwAb_RelayValue_KpCtrDriverVolt_V, Rte_Write_IoHwAb_RelayValue_KpEnOutState_flg, Rte_Write_IoHwAb_RelayValue_KpEnStateVld_flg, Rte_Write_IoHwAb_RsvValue_InRsvPWMDutyVld_flg, Rte_Write_IoHwAb_RsvValue_InRsvPWMDuty_pct, Rte_Write_IoHwAb_RsvValue_InRsvPWMFrqVld_flg, Rte_Write_IoHwAb_RsvValue_InRsvPWMFrq_Hz, Rte_Write_IoHwAb_RsvValue_RsvAD1VoltVld_flg, Rte_Write_IoHwAb_RsvValue_RsvAD1Volt_V, Rte_Write_IoHwAb_RsvValue_RsvAD2VoltVld_flg, Rte_Write_IoHwAb_RsvValue_RsvAD2Volt_V, Rte_Write_IoHwAb_RsvValue_RsvAD3VoltVld_flg, Rte_Write_IoHwAb_RsvValue_RsvAD3Volt_V, Rte_Write_IoHwAb_RsvValue_RsvAD4VoltVld_flg, Rte_Write_IoHwAb_RsvValue_RsvAD4Volt_V, Rte_Write_IoHwAb_RsvValue_RsvAD5VoltVld_flg, Rte_Write_IoHwAb_RsvValue_RsvAD5Volt_V, Rte_Write_IoHwAb_SbcValue_BMULastPwrDownState, Rte_Write_IoHwAb_SbcValue_BmuSbcCanTRSt_flg, Rte_Write_IoHwAb_SbcValue_BmuSbcRstbPinSt_flg, Rte_Write_IoHwAb_SbcValue_BmuSbcVauxOV_flg, Rte_Write_IoHwAb_SbcValue_BmuSbcVauxUV_flg, Rte_Write_IoHwAb_SbcValue_BmuSbcVcanOV_flg, Rte_Write_IoHwAb_SbcValue_BmuSbcVcanUV_flg, Rte_Write_IoHwAb_SbcValue_BmuSbcVccaOV_flg, Rte_Write_IoHwAb_SbcValue_BmuSbcVccaUV_flg, Rte_Write_IoHwAb_SbcValue_BmuSbcVcoreOV_flg, Rte_Write_IoHwAb_SbcValue_BmuSbcVpreOV_flg, Rte_Write_IoHwAb_SbcValue_BmuSbcVpreUV_flg, Rte_Write_IoHwAb_SbcValue_BmuSbxVcoreUV_flg, Rte_Write_IoHwAb_SbcValue_CANWakeupState_flg, Rte_Write_IoHwAb_SbcValue_KL15WakeupState_flg, Rte_Write_IoHwAb_SbcValue_RTCWakeupState_flg, Rte_Write_IoHwAb_SbcValue_SBCWakeupP1State_flg, Rte_Write_IoHwAb_SbcValue_SBCWakeupP2State_flg, Rte_Write_IoHwAb_SbcValue_SBCWakeupP3State_flg, Rte_Write_IoHwAb_ThermalValue_BmuTemp1NtcVld_flg, Rte_Write_IoHwAb_ThermalValue_BmuTemp1Ntc_Ohm, Rte_Write_IoHwAb_ThermalValue_BmuTemp2NtcVld_flg, Rte_Write_IoHwAb_ThermalValue_BmuTemp2Ntc_Ohm, Rte_Write_IoHwAb_ThermalValue_BmuTemp3NtcVld_flg, Rte_Write_IoHwAb_ThermalValue_BmuTemp3Ntc_Ohm, Rte_Write_IoHwAb_ThermalValue_BmuTemp4NtcVld_flg, Rte_Write_IoHwAb_ThermalValue_BmuTemp4Ntc_Ohm, Rte_Write_IoHwAb_ThermalValue_BmuTemp5NtcVld_flg, Rte_Write_IoHwAb_ThermalValue_BmuTemp5Ntc_Ohm, Rte_Write_IoHwAb_ThermalValue_BmuTemp6NtcVld_flg, Rte_Write_IoHwAb_ThermalValue_BmuTemp6Ntc_Ohm, Rte_Write_IoHwAb_ThermalValue_BmuTemp7NtcVld_flg, Rte_Write_IoHwAb_ThermalValue_BmuTemp7Ntc_Ohm, Rte_Write_IoHwAb_ThermalValue_InCoolPumpPWMDutyVld_flg, Rte_Write_IoHwAb_ThermalValue_InCoolPumpPWMDuty_Pct, Rte_Write_IoHwAb_ThermalValue_InCoolPumpPWMFrqVld_flg, Rte_Write_IoHwAb_ThermalValue_InCoolPumpPWMFrq_Hz, Rte_Write_IoHwAb_ThermalValue_InFanPWMDutyVld_flg, Rte_Write_IoHwAb_ThermalValue_InFanPWMDuty_Pct, Rte_Write_IoHwAb_ThermalValue_InFanPWMFrqVld_flg, Rte_Write_IoHwAb_ThermalValue_InFanPWMFrq_Hz, Rte_Write_IoHwAb_ThermalValue_ValveDiagVoltVld_flg, Rte_Write_IoHwAb_ThermalValue_ValveDiagVolt_V, Rte_Write_Sbc_Cdd_SbcValue_BMULastPwrDownState, Rte_Write_Sbc_Cdd_SbcValue_BmuSbcCanTRSt_flg, Rte_Write_Sbc_Cdd_SbcValue_BmuSbcRstbPinSt_flg, Rte_Write_Sbc_Cdd_SbcValue_BmuSbcVauxOV_flg, Rte_Write_Sbc_Cdd_SbcValue_BmuSbcVauxUV_flg, Rte_Write_Sbc_Cdd_SbcValue_BmuSbcVcanOV_flg, Rte_Write_Sbc_Cdd_SbcValue_BmuSbcVcanUV_flg, Rte_Write_Sbc_Cdd_SbcValue_BmuSbcVccaOV_flg, Rte_Write_Sbc_Cdd_SbcValue_BmuSbcVccaUV_flg, Rte_Write_Sbc_Cdd_SbcValue_BmuSbcVcoreOV_flg, Rte_Write_Sbc_Cdd_SbcValue_BmuSbcVpreOV_flg, Rte_Write_Sbc_Cdd_SbcValue_BmuSbcVpreUV_flg, Rte_Write_Sbc_Cdd_SbcValue_BmuSbxVcoreUV_flg, Rte_Write_Sbc_Cdd_SbcValue_CANWakeupState_flg, Rte_Write_Sbc_Cdd_SbcValue_KL15WakeupState_flg, Rte_Write_Sbc_Cdd_SbcValue_RTCWakeupState_flg, Rte_Write_Sbc_Cdd_SbcValue_SBCWakeupP1State_flg, Rte_Write_Sbc_Cdd_SbcValue_SBCWakeupP2State_flg, Rte_Write_Sbc_Cdd_SbcValue_SBCWakeupP3State_flg, Rte_memcpy, SchM_Deinit, SchM_IModeInit, SchM_Init, SchM_Mode_BswM_MDGR_BswM_MRP_BswM_MDG, SchM_Mode_WdgM_Current_WdgMSupervisionCycle, SchM_Switch_BswM_MDGP_AUTOSAR_BswM_ModeDeclarationGroups_MDG_ECUM_STATE], sw-addrmethod=CODE
        CONST_BOOLEAN: alignment=BOOLEAN, sw-addrmethod=CONST
        CONST_UNSPECIFIED: alignment=UNSPECIFIED, sw-addrmethod=CONST
        VAR_CLEARED_16: alignment=16, sw-addrmethod=VAR_CLEARED
        VAR_CLEARED_32: alignment=32, sw-addrmethod=VAR_CLEARED
        VAR_CLEARED_8: alignment=8, sw-addrmethod=VAR_CLEARED
        VAR_CLEARED_BOOLEAN: alignment=BOOLEAN, sw-addrmethod=VAR_CLEARED
        VAR_INIT_8: alignment=8, sw-addrmethod=VAR_INIT
package /AUTOSAR_Rte/CompuMethods
  compu method Methods_boolean: 0=FALSE, 1=TRUE
package /AUTOSAR_Rte/DataConstrs
  range DataConstraints_DataConstr_uint8: phys 0..255, raw 0..255
  range DataConstraints_DataConstr_uint32: phys 0..4294967295, raw 0..4294967295
  range DataConstraints_DataConstr_uint16: phys 0..65535, raw 0..65535
  range DataConstraints_DataConstr_boolean: phys 0..1, raw 0..1
package /AUTOSAR_Rte/ImplementationDataTypes
  33 x impl type:
    Rte_REActCounterType: category=VALUE  # This is an external type, i.e. it is declared in the Rte Library and not in the XML. RTEGen does not have any information about this type apart from its name.
    Rte_CDS_Asw_Swc: category=STRUCTURE
      element Rte_Dummy: implementation-data-type=uint8
    Rte_CDS_BswM: category=STRUCTURE
      element Rte_Dummy: implementation-data-type=uint8
    Rte_CDS_Cmu_Cdd: category=STRUCTURE
      element Rte_Dummy: implementation-data-type=uint8
    Rte_SwitchFP_ComM_ComM_CurrentMode_currentMode: category=FUNCTION_REFERENCE
    Rte_PDS_ComM_ComM_CurrentMode_P: category=STRUCTURE
      element Switch_currentMode: implementation-data-type=Rte_SwitchFP_ComM_ComM_CurrentMode_currentMode
    Rte_PDS_ComM_ComM_CurrentMode_PA: category=ARRAY
      element Rte_PDS_ComM_ComM_CurrentMode_PAElement: array-size=1, array-size-semantics=FIXED-SIZE, implementation-data-type=Rte_PDS_ComM_ComM_CurrentMode_P
    Rte_CDS_ComM: category=STRUCTURE
      element UM_ComMUser_Can_Network_0_Channel: implementation-data-type=Rte_PDS_ComM_ComM_CurrentMode_PA
    Rte_CDS_Det: category=STRUCTURE
      element Rte_Dummy: implementation-data-type=uint8
    Rte_CDS_EcuM: category=STRUCTURE
      element Rte_Dummy: implementation-data-type=uint8
    Rte_CDS_IoHwAb: category=STRUCTURE
      element Rte_Dummy: implementation-data-type=uint8
    Rte_CDS_NvM: category=STRUCTURE
      element Rte_Dummy: implementation-data-type=uint8
    Rte_CDS_Sbc_Cdd: category=STRUCTURE
      element Rte_Dummy: implementation-data-type=uint8
    Rte_SwitchAckFP_WdgM_WdgM_IndividualMode_currentMode: category=FUNCTION_REFERENCE
    Rte_SwitchFP_WdgM_WdgM_IndividualMode_currentMode: category=FUNCTION_REFERENCE
    Rte_PDS_WdgM_WdgM_IndividualMode_P: category=STRUCTURE
      element SwitchAck_currentMode: implementation-data-type=Rte_SwitchAckFP_WdgM_WdgM_IndividualMode_currentMode
      element Switch_currentMode: implementation-data-type=Rte_SwitchFP_WdgM_WdgM_IndividualMode_currentMode
    Rte_PDS_WdgM_WdgM_IndividualMode_PA: category=ARRAY
      element Rte_PDS_WdgM_WdgM_IndividualMode_PAElement: array-size=7, array-size-semantics=FIXED-SIZE, implementation-data-type=Rte_PDS_WdgM_WdgM_IndividualMode_P
    Rte_CDS_WdgM: category=STRUCTURE
      element mode_WdgMAliveSupervisedEntity_Asw_5ms: implementation-data-type=Rte_PDS_WdgM_WdgM_IndividualMode_PA
    Rte_CDS_WdgM_SWC: category=STRUCTURE
      element Rte_Dummy: implementation-data-type=uint8
    Rte_CDS_Xcp_SWC: category=STRUCTURE
      element Rte_Dummy: implementation-data-type=uint8
    Rte_SelfType_Asw_Swc: implementation-data-type=Rte_CDS_Asw_Swc
    Rte_SelfType_BswM: implementation-data-type=Rte_CDS_BswM
    Rte_SelfType_Cmu_Cdd: implementation-data-type=Rte_CDS_Cmu_Cdd
    Rte_SelfType_ComM: implementation-data-type=Rte_CDS_ComM
    Rte_SelfType_Det: implementation-data-type=Rte_CDS_Det
    Rte_SelfType_EcuM: implementation-data-type=Rte_CDS_EcuM
    Rte_SelfType_IoHwAb: implementation-data-type=Rte_CDS_IoHwAb
    Rte_SelfType_NvM: implementation-data-type=Rte_CDS_NvM
    Rte_SelfType_Sbc_Cdd: implementation-data-type=Rte_CDS_Sbc_Cdd
    Rte_SelfType_WdgM: implementation-data-type=Rte_CDS_WdgM
    Rte_SelfType_WdgM_SWC: implementation-data-type=Rte_CDS_WdgM_SWC
    Rte_SelfType_Xcp_SWC: implementation-data-type=Rte_CDS_Xcp_SWC
    Rte_TaskInfo: category=VALUE  # This is an external type, i.e. it is declared in the Rte Library and not in the XML. RTEGen does not have any information about this type apart from its name.
package /AUTOSAR_Rte/SwAddrMethods
  4 x sw addr method:
    CODE: memory-allocation-keyword-policy=ADDR-METHOD-SHORT-NAME, section-type=CODE
    CONST: memory-allocation-keyword-policy=ADDR-METHOD-SHORT-NAME-AND-ALIGNMENT, section-type=CONST
    VAR_CLEARED: memory-allocation-keyword-policy=ADDR-METHOD-SHORT-NAME-AND-ALIGNMENT, section-initialization-policy=CLEARED, section-type=VAR
    VAR_INIT: memory-allocation-keyword-policy=ADDR-METHOD-SHORT-NAME-AND-ALIGNMENT, section-initialization-policy=INIT, section-type=VAR
