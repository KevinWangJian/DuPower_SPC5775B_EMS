AUTOSAR XML (schema 4-2-2)
package /Os_SWC
  application sw component type Os_SWC
    behavior IB_Os_SWC
      4 x timing event:
        TE_ASW_OsTask_1ms: start-on-event=RE_ASW_OsTask_1ms, period=0.001
        TE_ASW_OsTask_2ms: start-on-event=RE_ASW_OsTask_2ms, period=0.002
        TE_ASW_OsTask_5ms: start-on-event=RE_ASW_OsTask_5ms, period=0.005
        TE_ASW_OsTask_10ms: start-on-event=RE_ASW_OsTask_10ms, period=0.01
      4 x runnable:
        RE_ASW_OsTask_1ms
        RE_ASW_OsTask_2ms
        RE_ASW_OsTask_5ms
        RE_ASW_OsTask_10ms
