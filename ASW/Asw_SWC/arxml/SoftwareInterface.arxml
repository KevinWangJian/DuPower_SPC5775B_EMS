AUTOSAR XML (schema 4-2-2)
package /SoftwareInterface/Interfaces
  15 x sender receiver interface:
    PowerValue
      data KL30Volt_V: compu {phys=raw*0.1 for raw 0..250; unit V}, implementation-data-type=uint8, type=uint8
      data KL30VoltVld_flg: type=boolean
    FanCmd
      data OutFanPWMFrq_Hz: compu {phys=raw*0.1 for raw 0..50000}, implementation-data-type=uint16, type=uint16
      data OutFanDuty_pct: compu {phys=raw*0.1 for raw 0..1000}, implementation-data-type=uint16, type=uint16
    SbcValue
      data KL15WakeupState_flg: type=boolean
      data BMULastPwrDownState: compu {1=PowerOnReset (CompuScale), 2=Sleep (CompuScale_0), 3=Watchdog (CompuScale_1), 4=KL30LowVoltage (CompuScale_2)}, implementation-data-type=uint8, type=uint8
    RelayCmd
      data GlobalHCtrCmd_flg: type=boolean
      data PosCtrCmd_flg: type=boolean
    RelayValue
      data GlobalHCtrState_flg: type=boolean
      data PosCtrCmdState_flg: type=boolean
    CMUCmd
      data CellBalCmd_flg: type=CellFlgArrayType
    CMUValue
      14 x data:
        CellBalState_flg: type=CellFlgArrayType
        CellTemp1_C: compu {phys=raw-40 for raw 0..165}, implementation-data-type=uint8, type=uint8
        CellTemp1Vld_flg: type=boolean
        CellTemp2_C: implementation-data-type=uint8, type=uint8
        CellTemp2Vld_flg: type=boolean
        CMUPCBTemp1_C: compu {phys=raw-40 for raw 0..165}, implementation-data-type=uint8, type=uint8
        CMUPCBTemp1Vld_flg: type=boolean
        CMUPCBTemp2_C: compu {phys=raw-40 for raw 0..165}, implementation-data-type=uint8, type=uint8
        CMUPCBTemp2Vld_flg: type=boolean
        CellVolt_mV: category=ARRAY, type=CellVoltArrayType
        CellVoltVld_flg: type=CellFlgArrayType
        CellComErr_flg: type=boolean
        CellOpenErr_flg: type=CellFlgArrayType
        CellMeasCmd_flg: type=boolean
    HVValue
      6 x data:
        VoltA_V: type=uint16
        VoltAVld_flg: type=boolean
        VoltB_V: type=uint16
        VoltBVld_flg: type=boolean
        VoltC_V: type=uint16
        VoltCVld_flg: type=boolean
    HighVoltCmd
      data PackVoltMeasCmd_flg: type=boolean
    SYSCmd
      data RadyToSleep_flg: type=boolean
    SYSValue
      data BSWRequestReset_flg: type=boolean
    FblCmd
      data FBLForbid_flg: type=boolean
    McuValue
      data BSWInitFinish_flg: type=boolean
    CurrValue
      data PackCurr_A: compu {phys=raw for raw -500000..500000}, implementation-data-type=sint32, type=sint32
      data PackCurrVld_flg: type=boolean
    FanValue
      data FeedbackVolt_V: compu {phys=raw*0.1 for raw 0..250}, implementation-data-type=uint8, type=uint8
  20 x sender receiver interface:
    CANValue
      data VehCANBusoff_flg: type=boolean
    CANCmd
      data SetAppCanRecovery_flg: type=boolean
    BMS_630h
      4 x data:
        BMS_630h_Rx_Data_Buff
        BMS_630h_Rx_Succ_flg: type=boolean
        BMS_630h_Rx_ID_Invalid_flg: type=boolean
        BMS_630h_Rx_Timeout_flg: type=boolean
    BMS_632h
      4 x data:
        BMS_632h_Rx_Data_Buff
        BMS_632h_Rx_Succ_flg: type=boolean
        BMS_632h_Rx_ID_Invalid_flg: type=boolean
        BMS_632h_Rx_Timeout_flg: type=boolean
    BMS_631h
      5 x data:
        BMS_631h_Tx_Active_flg: type=boolean
        BMS_631h_Tx_Data_Buff
        BMS_631h_Tx_Data_Length
        BMS_631h_Tx_Succ_flg: type=boolean
        BMS_631h_Tx_ID_Invalid_flg: type=boolean
    BMS_633h
      5 x data:
        BMS_633h_Tx_Active_flg: type=boolean
        BMS_633h_Tx_Data_Buff
        BMS_633h_Tx_Data_Length
        BMS_633h_Tx_Succ_flg: type=boolean
        BMS_633h_Tx_ID_Invalid_flg: type=boolean
    BMSL_1E1h
    BMSL_1F{3..5}h
    BMSL_1E4h
    BMSL_1F6h
    BMSL_2E1h
    BMSL_3F3h
    BMSL_3F4h
    BMSL_1F7h
    BMSL_3F5h
    BMSL_1F8h
    BMSL_1EAh
    BMSL_3FAh
package /SoftwareInterface/CompuMethods
  compu method CM_HVVoltB_V: phys=raw for raw 0..65535
package /SoftwareInterface/DataTypes
  impl type CellVoltArrayType: category=ARRAY
    element element: array-size=14, compu {phys=raw for raw 0..5000}, implementation-data-type=uint16
  impl type CellFlgArrayType: category=ARRAY
    element element: array-size=14, array-size-semantics=FIXED-SIZE, implementation-data-type=boolean
  impl type NVDataBlockArrayType: category=ARRAY
    element element: array-size=2048, array-size-semantics=FIXED-SIZE, implementation-data-type=uint8
