AUTOSAR XML (schema 4-2-2)
package /Xcp_SWC
  application sw component type Xcp_SWC
    behavior IB_Xcp_SWC
      timing event TE_Xcp_SWC_10ms: start-on-event=RE_Xcp_SWC_10ms, period=0.01
      runnable RE_Xcp_SWC_10ms
